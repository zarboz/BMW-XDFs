ASAP2_VERSION 1 3
/begin PROJECT _7211165 "195"
/begin HEADER "" VERSION "_7211165" PROJECT_NO _7211165 /end HEADER
/begin MODULE DIM ""
/begin MOD_COMMON "" BYTE_ORDER MSB_LAST ALIGNMENT_BYTE 1 ALIGNMENT_WORD 2 ALIGNMENT_LONG 2 /end MOD_COMMON
/begin CHARACTERISTIC ACCALIVE_A_DAT_UC "" VAL_BLK 0x812002 KwbUb 255.0 dez 0.00 255.0 FORMAT "%5.1" NUMBER 16 /end CHARACTERISTIC
/begin CHARACTERISTIC ACCALIVE_DAT_UC "" VAL_BLK 0x812012 KwbUb 255.0 dez 0.00 255.0 FORMAT "%5.1" NUMBER 16 /end CHARACTERISTIC
/begin CHARACTERISTIC ACCA_T_UC "" VALUE 0x8122A2 KwUb 10200.0 t40ms_ub_b10200 0.00 10200.0 FORMAT "%7.1" /end CHARACTERISTIC
/begin CHARACTERISTIC ACCA_T_UM "Entprellung bei ACC-Zähler-Fehler" VALUE 0x817AD1 KwUb 10200.0 t40ms_ub_b10200 0.00 10200.0 FORMAT "%7.1" /end CHARACTERISTIC
/begin CHARACTERISTIC ACCBIT_DAT_UC "" VAL_BLK 0x812022 KwbUb 255.0 dez 0.00 255.0 FORMAT "%5.1" NUMBER 16 /end CHARACTERISTIC
/begin CHARACTERISTIC ACCC_T_UC "" VALUE 0x8122A3 KwUb 10200.0 t40ms_ub_b10200 0.00 10200.0 FORMAT "%7.1" /end CHARACTERISTIC
/begin CHARACTERISTIC ACCC_T_UM "Fehlerzeit für ACC-Eingriff-Überwachnung der Funktionsüberwachung" VALUE 0x817AD2 KwUb 10200.0 t40ms_ub_b10200 0.00 10200.0 FORMAT "%7.1" /end CHARACTERISTIC
/begin CHARACTERISTIC ACCSTAT_DAT_UC "" VAL_BLK 0x812032 KwbUb 255.0 dez 0.00 255.0 FORMAT "%5.1" NUMBER 16 /end CHARACTERISTIC
/begin CHARACTERISTIC ADCC_T_UM "Fehlerzeit bei zueinander unplausiblen ADC-Werten für sp1s" VALUE 0x817C6B KwUb 2.550 t10msxs_ub_b2p55 0.00 2.550 FORMAT "%5.3" /end CHARACTERISTIC
/begin CHARACTERISTIC ANWFLMX "Anzahl der NW-Flanken je NW-Umdrehung" VALUE 0x81009E KwUb 255.0 dez 0.00 255.0 FORMAT "%5.1" /end CHARACTERISTIC
/begin CHARACTERISTIC ANWFOZA "Anzahl NW-Umdr. für Zündausblendung bei fuel-off Adaption" VALUE 0x812872 KwUb 255.0 dez 0.00 255.0 FORMAT "%5.1" /end CHARACTERISTIC
/begin CHARACTERISTIC ANWWSS "Toleranzschwelle f. Adaption Halte-TV" VALUE 0x810022 KwSb 255. dez_sb -128. 127. FORMAT "%4.0" /end CHARACTERISTIC
/begin CHARACTERISTIC ASCALIVE_A_DAT_UC "" VAL_BLK 0x812042 KwbUb 255.0 dez 0.00 255.0 FORMAT "%5.1" NUMBER 16 /end CHARACTERISTIC
/begin CHARACTERISTIC ASCALIVE_DAT_UC "" VAL_BLK 0x812052 KwbUb 255.0 dez 0.00 255.0 FORMAT "%5.1" NUMBER 16 /end CHARACTERISTIC
/begin CHARACTERISTIC ASRL_DAT_UC "" VAL_BLK 0x812062 KwbUb 99.61 rel_ub_q0p3906 0.00 99.61 FORMAT "%5.2" NUMBER 16 /end CHARACTERISTIC
/begin CHARACTERISTIC ASRS_DAT_UC "" VAL_BLK 0x812072 KwbUb 99.61 rel_ub_q0p3906 0.00 99.61 FORMAT "%5.2" NUMBER 16 /end CHARACTERISTIC
/begin CHARACTERISTIC AUSGH_T_UM "Heilungszeit für Fehler in der zyklischen RAM-Prüfung der Funktionsüberwachung" VALUE 0x817C6F KwUb 10200.0 t40ms_ub_b10200 0.00 10200.0 FORMAT "%7.1" /end CHARACTERISTIC
/begin CHARACTERISTIC AUSG_T_UM "Fehlertoleranzschwelle für zyklische RAM-Prüfung in der Funktionsüberwachung" VALUE 0x817C70 KwUb 255.0 dezsub1 1.000 256.0 FORMAT "%5.1" /end CHARACTERISTIC
/begin CHARACTERISTIC AUSZH_T_UM "Heilungszeit für Fehler in der zyklischen ROM-Prüfung der Funktionsüberwachung" VALUE 0x817C71 KwUb 10200.0 t40ms_ub_b10200 0.00 10200.0 FORMAT "%7.1" /end CHARACTERISTIC
/begin CHARACTERISTIC AUSZ_T_UM "Fehlertoleranzschwelle für zyklische ROM-Prüfung in der Funktionsüberwachung" VALUE 0x817C72 KwUb 255.0 dezsub1 1.000 256.0 FORMAT "%5.1" /end CHARACTERISTIC
/begin CHARACTERISTIC BACC_DAT_UC "" VAL_BLK 0x812082 KwbUb 255.0 dez 0.00 255.0 FORMAT "%5.1" NUMBER 16 /end CHARACTERISTIC
/begin CHARACTERISTIC BFGR_DAT_UC "" VAL_BLK 0x812092 KwbUb 255.0 dez 0.00 255.0 FORMAT "%5.1" NUMBER 16 /end CHARACTERISTIC
/begin CHARACTERISTIC BNOMSR_DAT_UC "" VAL_BLK 0x8120A2 KwbUb 255.0 dez 0.00 255.0 FORMAT "%5.1" NUMBER 16 /end CHARACTERISTIC
/begin CHARACTERISTIC BREACC_DAT_UC "" VAL_BLK 0x8120B2 KwbUb 255.0 dez 0.00 255.0 FORMAT "%5.1" NUMBER 16 /end CHARACTERISTIC
/begin CHARACTERISTIC BREMS_T_UM "Entprellzeit für betätigte Bremse in der Funktionsüberwachung" VALUE 0x817A64 KwUb 10200.0 t40ms_ub_b10200 0.00 10200.0 FORMAT "%7.1" /end CHARACTERISTIC
/begin CHARACTERISTIC BZ_MSR_M "MSR-Botschaftszähler-Maske (0Fh für 4-Bit-Botschaftszähler)" VALUE 0x817AD3 KwUb 255.0 dez 0.00 255.0 FORMAT "%5.1" /end CHARACTERISTIC
/begin CHARACTERISTIC BZ_MSR_UC "" VALUE 0x8122A4 KwUb 255.0 dez 0.00 255.0 FORMAT "%5.1" /end CHARACTERISTIC
/begin CHARACTERISTIC CBIT_DAT_UC "" VAL_BLK 0x8120C2 KwbUb 255.0 dez 0.00 255.0 FORMAT "%5.1" NUMBER 16 /end CHARACTERISTIC
/begin CHARACTERISTIC CMSR_DAT_UC "" VAL_BLK 0x8120D2 KwbUb 99.61 rel_ub_q0p3906 0.00 99.61 FORMAT "%5.2" NUMBER 16 /end CHARACTERISTIC
/begin CHARACTERISTIC CODEINDEX "" ASCII 0x81FC98 KwbUb 255.0 KennText 0.00 255.0 FORMAT "%5.1" NUMBER 2 /end CHARACTERISTIC
/begin CHARACTERISTIC CWDVMX "Codewort SW-Schalter für Integratorinit. bei VMAX-Regelung" VALUE 0x81A6A7 KwUb 255.0 dez 0.00 255.0 FORMAT "%5.1" /end CHARACTERISTIC
/begin CHARACTERISTIC CWNOMSRU "Codewort MSR-Überwachung nicht aktiv" VALUE 0x817AD4 KwUb 255.0 dez 0.00 255.0 FORMAT "%5.1" /end CHARACTERISTIC
/begin CHARACTERISTIC CWNOMSRU_UC "" VALUE 0x8122A5 KwUb 255.0 dez 0.00 255.0 FORMAT "%5.1" /end CHARACTERISTIC
/begin CHARACTERISTIC CWVSV "Codewort für Deaktivierung VS_VERST (CWVSV = 0: VS_VERST nicht aktiv)" VALUE 0x810005 KwUb 255.0 dez 0.00 255.0 FORMAT "%5.1" /end CHARACTERISTIC
/begin CHARACTERISTIC CW_NOROMCHKRESET "" VALUE 0x81014F KwUb 255.0 dez 0.00 255.0 FORMAT "%5.1" /end CHARACTERISTIC
/begin CHARACTERISTIC DFTEAHB "Schwelle Gemischanteil Tankentlüftung zum Setzen Bit ""Hohe Beladung""" VALUE 0x8195AA KwSb 1.992 fak_sb_b1 -1.000 0.9922 FORMAT "%5.3" /end CHARACTERISTIC
/begin CHARACTERISTIC DIAGINDEX "" ASCII 0x81FC9A KwbUb 255.0 KennText 0.00 255.0 FORMAT "%5.1" NUMBER 2 /end CHARACTERISTIC
/begin CHARACTERISTIC DIF_DAT "Datenreferenz: Prüflabel" ASCII 0x81FC66 KwbUb 255.0 KennText 0.00 255.0 FORMAT "%5.1" NUMBER 48 /end CHARACTERISTIC
/begin CHARACTERISTIC DMSTES "Kennlinie maximale Zunahme Massenstrom Tankentlüftung" CURVE 0x813E12 KlAUwSstUwWUw 6553.600 m_uw_q3p2 0.00 6553.600 FORMAT "%8.3"
 /begin AXIS_DESCR STD_AXIS mstesoll_w m_uw_b25p6 6 0.00 25.59961 FORMAT "%8.5" DEPOSIT ABSOLUTE /end AXIS_DESCR
/end CHARACTERISTIC
/begin CHARACTERISTIC DSTEMIN "Minimalwert für Weitertransport in Totzeitglied Gemischtransport" VALUE 0x814280 KwUw 0.9999695 fak_uw_b2 0.00 0.9999695 FORMAT "%9.7" /end CHARACTERISTIC
/begin CHARACTERISTIC DTIABS "Dti-Schwellwert für ersten Nachspritzer" VALUE 0x814000 DI__Kwuw__________ 209.7120 TEQL 0.00 209.7120 FORMAT "%8.4" /end CHARACTERISTIC
/begin CHARACTERISTIC DTIREL "Dti-Schwellwert für zweiten Nachspritzer" VALUE 0x814002 DI__Kwub__________ 99.61 PCENT 0.00 99.61 FORMAT "%5.2" /end CHARACTERISTIC
/begin CHARACTERISTIC DUETMOT "Delta Motorübertemperatur-Schwelle" VALUE 0x811DAF KwUb 191.3 temp_ub_b191p25 0.00 191.3 FORMAT "%5.1" /end CHARACTERISTIC
/begin CHARACTERISTIC DWNWEB "WNW-Schwelle für fnwue-Umschaltung" VALUE 0x812481 KwUb 63.7500 wkw_ub_q0p25 0.00 63.7500 FORMAT "%7.4" /end CHARACTERISTIC
/begin CHARACTERISTIC DZWSPM "Delta spätester Zündwinkel abhängig von Motortemperatur" CURVE 0x819720 GklWSb 191.3 zw_sb_q0p75 -96.00 95.25 FORMAT "%5.2"
 /begin AXIS_DESCR COM_AXIS tmot temp_ub_q0p75_o48 6 -48.00 143.3 AXIS_PTS_REF STM06__UB /end AXIS_DESCR
/end CHARACTERISTIC
/begin CHARACTERISTIC DZWSTTA "Delta Zündwinkel im Start" CURVE 0x81BEE0 KlAUbSstUbWSb 191.3 zw_sb_q0p75 -96.00 95.25 FORMAT "%5.2"
 /begin AXIS_DESCR STD_AXIS tans temp_ub_q0p75_o48 6 -48.00 143.3 FORMAT "%5.1" DEPOSIT ABSOLUTE /end AXIS_DESCR
/end CHARACTERISTIC
/begin CHARACTERISTIC EVZ_DAT_UC "" VAL_BLK 0x8120E2 KwbUb 255.0 dez 0.00 255.0 FORMAT "%5.1" NUMBER 16 /end CHARACTERISTIC
/begin CHARACTERISTIC FBTEB "Faktor Begrenzung Lerngeschwindigkeit für Beladung" CURVE 0x8195AB KlAUbSstUbWUb 0.9961 fak_ub_b1 0.00 0.9961
 /begin AXIS_DESCR STD_AXIS ftefvab fak_ub_b0p03125 6 0.00 0.03113 FORMAT "%7.5" DEPOSIT ABSOLUTE /end AXIS_DESCR
/end CHARACTERISTIC
/begin CHARACTERISTIC FBTEVA "Faktor ftefva-abhängige Lerngeschwindigkeit der Beladung" CURVE 0x8195B8 KlAUbSstUbWUb 0.9961 fak_ub_b1 0.00 0.9961 /begin AXIS_DESCR STD_AXIS ftefva fak_ub_b0p5 6 0.00 0.4980 DEPOSIT ABSOLUTE /end AXIS_DESCR /end CHARACTERISTIC
/begin CHARACTERISTIC FETATEBN "Kennlinie für drehzahlabhängigen Sollwert des Motorwirkungsgrades" CURVE 0x8195C5 KlAUbSstUbWUb 0.9961 fak_ub_b1 0.00 0.9961
 /begin AXIS_DESCR STD_AXIS nmot nmot_ub_q40 5 0.00 10200. FORMAT "%5.0" DEPOSIT ABSOLUTE /end AXIS_DESCR
/end CHARACTERISTIC
/begin CHARACTERISTIC FGKTE0 "Einzelzylinder Korrekturfaktor für EV 1 (Zündfolge)" VALUE 0x814D29 DI__Kwub__________ 0.4980 FAKTCIFI 0.7500 1.248 FORMAT "%5.3" /end CHARACTERISTIC
/begin CHARACTERISTIC FGKTE1 "Einzelzylinder Korrekturfaktor für EV 2 (Zündfolge)" VALUE 0x814D2A DI__Kwub__________ 0.4980 FAKTCIFI 0.7500 1.248 FORMAT "%5.3" /end CHARACTERISTIC
/begin CHARACTERISTIC FGKTE2 "Einzelzylinder Korrekturfaktor für EV 3 (Zündfolge)" VALUE 0x814D2B DI__Kwub__________ 0.4980 FAKTCIFI 0.7500 1.248 FORMAT "%5.3" /end CHARACTERISTIC
/begin CHARACTERISTIC FGKTE3 "Einzelzylinder Korrekturfaktor für EV 4 (Zündfolge)" VALUE 0x814D2C DI__Kwub__________ 0.4980 FAKTCIFI 0.7500 1.248 FORMAT "%5.3" /end CHARACTERISTIC
/begin CHARACTERISTIC FGKTE4 "Einzelzylinder Korrekturfaktor für EV 5 (Zündfolge)" VALUE 0x814D2D DI__Kwub__________ 0.4980 FAKTCIFI 0.7500 1.248 FORMAT "%5.3" /end CHARACTERISTIC
/begin CHARACTERISTIC FGKTE5 "Einzelzylinder Korrekturfaktor für EV 6 (Zündfolge)" VALUE 0x814D2E DI__Kwub__________ 0.4980 FAKTCIFI 0.7500 1.248 FORMAT "%5.3" /end CHARACTERISTIC
/begin CHARACTERISTIC FGKTE6 "Einzelzylinder Korrekturfaktor für EV 7 (Zündfolge)" VALUE 0x814D2F DI__Kwub__________ 0.4980 FAKTCIFI 0.7500 1.248 FORMAT "%5.3" /end CHARACTERISTIC
/begin CHARACTERISTIC FGKTE7 "Einzelzylinder Korrekturfaktor für EV 8 (Zündfolge)" VALUE 0x814D30 DI__Kwub__________ 0.4980 FAKTCIFI 0.7500 1.248 FORMAT "%5.3" /end CHARACTERISTIC
/begin CHARACTERISTIC FKATEB "Kennlinie Kraftstoffanteil Tankentlüftung abh. von te / TEMIN" CURVE 0x81AB76 KlAUbSstUbWUb 0.9961 fak_ub_b1 0.00 0.9961
 /begin AXIS_DESCR STD_AXIS qtetemin fak_ub_b4 5 0.00 3.984 FORMAT "%5.3" DEPOSIT ABSOLUTE /end AXIS_DESCR
/end CHARACTERISTIC
/begin CHARACTERISTIC FLNWVAD "Verhältnis zur Freigabe der Adaption der NW-Verstellgeschwindigkeit" VALUE 0x8190B9 KwUb 99.61 rel_ub_b99p6 0.00 99.61 FORMAT "%5.2" /end CHARACTERISTIC
/begin CHARACTERISTIC FNWADS "Faktor zur Adaption des NW-Spätanschlages" VALUE 0x81009F KwUb 0.9961 fak_ub_b1 0.00 0.9961 /end CHARACTERISTIC
/begin CHARACTERISTIC FNWTAP "Verh. NW-Tastverh.-Änderung zu Regelfehler" VALUE 0x81424C KwSw 99.9985 vhtvw_sw_b50 -50.0000 49.9985 FORMAT "%7.4" /end CHARACTERISTIC
/begin CHARACTERISTIC FNWVAD "Verh. Adaption NW-Verstellgeschw. zu Winkelabweichung" VALUE 0x810023 KwUb 7.78 umf_ub_b7p78 0.00 7.78 FORMAT "%4.2" /end CHARACTERISTIC
/begin CHARACTERISTIC FNWVTA "Verh. NW-Verstellgeschw. zu prop. Tastverh. im Neutralbereich" VALUE 0x8190BA KwSb 0.0398 vhvtv_sb_b0p02 -0.0200 0.0198 FORMAT "%6.4" /end CHARACTERISTIC
/begin CHARACTERISTIC FQTEFR "Kennlinie stetige Grenzwertregelung (fr)" CURVE 0x81AB82 KlAUbSstUbWSb 15.88 fak_sb_b16 0.00 15.88 FORMAT "%5.2"
 /begin AXIS_DESCR STD_AXIS frmxa fak_ub_b2 8 0.00 1.992 FORMAT "%5.3" DEPOSIT ABSOLUTE /end AXIS_DESCR
/end CHARACTERISTIC
/begin CHARACTERISTIC FQTEPT "Kennlinie Tankunterdruckbegrenzung (pte)" CURVE 0x81AB94 KlAUbSstSbWSb 15.88 fak_sb_b16 0.00 15.88 FORMAT "%5.2"
 /begin AXIS_DESCR STD_AXIS pte p_sb_q32 6 -32.00 31.75 FORMAT "%5.2" DEPOSIT ABSOLUTE /end AXIS_DESCR
/end CHARACTERISTIC
/begin CHARACTERISTIC FQTEVA "Progression bei Spülratenaufsteuerung" CURVE 0x8195D0 KlAUbSstUbWUb 15.94 fak_ub_b16 0.00 15.94 FORMAT "%5.2" /begin AXIS_DESCR STD_AXIS ftefva fak_ub_b0p5 6 0.00 0.4980 DEPOSIT ABSOLUTE /end AXIS_DESCR /end CHARACTERISTIC
/begin CHARACTERISTIC FRHB "fr-Schwelle für mögliches Rücksetzten Flip-Flop ""Hohe Beladung""" VALUE 0x8195DD KwUb 1.992 fak_ub_b2 0.00 1.992 FORMAT "%5.3" /end CHARACTERISTIC
/begin CHARACTERISTIC FSRFTEF "Faktor Steilheit Spülratenregelung in der Nähe des gewünschten Krafstoffanteils" VALUE 0x810086 KwUb 59.75 fak_ub_b64 4.000 63.75 FORMAT "%5.2" /end CHARACTERISTIC
/begin CHARACTERISTIC FTEADAB "Schwelle Beladung für Abbruch TE-Phase" VALUE 0x8195DE KwSb 127.5 fak_sb_b64 -64.00 63.50 FORMAT "%5.2" /end CHARACTERISTIC
/begin CHARACTERISTIC FTEADMX "Maximalwert der Beladung des AKF's" VALUE 0x8195DF KwSb 127.5 fak_sb_b64 -64.00 63.50 FORMAT "%5.2" /end CHARACTERISTIC
/begin CHARACTERISTIC FTEFHB "Schwelle für Spülrate Tankentlüftung für Erkennung hohe Beladung" VALUE 0x8195E0 KwUb 0.4980 fak_ub_b0p5 0.00 0.4980 /end CHARACTERISTIC
/begin CHARACTERISTIC FTEHB "Schwelle für Faktor Tankentlüftung für Erkennung hohe Beladung" VALUE 0x8195E1 KwSb 127.5 fak_sb_b64 -64.00 63.50 FORMAT "%5.2" /end CHARACTERISTIC
/begin CHARACTERISTIC FTEINIX "Kennlinie Max. Spülrate abhängig vom Integral Massenstrom TE nach TE Stop" CURVE 0x8195E2 KlAUbSstUbWUb 0.1992 fak_ub_b0p5 0.00 0.1992
 /begin AXIS_DESCR STD_AXIS imsteini m_ub_q0p0444 5 0.00 11.32 FORMAT "%5.2" DEPOSIT ABSOLUTE /end AXIS_DESCR
/end CHARACTERISTIC
/begin CHARACTERISTIC FUMRBRK "Faktor Umrechnung HC-Konzentration in Beladung ftead" VALUE 0x8195ED KwUb 31.88 fak_ub_b32 0.00 31.88 FORMAT "%5.2" /end CHARACTERISTIC
/begin CHARACTERISTIC FVERMN "Kennlinie Faktor Vermischung Regeneriergas Tankentlüftung mit Frischluft" CURVE 0x810AD9 KlAUbSstUbWUb 0.9961 fak_ub_b1 0.00 0.9961
 /begin AXIS_DESCR STD_AXIS nmot nmot_ub_q40 6 0.00 10200. FORMAT "%5.0" DEPOSIT ABSOLUTE /end AXIS_DESCR
/end CHARACTERISTIC
/begin CHARACTERISTIC FVERZTE "Faktor Verzögerung Regeneriergas zw. Drosselklappe und Einspritzventil" VALUE 0x814282 KwUw 0.0009764851 zv_uw_b9p765em4 0.00 0.0009764851 FORMAT "%12.10" /end CHARACTERISTIC
/begin CHARACTERISTIC FZWSTNM "Zündwinkel im Start" CURVE 0x8178AE KlAUbSstUbWSb 191.3 zw_sb_q0p75 -96.00 95.25 FORMAT "%5.2"
 /begin AXIS_DESCR STD_AXIS nmot nmot_ub_q40 6 0.00 10200. FORMAT "%5.0" DEPOSIT ABSOLUTE /end AXIS_DESCR
/end CHARACTERISTIC
/begin CHARACTERISTIC FZWSTTM "Zündwinkel im Start" CURVE 0x81BEEE KlAUbSstUbWSb 191.3 zw_sb_q0p75 -96.00 95.25 FORMAT "%5.2"
 /begin AXIS_DESCR STD_AXIS tmst temp_ub_q0p75_o48 6 -48.00 143.3 FORMAT "%5.1" DEPOSIT ABSOLUTE /end AXIS_DESCR
/end CHARACTERISTIC
/begin CHARACTERISTIC IP1A_MX_UM "max. Spannung für DK-Istwert-Poti 1 am unteren Anschlag für die Funktionsüberw." VALUE 0x817A70 KwUb 4.845 spg_ub_q0p019 0.00 4.845 FORMAT "%5.3" /end CHARACTERISTIC
/begin CHARACTERISTIC IP2A_MN_UM "min. Spannung für DK-Istwert-Poti 2 am unteren Anschlag für die Funktionsüberw." VALUE 0x817A71 KwUb 4.845 spg_ub_q0p019 0.00 4.845 FORMAT "%5.3" /end CHARACTERISTIC
/begin CHARACTERISTIC IPA_T_UM "Fehlertoleranzzeit für unteren DK-Anschlag im ungültigen Bereich f. d. Fktüberw." VALUE 0x817A72 KwUb 10200.0 t40ms_ub_b10200 0.00 10200.0 FORMAT "%7.1" /end CHARACTERISTIC
/begin CHARACTERISTIC ITANWHFM "Initialisierungswert für 'tanwrhf'" CURVE 0x810534 KlAUbSstUbWUb 100. tv_ub_b100 0.00 100. FORMAT "%4.0"
 /begin AXIS_DESCR STD_AXIS tmot temp_ub_q0p75_o48 5 -48.00 143.3 FORMAT "%5.1" DEPOSIT ABSOLUTE /end AXIS_DESCR
/end CHARACTERISTIC
/begin CHARACTERISTIC KFETATE "Kennfeld gewünscher Wirkungsgrad bei Tankentlüftung bei Erreichen te = TEMIN" MAP 0x81ABA2 KfAxUwAyUwSstxSwSstyUwWUw 50.00000 rel_q0p00195 50.00000 100.0000 FORMAT "%8.4"
 /begin AXIS_DESCR STD_AXIS fteadf_w fak_q0p00195 3 -64.00000 63.99805 FORMAT "%8.5" DEPOSIT ABSOLUTE /end AXIS_DESCR
 /begin AXIS_DESCR STD_AXIS mifa_w rel_uw_b100 5 0.00 99.99847 FORMAT "%8.5" DEPOSIT ABSOLUTE /end AXIS_DESCR
/end CHARACTERISTIC
/begin CHARACTERISTIC KFFTEAN "Kennfeld Maximale Spülrate bei Notlauftankentlüftung" MAP 0x8195EE GkfWUb 0.1992 fak_ub_b0p5 0.00 0.1992
 /begin AXIS_DESCR COM_AXIS nmot nmot_ub_q40 10 0.00 10200. AXIS_PTS_REF SNM10TEUB /end AXIS_DESCR
 /begin AXIS_DESCR COM_AXIS wdkba relDK_ub_b100 10 0.00 100.0 AXIS_PTS_REF SDK10TEUB /end AXIS_DESCR
/end CHARACTERISTIC
/begin CHARACTERISTIC KFFTEAX "Kennfeld maximale Spülrate" MAP 0x819652 KfAxUbAyUbSstxUbSstyUbWUb 0.1992 fak_ub_b0p5 0.00 0.1992
 /begin AXIS_DESCR STD_AXIS ml m_ub_b1020 5 0.00 1020. FORMAT "%5.0" DEPOSIT ABSOLUTE /end AXIS_DESCR
 /begin AXIS_DESCR STD_AXIS tans temp_ub_q0p75_o48 4 -48.00 143.3 FORMAT "%5.1" DEPOSIT ABSOLUTE /end AXIS_DESCR
/end CHARACTERISTIC
/begin CHARACTERISTIC KFFWK "Faktoren - Kennfeld für KFWK" MAP 0x812873 GkfWSb 0.9922 fak_sb_b1 0.00 0.9922
 /begin AXIS_DESCR COM_AXIS nmot nmot_ub_q40 24 0.00 10200. AXIS_PTS_REF SNM24ZUUB /end AXIS_DESCR
 /begin AXIS_DESCR COM_AXIS rl rel_ub_q0p75 16 0.00 191.3 AXIS_PTS_REF SRL16ZUUB /end AXIS_DESCR
/end CHARACTERISTIC
/begin CHARACTERISTIC KFKSZW "Zündwinkelkennfeld bei Klopfschutz" MAP 0x8129F3 GkfWSb 191.3 zw_sb_q0p75 -96.00 95.25 FORMAT "%5.2"
 /begin AXIS_DESCR COM_AXIS nmot nmot_ub_q40 24 0.00 10200. AXIS_PTS_REF SNM24ZUUB /end AXIS_DESCR
 /begin AXIS_DESCR COM_AXIS rl rel_ub_q0p75 16 0.00 191.3 AXIS_PTS_REF SRL16ZUUB /end AXIS_DESCR
/end CHARACTERISTIC
/begin CHARACTERISTIC KFMDZOF_UC "Kennfeld für Offset-Toleranz in Abhängigkeit vom zul. Moment im Befehlstest" MAP 0x81235C GkfWUb 99.61 rel_ub_b99p6 0.00 99.61 FORMAT "%5.2"
 /begin AXIS_DESCR COM_AXIS mzmax_uc rel_ub_b99p6 8 0.00 99.61 AXIS_PTS_REF MDV08_UC /end AXIS_DESCR
 /begin AXIS_DESCR COM_AXIS nmot_uc nmot_ub_q40 8 0.00 10200. AXIS_PTS_REF NMV08_UC /end AXIS_DESCR
/end CHARACTERISTIC
/begin CHARACTERISTIC KFMDZOF_UM "Kennfeld für Offset-Toleranz in Abhängigkeit vom zulässigen Moment" MAP 0x817B8B GkfWUb 99.61 rel_ub_b99p6 0.00 99.61 FORMAT "%5.2"
 /begin AXIS_DESCR COM_AXIS mzmax_um rel_ub_b99p6 8 0.00 99.61 AXIS_PTS_REF MDV08_UM /end AXIS_DESCR
 /begin AXIS_DESCR COM_AXIS nmot_um nmot_ub_q40 8 0.00 10200. AXIS_PTS_REF NMV08_UM /end AXIS_DESCR
/end CHARACTERISTIC
/begin CHARACTERISTIC KFMIRED "Kennfeld Abregelungsmoment für VMAX-Regelung" MAP 0x81A6A8 GkfWUb 99.61 rel_ub_b99p6 0.00 99.61 FORMAT "%5.2"
 /begin AXIS_DESCR COM_AXIS bfzglf bfzg_sb_q0p217 4 -27.78 27.56 AXIS_PTS_REF SBF02MFSB /end AXIS_DESCR
 /begin AXIS_DESCR COM_AXIS rl_w rel_uw_q0p0234 4 0.00 1535.977 AXIS_PTS_REF SRL03MFUW /end AXIS_DESCR
/end CHARACTERISTIC
/begin CHARACTERISTIC KFMIRLR "Kennfeld Abregelungsmoment für VMAX-Regelung bei Low Range" MAP 0x81A6B8 GkfWUb 99.61 rel_ub_b99p6 0.00 99.61 FORMAT "%5.2"
 /begin AXIS_DESCR COM_AXIS bfzglf bfzg_sb_q0p217 4 -27.78 27.56 AXIS_PTS_REF SBF02MFLRSB /end AXIS_DESCR
 /begin AXIS_DESCR COM_AXIS rl_w rel_uw_q0p0234 4 0.00 1535.977 AXIS_PTS_REF SRL03MFLRUW /end AXIS_DESCR
/end CHARACTERISTIC
/begin CHARACTERISTIC KFMI_UC "Kennfeld optimales Motormoment im Befehlstest" MAP 0x8122CB GkfWUb 99.61 rel_ub_b99p6 0.00 99.61 FORMAT "%5.2"
 /begin AXIS_DESCR COM_AXIS rl_uc rel_ub_q0p75 8 0.00 191.3 AXIS_PTS_REF RLV08_UC /end AXIS_DESCR
 /begin AXIS_DESCR COM_AXIS nmot_uc nmot_ub_q40 8 0.00 10200. AXIS_PTS_REF NZWV08_UC /end AXIS_DESCR
/end CHARACTERISTIC
/begin CHARACTERISTIC KFMI_UM "Kennfeld optimales Motormoment in der Funktionsüberwachung" MAP 0x817AFA GkfWUb 99.61 rel_ub_b99p6 0.00 99.61 FORMAT "%5.2"
 /begin AXIS_DESCR COM_AXIS rl_um rel_ub_q0p75 8 0.00 191.3 AXIS_PTS_REF RLV08_UM /end AXIS_DESCR
 /begin AXIS_DESCR COM_AXIS nmot_um nmot_ub_q40 8 0.00 10200. AXIS_PTS_REF NZWV08_UM /end AXIS_DESCR
/end CHARACTERISTIC
/begin CHARACTERISTIC KFMPED_UC "Kennfeld für zulässiges Moment aus der Pedalstellung im Befehlstest" MAP 0x81239C GkfWUb 99.61 rel_ub_b99p6 0.00 99.61 FORMAT "%5.2"
 /begin AXIS_DESCR COM_AXIS spsn_uc spg_ub_q0p019 8 0.00 4.845 AXIS_PTS_REF SPSNV08_UC /end AXIS_DESCR
 /begin AXIS_DESCR COM_AXIS nmot_uc nmot_ub_q40 8 0.00 10200. AXIS_PTS_REF NMV08_UC /end AXIS_DESCR
/end CHARACTERISTIC
/begin CHARACTERISTIC KFMPED_UM "Kennfeld für zulässiges Moment aus der Pedalstellung in der Funktionsüberwachg" MAP 0x817BCB GkfWUb 99.61 rel_ub_b99p6 0.00 99.61 FORMAT "%5.2"
 /begin AXIS_DESCR COM_AXIS spsn_um spg_ub_q0p019 8 0.00 4.845 AXIS_PTS_REF SPSNV08_UM /end AXIS_DESCR
 /begin AXIS_DESCR COM_AXIS nmot_um nmot_ub_q40 8 0.00 10200. AXIS_PTS_REF NMV08_UM /end AXIS_DESCR
/end CHARACTERISTIC
/begin CHARACTERISTIC KFMPNS_UC "Kennfeld für zul. Moment aus Pedalstellung bei kaltem Motor im Befehlstest" MAP 0x8123DC GkfWUb 99.61 rel_ub_b99p6 0.00 99.61 FORMAT "%5.2"
 /begin AXIS_DESCR COM_AXIS spsn_uc spg_ub_q0p019 8 0.00 4.845 AXIS_PTS_REF SPSNV08_UC /end AXIS_DESCR
 /begin AXIS_DESCR COM_AXIS nmot_uc nmot_ub_q40 8 0.00 10200. AXIS_PTS_REF NMV08_UC /end AXIS_DESCR
/end CHARACTERISTIC
/begin CHARACTERISTIC KFMPNS_UM "Kennfeld für zul. Moment aus Pedalstellung bei kaltem Motor" MAP 0x817C0B GkfWUb 99.61 rel_ub_b99p6 0.00 99.61 FORMAT "%5.2"
 /begin AXIS_DESCR COM_AXIS spsn_um spg_ub_q0p019 8 0.00 4.845 AXIS_PTS_REF SPSNV08_UM /end AXIS_DESCR
 /begin AXIS_DESCR COM_AXIS nmot_um nmot_ub_q40 8 0.00 10200. AXIS_PTS_REF NMV08_UM /end AXIS_DESCR
/end CHARACTERISTIC
/begin CHARACTERISTIC KFQTE "Kennfeld Auf-/Absteuergeschwindigkeit der Sollspülrate Tankentlüftung" MAP 0x819671 GkfWUb 0.01216 perio_ub_b0p012207 0.00 0.01216 FORMAT "%7.5" /begin AXIS_DESCR COM_AXIS ml m_ub_b1020 6 0.00 1020. AXIS_PTS_REF SML06TEUB /end AXIS_DESCR
 /begin AXIS_DESCR COM_AXIS frmit fak_ub_b2 5 0.00 1.992 AXIS_PTS_REF SFR05TEUB /end AXIS_DESCR
/end CHARACTERISTIC
/begin CHARACTERISTIC KFRLIP_UM "Kennfeld für rl - Berechnung aus Drosselklappenwinkel in der Funktionsüberwachg" MAP 0x817A73 KfAxUbAyUbSstxUbSstyUbWUb 191.3 rel_ub_q0p75 0.00 191.3 FORMAT "%5.1"
 /begin AXIS_DESCR STD_AXIS ipsn_um spg_ub_q0p019 8 0.00 4.845 FORMAT "%5.3" DEPOSIT ABSOLUTE /end AXIS_DESCR
 /begin AXIS_DESCR STD_AXIS nmot_um nmot_ub_q40 8 0.00 10200. FORMAT "%5.0" DEPOSIT ABSOLUTE /end AXIS_DESCR
/end CHARACTERISTIC
/begin CHARACTERISTIC KFTATX "Kennfeld für maximales Tastverhältnis" MAP 0x81968F KfAxUbAyUbSstxUbSstyUbWUb 99.61 rel_ub_b99p6 0.00 99.61 FORMAT "%5.2"
 /begin AXIS_DESCR STD_AXIS nmot nmot_ub_q40 10 0.00 10200. FORMAT "%5.0" DEPOSIT ABSOLUTE /end AXIS_DESCR
 /begin AXIS_DESCR STD_AXIS pspu fak_ub_b2 6 0.00 1.992 FORMAT "%5.3" DEPOSIT ABSOLUTE /end AXIS_DESCR
/end CHARACTERISTIC
/begin CHARACTERISTIC KFTEKA "Kennfeld Sollkraftstoffanteil bei Regenerierung" MAP 0x81ABD4 KfAxUbAyUbSstxUbSstyUbWSb 0.9922 fak_sb_b1 0.00 0.9922
 /begin AXIS_DESCR STD_AXIS nmot nmot_ub_q40 5 0.00 10200. FORMAT "%5.0" DEPOSIT ABSOLUTE /end AXIS_DESCR
 /begin AXIS_DESCR STD_AXIS rl rel_ub_q0p75 5 0.00 191.3 FORMAT "%5.1" DEPOSIT ABSOLUTE /end AXIS_DESCR
/end CHARACTERISTIC
/begin CHARACTERISTIC KFWK "Zündwinkelkennfeld für Klopfschutzfunktion" MAP 0x817898 KfAxUbAyUbSstxUbSstyUbWSb 191.3 zw_sb_q0p75 -96.00 95.25 FORMAT "%5.2"
 /begin AXIS_DESCR STD_AXIS tmot temp_ub_q0p75_o48 3 -48.00 143.3 FORMAT "%5.1" DEPOSIT ABSOLUTE /end AXIS_DESCR
 /begin AXIS_DESCR STD_AXIS tans temp_ub_q0p75_o48 4 -48.00 143.3 FORMAT "%5.1" DEPOSIT ABSOLUTE /end AXIS_DESCR
/end CHARACTERISTIC
/begin CHARACTERISTIC KFWNLLK "Sollwinkel für Nockenwelle im Leerlauf bei kaltem Motor" MAP 0x812482 KfAxUbAyUbSstxUbSstyUbWUb 63.7500 wkw_ub_q0p25 0.00 63.7500 FORMAT "%7.4"
 /begin AXIS_DESCR STD_AXIS nmot nmot_ub_q40 12 0.00 10200. FORMAT "%5.0" DEPOSIT ABSOLUTE /end AXIS_DESCR
 /begin AXIS_DESCR STD_AXIS rl rel_ub_q0p75 10 0.00 191.3 FORMAT "%5.1" DEPOSIT ABSOLUTE /end AXIS_DESCR
/end CHARACTERISTIC
/begin CHARACTERISTIC KFWNLLW "Sollwinkel für Nockenwelle im Leerlauf bei warmem Motor" MAP 0x812512 KfAxUbAyUbSstxUbSstyUbWUb 63.7500 wkw_ub_q0p25 0.00 63.7500 FORMAT "%7.4"
 /begin AXIS_DESCR STD_AXIS nmot nmot_ub_q40 12 0.00 10200. FORMAT "%5.0" DEPOSIT ABSOLUTE /end AXIS_DESCR
 /begin AXIS_DESCR STD_AXIS rl rel_ub_q0p75 10 0.00 191.3 FORMAT "%5.1" DEPOSIT ABSOLUTE /end AXIS_DESCR
/end CHARACTERISTIC
/begin CHARACTERISTIC KFWNSL "NW-Sollwinkel  bei SLP-Betrieb" MAP 0x8125A2 KfAxUbAyUbSstxUbSstyUbWUb 63.7500 wkw_ub_q0p25 0.00 63.7500 FORMAT "%7.4"
 /begin AXIS_DESCR STD_AXIS nmot nmot_ub_q40 4 0.00 10200. FORMAT "%5.0" DEPOSIT ABSOLUTE /end AXIS_DESCR
 /begin AXIS_DESCR STD_AXIS tmot temp_ub_q0p75_o48 4 -48.00 143.3 FORMAT "%5.1" DEPOSIT ABSOLUTE /end AXIS_DESCR
/end CHARACTERISTIC
/begin CHARACTERISTIC KFWNWK "Sollwinkel für Nockenwelle in der Teillast bei kaltem Motor" MAP 0x8125BC KfAxUbAyUbSstxUbSstyUbWUb 63.7500 wkw_ub_q0p25 0.00 63.7500 FORMAT "%7.4"
 /begin AXIS_DESCR STD_AXIS nmot nmot_ub_q40 16 0.00 10200. FORMAT "%5.0" DEPOSIT ABSOLUTE /end AXIS_DESCR
 /begin AXIS_DESCR STD_AXIS rl rel_ub_q0p75 16 0.00 191.3 FORMAT "%5.1" DEPOSIT ABSOLUTE /end AXIS_DESCR
/end CHARACTERISTIC
/begin CHARACTERISTIC KFWNWW "Sollwinkel für Nockenwelle in der Teillast bei warmem Motor" MAP 0x8126DE KfAxUbAyUbSstxUbSstyUbWUb 63.7500 wkw_ub_q0p25 0.00 63.7500 FORMAT "%7.4"
 /begin AXIS_DESCR STD_AXIS nmot nmot_ub_q40 16 0.00 10200. FORMAT "%5.0" DEPOSIT ABSOLUTE /end AXIS_DESCR
 /begin AXIS_DESCR STD_AXIS rl rel_ub_q0p75 16 0.00 191.3 FORMAT "%5.1" DEPOSIT ABSOLUTE /end AXIS_DESCR
/end CHARACTERISTIC
/begin CHARACTERISTIC KFWNWWK "Wichtungskennfeld für NW-Sollwinkel  Warm/Kalt in TL / LL" MAP 0x817770 KfAxUbAyUbSstxUwSstyUbWUb 1.000 fak_ub_q0p00392 0.00 1.000 FORMAT "%5.3"
 /begin AXIS_DESCR STD_AXIS tnst_w t10msxs_uw_b655p35 6 0.00 655.3500 FORMAT "%8.4" DEPOSIT ABSOLUTE /end AXIS_DESCR
 /begin AXIS_DESCR STD_AXIS tmot temp_ub_q0p75_o48 4 -48.00 143.3 FORMAT "%5.1" DEPOSIT ABSOLUTE /end AXIS_DESCR
/end CHARACTERISTIC
/begin CHARACTERISTIC KFZW1 "Zündwinkelkennfeld Variante 1" MAP 0x810BEF GkfWSb 191.3 zw_sb_q0p75 -96.00 95.25 FORMAT "%5.2"
 /begin AXIS_DESCR COM_AXIS nmot nmot_ub_q40 24 0.00 10200. AXIS_PTS_REF SNM24ZUUB /end AXIS_DESCR
 /begin AXIS_DESCR COM_AXIS rl rel_ub_q0p75 16 0.00 191.3 AXIS_PTS_REF SRL16ZUUB /end AXIS_DESCR
/end CHARACTERISTIC
/begin CHARACTERISTIC KFZW2 "Zündwinkelkennfeld Variante 2" MAP 0x810D6F GkfWSb 191.3 zw_sb_q0p75 -96.00 95.25 FORMAT "%5.2"
 /begin AXIS_DESCR COM_AXIS nmot nmot_ub_q40 24 0.00 10200. AXIS_PTS_REF SNM24ZUUB /end AXIS_DESCR
 /begin AXIS_DESCR COM_AXIS rl rel_ub_q0p75 16 0.00 191.3 AXIS_PTS_REF SRL16ZUUB /end AXIS_DESCR
/end CHARACTERISTIC
/begin CHARACTERISTIC KFZWMN "Min-Zündwinkel" MAP 0x810F37 GkfWSb 191.3 zw_sb_q0p75 -96.00 95.25 FORMAT "%5.2"
 /begin AXIS_DESCR COM_AXIS nmot nmot_ub_q40 16 0.00 10200. AXIS_PTS_REF SNM16ZUUB /end AXIS_DESCR
 /begin AXIS_DESCR COM_AXIS rl rel_ub_q0p75 12 0.00 191.3 AXIS_PTS_REF SRL12ZUUB /end AXIS_DESCR
/end CHARACTERISTIC
/begin CHARACTERISTIC KFZWMNST "Min-Zündwinkel für Start und Nachstart" MAP 0x810FF7 GkfWSb 191.3 zw_sb_q0p75 -96.00 95.25 FORMAT "%5.2"
 /begin AXIS_DESCR COM_AXIS nmot nmot_ub_q40 16 0.00 10200. AXIS_PTS_REF SNM16ZUUB /end AXIS_DESCR
 /begin AXIS_DESCR COM_AXIS rl rel_ub_q0p75 12 0.00 191.3 AXIS_PTS_REF SRL12ZUUB /end AXIS_DESCR
/end CHARACTERISTIC
/begin CHARACTERISTIC KFZWVL "Vollast - Zündkennfeld" MAP 0x810EEF GkfWSb 191.3 zw_sb_q0p75 -96.00 95.25 FORMAT "%5.2"
 /begin AXIS_DESCR COM_AXIS nmot nmot_ub_q40 24 0.00 10200. AXIS_PTS_REF SNM24ZUUB /end AXIS_DESCR
 /begin AXIS_DESCR COM_AXIS rl rel_ub_q0p75 3 0.00 191.3 AXIS_PTS_REF SRL03ZUUB /end AXIS_DESCR
/end CHARACTERISTIC
/begin CHARACTERISTIC KFZWWLNM "Delta Zündwinkel im Warmlauf" MAP 0x8178BC KfAxUbAyUbSstxUbSstyUbWSb 191.3 zw_sb_q0p75 -96.00 95.25 FORMAT "%5.2"
 /begin AXIS_DESCR STD_AXIS nmot nmot_ub_q40 16 0.00 10200. FORMAT "%5.0" DEPOSIT ABSOLUTE /end AXIS_DESCR
 /begin AXIS_DESCR STD_AXIS tans temp_ub_q0p75_o48 6 -48.00 143.3 FORMAT "%5.1" DEPOSIT ABSOLUTE /end AXIS_DESCR
/end CHARACTERISTIC
/begin CHARACTERISTIC KFZWWLTM "Delta Zündwinkel im Warmlauf" MAP 0x81BEFC KfAxUbAyUbSstxUbSstyUbWSb 191.3 zw_sb_q0p75 -96.00 95.25 FORMAT "%5.2"
 /begin AXIS_DESCR STD_AXIS tmot temp_ub_q0p75_o48 12 -48.00 143.3 FORMAT "%5.1" DEPOSIT ABSOLUTE /end AXIS_DESCR
 /begin AXIS_DESCR STD_AXIS tmst temp_ub_q0p75_o48 12 -48.00 143.3 FORMAT "%5.1" DEPOSIT ABSOLUTE /end AXIS_DESCR
/end CHARACTERISTIC
/begin CHARACTERISTIC KFZW_UC "Kennfeld für optimalen Zündwinkel im Befehlstest" MAP 0x81230B GkfWSb 191.3 zw_sb_q0p75 -96.00 95.25 FORMAT "%5.2"
 /begin AXIS_DESCR COM_AXIS rl_uc rel_ub_q0p75 8 0.00 191.3 AXIS_PTS_REF RLV08_UC /end AXIS_DESCR
 /begin AXIS_DESCR COM_AXIS nmot_uc nmot_ub_q40 8 0.00 10200. AXIS_PTS_REF NZWV08_UC /end AXIS_DESCR
/end CHARACTERISTIC
/begin CHARACTERISTIC KFZW_UM "Kennfeld für optimalen Zündwinkel in der Funktionsüberwachung" MAP 0x817B3A GkfWSb 191.3 zw_sb_q0p75 -96.00 95.25 FORMAT "%5.2"
 /begin AXIS_DESCR COM_AXIS rl_um rel_ub_q0p75 8 0.00 191.3 AXIS_PTS_REF RLV08_UM /end AXIS_DESCR
 /begin AXIS_DESCR COM_AXIS nmot_um nmot_ub_q40 8 0.00 10200. AXIS_PTS_REF NZWV08_UM /end AXIS_DESCR
/end CHARACTERISTIC
/begin CHARACTERISTIC KHCTEMN "Minimalwert HC-Konzentration Regeneriergas Tankentlüftung" VALUE 0x8196DD KwSb 3.984 fak_sb_b2 -2.000 1.984 FORMAT "%5.3" /end CHARACTERISTIC
/begin CHARACTERISTIC KHCTEMX "Maximalwert HC-Konzentration Regeneriergas Tankentlüftung" VALUE 0x8196DE KwSb 3.984 fak_sb_b2 -2.000 1.984 FORMAT "%5.3" /end CHARACTERISTIC
/begin CHARACTERISTIC KLETAZW_UC "ZW-Wirkungsgrad in Abhängigkeit von delta ZW im Befehlstest" CURVE 0x81234B KlAUbSstUbWUb 127.5 rel_ub_b127p5 0.00 127.5 FORMAT "%5.1"
 /begin AXIS_DESCR STD_AXIS dzw_uc zw_ub_q0p75 8 0.00 191.3 FORMAT "%5.1" DEPOSIT ABSOLUTE /end AXIS_DESCR
/end CHARACTERISTIC
/begin CHARACTERISTIC KLETAZW_UM "ZW-Wirkungsgrad in Abhängigkeit von delta ZW in der Funktionsüberwachung" CURVE 0x817B7A KlAUbSstUbWUb 127.5 rel_ub_b127p5 0.00 127.5 FORMAT "%5.1"
 /begin AXIS_DESCR STD_AXIS dzw_um zw_ub_q0p75 8 0.00 191.3 FORMAT "%5.1" DEPOSIT ABSOLUTE /end AXIS_DESCR
/end CHARACTERISTIC
/begin CHARACTERISTIC KLFVGNWF "Korrektur Drehzahlabhängigkeit 'vgnwrf'" CURVE 0x81053F KlAUbSstUbWUb 0.9961 fak_ub_b1 0.00 0.9961
 /begin AXIS_DESCR STD_AXIS nmot nmot_ub_q40 5 0.00 10200. FORMAT "%5.0" DEPOSIT ABSOLUTE /end AXIS_DESCR
/end CHARACTERISTIC
/begin CHARACTERISTIC KLNPED_UC "pedalsollwertabh. Drehzahlbegr. in der DK-Antrieb-Ersatzfunktion; Befehlstest" CURVE 0x812427 KlAUbSstUbWUb 10200. nmot_ub_q40 0.00 10200. FORMAT "%5.0"
 /begin AXIS_DESCR STD_AXIS spsn_uc spg_ub_q0p019 8 0.00 4.845 FORMAT "%5.3" DEPOSIT ABSOLUTE /end AXIS_DESCR
/end CHARACTERISTIC
/begin CHARACTERISTIC KLNPED_UM "pedalsollwertabh. Drehzahlbegrenzung in der DK-Antrieb-Ersatzfunktion, Fktsüberw" CURVE 0x817C57 KlAUbSstUbWUb 10200. nmot_ub_q40 0.00 10200. FORMAT "%5.0"
 /begin AXIS_DESCR STD_AXIS spsn_um spg_ub_q0p019 8 0.00 4.845 FORMAT "%5.3" DEPOSIT ABSOLUTE /end AXIS_DESCR
/end CHARACTERISTIC
/begin CHARACTERISTIC KSZWE "Klopfschutzzündwinkel Ersatzwert bei E_ta v E_tm" VALUE 0x812B73 KwSb 191.3 zw_sb_q0p75 -96.00 95.25 FORMAT "%5.2" /end CHARACTERISTIC
/begin CHARACTERISTIC MACCA_DAT_UC "" VAL_BLK 0x8120F2 KwbUb 255.0 dez 0.00 255.0 FORMAT "%5.1" NUMBER 16 /end CHARACTERISTIC
/begin CHARACTERISTIC MACCC_DAT_UC "" VAL_BLK 0x812102 KwbUb 255.0 dez 0.00 255.0 FORMAT "%5.1" NUMBER 16 /end CHARACTERISTIC
/begin CHARACTERISTIC MDIMX_UM "Maximal erreichbares indiziertes Motormoment für die Funktionsüberwachung" VALUE 0x817A63 KwUb 99.61 rel_ub_q0p3906 0.00 99.61 FORMAT "%5.2" /end CHARACTERISTIC
/begin CHARACTERISTIC MDIND_DAT_UC "" VAL_BLK 0x812112 KwbUb 255.0 dez 0.00 255.0 FORMAT "%5.1" NUMBER 16 /end CHARACTERISTIC
/begin AXIS_PTS MDV08_UC "Stützstellenverteilung für Moment im Befehlstest" 0x81241C mzmax_uc SstAUbSstUb 99.61 rel_ub_b99p6 8 0.00 99.61 FORMAT "%5.2" DEPOSIT ABSOLUTE /end AXIS_PTS
/begin AXIS_PTS MDV08_UM "Stützstellenverteilung für Moment in der Funktionsüberwachung" 0x817C4B mzmax_um SstAUbSstUb 99.61 rel_ub_b99p6 8 0.00 99.61 FORMAT "%5.2" DEPOSIT ABSOLUTE /end AXIS_PTS
/begin CHARACTERISTIC MIFA_DAT_UC "" VAL_BLK 0x812122 KwbUb 99.61 rel_ub_q0p3906 0.00 99.61 FORMAT "%5.2" NUMBER 16 /end CHARACTERISTIC
/begin CHARACTERISTIC MILSOL_DAT_UC "" VAL_BLK 0x812132 KwbUb 99.61 rel_ub_q0p3906 0.00 99.61 FORMAT "%5.2" NUMBER 16 /end CHARACTERISTIC
/begin CHARACTERISTIC MSRC_D_UC "" VAL_BLK 0x812142 KwbUb 255.0 dez 0.00 255.0 FORMAT "%5.1" NUMBER 16 /end CHARACTERISTIC
/begin CHARACTERISTIC MSRC_T_UC "Fehlerzeit für MSR-Eingriff-Überwachung des Befehlstests" VALUE 0x8122A6 KwUb 10200.0 t40ms_ub_b10200 0.00 10200.0 FORMAT "%7.1" /end CHARACTERISTIC
/begin CHARACTERISTIC MSRC_T_UM "Fehlerzeit für MSR-Eingriff-Überwachung der Funktionsüberwachung" VALUE 0x817AD5 KwUb 10200.0 t40ms_ub_b10200 0.00 10200.0 FORMAT "%7.1" /end CHARACTERISTIC
/begin CHARACTERISTIC MVER_D_UC "" VAL_BLK 0x812152 KwbUb 255.0 dez 0.00 255.0 FORMAT "%5.1" NUMBER 16 /end CHARACTERISTIC
/begin CHARACTERISTIC MVER_T_UC "Fehlerzeit beim Momentenvergleich im Befehlstest" VALUE 0x810165 KwUb 10200.0 t40ms_ub_b10200 0.00 10200.0 FORMAT "%7.1" /end CHARACTERISTIC
/begin CHARACTERISTIC MVER_T_UM "Fehlerzeit beim Momentenvergleich in der Funktionsüberwachung" VALUE 0x817C56 KwUb 10200.0 t40ms_ub_b10200 0.00 10200.0 FORMAT "%7.1" /end CHARACTERISTIC
/begin CHARACTERISTIC MZFFIL_UC "Filter-Zeitkonstante für verzögertes Moment im Befehlstest" VALUE 0x812425 KwUb 10159.4 zk40ms_ub_b10200 40.6299 10200.0 FORMAT "%7.1" /end CHARACTERISTIC
/begin CHARACTERISTIC MZFFIL_UM "Filter-Zeitkonstante für verzögertes Moment in der Funktionsüberwachung" VALUE 0x817C54 KwUb 10159.4 zk40ms_ub_b10200 40.6299 10200.0 FORMAT "%7.1" /end CHARACTERISTIC
/begin CHARACTERISTIC MZFPTR_DAT_UC "" VAL_BLK 0x812162 KwbUb 255.0 dez 0.00 255.0 FORMAT "%5.1" NUMBER 16 /end CHARACTERISTIC
/begin CHARACTERISTIC MZFREG_DAT_UC "" MAP 0x812172 KfWUb 255.0 dez 0.00 255.0 FORMAT "%5.1"
 /begin AXIS_DESCR FIX_AXIS x_uc dez 8 0.00 7.000 FORMAT "%5.3" FIX_AXIS_PAR 0 0 8 /end AXIS_DESCR
 /begin AXIS_DESCR FIX_AXIS y_uc dez 16 0.00 15.00 FORMAT "%5.2" FIX_AXIS_PAR 0 0 16 /end AXIS_DESCR
/end CHARACTERISTIC
/begin CHARACTERISTIC MZFTV_UC "Verzugszeit für zulässiges Moment mz_um im Befehlstest" VALUE 0x812426 KwUb 280.000 t40ms_ub_b10200 40.0000 320.000 FORMAT "%7.3" /end CHARACTERISTIC
/begin CHARACTERISTIC MZFTV_UM "Verzugszeit für zulässiges Moment mz_um in der Funktionsüberwachg" VALUE 0x817C55 KwUb 280.000 t40ms_ub_b10200 40.0000 320.000 FORMAT "%7.3" /end CHARACTERISTIC
/begin CHARACTERISTIC MZF_DAT_UC "" VAL_BLK 0x8121F2 KwbUb 99.61 rel_ub_q0p3906 0.00 99.61 FORMAT "%5.2" NUMBER 16 /end CHARACTERISTIC
/begin CHARACTERISTIC MZL_DAT_UC "" VAL_BLK 0x812202 KwbUb 0.3891 rel_ub_q0p00153 0.00 0.3891 NUMBER 16 /end CHARACTERISTIC
/begin CHARACTERISTIC NC_T_UM "Fehlertoleranzzeit für Motordrehzahlüberwachung für Funktionsüberwachung" VALUE 0x817A66 KwUb 10200.0 t40ms_ub_b10200 0.00 10200.0 FORMAT "%7.1" /end CHARACTERISTIC
/begin CHARACTERISTIC NDIF_UM "erlaubte Differenz zwischen nmot und nz_um in der Funktionsüberwachung" VALUE 0x817A67 KwUb 10200. nmot_ub_q40 0.00 10200. FORMAT "%5.0" /end CHARACTERISTIC
/begin CHARACTERISTIC NEVFZG "Drehzahlschwelle bei Fehlertachosignal" VALUE 0x812800 KwUb 10200. nmot_ub_q40 0.00 10200. FORMAT "%5.0" /end CHARACTERISTIC
/begin CHARACTERISTIC NFLAGS_D_UC "" VAL_BLK 0x812212 KwbUb 255.0 dez 0.00 255.0 FORMAT "%5.1" NUMBER 16 /end CHARACTERISTIC
/begin CHARACTERISTIC NKLO "Drehzahl - Klopfschutzschwelle" VALUE 0x810188 KwUb 10200. nmot_ub_q40 0.00 10200. FORMAT "%5.0" /end CHARACTERISTIC
/begin CHARACTERISTIC NMINVMX "Minimale Drehzahlschwelle zur VMAX-Regelung" VALUE 0x81A6C8 KwUb 10200. nmot_ub_q40 0.00 10200. FORMAT "%5.0" /end CHARACTERISTIC
/begin CHARACTERISTIC NMIN_UM "minimale Drehzahl für Motordrehzahlüberwachung der Funktionsüberwachung" VALUE 0x817A68 KwUb 10200. nmot_ub_q40 0.00 10200. FORMAT "%5.0" /end CHARACTERISTIC
/begin CHARACTERISTIC NMOT_DAT_UC "" VAL_BLK 0x812222 KwbUb 10200. nmot_ub_q40 0.00 10200. FORMAT "%5.0" NUMBER 16 /end CHARACTERISTIC
/begin AXIS_PTS NMV08_UC "Stützstellenverteilung für Motordrehzahl im Befehlstest" 0x8122A7 nmot_uc SstAUbSstUb 10200. nmot_ub_q40 8 0.00 10200. FORMAT "%5.0" DEPOSIT ABSOLUTE /end AXIS_PTS
/begin AXIS_PTS NMV08_UM "Stützstellenverteilung für Motordrehzahl in der Funktionsüberwachung" 0x817AD6 nmot_um SstAUbSstUb 10200. nmot_ub_q40 8 0.00 10200. FORMAT "%5.0" DEPOSIT ABSOLUTE /end AXIS_PTS
/begin CHARACTERISTIC NNWAFMX "obere n-Grenze f. Auswertung aller NW-Flanken" VALUE 0x8190B5 KwUb 10200. nmot_ub_q40 0.00 10200. FORMAT "%5.0" /end CHARACTERISTIC
/begin CHARACTERISTIC NNWHYS "Hysteresebreite zur Umschaltung auf 1 NW-Flanke je NW-Umdrehung" VALUE 0x8190B6 KwUb 10200. nmot_ub_q40 0.00 10200. FORMAT "%5.0" /end CHARACTERISTIC
/begin CHARACTERISTIC NNWMAX "Drehzahlschwelle für Abschaltung NW-Regelung" VALUE 0x812801 KwUb 10200. nmot_ub_q40 0.00 10200. FORMAT "%5.0" /end CHARACTERISTIC
/begin CHARACTERISTIC NOBELSTP "Lernen der Beladung freigeben" VALUE 0x8196DF KwUb 255.0 dez 0.00 255.0 FORMAT "%5.1" /end CHARACTERISTIC
/begin CHARACTERISTIC NRLIP_UM "Motordrehzahl-Schwelle für den rl/rlip-Vergleich in der Funktionsüberwachg" VALUE 0x817AC5 KwUb 10200. nmot_ub_q40 0.00 10200. FORMAT "%5.0" /end CHARACTERISTIC
/begin CHARACTERISTIC NSC_T_UM "Nachstartüberwachungszeit für die Funktionsüberwachung" VALUE 0x817CA2 KwUw 2621.400 t40msxs_uw_q0p04 0.00 2621.400 FORMAT "%8.3" /end CHARACTERISTIC
/begin CHARACTERISTIC NSOF_T_UM "Entprellzeit für Abschaltung der Nachstartaufweitung" VALUE 0x817A69 KwUb 10200.0 t40ms_ub_b10200 0.00 10200.0 FORMAT "%7.1" /end CHARACTERISTIC
/begin CHARACTERISTIC NWNWS "Drehzahlschwelle für Nockenwellensollwinkel-Spätumschaltung" VALUE 0x812802 KwUb 10200. nmot_ub_q40 0.00 10200. FORMAT "%5.0" /end CHARACTERISTIC
/begin CHARACTERISTIC NZMUL_UM "Multiplikator für Umrechnung der Zähnezahl in Motordrehzahl für Funktionsüberw." VALUE 0x817C9E KwUw 65535.00 dez 0.00 65535.00 FORMAT "%8.2" /end CHARACTERISTIC
/begin AXIS_PTS NZWV08_UC "" 0x8122B0 nmot_uc SstAUbSstUb 10200. nmot_ub_q40 8 0.00 10200. FORMAT "%5.0" DEPOSIT ABSOLUTE /end AXIS_PTS
/begin AXIS_PTS NZWV08_UM "" 0x817ADF nmot_um SstAUbSstUb 10200. nmot_ub_q40 8 0.00 10200. FORMAT "%5.0" DEPOSIT ABSOLUTE /end AXIS_PTS
/begin CHARACTERISTIC N_START_UM "Motordrehzahlschwelle für Unterdrehzahl-Ausstieg für die Fkt.-Überwachung" VALUE 0x817A6A KwUb 10200. nmot_ub_q40 0.00 10200. FORMAT "%5.0" /end CHARACTERISTIC
/begin CHARACTERISTIC N_STEND_UM "Motordrehzahlschwelle für Startende in der Fkt.-Überwachung" VALUE 0x817A6B KwUb 10200. nmot_ub_q40 0.00 10200. FORMAT "%5.0" /end CHARACTERISTIC
/begin CHARACTERISTIC REAC_D1_UC "" VAL_BLK 0x812232 KwbUb 255.0 dez 0.00 255.0 FORMAT "%5.1" NUMBER 16 /end CHARACTERISTIC
/begin CHARACTERISTIC REAC_D2_UC "" VAL_BLK 0x812242 KwbUb 255.0 dez 0.00 255.0 FORMAT "%5.1" NUMBER 16 /end CHARACTERISTIC
/begin CHARACTERISTIC REAC_T1_UC "Fehlerzeit bei der Funktions-Fehlerreaktionsüberwachung im Befehlstest" VALUE 0x812438 KwUb 10200.0 t40ms_ub_b10200 0.00 10200.0 FORMAT "%7.1" /end CHARACTERISTIC
/begin CHARACTERISTIC REAC_T1_UM "Fehlerzeit bei der Funktions-Fehlerreaktionsüberwachung in der Funktionsüberw." VALUE 0x817C68 KwUb 10200.0 t40ms_ub_b10200 0.00 10200.0 FORMAT "%7.1" /end CHARACTERISTIC
/begin CHARACTERISTIC REAC_T2_UC "Fehlerzeit bei der Funktionsüberwachungs-Fehlerreaktionsüberw. im Befehlstest" VALUE 0x812439 KwUb 10200.0 t40ms_ub_b10200 0.00 10200.0 FORMAT "%7.1" /end CHARACTERISTIC
/begin CHARACTERISTIC REAC_T2_UM "Fehlerzeit bei der Funktionsüberwachungs-Fehlerreaktionsüberwachung" VALUE 0x817C69 KwUb 10200.0 t40ms_ub_b10200 0.00 10200.0 FORMAT "%7.1" /end CHARACTERISTIC
/begin CHARACTERISTIC RFLAGS_D_UC "" VAL_BLK 0x812252 KwbUb 255.0 dez 0.00 255.0 FORMAT "%5.1" NUMBER 16 /end CHARACTERISTIC
/begin CHARACTERISTIC RLC_T_UM "Fehlertoleranzzeit für den rl-Vergleich mit der Funktion in der Funktionsüberw." VALUE 0x817AC6 KwUb 10200.0 t40ms_ub_b10200 0.00 10200.0 FORMAT "%7.1" /end CHARACTERISTIC
/begin CHARACTERISTIC RLIPFIL_UM "Filter-Zeitkonstante für verzögerte Lastinfo rlipt_um in d. Funktionsüberwachung" VALUE 0x817AC7 KwUb 10159.4 zk40ms_ub_b10200 40.6299 10200.0 FORMAT "%7.1" /end CHARACTERISTIC
/begin CHARACTERISTIC RLIPTV_UM "Verzugszeit für Lastinformation rlip_um in der Funktionsüberwachung" VALUE 0x817AC8 KwUb 320.000 t40ms_ub_b10200 0.00 320.000 FORMAT "%7.3" /end CHARACTERISTIC
/begin CHARACTERISTIC RLIP_T_UM "Fehlertoleranzzeit für den rl/rlip-Vergleich in der Funktionsüberwachg" VALUE 0x817AC9 KwUb 10200.0 t40ms_ub_b10200 0.00 10200.0 FORMAT "%7.1" /end CHARACTERISTIC
/begin CHARACTERISTIC RLKL "Lastsignal rl - Schwelle für Klopfschutz" VALUE 0x810189 KwUb 191.3 rel_ub_q0p75 0.00 191.3 FORMAT "%5.1" /end CHARACTERISTIC
/begin AXIS_PTS RLV08_UC "Stutzstellenverteilung für Lastinfo im Befehlstest" 0x8122B9 rl_uc SstAUbSstUb 191.3 rel_ub_q0p75 8 0.00 191.3 FORMAT "%5.1" DEPOSIT ABSOLUTE /end AXIS_PTS
/begin AXIS_PTS RLV08_UM "Stutzstellenverteilung für Lastinfo in der Funktionsüberwachung" 0x817AE8 rl_um SstAUbSstUb 191.3 rel_ub_q0p75 8 0.00 191.3 FORMAT "%5.1" DEPOSIT ABSOLUTE /end AXIS_PTS
/begin CHARACTERISTIC RL_BO_UM "Offset für Toleranzgerade f(rl_um) für rlipf_um in der Funktionsüberwachung" VALUE 0x817ACA KwUb 191.3 rel_ub_q0p75 0.00 191.3 FORMAT "%5.1" /end CHARACTERISTIC
/begin CHARACTERISTIC RL_DAT_UC "" VAL_BLK 0x812262 KwbUb 191.3 rel_ub_q0p75 0.00 191.3 FORMAT "%5.1" NUMBER 16 /end CHARACTERISTIC
/begin CHARACTERISTIC RL_MO_UM "Steigung für Toleranzgerade f(rl_um) für rlipf_um in der Funktionsüberwachung" VALUE 0x817ACB KwUb 255.0 dez 0.00 255.0 FORMAT "%5.1" /end CHARACTERISTIC
/begin CHARACTERISTIC ROMRSTA_UM "maximale Anzahl Resets bei Fehlererkennung im ROM-Check in der Initialisierung" VALUE 0x817A60 KwUb 255.0 dez 0.00 255.0 FORMAT "%5.1" /end CHARACTERISTIC
/begin CHARACTERISTIC RST_TV_UM "Kennung zur Anforderung eines Reset-Tastverhältnisses aus der Funktionsüberwach." VALUE 0x817A61 KwUb 255.0 dez 0.00 255.0 FORMAT "%5.1" /end CHARACTERISTIC
/begin AXIS_PTS SBF02MFLRSB "" 0x81A6C9 bfzglf SstAUbSstSb 55.34 bfzg_sb_q0p217 4 -27.78 27.56 FORMAT "%5.2" DEPOSIT ABSOLUTE /end AXIS_PTS
/begin AXIS_PTS SBF02MFSB "" 0x81A6CE bfzglf SstAUbSstSb 55.34 bfzg_sb_q0p217 4 -27.78 27.56 FORMAT "%5.2" DEPOSIT ABSOLUTE /end AXIS_PTS
/begin AXIS_PTS SDK10TEUB "wdkba abhängige Stützstellen (Anzahl 10)" 0x819812 wdkba SstAUbSstUb 100.0 relDK_ub_b100 10 0.00 100.0 FORMAT "%5.1" DEPOSIT ABSOLUTE /end AXIS_PTS
/begin CHARACTERISTIC SFLAGS_D_UC "" VAL_BLK 0x812272 KwbUb 255.0 dez 0.00 255.0 FORMAT "%5.1" NUMBER 16 /end CHARACTERISTIC
/begin AXIS_PTS SFR05TEUB "frmit abhängige Stützstellen (Anzahl 5)" 0x819824 frmit SstAUbSstUb 1.992 fak_ub_b2 5 0.00 1.992 FORMAT "%5.3" DEPOSIT ABSOLUTE /end AXIS_PTS
/begin CHARACTERISTIC SGFAMILY "" ASCII 0x81FC96 KwbUb 255.0 KennText 0.00 255.0 FORMAT "%5.1" NUMBER 2 /end CHARACTERISTIC
/begin CHARACTERISTIC SKA_DRHZ_UC "" VALUE 0x81243A KwUb 10200. nmot_ub_q40 0.00 10200. FORMAT "%5.0" /end CHARACTERISTIC
/begin CHARACTERISTIC SKA_DRHZ_UM "" VALUE 0x817C6A KwUb 10200. nmot_ub_q40 0.00 10200. FORMAT "%5.0" /end CHARACTERISTIC
/begin AXIS_PTS SML06TEUB "ml abhängige Stützstellen (Anzahl 6)" 0x81982A ml SstAUbSstUb 1020. m_ub_b1020 6 0.00 1020. FORMAT "%5.0" DEPOSIT ABSOLUTE /end AXIS_PTS
/begin AXIS_PTS SNM08__UB "Stützstellenverteilung Drehzahl, 8 Sst." 0x8119EA nmot SstAUbSstUb 10200. nmot_ub_q40 8 0.00 10200. FORMAT "%5.0" DEPOSIT ABSOLUTE /end AXIS_PTS
/begin AXIS_PTS SNM10TEUB "nmot abhängige Stützstellen (Anzahl 10)" 0x819867 nmot SstAUbSstUb 10200. nmot_ub_q40 10 0.00 10200. FORMAT "%5.0" DEPOSIT ABSOLUTE /end AXIS_PTS
/begin AXIS_PTS SNM16ZUUB "Stützstellenverteilung Drehzahl, 16 Sst." 0x811A29 nmot SstAUbSstUb 10200. nmot_ub_q40 16 0.00 10200. FORMAT "%5.0" DEPOSIT ABSOLUTE /end AXIS_PTS
/begin AXIS_PTS SNM24ZUUB "Stützstellenverteilung Drehzahl, 24 Sst." 0x811A3A nmot SstAUbSstUb 10200. nmot_ub_q40 24 0.00 10200. FORMAT "%5.0" DEPOSIT ABSOLUTE /end AXIS_PTS
/begin CHARACTERISTIC SP12LL_UM "maximale Differenz zwischen SP1S und SP2S unterhalb der Vollgas-Schwelle" VALUE 0x817ACC KwUb 4.845 spg_ub_q0p019 0.00 4.845 FORMAT "%5.3" /end CHARACTERISTIC
/begin CHARACTERISTIC SP12VG_UM "maximale Differenz zwischen SP1S und SP2S oberhalb der Vollgas-Schwelle" VALUE 0x817ACD KwUb 4.845 spg_ub_q0p019 0.00 4.845 FORMAT "%5.3" /end CHARACTERISTIC
/begin CHARACTERISTIC SP1ADC_DIF "max. Diff. zw. Sollwertpoti1 & Sollwertpoti1 vom Überw.Modul im stationären Fall" VALUE 0x817C6C KwUb 4.845 spg_ub_q0p019 0.00 4.845 FORMAT "%5.3" /end CHARACTERISTIC
/begin CHARACTERISTIC SP1_STAT "Bandbreite für die Erkennung auf sp1s stationär" VALUE 0x817C6D KwUb 4.845 spg_ub_q0p019 0.00 4.845 FORMAT "%5.3" /end CHARACTERISTIC
/begin CHARACTERISTIC SP1_STAT_T "Zeit für die Erkennung auf sp1s stationär" VALUE 0x817C6E KwUb 2.550 t10msxs_ub_b2p55 0.00 2.550 FORMAT "%5.3" /end CHARACTERISTIC
/begin CHARACTERISTIC SPSC_MIN_UM "" VALUE 0x817ACE KwUb 4.845 spg_ub_q0p019 0.00 4.845 FORMAT "%5.3" /end CHARACTERISTIC
/begin CHARACTERISTIC SPSC_T_UM "Fehlerzeit bei zueinander unplausiblen Sollwerten in der Funktionsüberwachung" VALUE 0x817ACF KwUb 10200.0 t40ms_ub_b10200 0.00 10200.0 FORMAT "%7.1" /end CHARACTERISTIC
/begin AXIS_PTS SPSNV08_UC "Stützstellenverteilung für Pedalwert im Befehlstest" 0x8122C2 spsn_uc SstAUbSstUb 4.845 spg_ub_q0p019 8 0.00 4.845 FORMAT "%5.3" DEPOSIT ABSOLUTE /end AXIS_PTS
/begin AXIS_PTS SPSNV08_UM "Stützstellenverteilung für Pedalwert in der Funktionsüberwachung" 0x817AF1 spsn_um SstAUbSstUb 4.845 spg_ub_q0p019 8 0.00 4.845 FORMAT "%5.3" DEPOSIT ABSOLUTE /end AXIS_PTS
/begin CHARACTERISTIC SPSN_DAT_UC "" VAL_BLK 0x812282 KwbUb 4.845 spg_ub_q0p019 0.00 4.845 FORMAT "%5.3" NUMBER 16 /end CHARACTERISTIC
/begin CHARACTERISTIC SPSVG_UM "Vollgas-Sollwert-Schwelle zur Umschaltung der maximalen Differenz SP1S-SP2S" VALUE 0x817AD0 KwUb 4.845 spg_ub_q0p019 0.00 4.845 FORMAT "%5.3" /end CHARACTERISTIC
/begin AXIS_PTS SRL03MFLRUW "" 0x81BBEC rl_w SstAUwSstUw 1535.977 rel_uw_q0p0234 4 0.00 1535.977 FORMAT "%8.3" DEPOSIT ABSOLUTE /end AXIS_PTS
/begin AXIS_PTS SRL03MFUW "" 0x81BBF6 rl_w SstAUwSstUw 1535.977 rel_uw_q0p0234 4 0.00 1535.977 FORMAT "%8.3" DEPOSIT ABSOLUTE /end AXIS_PTS
/begin AXIS_PTS SRL03ZUUB "Stützstellenverteilung relative Füllung, 3 Sst." 0x811A5C rl SstAUbSstUb 191.3 rel_ub_q0p75 3 0.00 191.3 FORMAT "%5.1" DEPOSIT ABSOLUTE /end AXIS_PTS
/begin AXIS_PTS SRL12ZUUB "Stützstellenverteilung relative Luftfüllung, 12 St." 0x811A84 rl SstAUbSstUb 191.3 rel_ub_q0p75 12 0.00 191.3 FORMAT "%5.1" DEPOSIT ABSOLUTE /end AXIS_PTS
/begin AXIS_PTS SRL16ZUUB "Stützstellenverteilung relative Füllung, 16 Sst." 0x811A91 rl SstAUbSstUb 191.3 rel_ub_q0p75 16 0.00 191.3 FORMAT "%5.1" DEPOSIT ABSOLUTE /end AXIS_PTS
/begin AXIS_PTS STM06__UB "Stützstellenverteilung Motortemperatur, 6 Sst." 0x8198CE tmot SstAUbSstUb 191.3 temp_ub_q0p75_o48 6 -48.00 143.3 FORMAT "%5.1" DEPOSIT ABSOLUTE /end AXIS_PTS
/begin CHARACTERISTIC TANFANWI "Tastverhältnis Halten für Prüfung Systemdichtheit" VALUE 0x81054A KwUb 100. tv_ub_b100 0.00 100. FORMAT "%4.0" /end CHARACTERISTIC
/begin CHARACTERISTIC TANSMN_UM "Ansauglufttemperaturschwelle zur Nachstartaufweitung in der Fkt.-Überwachung" VALUE 0x817A6C KwUb 191.3 temp_ub_q0p75_o48 -48.00 143.3 FORMAT "%5.1" /end CHARACTERISTIC
/begin CHARACTERISTIC TANW "Ansauglufttemperaturschwelle für Nockenwellenverstellung" VALUE 0x812803 KwUb 191.3 temp_ub_q0p75_o48 -48.00 143.3 FORMAT "%5.1" /end CHARACTERISTIC
/begin CHARACTERISTIC TANWF "Tastverhältnis Nockenwellenpos.reg. früh" VALUE 0x810024 KwUb 100. tv_ub_b100 0.00 100. FORMAT "%4.0" /end CHARACTERISTIC
/begin CHARACTERISTIC TANWSP "Tastverhältnis Nockenwellenpos.reg. spät" VALUE 0x810025 KwUb 100. tv_ub_b100 0.00 100. FORMAT "%4.0" /end CHARACTERISTIC
/begin CHARACTERISTIC TAWSP "Sperrzeit bis Adaption Spätanschlag erlaubt" VALUE 0x8190B7 KwUb 25.50 t100msxs_ub_b25p5 0.00 25.50 FORMAT "%5.2" /end CHARACTERISTIC
/begin CHARACTERISTIC TAWSPE "Zeit bis Adaption Spätanschlag beendet" VALUE 0x8190B8 KwUb 25.50 t100msxs_ub_b25p5 0.00 25.50 FORMAT "%5.2" /end CHARACTERISTIC
/begin CHARACTERISTIC TEFABE "Zeitdauer Diagnosen-Systemtest am Bandende" VALUE 0x81AC78 KwUw 393210.0 t6minxmin_q6 0.00 393210.0 FORMAT "%8.1" /end CHARACTERISTIC
/begin CHARACTERISTIC TFADTLMX "max. Zeitdauer für DM-TL Systemtest am Bandende" VALUE 0x81AC7A KwUw 6553.500 t100msxs_uw_b6553p5 0.00 6553.500 FORMAT "%8.3" /end CHARACTERISTIC
/begin CHARACTERISTIC TFGRENUM "Toleranzzeit für FGR-Einschaltung nach Erkennung FGR in der Funktionsüberwachung" VALUE 0x817A65 KwUb 10200.0 t40ms_ub_b10200 0.00 10200.0 FORMAT "%7.1" /end CHARACTERISTIC
/begin CHARACTERISTIC TFTEINI "Zeit für Erkennung TE Stop" VALUE 0x813E2C KwUw 6553.500 t100msxs_uw_b6553p5 0.00 6553.500 FORMAT "%8.3" /end CHARACTERISTIC
/begin CHARACTERISTIC TMNSMN_UM "Motortemperaturschwelle für die Nachstartaufweitung in der FKT.-Überwachung" VALUE 0x817A6D KwUb 191.3 temp_ub_q0p75_o48 -48.00 143.3 FORMAT "%5.1" /end CHARACTERISTIC
/begin CHARACTERISTIC TMNW "Motortemperaturschwelle für Nockenwellenverstellung" VALUE 0x812804 KwUb 191.3 temp_ub_q0p75_o48 -48.00 143.3 FORMAT "%5.1" /end CHARACTERISTIC
/begin CHARACTERISTIC TMTE "TMOT - Schwelle für Tankentlüftung" VALUE 0x81017F KwUb 191.3 temp_ub_q0p75_o48 -48.00 143.3 FORMAT "%5.1" /end CHARACTERISTIC
/begin CHARACTERISTIC TNWCOMN "Sperrzeit bis Adaption Halte-TV erlaubt" VALUE 0x810026 KwUb 255.000 t1ms_ub_b255 0.00 255.000 /end CHARACTERISTIC
/begin CHARACTERISTIC TQTEAB "Zeit für Absteuerung Spülrate Tankentlüftung" VALUE 0x810087 KwUb 81.28 t20msxs_ub_q0p32 0.3200 81.60 FORMAT "%5.2" /end CHARACTERISTIC
/begin CHARACTERISTIC TQTEDAB "Zeit für schnelle Absteuerung Spülrate Tankentlüftung" VALUE 0x810088 KwUb 81.28 t20msxs_ub_q0p32 0.3200 81.60 FORMAT "%5.2" /end CHARACTERISTIC
/begin CHARACTERISTIC TSUB "Schliesszeit" CURVE 0x814D31 FklWUb 26.11 TSZ 0.00 26.11 FORMAT "%5.2"
 /begin AXIS_DESCR FIX_AXIS UBATT UBQ 64 0.00 24.02 FORMAT "%5.2" FIX_AXIS_PAR 0 2 64 /end AXIS_DESCR
/end CHARACTERISTIC
/begin CHARACTERISTIC TTEAUS "Zeit nach Start bis TEB aktiv wird" VALUE 0x815FFC KwUw 6553.500 t100msxs_uw_q100 0.00 6553.500 FORMAT "%8.3" /end CHARACTERISTIC
/begin CHARACTERISTIC TUETM "Zeitübertemperatur nach Start" VALUE 0x815C98 KwUw 655.3500 TQ10 0.00 655.3500 FORMAT "%8.4" /end CHARACTERISTIC
/begin CHARACTERISTIC TVMXPR "Geschwindigkeit-Prädiktionshorizont für VMAX-Regelung" VALUE 0x81A6D3 KwUb 2.550 t10msxs_ub_b2p55 0.00 2.550 FORMAT "%5.3" /end CHARACTERISTIC
/begin CHARACTERISTIC TVSATEM "Verzögerungszeit für TEV zu nach SA-Bereitschaft" CURVE 0x810AE6 KlAUbSstUbWUb 5.100 t20msxs_ub_b5p1 0.00 5.100 FORMAT "%5.3"
 /begin AXIS_DESCR STD_AXIS tmot temp_ub_q0p75_o48 6 -48.00 143.3 FORMAT "%5.1" DEPOSIT ABSOLUTE /end AXIS_DESCR
/end CHARACTERISTIC
/begin CHARACTERISTIC TWNWS "Zeit für Nockenwellensollwinkel-Spätumschaltung" VALUE 0x814258 KwUw 655.3500 TQ10 0.00 655.3500 FORMAT "%8.4" /end CHARACTERISTIC
/begin CHARACTERISTIC TZTOL_UM "Toleranz zwischen Zeit- und Zahnzählererfassung in Timerinkrementen" VALUE 0x817CA0 KwUw 65535.00 dez 0.00 65535.00 FORMAT "%8.2" /end CHARACTERISTIC
/begin CHARACTERISTIC UETMOT "Motorübertemperatur-Schwelle" VALUE 0x811DB0 KwUb 191.3 temp_ub_q0p75_o48 -48.00 143.3 FORMAT "%5.1" /end CHARACTERISTIC
/begin CHARACTERISTIC UMRST_TV_UM "" VALUE 0x817A62 KwUb 255.0 dez 0.00 255.0 FORMAT "%5.1" /end CHARACTERISTIC
/begin CHARACTERISTIC VABSCH "Vmax-Regler-Abschaltschwelle, variantenkodiert" VALUE 0x81BC00 KwUw 511.9922 vfzg_uw_q0p00781 0.00 511.9922 FORMAT "%8.4" /end CHARACTERISTIC
/begin CHARACTERISTIC VABSCHLR "Vmax-Regler-Abschaltschwelle bei Low-Range-Betrieb" VALUE 0x81BC02 KwUw 511.9922 vfzg_uw_q0p00781 0.00 511.9922 FORMAT "%8.4" /end CHARACTERISTIC
/begin CHARACTERISTIC VFZG_DAT_UC "" VAL_BLK 0x815F98 KwbUw 511.9922 vfzg_uw_q0p00781 0.00 511.9922 FORMAT "%8.4" NUMBER 16 /end CHARACTERISTIC
/begin CHARACTERISTIC VGNWFM "Init.-Wert für NW-Verstellgeschwindigkeit Richtung früh" CURVE 0x81328C KlAUbSstUbWSb 1992. vnw_sb_b1000 -1000. 992. FORMAT "%4.0"
 /begin AXIS_DESCR STD_AXIS tmot temp_ub_q0p75_o48 5 -48.00 143.3 FORMAT "%5.1" DEPOSIT ABSOLUTE /end AXIS_DESCR
/end CHARACTERISTIC
/begin CHARACTERISTIC VGNWMN "Untergrenze für Verstellgeschwindigkeit (Betrag)" VALUE 0x81424E KwSw 1999.97 vnw_sw_b1000 -1000.00 999.969 FORMAT "%7.2" /end CHARACTERISTIC
/begin CHARACTERISTIC VGNWMX "Obergrenze für Verstellgeschwindigkeit (Betrag)" VALUE 0x814250 KwSw 1999.97 vnw_sw_b1000 -1000.00 999.969 FORMAT "%7.2" /end CHARACTERISTIC
/begin CHARACTERISTIC VGNWSM "Init.-Wert für NW-Verstellgeschwindigkeit Richtung spät" CURVE 0x813298 KlAUbSstUbWSb 1992. vnw_sb_b1000 -1000. 992. FORMAT "%4.0"
 /begin AXIS_DESCR STD_AXIS tmot temp_ub_q0p75_o48 5 -48.00 143.3 FORMAT "%5.1" DEPOSIT ABSOLUTE /end AXIS_DESCR
/end CHARACTERISTIC
/begin CHARACTERISTIC VHYST "Vmax-Hystereseschwelle, variantenkodiert" VALUE 0x81BC04 KwUw 511.9922 vfzg_uw_q0p00781 0.00 511.9922 FORMAT "%8.4" /end CHARACTERISTIC
/begin CHARACTERISTIC VHYSTLR "Vmax-Hystereseschwelle bei Low-Range-Betrieb" VALUE 0x81BC06 KwUw 511.9922 vfzg_uw_q0p00781 0.00 511.9922 FORMAT "%8.4" /end CHARACTERISTIC
/begin CHARACTERISTIC VMAXO "Vmax-Begrenzungswert (Linie mit 16 Varianten)" VALUE 0x81BC08 KwUw 511.9922 vfzg_uw_q0p00781 0.00 511.9922 FORMAT "%8.4" /end CHARACTERISTIC
/begin CHARACTERISTIC VMAXOLR "Vmax-Begrenzungswert bei Low-Range-Betrieb" VALUE 0x81BC0A KwUw 511.9922 vfzg_uw_q0p00781 0.00 511.9922 FORMAT "%8.4" /end CHARACTERISTIC
/begin CHARACTERISTIC VMAXP "P-Glied bei VMAX-Regelung" VALUE 0x81A6D4 KwUb 99.70 rel_ub_q0p391 0.00 99.70 FORMAT "%5.2" /end CHARACTERISTIC
/begin CHARACTERISTIC VMAXPLR "P-Glied bei VMAX-Regelung, Low Range aktiv" VALUE 0x81A6D5 KwUb 99.70 rel_ub_q0p391 0.00 99.70 FORMAT "%5.2" /end CHARACTERISTIC
/begin CHARACTERISTIC VMIN_UC "Minimalgeschwindigkeit für FGR-Betrieb im Befehlstest" VALUE 0x815FB8 KwUw 511.9922 vfzg_uw_q0p00781 0.00 511.9922 FORMAT "%8.4" /end CHARACTERISTIC
/begin CHARACTERISTIC VMIN_UM "Minimalgeschwindigkeit für FGR-Betrieb in der Funktionsüberwachung" VALUE 0x817CA4 KwUw 511.9922 vfzg_uw_q0p00781 0.00 511.9922 FORMAT "%8.4" /end CHARACTERISTIC
/begin CHARACTERISTIC VVORH "Vmax-Vorhaltschwelle, variantenkodiert" VALUE 0x81BC0C KwUw 511.9922 vfzg_uw_q0p00781 0.00 511.9922 FORMAT "%8.4" /end CHARACTERISTIC
/begin CHARACTERISTIC VVORHLR "Vmax-Vorhaltschwelle bei Low-Range-Betrieb" VALUE 0x81BC0E KwUw 511.9922 vfzg_uw_q0p00781 0.00 511.9922 FORMAT "%8.4" /end CHARACTERISTIC
/begin CHARACTERISTIC WAIT_T_UM "Wartezeit für Reset-Tastverhältnis aus der Funktionsüberwachung" VALUE 0x817C9C KwUw 9999.155 t_wdt_high 0.00 9999.155 FORMAT "%8.3" /end CHARACTERISTIC
/begin CHARACTERISTIC WEESTS "Winkelgrenze Einspritzende für sim. Startauslösungen" VALUE 0x814004 DI__Kwub__________ 717.3 WQ720 0.00 717.3 FORMAT "%5.1" /end CHARACTERISTIC
/begin CHARACTERISTIC WESBM "Winkel Einlaß-schließt vor SW-Bezugsmarke (tR)" VALUE 0x814003 DI__Kwub__________ 717.3 WQ720 0.00 717.3 FORMAT "%5.1" /end CHARACTERISTIC
/begin CHARACTERISTIC WKORA "Ansaugluft Korrekturzündwinkel" CURVE 0x813E62 KlAUbSstUbWSb 191.3 zw_sb_q0p75 -96.00 95.25 FORMAT "%5.2"
 /begin AXIS_DESCR STD_AXIS tans temp_ub_q0p75_o48 3 -48.00 143.3 FORMAT "%5.1" DEPOSIT ABSOLUTE /end AXIS_DESCR
/end CHARACTERISTIC
/begin CHARACTERISTIC WNWAIMN2 "max. Adaptionsgrenze" VALUE 0x81BE20 KwSw 255.996 wkw_sw_b128 -128.000 127.996 FORMAT "%7.3" /end CHARACTERISTIC
/begin CHARACTERISTIC WNWASA "Winkel Auslaßventil schließt am NW-Anschlag" VALUE 0x810027 KwSb 127.500 wkw_sb_q0p5 -64.0000 63.5000 FORMAT "%7.4" /end CHARACTERISTIC
/begin CHARACTERISTIC WNWASMN "Untere Begrenzung Adaption NW-Spätanschlag (Richtung früh)" VALUE 0x8142D4 KwSw 255.996 wkw_sw_b128 -128.000 127.996 FORMAT "%7.3" /end CHARACTERISTIC
/begin CHARACTERISTIC WNWASMX "Obere Begrenzung Adaption NW-Spätanschlag (Richtung spät)" VALUE 0x8142D6 KwSw 255.996 wkw_sw_b128 -128.000 127.996 FORMAT "%7.3" /end CHARACTERISTIC
/begin CHARACTERISTIC WNWEOA "Winkel Einlaßventil öffnet am NW-Anschlag" VALUE 0x810028 KwSb 127.500 wkw_sb_q0p5 -64.0000 63.5000 FORMAT "%7.4" /end CHARACTERISTIC
/begin CHARACTERISTIC WNWFVMN "min. Sollwinkelbegrenzung bei Fehler Geschwindigkeitssignal" VALUE 0x812805 KwUb 63.7500 wkw_ub_q0p25 0.00 63.7500 FORMAT "%7.4" /end CHARACTERISTIC
/begin CHARACTERISTIC WNWIMN "Untere Grenze für NW-Stellung" VALUE 0x8142D8 KwSw 255.996 wkw_sw_b128 -128.000 127.996 FORMAT "%7.3" /end CHARACTERISTIC
/begin CHARACTERISTIC WNWIMX "Obere Grenze für NW-Stellung" VALUE 0x8142DA KwSw 255.996 wkw_sw_b128 -128.000 127.996 FORMAT "%7.3" /end CHARACTERISTIC
/begin CHARACTERISTIC WNWKM "Korrekturwinkel Nockenwelle über Motortemperatur" CURVE 0x81A8DA KlAUbSstUbWSb 63.7500 wkw_sb_q0p25 -32.0000 31.7500 FORMAT "%7.4"
 /begin AXIS_DESCR STD_AXIS tmot temp_ub_q0p75_o48 4 -48.00 143.3 FORMAT "%5.1" DEPOSIT ABSOLUTE /end AXIS_DESCR
/end CHARACTERISTIC
/begin CHARACTERISTIC WNWKN "Korrekturwinkel Nockenwelle über Drehzahl" CURVE 0x81A8E4 KlAUbSstUbWSb 63.7500 wkw_sb_q0p25 -32.0000 31.7500 FORMAT "%7.4"
 /begin AXIS_DESCR STD_AXIS nmot nmot_ub_q40 5 0.00 10200. FORMAT "%5.0" DEPOSIT ABSOLUTE /end AXIS_DESCR
/end CHARACTERISTIC
/begin CHARACTERISTIC WNWMN "minimaler Nockenwellensollwinkel" VALUE 0x812806 KwUb 63.7500 wkw_ub_q0p25 0.00 63.7500 FORMAT "%7.4" /end CHARACTERISTIC
/begin CHARACTERISTIC WNWMX "maximaler Nockenwellensollwinkel" VALUE 0x812807 KwUb 63.7500 wkw_ub_q0p25 0.00 63.7500 FORMAT "%7.4" /end CHARACTERISTIC
/begin CHARACTERISTIC WNWSPS "Sollwinkel der Nockenwelle in Position Spätanschlag" VAL_BLK 0x8142DC KwbUw 2047.97 wkw_uw_b2048 0.00 2047.97 FORMAT "%7.2" NUMBER 8 /end CHARACTERISTIC
/begin CHARACTERISTIC WNWV "Sollwinkel für Nockenwelle abhängig von Fahrzeuggeschwindigkeit" CURVE 0x812808 KlAUbSstUbWUb 63.7500 wkw_ub_q0p25 0.00 63.7500 FORMAT "%7.4"
 /begin AXIS_DESCR STD_AXIS vfzg vfzg_ub_q1p25 12 0.00 318.8 FORMAT "%5.1" DEPOSIT ABSOLUTE /end AXIS_DESCR
/end CHARACTERISTIC
/begin CHARACTERISTIC WNWVLN "Sollwinkel für Nockenwelle in der Vollast" CURVE 0x812821 KlAUbSstUbWUb 63.7500 wkw_ub_q0p25 0.00 63.7500 FORMAT "%7.4"
 /begin AXIS_DESCR STD_AXIS nmot nmot_ub_q40 16 0.00 10200. FORMAT "%5.0" DEPOSIT ABSOLUTE /end AXIS_DESCR
/end CHARACTERISTIC
/begin CHARACTERISTIC WPHN "Phasengang" CURVE 0x819003 GklWSb 191.3 zw_sb_q0p75 -96.00 95.25 FORMAT "%5.2"
 /begin AXIS_DESCR COM_AXIS nmot nmot_ub_q40 8 0.00 10200. AXIS_PTS_REF SNM08__UB /end AXIS_DESCR
/end CHARACTERISTIC
/begin CHARACTERISTIC WSNW "Schwelle Nockenwellenwinkel (Unempfindlichkeitsbereich)" VALUE 0x814252 KwSw 255.996 wkw_sw_b128 -128.000 127.996 FORMAT "%7.3" /end CHARACTERISTIC
/begin CHARACTERISTIC WSNWAF "Schwelle NW-Winkel f. Adaption Verstellgeschw. und Halte-TV (früh)" VALUE 0x814254 KwSw 255.996 wkw_sw_b128 -128.000 127.996 FORMAT "%7.3" /end CHARACTERISTIC
/begin CHARACTERISTIC WSNWAS "Schwelle NW-Winkel f. Adaption Verstellgeschw. und Halte-TV" VALUE 0x814256 KwSw 255.996 wkw_sw_b128 -128.000 127.996 FORMAT "%7.3" /end CHARACTERISTIC
/begin CHARACTERISTIC WSNWS "Toleranzwinkel für Sollwinkelgleichheit" VALUE 0x8190BB KwUb 63.7500 wkw_ub_q0p25 0.00 63.7500 FORMAT "%7.4" /end CHARACTERISTIC
/begin CHARACTERISTIC ZBFIL "Zeitkonstante für Beschleunigungsfilter" VALUE 0x8100A3 KwUb 2.54000 zk10msxs_ub_b2p55 0.0100000 2.55000 FORMAT "%7.5" /end CHARACTERISTIC
/begin CHARACTERISTIC ZBTEML "Integrationsgeschwindigkeit Beladungsfaktor" CURVE 0x8196E0 GklWUb 6.101 perio_ub_b6p125 0.00 6.101 FORMAT "%5.3" /begin AXIS_DESCR COM_AXIS ml m_ub_b1020 6 0.00 1020. AXIS_PTS_REF SML06TEUB /end AXIS_DESCR /end CHARACTERISTIC
/begin CHARACTERISTIC ZETATE "Rampensteilheit für Veränderung Motorwirkungsgrad durch Tankentlüftung" VALUE 0x81ABFA KwUw 1279.590 rgrad_uw_b1280 0.3906250 1279.980 FORMAT "%8.3" /end CHARACTERISTIC
/begin CHARACTERISTIC ZIVMAX "I-Steigung für VMAX-Regelung" VALUE 0x81A6D6 KwUb 25.4996 zk100msxs_ub_b25p5 0.100392 25.6000 FORMAT "%7.4" /end CHARACTERISTIC
/begin CHARACTERISTIC ZIVMAXLR "I-Steigung für VMAX-Regelung bei Low Range" VALUE 0x81A6D7 KwUb 25.4996 zk100msxs_ub_b25p5 0.100392 25.6000 FORMAT "%7.4" /end CHARACTERISTIC
/begin CHARACTERISTIC ZKFTEAD "Zeitkonstante gefilteter Faktor Beladung Spülstrom bei Tankentlüftung" VALUE 0x81ABFC KwUw 6553.4999985 zk100msxs_uw_b6553 0.10000152590 6553.6000000 FORMAT "%12.7" /end CHARACTERISTIC
/begin CHARACTERISTIC ZKWNFIL "Zeitkonstante für die Filterung von wnwue" VALUE 0x8132A4 KwUw 655.350000 zk10msxs_uw_b655 0.0100001526 655.360000 FORMAT "%10.6" /end CHARACTERISTIC
/begin CHARACTERISTIC ZNWVENTM "Zeitkonstante der Verstelleinheit" CURVE 0x81054B KlAUbSstUbWUb 255.000 t1ms_ub_b255 0.00 255.000
 /begin AXIS_DESCR STD_AXIS tmot temp_ub_q0p75_o48 5 -48.00 143.3 FORMAT "%5.1" DEPOSIT ABSOLUTE /end AXIS_DESCR
/end CHARACTERISTIC
/begin CHARACTERISTIC ZWAPPL "Applikationsschnittstelle Zündwinkelverstellung" VALUE 0x810014 KwSb 191.3 zw_sb_q0p75 -96.00 95.25 FORMAT "%5.2" /end CHARACTERISTIC
/begin CHARACTERISTIC ZWC_T_UM "Fehlertoleranzzeit der Zündwinkelüberwachung in der Funktionsüberw." VALUE 0x817A6E KwUb 255.0 dez 0.00 255.0 FORMAT "%5.1" /end CHARACTERISTIC
/begin CHARACTERISTIC ZWOUT_DAT_UC "" VAL_BLK 0x812292 KwbUb 191.3 zw_sb_q0p75 0.00 191.3 FORMAT "%5.1" NUMBER 16 /end CHARACTERISTIC
/begin CHARACTERISTIC ZYLANZ_UM "Zylinderzahl für die Zündwinkelüberwachung in der Funktionsüberw." VALUE 0x817A6F KwUb 255.0 dez 0.00 255.0 FORMAT "%5.1" /end CHARACTERISTIC
/begin CHARACTERISTIC ZZWMNST "Zeitkonstante für Abregelung ZW-Begrenzung im Nachstart" VALUE 0x81AC4A KwUw 13107.0000 zk200msxs_uw_b13107 0.200003052 13107.2000 FORMAT "%10.4" /end CHARACTERISTIC
/begin CHARACTERISTIC _2SG "" VALUE 0x813F00 KwUb 255.0 dez 0.00 255.0 FORMAT "%5.1" /end CHARACTERISTIC
/begin CHARACTERISTIC _720_DIV_BY_ZYLZA "" VALUE 0x813F01 KwUb 255.0 dez 0.00 255.0 FORMAT "%5.1" /end CHARACTERISTIC
/begin CHARACTERISTIC _CCmfaICI "" VALUE 0x813F02 KwUb 255.0 dez 0.00 255.0 FORMAT "%5.1" /end CHARACTERISTIC
/begin CHARACTERISTIC _DT_3M8 "" VALUE 0x813F40 KwUw 65535.00 dez 0.00 65535.00 FORMAT "%8.2" /end CHARACTERISTIC
/begin CHARACTERISTIC _DT_3P8 "" VALUE 0x813F42 KwUw 65535.00 dez 0.00 65535.00 FORMAT "%8.2" /end CHARACTERISTIC
/begin CHARACTERISTIC _DT_4M8 "" VALUE 0x813F44 KwUw 65535.00 dez 0.00 65535.00 FORMAT "%8.2" /end CHARACTERISTIC
/begin CHARACTERISTIC _DT_4P8 "" VALUE 0x813F46 KwUw 65535.00 dez 0.00 65535.00 FORMAT "%8.2" /end CHARACTERISTIC
/begin CHARACTERISTIC _DT_5M8 "" VALUE 0x813F48 KwUw 65535.00 dez 0.00 65535.00 FORMAT "%8.2" /end CHARACTERISTIC
/begin CHARACTERISTIC _DT_5P8 "" VALUE 0x813F4A KwUw 65535.00 dez 0.00 65535.00 FORMAT "%8.2" /end CHARACTERISTIC
/begin CHARACTERISTIC _DVEADA "" VALUE 0x813F03 KwUb 255.0 dez 0.00 255.0 FORMAT "%5.1" /end CHARACTERISTIC
/begin CHARACTERISTIC _EGAS "" VALUE 0x813F04 KwUb 255.0 dez 0.00 255.0 FORMAT "%5.1" /end CHARACTERISTIC
/begin CHARACTERISTIC _EVMB "" VALUE 0x813F05 KwUb 255.0 dez 0.00 255.0 FORMAT "%5.1" /end CHARACTERISTIC
/begin CHARACTERISTIC _EVMB2 "" VALUE 0x813F06 KwUb 255.0 dez 0.00 255.0 FORMAT "%5.1" /end CHARACTERISTIC
/begin CHARACTERISTIC _EVOFS "" VALUE 0x813F07 KwUb 255.0 dez 0.00 255.0 FORMAT "%5.1" /end CHARACTERISTIC
/begin CHARACTERISTIC _FRAME_MAX "" VALUE 0x813F4C KwUw 65535.00 dez 0.00 65535.00 FORMAT "%8.2" /end CHARACTERISTIC
/begin CHARACTERISTIC _FRAME_MIN "" VALUE 0x813F4E KwUw 65535.00 dez 0.00 65535.00 FORMAT "%8.2" /end CHARACTERISTIC
/begin CHARACTERISTIC _FREQ_CPU "" VALUE 0x813F50 KwUw 65535.00 dez 0.00 65535.00 FORMAT "%8.2" /end CHARACTERISTIC
/begin CHARACTERISTIC _IKRSCHWELLE "" VALUE 0x813F08 KwUb 255.0 dez 0.00 255.0 FORMAT "%5.1" /end CHARACTERISTIC
/begin CHARACTERISTIC _INGASOS "" VALUE 0x813F09 KwUb 255.0 dez 0.00 255.0 FORMAT "%5.1" /end CHARACTERISTIC
/begin CHARACTERISTIC _NWS "" VALUE 0x813F0A KwUb 255.0 dez 0.00 255.0 FORMAT "%5.1" /end CHARACTERISTIC
/begin CHARACTERISTIC _PECVFZ_RELOAD "" VALUE 0x813F0B KwUb 255.0 dez 0.00 255.0 FORMAT "%5.1" /end CHARACTERISTIC
/begin CHARACTERISTIC _REDMX "" VALUE 0x813F0C KwUb 255.0 dez 0.00 255.0 FORMAT "%5.1" /end CHARACTERISTIC
/begin CHARACTERISTIC _SHK_OT "" VALUE 0x813F0D KwUb 255.0 dez 0.00 255.0 FORMAT "%5.1" /end CHARACTERISTIC
/begin CHARACTERISTIC _STERHK "" VALUE 0x813F0E KwUb 255.0 dez 0.00 255.0 FORMAT "%5.1" /end CHARACTERISTIC
/begin CHARACTERISTIC _STERSY "" VALUE 0x813F0F KwUb 255.0 dez 0.00 255.0 FORMAT "%5.1" /end CHARACTERISTIC
/begin CHARACTERISTIC _STERVK "" VALUE 0x813F10 KwUb 255.0 dez 0.00 255.0 FORMAT "%5.1" /end CHARACTERISTIC
/begin CHARACTERISTIC _STETLR "" VALUE 0x813F11 KwUb 255.0 dez 0.00 255.0 FORMAT "%5.1" /end CHARACTERISTIC
/begin CHARACTERISTIC _TN "" VALUE 0x813F12 KwUb 255.0 dez 0.00 255.0 FORMAT "%5.1" /end CHARACTERISTIC
/begin CHARACTERISTIC _TURBO "" VALUE 0x813F13 KwUb 255.0 dez 0.00 255.0 FORMAT "%5.1" /end CHARACTERISTIC
/begin CHARACTERISTIC _TWO_ZYLZA "" VALUE 0x813F14 KwUb 255.0 dez 0.00 255.0 FORMAT "%5.1" /end CHARACTERISTIC
/begin CHARACTERISTIC _WKW075 "" VALUE 0x813F15 KwUb 255.0 dez 0.00 255.0 FORMAT "%5.1" /end CHARACTERISTIC
/begin CHARACTERISTIC _WMAX "" VALUE 0x813F16 KwSb 255.0 dez -128.0 127.0 FORMAT "%5.1" /end CHARACTERISTIC
/begin CHARACTERISTIC _WMIN "" VALUE 0x813F17 KwSb 255.0 dez -128.0 127.0 FORMAT "%5.1" /end CHARACTERISTIC
/begin CHARACTERISTIC _ZYLMASK "" VALUE 0x813F18 KwUb 255.0 dez 0.00 255.0 FORMAT "%5.1" /end CHARACTERISTIC
/begin CHARACTERISTIC _ZYLZA "" VALUE 0x813F19 KwUb 255.0 dez 0.00 255.0 FORMAT "%5.1" /end CHARACTERISTIC
/begin CHARACTERISTIC _ZZBANK "" VALUE 0x813F1A KwUb 255.0 dez 0.00 255.0 FORMAT "%5.1" /end CHARACTERISTIC
/begin MEASUREMENT adcc_c_um "Fehlerzähler bei zueinander unplausiblen ADC-Werten für sp1s" UBYTE t10msxs_ub_b2p55 1 100 0 2.55 FORMAT "%5.3" ECU_ADDRESS 0x382E81 /end MEASUREMENT
/begin MEASUREMENT alc_old_uc "" UBYTE dez 1 100 0 255 FORMAT "%5.1" ECU_ADDRESS 0x380D04 /end MEASUREMENT
/begin MEASUREMENT alc_old_um "" UBYTE dez 1 100 0 255 FORMAT "%5.1" ECU_ADDRESS 0x382E65 /end MEASUREMENT
/begin MEASUREMENT alv_old_um "" UBYTE dez 1 100 0 255 FORMAT "%5.1" ECU_ADDRESS 0x382E69 /end MEASUREMENT
/begin MEASUREMENT anwws "Zahl Spät-TVs abzüglich Zahl Früh-TVs bei stat. NW-Sollwert" SBYTE dez_sb 1 100 -128 127 FORMAT "%4.0" ARRAY_SIZE 2 ECU_ADDRESS 0x38093A /end MEASUREMENT
/begin MEASUREMENT asc_alive_a_uc "" UBYTE dez 1 100 0 255 FORMAT "%5.1" ECU_ADDRESS 0x380CF9 /end MEASUREMENT
/begin MEASUREMENT asc_alive_uc "" UBYTE dez 1 100 0 255 FORMAT "%5.1" ECU_ADDRESS 0x380CFA /end MEASUREMENT
/begin MEASUREMENT asic_id "" UWORD dez 1 100 0 65535 FORMAT "%8.2" ECU_ADDRESS 0x382302 /end MEASUREMENT
/begin MEASUREMENT ausgh_c_um "Heilungszähler für Fehler in der zyklischen RAM-Prüfung der Funktionsüberwachung" UBYTE t40ms_ub_b10200 1 100 0 10200 FORMAT "%7.1" ECU_ADDRESS 0x382E86 /end MEASUREMENT
/begin MEASUREMENT ausg_c_um "Fehlerzähler für zyklische RAM-Prüfung in der Funktionsüberwachung" UBYTE dezsub1 1 100 1 256 FORMAT "%5.1" ECU_ADDRESS 0x382E87 /end MEASUREMENT
/begin MEASUREMENT auszh_c_um "Heilungszähler für Fehler in der zyklischen ROM-Prüfung der Funktionsüberwachung" UBYTE t40ms_ub_b10200 1 100 0 10200 FORMAT "%7.1" ECU_ADDRESS 0x382E88 /end MEASUREMENT
/begin MEASUREMENT ausz_c_um "Fehlerzähler für zyklische ROM-Prüfung in der Funktionsüberwachung" UBYTE dezsub1 1 100 1 256 FORMAT "%5.1" ECU_ADDRESS 0x382E89 /end MEASUREMENT
/begin MEASUREMENT bfzglf "Fahrzeuglängsbeschleunigung gefiltert" SBYTE bfzg_sb_q0p217 1 100 -27.776 27.559 FORMAT "%5.2" ECU_ADDRESS 0x380CE4 /end MEASUREMENT
/begin MEASUREMENT bgCtr "" UWORD dez 1 100 0 65535 FORMAT "%8.2" ECU_ADDRESS 0x3824AE /end MEASUREMENT
/begin MEASUREMENT brems_c_um "Entprellzähler für betätigte Bremse in der Funktionsüberwachung" UBYTE t40ms_ub_b10200 1 100 0 10200 FORMAT "%7.1" ECU_ADDRESS 0x382E48 /end MEASUREMENT
/begin MEASUREMENT bz_uc "" UBYTE dez 1 100 0 255 FORMAT "%5.1" ECU_ADDRESS 0x380D08 /end MEASUREMENT
/begin MEASUREMENT bz_um "" UBYTE dez 1 100 0 255 FORMAT "%5.1" ECU_ADDRESS 0x382E6A /end MEASUREMENT
/begin MEASUREMENT B_acc_uc "" UWORD B_TRUE 1 100 0 1 BIT_MASK 0x20 FORMAT "%13.11" ECU_ADDRESS 0xFDC8 /end MEASUREMENT
/begin MEASUREMENT B_adhtv "Adaption Halte-TV ist freigegeben" UBYTE B_TRUE 1 100 0 1 BIT_MASK 0x4 FORMAT "%13.11" ECU_ADDRESS 0x38093C /end MEASUREMENT
/begin MEASUREMENT B_admtllff "" UBYTE B_TRUE 1 100 0 1 BIT_MASK 0x1 FORMAT "%13.11" ECU_ADDRESS 0x380A0F /end MEASUREMENT
/begin MEASUREMENT B_admtllOld "" UBYTE B_TRUE 1 100 0 1 BIT_MASK 0x4 FORMAT "%13.11" ECU_ADDRESS 0x382F30 /end MEASUREMENT
/begin MEASUREMENT B_auswrt "" UBYTE B_TRUE 1 100 0 1 BIT_MASK 0x2 FORMAT "%13.11" ECU_ADDRESS 0x38315D /end MEASUREMENT
/begin MEASUREMENT B_brems_um "Bedingung Bremse getreten für die Funktionsüberwachung" UBYTE B_TRUE 1 100 0 1 BIT_MASK 0x1 FORMAT "%13.11" ECU_ADDRESS 0x382E42 /end MEASUREMENT
/begin MEASUREMENT B_bsl_um "erkannter Low-Pegel am FGR-Bedienhebelschalter Beschleunigen in Funktionsüberw." UBYTE B_TRUE 1 100 0 1 BIT_MASK 0x10 FORMAT "%13.11" ECU_ADDRESS 0x382E42 /end MEASUREMENT
/begin MEASUREMENT B_bt "Bedingung Bauteileansteuerung  allgemein" UWORD B_TRUE 1 100 0 1 BIT_MASK 0x2000 FORMAT "%13.11" ECU_ADDRESS 0xFD68 /end MEASUREMENT
/begin MEASUREMENT B_btanskl "Bedingung Bauteileansteuerung: Ansaugklappe" UWORD B_TRUE 1 100 0 1 BIT_MASK 0x4000 FORMAT "%13.11" ECU_ADDRESS 0xFD68 /end MEASUREMENT
/begin MEASUREMENT B_btdmmv "Bedingung Bauteileansteuerung; DM-TL Magnetventil" UWORD B_TRUE 1 100 0 1 BIT_MASK 0x8000 FORMAT "%13.11" ECU_ADDRESS 0xFD68 /end MEASUREMENT
/begin MEASUREMENT B_btdmpm "Bedingung Bauteileansteuerung; DM-TL Pumpenmotor" UWORD B_TRUE 1 100 0 1 BIT_MASK 0x1 FORMAT "%13.11" ECU_ADDRESS 0xFD6A /end MEASUREMENT
/begin MEASUREMENT B_btebl "Bedingung Bauteileansteuerung; elektr. E-Box Lüfter" UWORD B_TRUE 1 100 0 1 BIT_MASK 0x2 FORMAT "%13.11" ECU_ADDRESS 0xFD6A /end MEASUREMENT
/begin MEASUREMENT B_btekp "Bedingung Bauteileansteuerung; Elektrokraftstoffpumpe" UWORD B_TRUE 1 100 0 1 BIT_MASK 0x4 FORMAT "%13.11" ECU_ADDRESS 0xFD6A /end MEASUREMENT
/begin MEASUREMENT B_btev1 "" UWORD B_TRUE 1 100 0 1 BIT_MASK 0x8 FORMAT "%13.11" ECU_ADDRESS 0xFD6A /end MEASUREMENT
/begin MEASUREMENT B_btev2 "" UWORD B_TRUE 1 100 0 1 BIT_MASK 0x10 FORMAT "%13.11" ECU_ADDRESS 0xFD6A /end MEASUREMENT
/begin MEASUREMENT B_btev3 "" UWORD B_TRUE 1 100 0 1 BIT_MASK 0x20 FORMAT "%13.11" ECU_ADDRESS 0xFD6A /end MEASUREMENT
/begin MEASUREMENT B_btev4 "" UWORD B_TRUE 1 100 0 1 BIT_MASK 0x40 FORMAT "%13.11" ECU_ADDRESS 0xFD6A /end MEASUREMENT
/begin MEASUREMENT B_btev5 "" UWORD B_TRUE 1 100 0 1 BIT_MASK 0x80 FORMAT "%13.11" ECU_ADDRESS 0xFD6A /end MEASUREMENT
/begin MEASUREMENT B_btev6 "" UWORD B_TRUE 1 100 0 1 BIT_MASK 0x100 FORMAT "%13.11" ECU_ADDRESS 0xFD6A /end MEASUREMENT
/begin MEASUREMENT B_btev7 "" UWORD B_TRUE 1 100 0 1 BIT_MASK 0x200 FORMAT "%13.11" ECU_ADDRESS 0xFD6A /end MEASUREMENT
/begin MEASUREMENT B_btev8 "" UWORD B_TRUE 1 100 0 1 BIT_MASK 0x400 FORMAT "%13.11" ECU_ADDRESS 0xFD6A /end MEASUREMENT
/begin MEASUREMENT B_bthdm "Bedingung Bauteileansteuerung: DM-TL Heizung" UWORD B_TRUE 1 100 0 1 BIT_MASK 0x800 FORMAT "%13.11" ECU_ADDRESS 0xFD6A /end MEASUREMENT
/begin MEASUREMENT B_bthsh "Bedingung Bauteileansteuerung; LS-Heizung hinter Kat." UWORD B_TRUE 1 100 0 1 BIT_MASK 0x1000 FORMAT "%13.11" ECU_ADDRESS 0xFD6A /end MEASUREMENT
/begin MEASUREMENT B_bthsh2 "Bedingung Bauteileansteuerung; LS-Heizung hinter Kat. Bank 2" UWORD B_TRUE 1 100 0 1 BIT_MASK 0x2000 FORMAT "%13.11" ECU_ADDRESS 0xFD6A /end MEASUREMENT
/begin MEASUREMENT B_bthsv "Bedingung Bauteileansteuerung; LS-Heizung vor Kat." UWORD B_TRUE 1 100 0 1 BIT_MASK 0x4000 FORMAT "%13.11" ECU_ADDRESS 0xFD6A /end MEASUREMENT
/begin MEASUREMENT B_bthsv2 "Bedingung Bauteileansteuerung; LS-Heizung vor Kat. Bank 2" UWORD B_TRUE 1 100 0 1 BIT_MASK 0x8000 FORMAT "%13.11" ECU_ADDRESS 0xFD6A /end MEASUREMENT
/begin MEASUREMENT B_btkos "Bedingung Bauteileansteuerung; Klimakompressor" UWORD B_TRUE 1 100 0 1 BIT_MASK 0x1 FORMAT "%13.11" ECU_ADDRESS 0xFD6C /end MEASUREMENT
/begin MEASUREMENT B_btldp "Bedingung Bauteileansteuerung; Leckdiagnosepumpe" UWORD B_TRUE 1 100 0 1 BIT_MASK 0x2 FORMAT "%13.11" ECU_ADDRESS 0xFD6C /end MEASUREMENT
/begin MEASUREMENT B_btslp "Bedingung Bauteileansteuerung; Sekundärluftpumpe" UWORD B_TRUE 1 100 0 1 BIT_MASK 0x4 FORMAT "%13.11" ECU_ADDRESS 0xFD6C /end MEASUREMENT
/begin MEASUREMENT B_btslv "Bedingung Bauteileansteuerung; Sekundärluftventil" UWORD B_TRUE 1 100 0 1 BIT_MASK 0x8 FORMAT "%13.11" ECU_ADDRESS 0xFD6C /end MEASUREMENT
/begin MEASUREMENT B_btsta "Bedingung Bauteileansteuerung; Startrelais" UWORD B_TRUE 1 100 0 1 BIT_MASK 0x10 FORMAT "%13.11" ECU_ADDRESS 0xFD6C /end MEASUREMENT
/begin MEASUREMENT B_bttev "Bedingung Bauteileansteuerung; Tankentlüftungsventil" UWORD B_TRUE 1 100 0 1 BIT_MASK 0x20 FORMAT "%13.11" ECU_ADDRESS 0xFD6C /end MEASUREMENT
/begin MEASUREMENT B_clbacc "Bedingung löschen des Bits B_acc über KWP2000* Service" UWORD B_TRUE 1 100 0 1 BIT_MASK 0x200 FORMAT "%13.11" ECU_ADDRESS 0xFD46 /end MEASUREMENT
/begin MEASUREMENT B_clkatfz "Bedingung Variantenerkennung zurücksetzen (mit Adaptionswerte löschen)" UWORD B_TRUE 1 100 0 1 BIT_MASK 0x400 FORMAT "%13.11" ECU_ADDRESS 0xFD46 /end MEASUREMENT
/begin MEASUREMENT B_dcdis_um "Fehlerreaktions-Info der Funktionsüberwachung (Abschaltung der DK-Steller-ES)" UBYTE B_TRUE 1 100 0 1 BIT_MASK 0x1 FORMAT "%13.11" ECU_ADDRESS 0x382E41 /end MEASUREMENT
/begin MEASUREMENT B_dmmvet "Bedingung Endstufentest DMTL-Magnetventil an" UWORD B_TRUE 1 100 0 1 BIT_MASK 0x40 FORMAT "%13.11" ECU_ADDRESS 0xFD6C /end MEASUREMENT
/begin MEASUREMENT B_dmpmet "Bedingung Endstufentest DMTL-Pumpenmotor an" UWORD B_TRUE 1 100 0 1 BIT_MASK 0x80 FORMAT "%13.11" ECU_ADDRESS 0xFD6C /end MEASUREMENT
/begin MEASUREMENT B_eblet "Stellglieddiagnose E-Box Lüftersteuerung: Eingriff Tester" UWORD B_TRUE 1 100 0 1 BIT_MASK 0x100 FORMAT "%13.11" ECU_ADDRESS 0xFD6C /end MEASUREMENT
/begin MEASUREMENT B_eep2err "" UWORD B_TRUE 1 100 0 1 BIT_MASK 0x1 FORMAT "%13.11" ECU_ADDRESS 0xFDDC /end MEASUREMENT
/begin MEASUREMENT B_eeperr "" UWORD B_TRUE 1 100 0 1 BIT_MASK 0x2 FORMAT "%13.11" ECU_ADDRESS 0xFDDC /end MEASUREMENT
/begin MEASUREMENT B_ekpet "Stellglieddiagnose EKP: Eingriff Tester" UWORD B_TRUE 1 100 0 1 BIT_MASK 0x200 FORMAT "%13.11" ECU_ADDRESS 0xFD6C /end MEASUREMENT
/begin MEASUREMENT B_estart "Bedingung KL 50 ein" UWORD B_TRUE 1 100 0 1 BIT_MASK 0x4 FORMAT "%13.11" ECU_ADDRESS 0xFDBE /end MEASUREMENT
/begin MEASUREMENT B_etret "Bedingung elektr. Thermostatregelung ein über Tester" UWORD B_TRUE 1 100 0 1 BIT_MASK 0x400 FORMAT "%13.11" ECU_ADDRESS 0xFD6C /end MEASUREMENT
/begin MEASUREMENT B_ews_ok "" UBYTE B_TRUE 1 100 0 1 BIT_MASK 0x1 FORMAT "%13.11" ECU_ADDRESS 0x38315D /end MEASUREMENT
/begin MEASUREMENT B_fa "Bedingung Funktionsanforderung allgemein" UWORD B_TRUE 1 100 0 1 BIT_MASK 0x4000 FORMAT "%13.11" ECU_ADDRESS 0xFD4A /end MEASUREMENT
/begin MEASUREMENT B_fadldp "Bedingung Funktionsanforderung DLDP-Funktion starten" UWORD B_TRUE 1 100 0 1 BIT_MASK 0x800 FORMAT "%13.11" ECU_ADDRESS 0xFD6C /end MEASUREMENT
/begin MEASUREMENT B_fadmet "Bedingung DMTL-Endstufen Diagnosetestersteuerung" UWORD B_TRUE 1 100 0 1 BIT_MASK 0x1000 FORMAT "%13.11" ECU_ADDRESS 0xFD6C /end MEASUREMENT
/begin MEASUREMENT B_fadmtl "Bedingung Funktionsanforderung Tankentlüftungssystem" UBYTE B_TRUE 1 100 0 1 BIT_MASK 0x2 FORMAT "%13.11" ECU_ADDRESS 0x382F30 /end MEASUREMENT
/begin MEASUREMENT B_fadmtle "Bedingung Funktionsanforderung Tankentlüftungssystem, Enable" UWORD B_TRUE 1 100 0 1 BIT_MASK 0x2000 FORMAT "%13.11" ECU_ADDRESS 0xFD6C /end MEASUREMENT
/begin MEASUREMENT B_fadmtls "Bedingung Funktionsanforderung Tankentlüftungssystem, gestoppt" UWORD B_TRUE 1 100 0 1 BIT_MASK 0x4000 FORMAT "%13.11" ECU_ADDRESS 0xFD6C /end MEASUREMENT
/begin MEASUREMENT B_fadmtltop "" UBYTE B_TRUE 1 100 0 1 BIT_MASK 0x2 FORMAT "%13.11" ECU_ADDRESS 0x380A0F /end MEASUREMENT
/begin MEASUREMENT B_fadmtltopOld "" UBYTE B_TRUE 1 100 0 1 BIT_MASK 0x4 FORMAT "%13.11" ECU_ADDRESS 0x380A0F /end MEASUREMENT
/begin MEASUREMENT B_fadtlbe "Bedingung Systemtest Tankentlüftungssystem bei Fz-Produktion" UBYTE B_TRUE 1 100 0 1 BIT_MASK 0x1 FORMAT "%13.11" ECU_ADDRESS 0x382F30 /end MEASUREMENT
/begin MEASUREMENT B_fadtlbeff "" UBYTE B_TRUE 1 100 0 1 BIT_MASK 0x8 FORMAT "%13.11" ECU_ADDRESS 0x382F30 /end MEASUREMENT
/begin MEASUREMENT B_faetr "Bedingung Funktionsanforderung elektr. Thermostatregelung" UWORD B_TRUE 1 100 0 1 BIT_MASK 0x8000 FORMAT "%13.11" ECU_ADDRESS 0xFD6C /end MEASUREMENT
/begin MEASUREMENT B_faevz "Bedingung Zylinderausblendung durch Tester" UWORD B_TRUE 1 100 0 1 BIT_MASK 0x8000 FORMAT "%13.11" ECU_ADDRESS 0xFD4A /end MEASUREMENT
/begin MEASUREMENT B_falls "Bedingung: Funktionsanforderung Drehzahländerung durch Tester" UWORD B_TRUE 1 100 0 1 BIT_MASK 0x1 FORMAT "%13.11" ECU_ADDRESS 0xFD4C /end MEASUREMENT
/begin MEASUREMENT B_falr "Bedingung: Funktionsanforderung Lambdaregelung aus" UWORD B_TRUE 1 100 0 1 BIT_MASK 0x1 FORMAT "%13.11" ECU_ADDRESS 0xFD6E /end MEASUREMENT
/begin MEASUREMENT B_falra "Bedingung: Funktionsanforderung Lambdaregelung-Adaption" UWORD B_TRUE 1 100 0 1 BIT_MASK 0x2 FORMAT "%13.11" ECU_ADDRESS 0xFD6E /end MEASUREMENT
/begin MEASUREMENT B_famls "Bedingung Funktionsanforderung Motorlüfter" UWORD B_TRUE 1 100 0 1 BIT_MASK 0x4 FORMAT "%13.11" ECU_ADDRESS 0xFD6E /end MEASUREMENT
/begin MEASUREMENT B_fanwh "Anforderung Prüfung Systemdichtheit" UWORD B_TRUE 1 100 0 1 BIT_MASK 0x800 FORMAT "%13.11" ECU_ADDRESS 0xFDDA /end MEASUREMENT
/begin MEASUREMENT B_fanwhst "Prüfung Systemdichtheit Start" UBYTE B_TRUE 1 100 0 1 BIT_MASK 0x4 FORMAT "%13.11" ECU_ADDRESS 0x380942 /end MEASUREMENT
/begin MEASUREMENT B_fanws "Bedingung Funktionsanforderung Diagnose Nockenwellensteuerung" UWORD B_TRUE 1 100 0 1 BIT_MASK 0x8 FORMAT "%13.11" ECU_ADDRESS 0xFD6E /end MEASUREMENT
/begin MEASUREMENT B_fanwsd "Bedingung Funktionsanforderung Nockenwellenregelung Dichtheit" UWORD B_TRUE 1 100 0 1 BIT_MASK 0x10 FORMAT "%13.11" ECU_ADDRESS 0xFD6E /end MEASUREMENT
/begin MEASUREMENT B_fanwtst "Bedingung Testeranforderung Sytemtest Sollwinkelvorgabe" UWORD B_TRUE 1 100 0 1 BIT_MASK 0x1000 FORMAT "%13.11" ECU_ADDRESS 0xFDDA /end MEASUREMENT
/begin MEASUREMENT B_fasls "Bedingung Funktionsanforderung Sekundärluftsystem" UWORD B_TRUE 1 100 0 1 BIT_MASK 0x20 FORMAT "%13.11" ECU_ADDRESS 0xFD6E /end MEASUREMENT
/begin MEASUREMENT B_fates "Bedingung Funktionsanforderung Tankentlüftungssystem" UWORD B_TRUE 1 100 0 1 BIT_MASK 0x40 FORMAT "%13.11" ECU_ADDRESS 0xFD6E /end MEASUREMENT
/begin MEASUREMENT B_fgrenold "" UBYTE B_TRUE 1 100 0 1 BIT_MASK 0x80 FORMAT "%13.11" ECU_ADDRESS 0x382E42 /end MEASUREMENT
/begin MEASUREMENT B_fgren_um "FGR-/ACC-Einschaltung aus Bedienhebel gültig in der Funktionsüberwachung" UBYTE B_TRUE 1 100 0 1 BIT_MASK 0x4 FORMAT "%13.11" ECU_ADDRESS 0x382E42 /end MEASUREMENT
/begin MEASUREMENT B_fgrfr_uc "FGR-/ACC-Momenteneingriff erlaubt im Befehlstest" UWORD B_TRUE 1 100 0 1 BIT_MASK 0x40 FORMAT "%13.11" ECU_ADDRESS 0xFDC8 /end MEASUREMENT
/begin MEASUREMENT B_fgr_uc "Ebene 3 Bit FGR-Eingriff in BT zulassen" UWORD B_TRUE 1 100 0 1 BIT_MASK 0x80 FORMAT "%13.11" ECU_ADDRESS 0xFDC8 /end MEASUREMENT
/begin MEASUREMENT B_fgr_um "FGR-/ACC-Momenteneingriff in der Funktionsüberwachung erlaubt" UWORD B_TRUE 1 100 0 1 BIT_MASK 0x4000 FORMAT "%13.11" ECU_ADDRESS 0xFDC6 /end MEASUREMENT
/begin MEASUREMENT B_ftv "Früh-Tastverhätnis NW-Lageregelung aktiv" UBYTE B_TRUE 1 100 0 1 BIT_MASK 0x8 FORMAT "%13.11" ECU_ADDRESS 0x38093C /end MEASUREMENT
/begin MEASUREMENT B_ftvold "" UBYTE B_TRUE 1 100 0 1 BIT_MASK 0x1 FORMAT "%13.11" ECU_ADDRESS 0x380942 /end MEASUREMENT
/begin MEASUREMENT B_ftvsr "" UBYTE B_TRUE 1 100 0 1 BIT_MASK 0x2 FORMAT "%13.11" ECU_ADDRESS 0x380942 /end MEASUREMENT
/begin MEASUREMENT B_gwrte "Bedingung fr-Grenzwertregelung Tankentlüftung aktiv" UWORD B_TRUE 1 100 0 1 BIT_MASK 0x80 FORMAT "%13.11" ECU_ADDRESS 0xFD3A /end MEASUREMENT
/begin MEASUREMENT B_hsh2et "" UWORD B_TRUE 1 100 0 1 BIT_MASK 0x80 FORMAT "%13.11" ECU_ADDRESS 0xFD6E /end MEASUREMENT
/begin MEASUREMENT B_hshet "" UWORD B_TRUE 1 100 0 1 BIT_MASK 0x100 FORMAT "%13.11" ECU_ADDRESS 0xFD6E /end MEASUREMENT
/begin MEASUREMENT B_hsv2et "" UWORD B_TRUE 1 100 0 1 BIT_MASK 0x200 FORMAT "%13.11" ECU_ADDRESS 0xFD6E /end MEASUREMENT
/begin MEASUREMENT B_hsvet "" UWORD B_TRUE 1 100 0 1 BIT_MASK 0x400 FORMAT "%13.11" ECU_ADDRESS 0xFD6E /end MEASUREMENT
/begin MEASUREMENT B_htv "Halte-Tastverhältnis NW-Lageregelung ist aktiv" UBYTE B_TRUE 1 100 0 1 BIT_MASK 0x10 FORMAT "%13.11" ECU_ADDRESS 0x38093C /end MEASUREMENT
/begin MEASUREMENT B_inistw "" UWORD B_TRUE 1 100 0 1 BIT_MASK 0x4 FORMAT "%13.11" ECU_ADDRESS 0xFDDC /end MEASUREMENT
/begin MEASUREMENT B_INIT "Bedingung Initialisierung" UWORD B_TRUE 1 100 0 1 BIT_MASK 0x20 FORMAT "%13.11" ECU_ADDRESS 0xFD00 /end MEASUREMENT
/begin MEASUREMENT B_i_ska "Funktions-Fehlerreaktion irreversible SKA (Sicherheits-Kraftstoffabschaltung)" UBYTE B_TRUE 1 100 0 1 BIT_MASK 0x4 FORMAT "%13.11" ECU_ADDRESS 0x382E41 /end MEASUREMENT
/begin MEASUREMENT B_i_ska_uc "Ebene 3 irreversibles Fehlerbit fuer BT" UWORD B_TRUE 1 100 0 1 BIT_MASK 0x800 FORMAT "%13.11" ECU_ADDRESS 0xFDC8 /end MEASUREMENT
/begin MEASUREMENT B_i_ska_um "Fehlerreaktion irrev. SKA (Sicherheitskraftstoffabschaltung) aus Fkt-Überwachung" UWORD B_TRUE 1 100 0 1 BIT_MASK 0x40 FORMAT "%13.11" ECU_ADDRESS 0xFD8A /end MEASUREMENT
/begin MEASUREMENT B_kkl_um "erkannter Low-Pegel am FGR-Bedienhebelschalter Kontrollkontakt in Funktionsüberw" UBYTE B_TRUE 1 100 0 1 BIT_MASK 0x40 FORMAT "%13.11" ECU_ADDRESS 0x382E42 /end MEASUREMENT
/begin MEASUREMENT B_kl15 "Bedingung Klemme 15" UWORD B_TRUE 1 100 0 1 BIT_MASK 0x4 FORMAT "%13.11" ECU_ADDRESS 0xFD00 /end MEASUREMENT
/begin MEASUREMENT B_koset "Stellglieddiagnose Klimakompressor-Relais: Eingriff Tester" UWORD B_TRUE 1 100 0 1 BIT_MASK 0x800 FORMAT "%13.11" ECU_ADDRESS 0xFD6E /end MEASUREMENT
/begin MEASUREMENT B_kwperr "" UWORD B_TRUE 1 100 0 1 BIT_MASK 0x8 FORMAT "%13.11" ECU_ADDRESS 0xFDDC /end MEASUREMENT
/begin MEASUREMENT B_lrar "Bedingung reduzierte Korrekturbereiche in der LRA" UWORD B_TRUE 1 100 0 1 BIT_MASK 0x1 FORMAT "%13.11" ECU_ADDRESS 0xFD3E /end MEASUREMENT
/begin MEASUREMENT B_m9cvn "Bedingung zur Berechnung der Checksumme (CVN) nach SAE/ISO Mode/Service $09" UWORD B_TRUE 1 100 0 1 BIT_MASK 0x40 FORMAT "%13.11" ECU_ADDRESS 0xFD78 /end MEASUREMENT
/begin MEASUREMENT B_m9cvnout "Bedingung; Checksumme (CVN) im Mode/Service $09 mind. 1-mal ausgegeben" UWORD B_TRUE 1 100 0 1 BIT_MASK 0x80 FORMAT "%13.11" ECU_ADDRESS 0xFD78 /end MEASUREMENT
/begin MEASUREMENT B_mcacti "Bedingung McMESS aktiv" UWORD B_TRUE 1 100 0 1 BIT_MASK 0x8 FORMAT "%13.11" ECU_ADDRESS 0xFD3E /end MEASUREMENT
/begin MEASUREMENT B_motor "" UBYTE B_TRUE 1 100 0 1 BIT_MASK 0x20 FORMAT "%13.11" ECU_ADDRESS 0x38315D /end MEASUREMENT
/begin MEASUREMENT B_mzns_um "Nachstartaufweitung des zuläsigen Moments in der Funktonsüberwachung aktiv" UWORD B_TRUE 1 100 0 1 BIT_MASK 0x200 FORMAT "%13.11" ECU_ADDRESS 0xFDC6 /end MEASUREMENT
/begin MEASUREMENT B_nnwmx "Drehzahlschwelle für NW-Regelung überschritten" UWORD B_TRUE 1 100 0 1 BIT_MASK 0x10 FORMAT "%13.11" ECU_ADDRESS 0xFD26 /end MEASUREMENT
/begin MEASUREMENT B_noacc_uc "" UWORD B_TRUE 1 100 0 1 BIT_MASK 0x100 FORMAT "%13.11" ECU_ADDRESS 0xFDC8 /end MEASUREMENT
/begin MEASUREMENT B_noacc_um "Bedingung keine Übernahme des ACC-Momentes" UWORD B_TRUE 1 100 0 1 BIT_MASK 0x8000 FORMAT "%13.11" ECU_ADDRESS 0xFDC6 /end MEASUREMENT
/begin MEASUREMENT B_noadv "keine Adaption Verstellgeschwindigkeit" UWORD B_TRUE 1 100 0 1 BIT_MASK 0x400 FORMAT "%13.11" ECU_ADDRESS 0xFD4A /end MEASUREMENT
/begin MEASUREMENT B_nom8dmtl "Bedingung: Start der DMTL über Scan-Tool Mode 8 nicht möglich" UBYTE B_TRUE 1 100 0 1 BIT_MASK 0x8 FORMAT "%13.11" ECU_ADDRESS 0x380A0F /end MEASUREMENT
/begin MEASUREMENT B_nomsr_um "MSR-Momentenvorgabe in der Funktionsüberwachung nicht übernommen" UBYTE B_TRUE 1 100 0 1 BIT_MASK 0x2 FORMAT "%13.11" ECU_ADDRESS 0x382E42 /end MEASUREMENT
/begin MEASUREMENT B_notlu "Anforderung Notluftfahren aus der Funktion" UBYTE B_TRUE 1 100 0 1 BIT_MASK 0x8 FORMAT "%13.11" ECU_ADDRESS 0x382E41 /end MEASUREMENT
/begin MEASUREMENT B_nouetm "Bedingung keine Übertemperatur im Nachlauf" UBYTE B_TRUE 1 100 0 1 BIT_MASK 0x1 FORMAT "%13.11" ECU_ADDRESS 0x38312B /end MEASUREMENT
/begin MEASUREMENT b_nsakt_um "Nachstart aktiv für die Fkt.-Überwachung" UBYTE B_TRUE 1 100 0 1 BIT_MASK 0x4 FORMAT "%13.11" ECU_ADDRESS 0x382E40 /end MEASUREMENT
/begin MEASUREMENT b_nsend_um "Nachstartüberwachungszeit abgelaufen für die Fkt.-Überwachung" UBYTE B_TRUE 1 100 0 1 BIT_MASK 0x1 FORMAT "%13.11" ECU_ADDRESS 0x382E40 /end MEASUREMENT
/begin MEASUREMENT B_nwads "Freigabe Adaption NW-Spätanschlag" UWORD B_TRUE 1 100 0 1 BIT_MASK 0x800 FORMAT "%13.11" ECU_ADDRESS 0xFD4A /end MEASUREMENT
/begin MEASUREMENT B_nwaf "Flag für Auswertung aller Flanken" UWORD B_TRUE 1 100 0 1 BIT_MASK 0x1000 FORMAT "%13.11" ECU_ADDRESS 0xFD4A /end MEASUREMENT
/begin MEASUREMENT B_nwco "Nockenwellen-Sollwert ist konstant" UWORD B_TRUE 1 100 0 1 BIT_MASK 0x1 FORMAT "%13.11" ECU_ADDRESS 0xFD46 /end MEASUREMENT
/begin MEASUREMENT B_nwi "Auszuwertender NW-Interrupt liegt vor" UBYTE B_TRUE 1 100 0 1 BIT_MASK 0x1 FORMAT "%13.11" ECU_ADDRESS 0x38093C /end MEASUREMENT
/begin MEASUREMENT B_nwoff "Abschaltung der Nockenwellen-Regelung" UBYTE B_TRUE 1 100 0 1 BIT_MASK 0x80 FORMAT "%13.11" ECU_ADDRESS 0x38093C /end MEASUREMENT
/begin MEASUREMENT B_ph2mem "" UWORD B_TRUE 1 100 0 1 BIT_MASK 0x10 FORMAT "%13.11" ECU_ADDRESS 0xFD7A /end MEASUREMENT
/begin MEASUREMENT B_phad "Adaption Kurbel/Nockenwelle erfolgt" UWORD B_TRUE 1 100 0 1 BIT_MASK 0x2000 FORMAT "%13.11" ECU_ADDRESS 0xFD4A /end MEASUREMENT
/begin MEASUREMENT B_phmem "" UWORD B_TRUE 1 100 0 1 BIT_MASK 0x20 FORMAT "%13.11" ECU_ADDRESS 0xFD7A /end MEASUREMENT
/begin MEASUREMENT B_ptyerr "" UWORD B_TRUE 1 100 0 1 BIT_MASK 0x10 FORMAT "%13.11" ECU_ADDRESS 0xFDDC /end MEASUREMENT
/begin MEASUREMENT B_pwgnotum "= b_pwgnot_um Funktionsüberwachungs-Fehlerreaktion PWG-Leerlauf (= b_pwgnot_sr)" UWORD B_TRUE 1 100 0 1 BIT_MASK 0x2000 FORMAT "%13.11" ECU_ADDRESS 0xFD8A /end MEASUREMENT
/begin MEASUREMENT B_qtedab "Bedingung schnelle Absteuerung der Spülrate" UWORD B_TRUE 1 100 0 1 BIT_MASK 0x8 FORMAT "%13.11" ECU_ADDRESS 0xFD3A /end MEASUREMENT
/begin MEASUREMENT B_ramerr "" UWORD B_TRUE 1 100 0 1 BIT_MASK 0x20 FORMAT "%13.11" ECU_ADDRESS 0xFDDC /end MEASUREMENT
/begin MEASUREMENT B_read_active "" UWORD B_TRUE 1 100 0 1 BIT_MASK 0x40 FORMAT "%13.11" ECU_ADDRESS 0xFDDC /end MEASUREMENT
/begin MEASUREMENT B_recerr "" UWORD B_TRUE 1 100 0 1 BIT_MASK 0x80 FORMAT "%13.11" ECU_ADDRESS 0xFDDC /end MEASUREMENT
/begin MEASUREMENT B_resstw "" UWORD B_TRUE 1 100 0 1 BIT_MASK 0x100 FORMAT "%13.11" ECU_ADDRESS 0xFDDC /end MEASUREMENT
/begin MEASUREMENT B_slpet "Stellglieddiagnose SLP: Eingriff Tester" UWORD B_TRUE 1 100 0 1 BIT_MASK 0x1000 FORMAT "%13.11" ECU_ADDRESS 0xFD6E /end MEASUREMENT
/begin MEASUREMENT B_slvet "Stellglieddiagnose SLV: Eingriff Tester" UWORD B_TRUE 1 100 0 1 BIT_MASK 0x2000 FORMAT "%13.11" ECU_ADDRESS 0xFD6E /end MEASUREMENT
/begin MEASUREMENT B_staet "Stellglieddiagnose Startrelais: Eingriff Tester" UWORD B_TRUE 1 100 0 1 BIT_MASK 0x4000 FORMAT "%13.11" ECU_ADDRESS 0xFD6E /end MEASUREMENT
/begin MEASUREMENT B_stv "Spät-Tastverhältnis NW-Lageregelung ist/war aktiv" UBYTE B_TRUE 1 100 0 1 BIT_MASK 0x20 FORMAT "%13.11" ECU_ADDRESS 0x38093C /end MEASUREMENT
/begin MEASUREMENT B_te "Bedingung Tankentlüftung" UWORD B_TRUE 1 100 0 1 BIT_MASK 0x10 FORMAT "%13.11" ECU_ADDRESS 0xFD3A /end MEASUREMENT
/begin MEASUREMENT B_teabb "Bedingung Tankentlüftung abbruchbereit" UWORD B_TRUE 1 100 0 1 BIT_MASK 0x2 FORMAT "%13.11" ECU_ADDRESS 0xFD3E /end MEASUREMENT
/begin MEASUREMENT B_teakt "Bedingung Tankentlüftung aktiv (normaler Betrieb oder Notlauf)" UWORD B_TRUE 1 100 0 1 BIT_MASK 0x100 FORMAT "%13.11" ECU_ADDRESS 0xFD3A /end MEASUREMENT
/begin MEASUREMENT B_tef "Bedingung Tankentlüftung prinzipiell freigegeben" UWORD B_TRUE 1 100 0 1 BIT_MASK 0x800 FORMAT "%13.11" ECU_ADDRESS 0xFDD0 /end MEASUREMENT
/begin MEASUREMENT B_tehb "Bedingung Tankentlüftung mit hoher Beladung" UWORD B_TRUE 1 100 0 1 BIT_MASK 0x4 FORMAT "%13.11" ECU_ADDRESS 0xFD3E /end MEASUREMENT
/begin MEASUREMENT B_tehbx "Bedingung Beladungsintegrator ftead am Maximalanschlag" UWORD B_TRUE 1 100 0 1 BIT_MASK 0x200 FORMAT "%13.11" ECU_ADDRESS 0xFD3A /end MEASUREMENT
/begin MEASUREMENT B_tei "Bedingung Tankentlüftung funktionsintern" UWORD B_TRUE 1 100 0 1 BIT_MASK 0x20 FORMAT "%13.11" ECU_ADDRESS 0xFD3A /end MEASUREMENT
/begin MEASUREMENT B_ten "Bedingung Tankentlüftung im Notlaufbetrieb (ohne Lambdaregelung)" UWORD B_TRUE 1 100 0 1 BIT_MASK 0x40 FORMAT "%13.11" ECU_ADDRESS 0xFD3A /end MEASUREMENT
/begin MEASUREMENT B_tevet "Condition purge valve on by tester" UWORD B_TRUE 1 100 0 1 BIT_MASK 0x8000 FORMAT "%13.11" ECU_ADDRESS 0xFD6E /end MEASUREMENT
/begin MEASUREMENT B_timerr "" UWORD B_TRUE 1 100 0 1 BIT_MASK 0x200 FORMAT "%13.11" ECU_ADDRESS 0xFDDC /end MEASUREMENT
/begin MEASUREMENT B_trev_inc "" UWORD B_TRUE 1 100 0 1 BIT_MASK 0x200 FORMAT "%13.11" ECU_ADDRESS 0xFD20 /end MEASUREMENT
/begin MEASUREMENT B_ub_ska "Batteriespannung nicht o.k., Unterspannungsabschaltung aktiv" UBYTE B_TRUE 1 100 0 1 BIT_MASK 0x2 FORMAT "%13.11" ECU_ADDRESS 0x382E41 /end MEASUREMENT
/begin MEASUREMENT B_uetm "Bedingung Übertemperatur" UWORD B_TRUE 1 100 0 1 BIT_MASK 0x1 FORMAT "%13.11" ECU_ADDRESS 0xFDBE /end MEASUREMENT
/begin MEASUREMENT B_uetmc "Bedingung Übertemperatur; CAN-Sende-Botschaft" UWORD B_TRUE 1 100 0 1 BIT_MASK 0x2 FORMAT "%13.11" ECU_ADDRESS 0xFDBE /end MEASUREMENT
/begin MEASUREMENT B_URSTA "Bedingungen Urstart im Steuergerät" UWORD B_TRUE 1 100 0 1 BIT_MASK 0x1000 FORMAT "%13.11" ECU_ADDRESS 0xFD00 /end MEASUREMENT
/begin MEASUREMENT B_vmax "Bedingung VMAX-Regelung aktiv" UWORD dez 1 100 0 1 BIT_MASK 0x2 FORMAT "%5.3" ECU_ADDRESS 0xFDC4 /end MEASUREMENT
/begin MEASUREMENT B_vzl_um "erkannter Low-Pegel am FGR-Bedienhebelschalter Verzögern in der Funktionsüberw." UBYTE B_TRUE 1 100 0 1 BIT_MASK 0x8 FORMAT "%13.11" ECU_ADDRESS 0x382E42 /end MEASUREMENT
/begin MEASUREMENT B_wal_um "erkannter Low-Pegel am FGR-Bedienhebelschalter Wiederaufnahme in Funktionsüberw." UBYTE B_TRUE 1 100 0 1 BIT_MASK 0x20 FORMAT "%13.11" ECU_ADDRESS 0x382E42 /end MEASUREMENT
/begin MEASUREMENT B_wcerr "" UWORD B_TRUE 1 100 0 1 BIT_MASK 0x400 FORMAT "%13.11" ECU_ADDRESS 0xFDDC /end MEASUREMENT
/begin MEASUREMENT B_wc_exa "" UBYTE B_TRUE 1 100 0 1 BIT_MASK 0x8 FORMAT "%13.11" ECU_ADDRESS 0x38315D /end MEASUREMENT
/begin MEASUREMENT B_wc_exn "" UBYTE B_TRUE 1 100 0 1 BIT_MASK 0x4 FORMAT "%13.11" ECU_ADDRESS 0x38315D /end MEASUREMENT
/begin MEASUREMENT B_wkora "Bedingung Zündwinkelkorrektur für Klopfschutz" UWORD B_TRUE 1 100 0 1 BIT_MASK 0x4 FORMAT "%13.11" ECU_ADDRESS 0xFD5E /end MEASUREMENT
/begin MEASUREMENT B_wnwmxbe "Bedingung Adaptionswinkel unterhalb max. erlaubter Grenze" UWORD B_TRUE 1 100 0 1 BIT_MASK 0x200 FORMAT "%13.11" ECU_ADDRESS 0xFDDA /end MEASUREMENT
/begin MEASUREMENT B_wnws "Bedingung Nockenwellensollwinkel/ - Spätanschlag" UWORD B_TRUE 1 100 0 1 BIT_MASK 0x400 FORMAT "%13.11" ECU_ADDRESS 0xFDDA /end MEASUREMENT
/begin MEASUREMENT B_wnws0 "NW-Sollwert=0 ist erreicht" UBYTE B_TRUE 1 100 0 1 BIT_MASK 0x40 FORMAT "%13.11" ECU_ADDRESS 0x38093C /end MEASUREMENT
/begin MEASUREMENT B_write_active "" UWORD B_TRUE 1 100 0 1 BIT_MASK 0x800 FORMAT "%13.11" ECU_ADDRESS 0xFDDC /end MEASUREMENT
/begin MEASUREMENT B_wuerg "" UBYTE B_TRUE 1 100 0 1 BIT_MASK 0x10 FORMAT "%13.11" ECU_ADDRESS 0x38315D /end MEASUREMENT
/begin MEASUREMENT B_zndaus "Bedingung Zündungsausblendung aktiv" UWORD B_TRUE 1 100 0 1 BIT_MASK 0x100 FORMAT "%13.11" ECU_ADDRESS 0xFDE0 /end MEASUREMENT
/begin MEASUREMENT B_zwkra "Bedingung: Zündwinkel der KR wird ausgegeben" UWORD B_TRUE 1 100 0 1 BIT_MASK 0x40 FORMAT "%13.11" ECU_ADDRESS 0xFD24 /end MEASUREMENT
/begin MEASUREMENT B_zwmnste "Bedingung Abregelung der Zündwinkelspätbegrenzung erfüllt" UWORD B_TRUE 1 100 0 1 BIT_MASK 0x8 FORMAT "%13.11" ECU_ADDRESS 0xFD5E /end MEASUREMENT
/begin MEASUREMENT B_zwspae "Bedingung: Zündwinkel zwspae bei Schubabschaltung wird ausgegeben" UWORD B_TRUE 1 100 0 1 BIT_MASK 0x80 FORMAT "%13.11" ECU_ADDRESS 0xFD24 /end MEASUREMENT
/begin MEASUREMENT devoff "EV-Ausblendmaske bei Testeranforderung" UBYTE dez 1 100 0 255 FORMAT "%5.1" ECU_ADDRESS 0x380B51 /end MEASUREMENT
/begin MEASUREMENT dftef_w "Eingang Integrator Spülrate" SWORD perio_sw_b1p562 1 100 -1.562 1.56195 FORMAT "%8.6" ECU_ADDRESS 0x3812C6 /end MEASUREMENT
/begin MEASUREMENT dkatefrg "Abweichung Kraftstoffanteil Tankentlüftung bei Sollspülrate von Zielwert" SBYTE fak_sb_b1 1 100 -1 0.992188 FORMAT "%5.3" ECU_ADDRESS 0x3809F1 /end MEASUREMENT
/begin MEASUREMENT dkhc_w "Eingang Integrator HC-Konzentration" SWORD perio_sw_b6p125 1 100 -6.125 6.12481 FORMAT "%8.6" ECU_ADDRESS 0x380E34 /end MEASUREMENT
/begin MEASUREMENT dmvmxi_w "Drehmoment I-Anteil bei VMAX-Regelung" SWORD rel_sw_b100 1 100 -100 99.9969 FORMAT "%8.4" ECU_ADDRESS 0x382480 /end MEASUREMENT
/begin MEASUREMENT dmvmxp_w "Drehmoment P-Anteil bei VMAX-Regelung" SWORD rel_sw_b100 1 100 -100 99.9969 FORMAT "%8.4" ECU_ADDRESS 0x382482 /end MEASUREMENT
/begin MEASUREMENT dstert20_w "Normierte Weitertransportstrecke Regeneriergas im Saugrohr im 20ms-Raster" UWORD fak_uw_b2 1 100 0 1.99997 FORMAT "%8.6" ECU_ADDRESS 0x3812C8 /end MEASUREMENT
/begin MEASUREMENT DSTP_INJ "" UWORD DEZL 1 100 0 65535 FORMAT "%8.2" ECU_ADDRESS 0xF906 /end MEASUREMENT
/begin MEASUREMENT dvprae_w "Prädizierter Geschwindigkeitsanteil" UWORD vfzg_uw_q0p00781 1 100 0 511.992 FORMAT "%8.4" ECU_ADDRESS 0x382484 /end MEASUREMENT
/begin MEASUREMENT dvsi_w "Abweichung zwischen Soll- und Istgeschwindigkeit der VMAX-Regelung" SWORD vfzg_sw_q0p00781 1 100 -256 255.992 FORMAT "%8.4" ECU_ADDRESS 0x382486 /end MEASUREMENT
/begin MEASUREMENT dzwks "delta Zündwinkel Klopfschutz" SBYTE zw_sb_q0p75 1 100 -96 95.25 FORMAT "%5.2" ECU_ADDRESS 0x380D7A /end MEASUREMENT
/begin MEASUREMENT dzwspae "Korrektur-Zündwinkel für den spätest erlaubten Zündwinkel" SBYTE zw_sb_q0p75 1 100 -96 95.25 FORMAT "%5.2" ECU_ADDRESS 0x380926 /end MEASUREMENT
/begin MEASUREMENT dzwwl "Delta Zuendwinkel aus Warmlauf" SBYTE zw_sb_q0p75 1 100 -96 95.25 FORMAT "%5.2" ECU_ADDRESS 0x380A09 /end MEASUREMENT
/begin MEASUREMENT dzw_uc "Delta Zündwinkel zwischen zwopt und zwout im Befehlstest" UBYTE zw_ub_q0p75 1 100 0 191.25 FORMAT "%5.1" ECU_ADDRESS 0x380D0B /end MEASUREMENT
/begin MEASUREMENT dzw_um "Delta Zündwinkel zwischen zwopt und zwout in der Funktionsüberwachung" UBYTE zw_ub_q0p75 1 100 0 191.25 FORMAT "%5.1" ECU_ADDRESS 0x382E6D /end MEASUREMENT
/begin MEASUREMENT ei_accc_uc "" UWORD B_TRUE 1 100 0 1 BIT_MASK 0x200 FORMAT "%13.11" ECU_ADDRESS 0xFDC8 /end MEASUREMENT
/begin MEASUREMENT ei_accc_um "irreversibles Fehlerbit bei der ACC-Überwachung der Funktionsüberwachung" UWORD B_TRUE 1 100 0 1 BIT_MASK 0x1 FORMAT "%13.11" ECU_ADDRESS 0xFDC8 /end MEASUREMENT
/begin MEASUREMENT ei_adcc_um "irreversibles Fehlerbit bei der AD-Wandler-Überwachung" UWORD B_TRUE 1 100 0 1 BIT_MASK 0x10 FORMAT "%13.11" ECU_ADDRESS 0xFDC8 /end MEASUREMENT
/begin MEASUREMENT ei_ipa_um "irrev. Fehlerbit für unterer DK-Anschlag im ungültigen Bereich in der Fkt-Überw." UWORD B_TRUE 1 100 0 1 BIT_MASK 0x800 FORMAT "%13.11" ECU_ADDRESS 0xFDC6 /end MEASUREMENT
/begin MEASUREMENT ei_msrc_uc "irreversibles Fehlerbit bei der MSR-Überwachung im Befehlstest" UWORD B_TRUE 1 100 0 1 BIT_MASK 0x400 FORMAT "%13.11" ECU_ADDRESS 0xFDC8 /end MEASUREMENT
/begin MEASUREMENT ei_msrc_um "irreversibles Fehlerbit bei der MSR-Überwachung der Funktionsüberwachung" UWORD B_TRUE 1 100 0 1 BIT_MASK 0x2 FORMAT "%13.11" ECU_ADDRESS 0xFDC8 /end MEASUREMENT
/begin MEASUREMENT ei_mver_uc "Ebene 3 irreversibles Fehlerbit fuer URCMVER aus BT" UWORD B_TRUE 1 100 0 1 BIT_MASK 0x1000 FORMAT "%13.11" ECU_ADDRESS 0xFDC8 /end MEASUREMENT
/begin MEASUREMENT ei_mver_um "irreversibles Fehlerbit beim Momentenvergleich der Funktionsüberwachung" UWORD B_TRUE 1 100 0 1 BIT_MASK 0x4 FORMAT "%13.11" ECU_ADDRESS 0xFDC8 /end MEASUREMENT
/begin MEASUREMENT ei_nc_um "irreversibles Fehlerbit beim Drehzahlvergleich der Funktionsüberwachung" UWORD B_TRUE 1 100 0 1 BIT_MASK 0x100 FORMAT "%13.11" ECU_ADDRESS 0xFDC6 /end MEASUREMENT
/begin MEASUREMENT ei_reac_uc "Ebene 3 irreversibles Fehlerbit fuer UFREAC aus BT" UWORD B_TRUE 1 100 0 1 BIT_MASK 0x2000 FORMAT "%13.11" ECU_ADDRESS 0xFDC8 /end MEASUREMENT
/begin MEASUREMENT ei_reac_um "irreversibles Fehlerbit der Fehlerreaktionsüberwachung der Funktionsüberwachung" UWORD B_TRUE 1 100 0 1 BIT_MASK 0x8 FORMAT "%13.11" ECU_ADDRESS 0xFDC8 /end MEASUREMENT
/begin MEASUREMENT ei_rlc_um "irreversibles Fehlerbit beim rl-Vergleich mit der Funktion in der Funktionsüberw" UWORD B_TRUE 1 100 0 1 BIT_MASK 0x1000 FORMAT "%13.11" ECU_ADDRESS 0xFDC6 /end MEASUREMENT
/begin MEASUREMENT ei_rlip_um "irreversibles Fehlerbit beim rl/rlip-Vergleich der Funktionsüberwachung" UWORD B_TRUE 1 100 0 1 BIT_MASK 0x2000 FORMAT "%13.11" ECU_ADDRESS 0xFDC6 /end MEASUREMENT
/begin MEASUREMENT ei_spsc_um "irreversibles Fehlerbit bei d. Sollwertplausibilisierung d. Funktionsüberwachung" UWORD B_TRUE 1 100 0 1 BIT_MASK 0x4000 FORMAT "%13.11" ECU_ADDRESS 0xFD8A /end MEASUREMENT
/begin MEASUREMENT ei_zwc_um "irreversibles Fehlerbit bei der Zündwinkelüberwachung der Funktionsüberwachung" UWORD B_TRUE 1 100 0 1 BIT_MASK 0x400 FORMAT "%13.11" ECU_ADDRESS 0xFDC6 /end MEASUREMENT
/begin MEASUREMENT errorCntTcsort "" UBYTE dez 1 100 0 255 FORMAT "%5.1" ECU_ADDRESS 0x380BEC /end MEASUREMENT
/begin MEASUREMENT esst_sbf02mflrsb "" UWORD dez 1 100 0 65535 FORMAT "%8.2" ECU_ADDRESS 0x382488 /end MEASUREMENT
/begin MEASUREMENT esst_sbf02mfsb "" UWORD dez 1 100 0 65535 FORMAT "%8.2" ECU_ADDRESS 0x38248A /end MEASUREMENT
/begin MEASUREMENT esst_srl03mflruw "" UWORD dez 1 100 0 65535 FORMAT "%8.2" ECU_ADDRESS 0x38248C /end MEASUREMENT
/begin MEASUREMENT esst_srl03mfuw "" UWORD dez 1 100 0 65535 FORMAT "%8.2" ECU_ADDRESS 0x38248E /end MEASUREMENT
/begin MEASUREMENT etate "Motorwirkungsgrad bei Tankentlüftung mit hoher Beladung" UBYTE rel_ub_b127p5 1 100 0 127.5 FORMAT "%5.1" ECU_ADDRESS 0x3809F2 /end MEASUREMENT
/begin MEASUREMENT etateint "Integrator Motrwirkungsgrad bei Tankentlüftung" UBYTE rel_ub_b127p5 1 100 0 127.5 FORMAT "%5.1" ECU_ADDRESS 0x3809F3 /end MEASUREMENT
/begin MEASUREMENT etatesol "beladungsabhängiger Soll-Motorwirkungsgrad bei Betrieb mit Tankentlüftung" UBYTE rel_ub_b127p5 1 100 0 127.5 FORMAT "%5.1" ECU_ADDRESS 0x380969 /end MEASUREMENT
/begin MEASUREMENT etazwmn "Minimum-Zündwinkelwirkungsgrad" UBYTE rel_ub_b127p5 1 100 0 127.5 FORMAT "%5.1" ECU_ADDRESS 0xF84C /end MEASUREMENT
/begin MEASUREMENT etazw_uc "Ist-Zündwinkelwirkungsgrad im Befehlstest" UBYTE rel_ub_b127p5 1 100 0 127.5 FORMAT "%5.1" ECU_ADDRESS 0x380D0C /end MEASUREMENT
/begin MEASUREMENT etazw_um "Ist-Zündwinkelwirkungsgrad in der Funktionsüberwachung" UBYTE rel_ub_b127p5 1 100 0 127.5 FORMAT "%5.1" ECU_ADDRESS 0x380CF1 /end MEASUREMENT
/begin MEASUREMENT evz_aus_uc "Einspritzausblendmuster im Befehlstest" UBYTE dez 1 100 0 255 FORMAT "%5.1" ECU_ADDRESS 0x380CFB /end MEASUREMENT
/begin MEASUREMENT evz_aus_um "Einspritzausblendmuster in der Funktionsüberwachung" UBYTE dez 1 100 0 255 FORMAT "%5.1" ECU_ADDRESS 0x382E43 /end MEASUREMENT
/begin MEASUREMENT EwsNvBits "" UBYTE dez 1 100 0 255 FORMAT "%5.1" ECU_ADDRESS 0x38315D /end MEASUREMENT
/begin MEASUREMENT fbetate "gewünschter Motorwirkungsgrad als f(nmot) bei TE zur Vermeidung von te <= TEMIN" UBYTE fak_ub_b1 1 100 0 0.996094 ECU_ADDRESS 0x38096A /end MEASUREMENT
/begin MEASUREMENT fbkate "Faktor Kraftstoffanteil Tankentlüftung abhängig von te / TEMIN" UBYTE fak_ub_b1 1 100 0 0.996094 ECU_ADDRESS 0x38096B /end MEASUREMENT
/begin MEASUREMENT FGEZS0 "" UBYTE FAKTCIFI 1 100 0.75 1.24805 FORMAT "%5.3" ECU_ADDRESS 0xF976 /end MEASUREMENT
/begin MEASUREMENT FGEZS1 "" UBYTE FAKTCIFI 1 100 0.75 1.24805 FORMAT "%5.3" ECU_ADDRESS 0xF978 /end MEASUREMENT
/begin MEASUREMENT FGEZS2 "" UBYTE FAKTCIFI 1 100 0.75 1.24805 FORMAT "%5.3" ECU_ADDRESS 0xF97A /end MEASUREMENT
/begin MEASUREMENT FGEZS3 "" UBYTE FAKTCIFI 1 100 0.75 1.24805 FORMAT "%5.3" ECU_ADDRESS 0xF97C /end MEASUREMENT
/begin MEASUREMENT FGEZS4 "" UBYTE FAKTCIFI 1 100 0.75 1.24805 FORMAT "%5.3" ECU_ADDRESS 0xF97E /end MEASUREMENT
/begin MEASUREMENT FGEZS5 "" UBYTE FAKTCIFI 1 100 0.75 1.24805 FORMAT "%5.3" ECU_ADDRESS 0xF980 /end MEASUREMENT
/begin MEASUREMENT FGEZS6 "" UBYTE FAKTCIFI 1 100 0.75 1.24805 FORMAT "%5.3" ECU_ADDRESS 0xF982 /end MEASUREMENT
/begin MEASUREMENT FGEZS7 "" UBYTE FAKTCIFI 1 100 0.75 1.24805 FORMAT "%5.3" ECU_ADDRESS 0xF984 /end MEASUREMENT
/begin MEASUREMENT fgwrte "Eingriff Grenzwertregelung Tankentlüftung" SBYTE fak_sb_b16 1 100 -16 15.875 FORMAT "%5.2" ECU_ADDRESS 0x3809F4 /end MEASUREMENT
/begin MEASUREMENT fkateapp "Faktor applizierter Krafstoffanteil Tankentlüftung" SBYTE fak_sb_b1 1 100 -1 0.992188 FORMAT "%5.3" ECU_ADDRESS 0x38096C /end MEASUREMENT
/begin MEASUREMENT fkatefrg "Faktor Kraftstoffanteil Tankentlüftung bei Sollspülrate" SBYTE fak_sb_b1 1 100 -1 0.992188 FORMAT "%5.3" ECU_ADDRESS 0x3809F5 /end MEASUREMENT
/begin MEASUREMENT fkatei "Faktor Kraftstoffanteil Tankentlüftung (aktueller Istwert)" SBYTE fak_sb_b1 1 100 -1 0.992188 FORMAT "%5.3" ECU_ADDRESS 0x3809F6 /end MEASUREMENT
/begin MEASUREMENT fkates "Faktor Kraftstoffanteil Tankentlüftung (Sollwert)" SBYTE fak_sb_b1 1 100 -1 0.992188 FORMAT "%5.3" ECU_ADDRESS 0x3809F7 /end MEASUREMENT
/begin MEASUREMENT fngwrte "Faktor Regelung Spülrate nach Grenzwertregeleingriff" SBYTE fak_sb_b16 1 100 -16 15.875 FORMAT "%5.2" ECU_ADDRESS 0x3809F8 /end MEASUREMENT
/begin MEASUREMENT fnwue "Gewichtungsfaktor Nockenwellenüberschneidung (Einlaß)" UBYTE fak_ub_b1 1 100 0 0.996094 ECU_ADDRESS 0x380949 /end MEASUREMENT
/begin MEASUREMENT fregfte "Faktor Regelung Spülrate vor Grenzwertregeleingriff" SBYTE fak_sb_b16 1 100 -16 15.875 FORMAT "%5.2" ECU_ADDRESS 0x3809F9 /end MEASUREMENT
/begin MEASUREMENT frmit "Bei Stereo-LR: Mittelwert des fr,fr2 oder bei Ausfall einer Bank: fr der i.O. Bk" UBYTE fak_ub_b2 1 100 0 1.99219 FORMAT "%5.3" ECU_ADDRESS 0x3809FA /end MEASUREMENT
/begin MEASUREMENT frmit_w "Mittelwert aus fr und fr2 (16 bit)" UWORD fak_uw_b2 1 100 0 1.99997 FORMAT "%8.6" ECU_ADDRESS 0x3812CA /end MEASUREMENT
/begin MEASUREMENT frmxa "fr-Max-Auschlag: Bei Stereo-LR: der fr, der am weitesten von 1.0 entfernt" UBYTE fak_ub_b2 1 100 0 1.99219 FORMAT "%5.3" ECU_ADDRESS 0x3809FB /end MEASUREMENT
/begin MEASUREMENT frmxaold_w "Mittelwert Lambdaregler - alter Wert (16 bit)" UWORD fak_uw_b2 1 100 0 1.99997 FORMAT "%8.6" ECU_ADDRESS 0x3812CC /end MEASUREMENT
/begin MEASUREMENT frmxa_w "fr-Max-Ausschlag: Bei Stereo LR der fr, der am weitesten von 1.0 weg (16 bit)" UWORD fak_uw_b2 1 100 0 1.99997 FORMAT "%8.6" ECU_ADDRESS 0x3812CE /end MEASUREMENT
/begin MEASUREMENT fteadf "gefilteter Faktor Beladung Spülstrom bei Tankentlüftung" SBYTE fak_sb_q0p5 1 100 -64 63.5 FORMAT "%5.2" ECU_ADDRESS 0x38096D /end MEASUREMENT
/begin MEASUREMENT fteadf_w "gefilteter Faktor Beladung Spülstrom bei Tankentlüftung (16 Bit)" SWORD fak_q0p00195 1 100 -64 63.998 FORMAT "%8.5" ECU_ADDRESS 0x380E36 /end MEASUREMENT
/begin MEASUREMENT ftead_w "Beladung des Aktivkohlefilters" SWORD fak_sw_b64 1 100 -64 63.998 FORMAT "%8.5" ECU_ADDRESS 0xFA3C /end MEASUREMENT
/begin MEASUREMENT ftefsold_w "Letzter Sollwert der Spülrate Tankentlüftung vor Absteuerung" UWORD fak_uw_b0p5 1 100 0 0.499992 FORMAT "%9.7" ECU_ADDRESS 0x3812D0 /end MEASUREMENT
/begin MEASUREMENT ftefsoll_w "Sollwert der Spülrate Tankentlüftung" UWORD fak_uw_b0p5 1 100 0 0.499992 FORMAT "%9.7" ECU_ADDRESS 0x3812D2 /end MEASUREMENT
/begin MEASUREMENT ftefva "Spülrate der Tankentlüftung" UBYTE fak_ub_b0p5 1 100 0 0.498047 ECU_ADDRESS 0x3809FC /end MEASUREMENT
/begin MEASUREMENT ftefvab "Begrenzungswert der Spülrate Tankentlüftung" UBYTE fak_ub_b0p03125 1 100 0 0.0311279 FORMAT "%7.5" ECU_ADDRESS 0x38096E /end MEASUREMENT
/begin MEASUREMENT ftefvamx_w "max. Spülrate (Begrenzung absolut, 16 bit)" UWORD fak_uw_b0p5 1 100 0 0.499992 FORMAT "%9.7" ECU_ADDRESS 0x3812D4 /end MEASUREMENT
/begin MEASUREMENT ftefva_w "Spülrate Tankentlüftung" UWORD fak_uw_b0p5 1 100 0 0.499992 FORMAT "%9.7" ECU_ADDRESS 0x3812D6 /end MEASUREMENT
/begin MEASUREMENT fteml "Aufsteuergeschwindigkeit der Spülrate und des Massenstroms TEV" UBYTE perio_ub_b0p012207 1 100 0 0.0121593 FORMAT "%7.5" ECU_ADDRESS 0x3809FD /end MEASUREMENT
/begin MEASUREMENT fvermte_w "Faktor Vermischung Regeneriergas im Saugrohr" UWORD fak_uw_b1 1 100 0 0.999985 FORMAT "%9.7" ECU_ADDRESS 0x3812D8 /end MEASUREMENT
/begin MEASUREMENT hsh2tim "" UBYTE dez 1 100 0 255 FORMAT "%5.1" ECU_ADDRESS 0x380A9F /end MEASUREMENT
/begin MEASUREMENT hshtim "" UBYTE dez 1 100 0 255 FORMAT "%5.1" ECU_ADDRESS 0x380AA0 /end MEASUREMENT
/begin MEASUREMENT hsv2tim "" UBYTE dez 1 100 0 255 FORMAT "%5.1" ECU_ADDRESS 0x380AA1 /end MEASUREMENT
/begin MEASUREMENT hsvtim "" UBYTE dez 1 100 0 255 FORMAT "%5.1" ECU_ADDRESS 0x380AA2 /end MEASUREMENT
/begin MEASUREMENT imsteini "Integral Massenstrom TEV nach längerem TE-Stop" UBYTE m_ub_q0p0444 1 100 0 11.322 FORMAT "%5.2" ECU_ADDRESS 0x38096F /end MEASUREMENT
/begin MEASUREMENT iniRoutineCtr "" UWORD dez 1 100 0 65535 FORMAT "%8.2" ECU_ADDRESS 0x3824B0 /end MEASUREMENT
/begin MEASUREMENT ipa_c_um "Fehlerzähler für unterer DK-Anschlag im ungültigen Bereich f. d. Funktionsüberw." UBYTE t40ms_ub_b10200 1 100 0 10200 FORMAT "%7.1" ECU_ADDRESS 0x382E50 /end MEASUREMENT
/begin MEASUREMENT ipsn_um "aktive DK-Istwertpoti-Info ohne unteren Anschlag für die Funktionsüberwachung" UBYTE spg_ub_q0p019 1 100 0 4.845 FORMAT "%5.3" ECU_ADDRESS 0x382E51 /end MEASUREMENT
/begin MEASUREMENT ivmax "Initialisierungswert Integrator für VMAX-Regelung" SBYTE rel_sb_q0p78 1 100 -99.84 99.06 FORMAT "%5.2" ECU_ADDRESS 0x380CE5 /end MEASUREMENT
/begin MEASUREMENT khc_w "Adaptierte HC-Konzentration Regenerierstrom" SWORD fak_sw_b2 1 100 -2 1.99994 FORMAT "%8.6" ECU_ADDRESS 0x380E38 /end MEASUREMENT
/begin MEASUREMENT kteev_w "Konzentration Regeneriergas im Saugrohr auf Höhe der Einspritzventile" UWORD fak_uw_b1 1 100 0 0.999985 FORMAT "%9.7" ECU_ADDRESS 0x3812DA /end MEASUREMENT
/begin MEASUREMENT ktetevvz_w "Konzentration Regeneriergas im Saugrohr verzögert" UWORD fak_uw_b1 1 100 0 0.999985 FORMAT "%9.7" ECU_ADDRESS 0x3812DC /end MEASUREMENT
/begin MEASUREMENT ktetev_w "Konzentration Regeneriergas im Saugrohr auf Höhe vom TEV" UWORD fak_uw_b1 1 100 0 0.999985 FORMAT "%9.7" ECU_ADDRESS 0x3812DE /end MEASUREMENT
/begin MEASUREMENT macca_c_uc "" UBYTE t40ms_ub_b10200 1 100 0 10200 FORMAT "%7.1" ECU_ADDRESS 0x380D05 /end MEASUREMENT
/begin MEASUREMENT macca_c_um "" UBYTE t40ms_ub_b10200 1 100 0 10200 FORMAT "%7.1" ECU_ADDRESS 0x382E66 /end MEASUREMENT
/begin MEASUREMENT maccc_c_uc "" UBYTE t40ms_ub_b10200 1 100 0 10200 FORMAT "%7.1" ECU_ADDRESS 0x380D06 /end MEASUREMENT
/begin MEASUREMENT maccc_c_um "" UBYTE t40ms_ub_b10200 1 100 0 10200 FORMAT "%7.1" ECU_ADDRESS 0x382E67 /end MEASUREMENT
/begin MEASUREMENT mdif_w_uc "Differenz zwischen zulässigem und Ist-Moment im Befehlstest" SWORD rel_ub_q0p3906 1 100 -12800 12799.6 FORMAT "%8.2" ECU_ADDRESS 0x38260C /end MEASUREMENT
/begin MEASUREMENT mdif_w_um "Differenz zwischen zulässigem und Ist-Moment in der Funktionsüberwachung" SWORD rel_ub_q0p3906 1 100 -12800 12799.6 FORMAT "%8.2" ECU_ADDRESS 0x3825DE /end MEASUREMENT
/begin MEASUREMENT mdst08_uc "" UWORD dez 1 100 0 65535 FORMAT "%8.2" ECU_ADDRESS 0x38260A /end MEASUREMENT
/begin MEASUREMENT mdst08_um "Stützstelle für Momenten-Info (MZ_UM) zur Ermittlung des Momenten-Offsets in FU" UWORD dez 1 100 0 65535 FORMAT "%8.2" ECU_ADDRESS 0x382EB2 /end MEASUREMENT
/begin MEASUREMENT mfgr_uc "Momentenwunsch aus der Fahrgeschwindigkeitsregelung im Befehlstest" UBYTE rel_ub_q0p3906 1 100 0 99.6094 FORMAT "%5.2" ECU_ADDRESS 0x380D07 /end MEASUREMENT
/begin MEASUREMENT mfgr_um "Momentenwunsch aus der Fahrgeschwindigkeitsregelung für die Funktionsüberwachung" UBYTE rel_ub_q0p3906 1 100 0 99.6094 FORMAT "%5.2" ECU_ADDRESS 0x382E68 /end MEASUREMENT
/begin MEASUREMENT mifa_uc "FGR-/ACC- oder Fahrerwunschmoment der Funktion im Befehlstest" UBYTE rel_ub_q0p3906 1 100 0 99.6094 FORMAT "%5.2" ECU_ADDRESS 0x380CFC /end MEASUREMENT
/begin MEASUREMENT mifa_um "FGR-/ACC- oder Fahrerwunschmoment der Funktion für die Funktionsüberwachung" UBYTE rel_ub_q0p3906 1 100 0 99.6094 FORMAT "%5.2" ECU_ADDRESS 0x382E44 /end MEASUREMENT
/begin MEASUREMENT milsol_uc "Fahrermomentenwunsch für Füllung im Befehlstest" UBYTE rel_ub_q0p3906 1 100 0 99.6094 FORMAT "%5.2" ECU_ADDRESS 0x380CFD /end MEASUREMENT
/begin MEASUREMENT milsol_um "Fahrermomentenwunsch für Füllung für die Funktionsüberwachung" UBYTE rel_ub_q0p3906 1 100 0 99.6094 FORMAT "%5.2" ECU_ADDRESS 0x382E45 /end MEASUREMENT
/begin MEASUREMENT miopt_uc "optimales indiziertes Moment im Befehlstest" UBYTE rel_ub_b99p6 1 100 0 99.6094 FORMAT "%5.2" ECU_ADDRESS 0x380D0D /end MEASUREMENT
/begin MEASUREMENT miopt_um "optimales indiziertes Moment in der Funktionsüberwachung" UBYTE rel_ub_b99p6 1 100 0 99.6094 FORMAT "%5.2" ECU_ADDRESS 0x380CF2 /end MEASUREMENT
/begin MEASUREMENT mired "indiziertes Reduktionsmoment zur VMAX-Regelung" UBYTE rel_ub_b99p6 1 100 0 99.6094 FORMAT "%5.2" ECU_ADDRESS 0x380CE6 /end MEASUREMENT
/begin MEASUREMENT mitebg_w "Momentvorgabe für Mindestfüllung Tankentlüftung" UWORD rel_uw_b100 1 100 0 99.9985 FORMAT "%8.5" ECU_ADDRESS 0xFA3E /end MEASUREMENT
/begin MEASUREMENT mivmxs "ind. Soll-Motormoment zur Integratorinitialisierung VMAX-Regelung" SBYTE rel_sb_q0p78 1 100 -99.84 99.06 FORMAT "%5.2" ECU_ADDRESS 0x380CE7 /end MEASUREMENT
/begin MEASUREMENT mivmx_w "Indiziertes Sollmoment der VMAX-Regelung" UWORD rel_uw_b100 1 100 0 99.9985 FORMAT "%8.5" ECU_ADDRESS 0x3813A4 /end MEASUREMENT
/begin MEASUREMENT mi_uc "Berechnetes Ist-Moment im Befehlstest" UBYTE rel_ub_b99p6 1 100 0 99.6094 FORMAT "%5.2" ECU_ADDRESS 0x380D0E /end MEASUREMENT
/begin MEASUREMENT mi_um "Berechnetes Ist-Moment in der Funktionsüberwachung" UBYTE rel_ub_b99p6 1 100 0 99.6094 FORMAT "%5.2" ECU_ADDRESS 0x382E6E /end MEASUREMENT
/begin MEASUREMENT mmsr_uc "zulässiger MSR-Momentenwunsch für die Funktionsüberwachung" UBYTE rel_ub_q0p3906 1 100 0 99.6094 FORMAT "%5.2" ECU_ADDRESS 0x380D09 /end MEASUREMENT
/begin MEASUREMENT mmsr_um "zulässiger MSR-Momentenwunsch für die Funktionsüberwachung" UBYTE rel_ub_q0p3906 1 100 0 99.6094 FORMAT "%5.2" ECU_ADDRESS 0x382E6B /end MEASUREMENT
/begin MEASUREMENT mped_uc "zulässiges indiziertes Moment aus Fahrpedal im Befehlstest" UBYTE rel_ub_b99p6 1 100 0 99.6094 FORMAT "%5.2" ECU_ADDRESS 0x380D10 /end MEASUREMENT
/begin MEASUREMENT mped_um "zulässiges indiziertes Moment aus Fahrpedal in der Funktionsüberwachung" UBYTE rel_ub_b99p6 1 100 0 99.6094 FORMAT "%5.2" ECU_ADDRESS 0x380CF4 /end MEASUREMENT
/begin MEASUREMENT msrc_c_uc "Fehlerzähler für MSR-Überwachung des Befehlstestes" UBYTE t40ms_ub_b10200 1 100 0 10200 FORMAT "%7.1" ECU_ADDRESS 0x380D0A /end MEASUREMENT
/begin MEASUREMENT msrc_c_um "Fehlerzähler für MSR-Eingriff-Überwachung der Funktionsüberwachung" UBYTE t40ms_ub_b10200 1 100 0 10200 FORMAT "%7.1" ECU_ADDRESS 0x382E6C /end MEASUREMENT
/begin MEASUREMENT mssgin_w "Ins Saugrohr strömender Massenstrom (Drosselklappe + TEV)" UWORD m_uw_b6553p5 1 100 0 6553.5 FORMAT "%8.3" ECU_ADDRESS 0x3812E0 /end MEASUREMENT
/begin MEASUREMENT msteev_w "Massenstrom Regeneriergas auf Höhe Einspritzventil" UWORD m_uw_b25p6 1 100 0 25.5996 FORMAT "%8.5" ECU_ADDRESS 0x3812E2 /end MEASUREMENT
/begin MEASUREMENT mstesmx_w "Maximal möglicher Sollmassenstrom Tankentlüftung" UWORD m_uw_b25p6 1 100 0 25.5996 FORMAT "%8.5" ECU_ADDRESS 0x3812E4 /end MEASUREMENT
/begin MEASUREMENT mstesoll_w "Massenstrom Tankentlüftung ins Saugrohr, Sollwert" UWORD m_uw_b25p6 1 100 0 25.5996 FORMAT "%8.5" ECU_ADDRESS 0xFA40 /end MEASUREMENT
/begin MEASUREMENT mver_c_uc "Fehlerzähler für Momentenvergleich im Befehlstest" UBYTE t40ms_ub_b10200 1 100 0 10200 FORMAT "%7.1" ECU_ADDRESS 0x380D1F /end MEASUREMENT
/begin MEASUREMENT mver_c_um "Fehlerzähler für Momentenvergleich der Funktionsüberwachung" UBYTE t40ms_ub_b10200 1 100 0 10200 FORMAT "%7.1" ECU_ADDRESS 0x382E7C /end MEASUREMENT
/begin MEASUREMENT mzfo_uc "Gefiltertes zulässiges Moment inclusive Offset im Befehlstest" UBYTE rel_ub_q0p3906 1 100 0 99.6094 FORMAT "%5.2" ECU_ADDRESS 0x380D20 /end MEASUREMENT
/begin MEASUREMENT mzfo_um "gefiltertes zulässiges Moment inclusive Offset in der Funktionsüberwachung" UBYTE rel_ub_q0p3906 1 100 0 99.6094 FORMAT "%5.2" ECU_ADDRESS 0x382E7D /end MEASUREMENT
/begin MEASUREMENT mzf_low_uc "" UBYTE rel_ub_q0p00153 1 100 0 0.389074 ECU_ADDRESS 0x380D14 /end MEASUREMENT
/begin MEASUREMENT mzf_low_um "Nachkommastellen für gefiltertes zulässiges Moment der Funktionsüberwachung" UBYTE rel_ub_q0p00153 1 100 0 0.389074 ECU_ADDRESS 0x382E71 /end MEASUREMENT
/begin MEASUREMENT mzf_ptr_uc "" UBYTE dez 1 100 0 255 FORMAT "%5.1" ECU_ADDRESS 0x380D15 /end MEASUREMENT
/begin MEASUREMENT mzf_ptr_um "Zeiger des Registers mzf_reg_um" UBYTE dez 1 100 0 255 FORMAT "%5.1" ECU_ADDRESS 0x382E72 /end MEASUREMENT
/begin MEASUREMENT mzf_reg_uc "" UBYTE rel_ub_q0p3906 1 100 0 99.6094 FORMAT "%5.2" ARRAY_SIZE 8 ECU_ADDRESS 0x380D16 /end MEASUREMENT
/begin MEASUREMENT mzf_reg_um "Register für zulässiges Moment zeitverzögert" UBYTE rel_ub_q0p3906 1 100 0 99.6094 FORMAT "%5.2" ARRAY_SIZE 8 ECU_ADDRESS 0x382E73 /end MEASUREMENT
/begin MEASUREMENT mzf_uc "gefiltertes zulässiges Moment im Befehlstest" UBYTE rel_ub_q0p3906 1 100 0 99.6094 FORMAT "%5.2" ECU_ADDRESS 0x380D1E /end MEASUREMENT
/begin MEASUREMENT mzf_um "gefiltertes zulässiges Moment der Funktionsüberwachung" UBYTE rel_ub_q0p3906 1 100 0 99.6094 FORMAT "%5.2" ECU_ADDRESS 0x382E7B /end MEASUREMENT
/begin MEASUREMENT mzmax_uc "" UBYTE rel_ub_b99p6 1 100 0 99.6094 FORMAT "%5.2" ECU_ADDRESS 0x380D11 /end MEASUREMENT
/begin MEASUREMENT mzmax_um "zulässiges Moment aus der Maximalauswahl in der Funktionsüberwachung" UBYTE rel_ub_b99p6 1 100 0 99.6094 FORMAT "%5.2" ECU_ADDRESS 0x380CF5 /end MEASUREMENT
/begin MEASUREMENT mzo_uc "Toleranz-Offset für das zulässige Moment im Befehlstest" UBYTE rel_ub_b99p6 1 100 0 99.6094 FORMAT "%5.2" ECU_ADDRESS 0x380D12 /end MEASUREMENT
/begin MEASUREMENT mzo_um "Toleranz-Offset fürs zulässige Moment in der Funktionsüberwachung" UBYTE rel_ub_b99p6 1 100 0 99.6094 FORMAT "%5.2" ECU_ADDRESS 0x382E6F /end MEASUREMENT
/begin MEASUREMENT mz_uc "resultierendes zulässiges Moment im Befehlstest" UBYTE rel_ub_b99p6 1 100 0 99.6094 FORMAT "%5.2" ECU_ADDRESS 0x380D13 /end MEASUREMENT
/begin MEASUREMENT mz_um "resultierendes zulässiges Moment aus der Koordination der Funktionsüberwachung" UBYTE rel_ub_b99p6 1 100 0 99.6094 FORMAT "%5.2" ECU_ADDRESS 0x382E70 /end MEASUREMENT
/begin MEASUREMENT nc_c_um "Fehlerzähler für Motordrehzahlvergleich für die Funktionsüberwachung" UBYTE t40ms_ub_b10200 1 100 0 10200 FORMAT "%7.1" ECU_ADDRESS 0x382E4A /end MEASUREMENT
/begin MEASUREMENT nmot_uc "Motordrehzahl im Befehlstest" UBYTE nmot_ub_q40 1 100 0 10200 FORMAT "%5.0" ECU_ADDRESS 0x380CFE /end MEASUREMENT
/begin MEASUREMENT nmot_um "Motordrehzahl in der Funktionsüberwachung" UBYTE nmot_ub_q40 1 100 0 10200 FORMAT "%5.0" ECU_ADDRESS 0x382E4B /end MEASUREMENT
/begin MEASUREMENT nmst08_uc "" UWORD dez 1 100 0 65535 FORMAT "%8.2" ECU_ADDRESS 0x382602 /end MEASUREMENT
/begin MEASUREMENT nmst08_um "Stützstelle für Motordrehzahl in der Funktionsüberwachung (NMOT_UM)" UWORD dez 1 100 0 65535 FORMAT "%8.2" ECU_ADDRESS 0x382EAA /end MEASUREMENT
/begin MEASUREMENT nsc_c_um "Nachstart-Zeitzähler Nachstartaufweitung der FU" UWORD t40msxs_uw_q0p04 1 100 0 2621.4 FORMAT "%8.3" ECU_ADDRESS 0x382EA8 /end MEASUREMENT
/begin MEASUREMENT nska_uc "Grenzdrehzahl bei aktiver Fehlerreaktion im Befehlstest" UBYTE nmot_ub_q40 1 100 0 10200 FORMAT "%5.0" ECU_ADDRESS 0x380D21 /end MEASUREMENT
/begin MEASUREMENT nska_um "Grenzdrehzahl bei aktiver Fehlerreaktion in der Funktionsüberwachung" UBYTE nmot_ub_q40 1 100 0 10200 FORMAT "%5.0" ECU_ADDRESS 0x382E7E /end MEASUREMENT
/begin MEASUREMENT nsof_c_um "Zähler Entprellzeit für Abschaltung der Nachstartaufweitung" UBYTE t40ms_ub_b10200 1 100 0 10200 FORMAT "%7.1" ECU_ADDRESS 0x382E4D /end MEASUREMENT
/begin MEASUREMENT nsolfa "Leerlaufsolldrehzahl, Funktionsanforderung Tester" UBYTE nmot_ub_q10 1 100 0 2550 FORMAT "%5.0" ECU_ADDRESS 0x380AA3 /end MEASUREMENT
/begin MEASUREMENT nsyn_ctr "Zähler (Byte) Neusynchronisationen durch Lückenverlust" UBYTE DEZ 1 100 0 255 FORMAT "%5.1" ECU_ADDRESS 0x382F24 /end MEASUREMENT
/begin MEASUREMENT nwbits "" UBYTE default 1 100 0 255 FORMAT "%5.1" ARRAY_SIZE 2 ECU_ADDRESS 0x38093C /end MEASUREMENT
/begin MEASUREMENT nwsdstat "Diagnosestatus Tester Nockenwellenregelung Systemdichtheit" UBYTE dez 1 100 0 255 FORMAT "%5.1" ECU_ADDRESS 0x380D5C /end MEASUREMENT
/begin MEASUREMENT nwsdstat2 "Diagnosestatus Tester Nockenwellenregelung Systemdichtheit Bank 2" UBYTE dez 1 100 0 255 FORMAT "%5.1" ECU_ADDRESS 0x380D5D /end MEASUREMENT
/begin MEASUREMENT nwsstat "Diagnosestatus Tester Nockenwellenregelung" UBYTE dez 1 100 0 255 FORMAT "%5.1" ECU_ADDRESS 0x380D5E /end MEASUREMENT
/begin MEASUREMENT nwsstat2 "Diagnosestatus Tester Nockenwellenregelung Bank 2" UBYTE dez 1 100 0 255 FORMAT "%5.1" ECU_ADDRESS 0x380D5F /end MEASUREMENT
/begin MEASUREMENT nzwst08_uc "" UWORD dez 1 100 0 65535 FORMAT "%8.2" ECU_ADDRESS 0x382604 /end MEASUREMENT
/begin MEASUREMENT nzwst08_um "" UWORD dez 1 100 0 65535 FORMAT "%8.2" ECU_ADDRESS 0x382EAC /end MEASUREMENT
/begin MEASUREMENT nz_um "Motordrehzahl aus Zahnzählerdifferenz pro Zeit in der Funktionsüberwachung" UBYTE nmot_ub_q40 1 100 0 10200 FORMAT "%5.0" ECU_ADDRESS 0x382E4C /end MEASUREMENT
/begin MEASUREMENT n_flags_uc "Byte für Nachstart-Bits des Befehlstestes" UBYTE dez 1 100 0 255 FORMAT "%5.1" ECU_ADDRESS 0x380CF6 /end MEASUREMENT
/begin MEASUREMENT n_flags_um "Byte für Nachstart-Bits der Funktionsüberwachung" UBYTE dez 1 100 0 255 FORMAT "%5.1" ECU_ADDRESS 0x382E40 /end MEASUREMENT
/begin MEASUREMENT pm_akt "" UBYTE dez 1 100 0 255 FORMAT "%5.1" ECU_ADDRESS 0x380D61 /end MEASUREMENT
/begin MEASUREMENT pm_fre "" UBYTE dez 1 100 0 255 FORMAT "%5.1" ECU_ADDRESS 0x380D62 /end MEASUREMENT
/begin MEASUREMENT pm_mod "" UBYTE dez 1 100 0 255 FORMAT "%5.1" ECU_ADDRESS 0x380D63 /end MEASUREMENT
/begin MEASUREMENT pm_ta "" UBYTE dez 1 100 0 255 FORMAT "%5.1" ECU_ADDRESS 0x380D64 /end MEASUREMENT
/begin MEASUREMENT pm_td "" UBYTE dez 1 100 0 255 FORMAT "%5.1" ECU_ADDRESS 0x380D65 /end MEASUREMENT
/begin MEASUREMENT pspu "Quotient Saugrohrdruck Umgebungsdruck" UBYTE fak_ub_b2 1 100 0 1.99219 FORMAT "%5.3" ECU_ADDRESS 0x380A0C /end MEASUREMENT
/begin MEASUREMENT pty_fctr "" UBYTE dez 1 100 0 255 FORMAT "%5.1" ECU_ADDRESS 0x380D66 /end MEASUREMENT
/begin MEASUREMENT qtetemin "Quotient: te / TEMIN für BDE teh_w/teminh_w bzw. tes_w/temins" UBYTE fak_ub_b4 1 100 0 3.98438 FORMAT "%5.3" ECU_ADDRESS 0x3809FE /end MEASUREMENT
/begin MEASUREMENT r1000msCtr "" UWORD dez 1 100 0 65535 FORMAT "%8.2" ECU_ADDRESS 0x3824B2 /end MEASUREMENT
/begin MEASUREMENT r100msCtr "" UWORD dez 1 100 0 65535 FORMAT "%8.2" ECU_ADDRESS 0x3824B4 /end MEASUREMENT
/begin MEASUREMENT r10msCtr "10ms-Raster-Zähler der Funktion" UWORD dez 1 100 0 65535 FORMAT "%8.2" ECU_ADDRESS 0x3824B6 /end MEASUREMENT
/begin MEASUREMENT r1msCtr "" UWORD dez 1 100 0 65535 FORMAT "%8.2" ECU_ADDRESS 0x3824B8 /end MEASUREMENT
/begin MEASUREMENT r200msCtr "" UWORD dez 1 100 0 65535 FORMAT "%8.2" ECU_ADDRESS 0x3824BA /end MEASUREMENT
/begin MEASUREMENT r20msCtr "" UWORD dez 1 100 0 65535 FORMAT "%8.2" ECU_ADDRESS 0x3824BC /end MEASUREMENT
/begin MEASUREMENT r2msCtr "" UWORD dez 1 100 0 65535 FORMAT "%8.2" ECU_ADDRESS 0x3824BE /end MEASUREMENT
/begin MEASUREMENT r50msCtr "" UWORD dez 1 100 0 65535 FORMAT "%8.2" ECU_ADDRESS 0x3824C0 /end MEASUREMENT
/begin MEASUREMENT ram_c_um "Fehlerzähler im Dauer-RAM für RAM-Konsistenz-Prüfung (Diagnose) in der Fkt-Überw" UBYTE dez 1 100 0 255 FORMAT "%5.1" ECU_ADDRESS 0x38312F /end MEASUREMENT
/begin MEASUREMENT reac_c1_uc "Fehlerzähler 1 für Fehlerreaktionsüberwachung im Befehlstest" UBYTE t40ms_ub_b10200 1 100 0 10200 FORMAT "%7.1" ECU_ADDRESS 0x380D22 /end MEASUREMENT
/begin MEASUREMENT reac_c1_um "Fehlerzähler 1 für Fehlerreaktionsüberwachung in Funktionsüberwachung" UBYTE t40ms_ub_b10200 1 100 0 10200 FORMAT "%7.1" ECU_ADDRESS 0x382E7F /end MEASUREMENT
/begin MEASUREMENT reac_c2_uc "Fehlerzähler 2 für Fehlerreaktionsüberwachung im Befehlstest" UBYTE t40ms_ub_b10200 1 100 0 10200 FORMAT "%7.1" ECU_ADDRESS 0x380D23 /end MEASUREMENT
/begin MEASUREMENT reac_c2_um "Fehlerzähler 2 für Fehlerreaktionsüberwachung in Funktionsüberwachung" UBYTE t40ms_ub_b10200 1 100 0 10200 FORMAT "%7.1" ECU_ADDRESS 0x382E80 /end MEASUREMENT
/begin MEASUREMENT reac_c_um "Fehlerzähler im Dauer-RAM für Fehlerreaktionsüberwachung (Diagnose) in der FU" UBYTE dez 1 100 0 255 FORMAT "%5.1" ECU_ADDRESS 0x383130 /end MEASUREMENT
/begin MEASUREMENT rec_fctr "" UBYTE dez 1 100 0 255 FORMAT "%5.1" ECU_ADDRESS 0x380D67 /end MEASUREMENT
/begin MEASUREMENT reset_indication_um "" UWORD dez 1 100 0 65535 FORMAT "%8.2" ECU_ADDRESS 0x383A4E /end MEASUREMENT
/begin MEASUREMENT rkte_w "Relativer Gemischanteil Tankentlüftung" SWORD rel_sw_q0p0468 1 100 -1536 1535.95 FORMAT "%8.3" ECU_ADDRESS 0x3812E6 /end MEASUREMENT
/begin MEASUREMENT rlc_c_um "Fehlerzähler für rl-Vergleich mit der Funktion in der Funktionsüberwachung" UBYTE t40ms_ub_b10200 1 100 0 10200 FORMAT "%7.1" ECU_ADDRESS 0x382E52 /end MEASUREMENT
/begin MEASUREMENT rlf_ptr_um "Pointer für Schieberegister des Lastfilters" UBYTE dez 1 100 0 255 FORMAT "%5.1" ECU_ADDRESS 0x382E53 /end MEASUREMENT
/begin MEASUREMENT rlf_reg_um "" UBYTE rel_ub_q0p75 1 100 0 191.25 FORMAT "%5.1" ARRAY_SIZE 8 ECU_ADDRESS 0x382E54 /end MEASUREMENT
/begin MEASUREMENT rlipf_low_um "" UBYTE rel_ub_q0p0029 1 100 0 0.74707 ECU_ADDRESS 0x382E5C /end MEASUREMENT
/begin MEASUREMENT rlipf_um "relative Luftfüllung aus Nebenlastsignal hinter Tiefpaß in der Funktionsüberw." UBYTE rel_ub_q0p75 1 100 0 191.25 FORMAT "%5.1" ECU_ADDRESS 0x382E5D /end MEASUREMENT
/begin MEASUREMENT rlip_c_um "Fehlerzähler für rl/rlip-Vergleich in der Funktionsüberwachung" UBYTE t40ms_ub_b10200 1 100 0 10200 FORMAT "%7.1" ECU_ADDRESS 0x382E5E /end MEASUREMENT
/begin MEASUREMENT rlip_um "relative Luftfüllung aus Nebenlastsignal für die Funktionsüberwachung" UBYTE rel_ub_q0p75 1 100 0 191.25 FORMAT "%5.1" ECU_ADDRESS 0x382E5F /end MEASUREMENT
/begin MEASUREMENT rlst08_uc "" UWORD dez 1 100 0 65535 FORMAT "%8.2" ECU_ADDRESS 0x382606 /end MEASUREMENT
/begin MEASUREMENT rlst08_um "Stützstelle der SSV RLV08_UM" UWORD dez 1 100 0 65535 FORMAT "%8.2" ECU_ADDRESS 0x382EAE /end MEASUREMENT
/begin MEASUREMENT rlteev_w "Relative Füllung verursacht durch Regeneriergas Tankentlüftung" UWORD rel_uw_b192 1 100 0 191.997 FORMAT "%8.4" ECU_ADDRESS 0x3812E8 /end MEASUREMENT
/begin MEASUREMENT rlzo_um "obere Toleranzgrenze für rl aus Nebenlastsignal in der Funktionsüberwachung" UBYTE rel_ub_q0p75 1 100 0 191.25 FORMAT "%5.1" ECU_ADDRESS 0x380CF0 /end MEASUREMENT
/begin MEASUREMENT rl_uc "relative Luftfüllung im Befehlstest" UBYTE rel_ub_q0p75 1 100 0 191.25 FORMAT "%5.1" ECU_ADDRESS 0x380CFF /end MEASUREMENT
/begin MEASUREMENT rl_um "relative Luftfüllung in der Funktionsüberwachung" UBYTE rel_ub_q0p75 1 100 0 191.25 FORMAT "%5.1" ECU_ADDRESS 0x382E60 /end MEASUREMENT
/begin MEASUREMENT rl_w_um "relative Luftfüllung (Word) in der Funktionsüberwachung" UWORD rel_uw_q0p0234 1 100 0 1535.98 FORMAT "%8.3" ECU_ADDRESS 0x3825A6 /end MEASUREMENT
/begin MEASUREMENT romErrPage "" UBYTE dez 1 100 0 255 FORMAT "%5.1" ECU_ADDRESS 0x383131 /end MEASUREMENT
/begin MEASUREMENT romRstC_um "Zähler im DauerRAM für Resets bei ROM-Check-Fehler in der Init. in der FU" UBYTE dez 1 100 0 255 FORMAT "%5.1" ECU_ADDRESS 0x38312C /end MEASUREMENT
/begin MEASUREMENT romz_c_um "Fehlerzähler im Dauer-RAM für ROM-Prüfung (Diagnose) in der Funktionsüberwachung" UBYTE dez 1 100 0 255 FORMAT "%5.1" ECU_ADDRESS 0x383132 /end MEASUREMENT
/begin MEASUREMENT rst_tv "Variable im Dauer-RAM zur Anforderung Reset-Tastverhältnis aus der Fkt-Überwach." UBYTE dez 1 100 0 255 FORMAT "%5.1" ECU_ADDRESS 0x383133 /end MEASUREMENT
/begin MEASUREMENT r_flags_uc "Byte für Fehlerreaktions-Bits des Befehlstest" UBYTE dez 1 100 0 255 FORMAT "%5.1" ECU_ADDRESS 0x380CF7 /end MEASUREMENT
/begin MEASUREMENT r_flags_um "Byte für Fehlerreaktions-Bits der Funktionsüberwachung" UBYTE dez 1 100 0 255 FORMAT "%5.1" ECU_ADDRESS 0x382E41 /end MEASUREMENT
/begin MEASUREMENT sp1p_a_um "10ms alter Wert f. Sollwert-Poti 1 (PWG) vom Überwachungsmodul für den ADC-Test" UBYTE spg_ub_q0p019 1 100 0 4.845 FORMAT "%5.3" ECU_ADDRESS 0x382E82 /end MEASUREMENT
/begin MEASUREMENT sp1p_st_um "Stationärzähler für Sollwertpoti 1 vom Überwachungsmodul" UBYTE t10msxs_ub_b2p55 1 100 0 2.55 FORMAT "%5.3" ECU_ADDRESS 0x382E83 /end MEASUREMENT
/begin MEASUREMENT sp1s_a_um "10ms alter Wert f. Sollwert-Poti 1 (PWG) für die Funktionsüberwachung" UBYTE spg_ub_q0p019 1 100 0 4.845 FORMAT "%5.3" ECU_ADDRESS 0x382E84 /end MEASUREMENT
/begin MEASUREMENT sp1s_st_um "Stationärzähler für Sollwertpoti 1" UBYTE t10msxs_ub_b2p55 1 100 0 2.55 FORMAT "%5.3" ECU_ADDRESS 0x382E85 /end MEASUREMENT
/begin MEASUREMENT sp1s_um "aktueller Wert für Sollwert-Poti 1 (PWG) für die Funktionsüberwachung" UBYTE spg_ub_q0p019 1 100 0 4.845 FORMAT "%5.3" ECU_ADDRESS 0x382E61 /end MEASUREMENT
/begin MEASUREMENT sp2s_um "aktueller Wert für Sollwert-Poti 2 (PWG) für die Funktionsüberwachung" UBYTE spg_ub_q0p0098 1 100 0 2.49023 FORMAT "%5.3" ECU_ADDRESS 0x382E62 /end MEASUREMENT
/begin MEASUREMENT spsc_c_um "Fehlerzähler bei zueinander unplausiblen Sollwerten in der Funktionsüberwachung" UBYTE t40ms_ub_b10200 1 100 0 10200 FORMAT "%7.1" ECU_ADDRESS 0x382E63 /end MEASUREMENT
/begin MEASUREMENT spsnst08_uc "" UWORD dez 1 100 0 65535 FORMAT "%8.2" ECU_ADDRESS 0x382608 /end MEASUREMENT
/begin MEASUREMENT spsnst08_um "" UWORD dez 1 100 0 65535 FORMAT "%8.2" ECU_ADDRESS 0x382EB0 /end MEASUREMENT
/begin MEASUREMENT spsn_uc "nach unten auf Leerlauf begrenzter Pedalwert (8 Bit) im Befehlstest" UBYTE spg_ub_q0p019 1 100 0 4.845 FORMAT "%5.3" ECU_ADDRESS 0x380D00 /end MEASUREMENT
/begin MEASUREMENT spsn_um "Pedalsollwert (8 Bit) in der Funktionsüberwachung" UBYTE spg_ub_q0p019 1 100 0 4.845 FORMAT "%5.3" ECU_ADDRESS 0x382E64 /end MEASUREMENT
/begin MEASUREMENT srst_c_um "Zähler im Dauer-RAM für Software-Reset (Diagnose) aus der Funktionsüberwachung" UBYTE dez 1 100 0 255 FORMAT "%5.1" ECU_ADDRESS 0x383134 /end MEASUREMENT
/begin MEASUREMENT stpdmtl "Funktionsstatus-Zähler DM-TL für Testerausgabe" UBYTE dez 1 100 0 255 FORMAT "%5.1" ECU_ADDRESS 0x382F2E /end MEASUREMENT
/begin MEASUREMENT stpdmtla "Funktionsstatus-Zähler DM-TL für Testerausgabe aus letztem Fahrzyklus" UBYTE dez 1 100 0 255 FORMAT "%5.1" ECU_ADDRESS 0x382F2F /end MEASUREMENT
/begin MEASUREMENT stpdmtlm8 "Funktionsstatus-Zähler DM-TL für Scan-Tool Mode 8" UBYTE dez 1 100 0 255 FORMAT "%5.1" ECU_ADDRESS 0x380A0E /end MEASUREMENT
/begin MEASUREMENT S_bls "Schalter Bremslicht" UWORD B_TRUE 1 100 0 1 BIT_MASK 0x8 FORMAT "%13.11" ECU_ADDRESS 0xFDBE /end MEASUREMENT
/begin MEASUREMENT S_brs "Schalter Bremstest" UWORD B_TRUE 1 100 0 1 BIT_MASK 0x10 FORMAT "%13.11" ECU_ADDRESS 0xFDBE /end MEASUREMENT
/begin MEASUREMENT s_flags_uc "Byte für Status-Bits des Befehlstests" UBYTE dez 1 100 0 255 FORMAT "%5.1" ECU_ADDRESS 0x380CF8 /end MEASUREMENT
/begin MEASUREMENT s_flags_um "Byte für Status-Bits der Funktionsüberwachung" UBYTE dez 1 100 0 255 FORMAT "%5.1" ECU_ADDRESS 0x382E42 /end MEASUREMENT
/begin MEASUREMENT S_kupp "Schalter Kupplung" UWORD B_TRUE 1 100 0 1 BIT_MASK 0x20 FORMAT "%13.11" ECU_ADDRESS 0xFDBE /end MEASUREMENT
/begin MEASUREMENT S_ldpr "" UWORD B_TRUE 1 100 0 1 BIT_MASK 0x40 FORMAT "%13.11" ECU_ADDRESS 0xFDBE /end MEASUREMENT
/begin MEASUREMENT t1tvir_w "" UWORD TEQL 1 100 0 209.712 FORMAT "%8.4" ARRAY_SIZE 2 ECU_ADDRESS 0xE444 /end MEASUREMENT
/begin MEASUREMENT T2DMTLbits "" UBYTE dez 1 100 0 255 FORMAT "%5.1" ECU_ADDRESS 0x380A0F /end MEASUREMENT
/begin MEASUREMENT T2DMTLbitsNOV "" UBYTE dez 1 100 0 255 FORMAT "%5.1" ECU_ADDRESS 0x382F30 /end MEASUREMENT
/begin MEASUREMENT talt_um "Timerwert des vorhergehenden Berechnungszeitpunkts im 40ms-Raster" UWORD dez 1 100 0 65535 FORMAT "%8.2" ECU_ADDRESS 0x382EA0 /end MEASUREMENT
/begin MEASUREMENT tamldia "Tastverhältnis E-Lüfter Diagnoseeingriff" UBYTE rel_ub_b100 1 100 0 100 FORMAT "%5.1" ECU_ADDRESS 0x380AA4 /end MEASUREMENT
/begin MEASUREMENT tans_um "Ansaugluft-Temperatur in der Funktionsüberwachung" UBYTE temp_ub_q0p75_o48 1 100 -48 143.25 FORMAT "%5.1" ECU_ADDRESS 0x382E46 /end MEASUREMENT
/begin MEASUREMENT tanwp "Tastverhältnis für NW-Verstellung proportional zum Regelfehler" SBYTE tv_sb_b50 1 100 -50 49.6094 FORMAT "%4.1" ARRAY_SIZE 2 ECU_ADDRESS 0x38093E /end MEASUREMENT
/begin MEASUREMENT tanwr "Tastverhältnis Nockenwellenregelung" UBYTE tv_ub_b100 1 100 0 100 FORMAT "%4.0" ARRAY_SIZE 2 ECU_ADDRESS 0xE506 /end MEASUREMENT
/begin MEASUREMENT tanwrhf "Adaptiertes Halte-Tastverhältnis (NW-Regelung)" UBYTE tv_ub_b100 1 100 0 100 FORMAT "%4.0" ARRAY_SIZE 2 ECU_ADDRESS 0x380940 /end MEASUREMENT
/begin MEASUREMENT tcap_um "Timerwert des aktuellen Berechnungszeitpunkts im 40ms-Raster" UWORD dez 1 100 0 65535 FORMAT "%8.2" ECU_ADDRESS 0x382EA2 /end MEASUREMENT
/begin MEASUREMENT tevtim "" UBYTE dez 1 100 0 255 FORMAT "%5.1" ECU_ADDRESS 0x380AA5 /end MEASUREMENT
/begin MEASUREMENT tfadtlbe "Zeitzähler für Abbruch Funktionsanforderung DM-TL Systemtest" UWORD t100msxs_uw_b6553p5 1 100 0 6553.5 FORMAT "%8.3" ECU_ADDRESS 0x38319C /end MEASUREMENT
/begin MEASUREMENT tfgrenum_c "" UBYTE t40ms_ub_b10200 1 100 0 10200 FORMAT "%7.1" ECU_ADDRESS 0x382E49 /end MEASUREMENT
/begin MEASUREMENT TI_EV0 "Einspritzzeit 1. Zylinder in Zündfolge" UWORD TEQL 1 100 0 209.712 FORMAT "%8.4" ECU_ADDRESS 0xF934 /end MEASUREMENT
/begin MEASUREMENT TI_EV1 "Einspritzzeit 2. Zylinder in Zündfolge" UWORD TEQL 1 100 0 209.712 FORMAT "%8.4" ECU_ADDRESS 0xF936 /end MEASUREMENT
/begin MEASUREMENT TI_EV2 "Einspritzzeit 3. Zylinder in Zündfolge" UWORD TEQL 1 100 0 209.712 FORMAT "%8.4" ECU_ADDRESS 0xF938 /end MEASUREMENT
/begin MEASUREMENT TI_EV3 "Einspritzzeit 4. Zylinder in Zündfolge" UWORD TEQL 1 100 0 209.712 FORMAT "%8.4" ECU_ADDRESS 0xF93A /end MEASUREMENT
/begin MEASUREMENT TI_EV4 "Einspritzzeit 5. Zylinder in Zündfolge" UWORD TEQL 1 100 0 209.712 FORMAT "%8.4" ECU_ADDRESS 0xF93C /end MEASUREMENT
/begin MEASUREMENT TI_EV5 "Einspritzzeit 6. Zylinder in Zündfolge" UWORD TEQL 1 100 0 209.712 FORMAT "%8.4" ECU_ADDRESS 0xF93E /end MEASUREMENT
/begin MEASUREMENT TI_EV6 "Einspritzzeit 7. Zylinder in Zündfolge" UWORD TEQL 1 100 0 209.712 FORMAT "%8.4" ECU_ADDRESS 0xF940 /end MEASUREMENT
/begin MEASUREMENT TI_EV7 "Einspritzzeit 8. Zylinder in Zündfolge" UWORD TEQL 1 100 0 209.712 FORMAT "%8.4" ECU_ADDRESS 0xF942 /end MEASUREMENT
/begin MEASUREMENT tmot_um "Motor-Temperatur in der Funktionsüberwachung" UBYTE temp_ub_q0p75_o48 1 100 -48 143.25 FORMAT "%5.1" ECU_ADDRESS 0x382E47 /end MEASUREMENT
/begin MEASUREMENT tnwsfi "Diagnose Tester Nockenwellenregelung Frühverstellzeit" UWORD t10msxs_uw_b655p35 1 100 0 655.35 FORMAT "%8.4" ECU_ADDRESS 0x382758 /end MEASUREMENT
/begin MEASUREMENT tnwsfi2 "Diagnose Tester Nockenwellenregelung Frühverstellung Bank 2" UWORD t10msxs_uw_b655p35 1 100 0 655.35 FORMAT "%8.4" ECU_ADDRESS 0x38275A /end MEASUREMENT
/begin MEASUREMENT tnwssi "Diagnose Tester Nockenwellenregelung Spätverstellzeit" UWORD t10msxs_uw_b655p35 1 100 0 655.35 FORMAT "%8.4" ECU_ADDRESS 0x38275C /end MEASUREMENT
/begin MEASUREMENT tnwssi2 "Diagnose Tester Nockenwellenregelung Spätverstellzeit Bank 2" UWORD t10msxs_uw_b655p35 1 100 0 655.35 FORMAT "%8.4" ECU_ADDRESS 0x38275E /end MEASUREMENT
/begin MEASUREMENT trevovCtr "" UWORD dez 1 100 0 65535 FORMAT "%8.2" ECU_ADDRESS 0xF848 /end MEASUREMENT
/begin MEASUREMENT ttimout "" UWORD dez 1 100 0 65535 FORMAT "%8.2" ECU_ADDRESS 0x383F26 /end MEASUREMENT
/begin MEASUREMENT tvbits "" UBYTE default 1 100 0 255 FORMAT "%5.1" ARRAY_SIZE 2 ECU_ADDRESS 0x380942 /end MEASUREMENT
/begin MEASUREMENT TVUB_R "EV-Spannungskorrektur" UWORD TEQL 1 100 0 209.712 FORMAT "%8.4" ECU_ADDRESS 0xF964 /end MEASUREMENT
/begin MEASUREMENT tweiter "" UWORD dez 1 100 0 65535 FORMAT "%8.2" ECU_ADDRESS 0x383F28 /end MEASUREMENT
/begin MEASUREMENT twuerg "" UWORD dez 1 100 0 65535 FORMAT "%8.2" ECU_ADDRESS 0x383F2A /end MEASUREMENT
/begin MEASUREMENT tznwco "Zeit mit stationärem NW-Sollwert nach Halte-TV" UBYTE t1ms_ub_b255 1 100 0 255 ARRAY_SIZE 2 ECU_ADDRESS 0x380944 /end MEASUREMENT
/begin MEASUREMENT t_bthsh "" UBYTE dez 1 100 0 255 FORMAT "%5.1" ECU_ADDRESS 0x380AA6 /end MEASUREMENT
/begin MEASUREMENT t_bthsh2 "" UBYTE dez 1 100 0 255 FORMAT "%5.1" ECU_ADDRESS 0x380AA7 /end MEASUREMENT
/begin MEASUREMENT t_bthsv "" UBYTE dez 1 100 0 255 FORMAT "%5.1" ECU_ADDRESS 0x380AA8 /end MEASUREMENT
/begin MEASUREMENT t_bthsv2 "" UBYTE dez 1 100 0 255 FORMAT "%5.1" ECU_ADDRESS 0x380AA9 /end MEASUREMENT
/begin MEASUREMENT t_bttev "" UBYTE dez 1 100 0 255 FORMAT "%5.1" ECU_ADDRESS 0x380AAA /end MEASUREMENT
/begin MEASUREMENT t_bttim "" UBYTE dez 1 100 0 255 FORMAT "%5.1" ECU_ADDRESS 0x380AAB /end MEASUREMENT
/begin MEASUREMENT UBATT "Batteriespannung" UBYTE UBQ 1 100 0 24.021 FORMAT "%5.2" ECU_ADDRESS 0xF900 /end MEASUREMENT
/begin MEASUREMENT UetmNvBits "" UBYTE dez 1 100 0 255 FORMAT "%5.1" ECU_ADDRESS 0x38312B /end MEASUREMENT
/begin MEASUREMENT uma2_res "Antwortbeitrag des Befehlstests" SWORD dez 1 100 -32768 32767 FORMAT "%8.2" ECU_ADDRESS 0x38255E /end MEASUREMENT
/begin MEASUREMENT umErrorCtrFr "" UBYTE dez 1 100 0 255 FORMAT "%5.1" ECU_ADDRESS 0x38312E /end MEASUREMENT
/begin MEASUREMENT umrst_c_um "Zähler im Dauer-RAM für Software-Reset (Diagnose) aus %UMKOM" UBYTE dez 1 100 0 255 FORMAT "%5.1" ECU_ADDRESS 0x383135 /end MEASUREMENT
/begin MEASUREMENT uuptes_w "ADC-Spannung Pumpenstrom Tankdiagnose" UWORD spg_q0p00488 1 100 0 319.995 FORMAT "%8.4" ARRAY_SIZE 5 ECU_ADDRESS 0x382304 /end MEASUREMENT
/begin MEASUREMENT vfgr_uc "" UWORD vfzg_uw_q0p00781 1 100 0 511.992 FORMAT "%8.4" ECU_ADDRESS 0x3825EE /end MEASUREMENT
/begin MEASUREMENT vfgr_um "Fahrzeuggeschwindigkeit in der Funktionsüberwachung" UWORD vfzg_uw_q0p00781 1 100 0 511.992 FORMAT "%8.4" ECU_ADDRESS 0x382E9E /end MEASUREMENT
/begin MEASUREMENT vfzgpr_w "Prädizierte Fahrzeuggeschwindigkeit für VMAX-Regelung" UWORD vfzg_uw_q0p00781 1 100 0 511.992 FORMAT "%8.4" ECU_ADDRESS 0x382490 /end MEASUREMENT
/begin MEASUREMENT vnwadf_w "Adaptierte NW-Verstellgeschwindigkeit Richtung früh" SWORD vnw_sw_b1000 1 100 -1000 999.969 FORMAT "%7.2" ARRAY_SIZE 2 ECU_ADDRESS 0x3810FC /end MEASUREMENT
/begin MEASUREMENT vnwads_w "Adaptierte NW-Verstellgeschwindigkeit Richtung spät" SWORD vnw_sw_b1000 1 100 -1000 999.969 FORMAT "%7.2" ARRAY_SIZE 2 ECU_ADDRESS 0x381100 /end MEASUREMENT
/begin MEASUREMENT vnwadta_w "" SWORD vnw_sw_b1000 1 100 -1000 999.969 FORMAT "%7.2" ARRAY_SIZE 2 ECU_ADDRESS 0x381104 /end MEASUREMENT
/begin MEASUREMENT vnwdsend_w "" SWORD vnw_sw_b1000 1 100 -1000 999.969 FORMAT "%7.2" ARRAY_SIZE 2 ECU_ADDRESS 0x381108 /end MEASUREMENT
/begin MEASUREMENT vnwfad_w "" SWORD vnw_sw_b1000 1 100 -1000 999.969 FORMAT "%7.2" ARRAY_SIZE 2 ECU_ADDRESS 0x38110C /end MEASUREMENT
/begin MEASUREMENT vnwgsend_w "Geschätzter Endwert NW-Verstellgeschwindigkeit" SWORD vnw_sw_b1000 1 100 -1000 999.969 FORMAT "%7.2" ARRAY_SIZE 2 ECU_ADDRESS 0x381110 /end MEASUREMENT
/begin MEASUREMENT vnwgs_w "Geschätzte aktuelle NW-Verstellgeschwindigkeit" SWORD vnw_sw_b1000 1 100 -1000 999.969 FORMAT "%7.2" ARRAY_SIZE 2 ECU_ADDRESS 0xE448 /end MEASUREMENT
/begin MEASUREMENT vnwsad_w "" SWORD vnw_sw_b1000 1 100 -1000 999.969 FORMAT "%7.2" ARRAY_SIZE 2 ECU_ADDRESS 0x381114 /end MEASUREMENT
/begin MEASUREMENT vsdmr "Vorgabe Drehmomentreserve über Verstellsystem VSxy" UBYTE rel_ub_q0p3906 1 100 0 99.6094 FORMAT "%5.2" ECU_ADDRESS 0x380900 /end MEASUREMENT
/begin MEASUREMENT vsfpses "Faktor zur Verstellung Saugrohrdruck zur Applikation Einspritzung" UBYTE fak_ub_b2 1 100 0 1.99219 FORMAT "%5.3" ECU_ADDRESS 0x380AAC /end MEASUREMENT
/begin MEASUREMENT vsfrk "Korrektur der relativen Kraftstoffmasse über Verstellsysteme" UBYTE fak_ub_b1p25_o0p75 1 100 0.75 1.24805 FORMAT "%5.3" ECU_ADDRESS 0x380AAD /end MEASUREMENT
/begin MEASUREMENT vske "verstellbarer Offset für Klopferkennungsschwelle über VS20" SBYTE fak_ub_b16 1 100 -8 7.9375 FORMAT "%5.3" ECU_ADDRESS 0x380901 /end MEASUREMENT
/begin MEASUREMENT vsldtv "Verstellgröße LDR-Tastverhältnis vom VSx-System zur Applikation" UBYTE tv_ub_b100 1 100 0 100 FORMAT "%4.0" ECU_ADDRESS 0x380AAE /end MEASUREMENT
/begin MEASUREMENT vsns "Änderung der Solldrehzahl über Verstellsystem VSxy" UBYTE nmot_ub_q10 1 100 0 2550 FORMAT "%5.0" ECU_ADDRESS 0x380AAF /end MEASUREMENT
/begin MEASUREMENT vsrlmx "Additive Füllungskorrektur für rlmx vom Verstellsystem" SBYTE rel_sb_q0p75 1 100 -96 95.25 FORMAT "%5.2" ECU_ADDRESS 0x380AB0 /end MEASUREMENT
/begin MEASUREMENT vsvw "Änderung Einspritzvorlagerungswinkel über Verstellsystem" SBYTE zw_sb_q6 1 100 -768 762 FORMAT "%5.1" ECU_ADDRESS 0x380AB1 /end MEASUREMENT
/begin MEASUREMENT vswnws "Änderung der Winkel Nockenwelle (variable NWS) über Verstellsystem VSxy" UBYTE wkw_ub_q0p25 1 100 0 63.75 FORMAT "%7.4" ECU_ADDRESS 0x380AB2 /end MEASUREMENT
/begin MEASUREMENT vszw "Zündwinkelkorrektur durch Verstellsystem" SBYTE zw_sb_q0p75 1 100 -96 95.25 FORMAT "%5.2" ECU_ADDRESS 0x380902 /end MEASUREMENT
/begin MEASUREMENT vszwkr "Zylinderindividuelle ZW-Verstellung durch Verstellsystem" SBYTE zw_sb_q0p75 1 100 -96 95.25 FORMAT "%5.2" ARRAY_SIZE 8 ECU_ADDRESS 0x380903 /end MEASUREMENT
/begin MEASUREMENT wc_fctr "" UBYTE dez 1 100 0 255 FORMAT "%5.1" ECU_ADDRESS 0x380D68 /end MEASUREMENT
/begin MEASUREMENT wnw "Vorsteuerwert für Nockenwellenwinkel" UBYTE wkw_ub_q0p25 1 100 0 63.75 FORMAT "%7.4" ECU_ADDRESS 0x380D5A /end MEASUREMENT
/begin MEASUREMENT wnwam "Nockenwellenwinkel Auslaß (Mittelwert)" UBYTE wkw_ub_q0p5 1 100 0 127.5 ECU_ADDRESS 0x38094A /end MEASUREMENT
/begin MEASUREMENT wnwem "Nockenwellenwinkel Einlaß (Mittelwert)" SBYTE wkw_sb_q0p5 1 100 -64 63.5 FORMAT "%7.4" ECU_ADDRESS 0x380946 /end MEASUREMENT
/begin MEASUREMENT wnwgsend_w "Geschätzter Endwert NW-Winkel (bei Ausgabe Halte-TV)" SWORD wkw_sw_b128 1 100 -128 127.996 FORMAT "%7.3" ARRAY_SIZE 2 ECU_ADDRESS 0x381118 /end MEASUREMENT
/begin MEASUREMENT wnwgs_w "Geschätzter NW-Winkel" SWORD wkw_sw_b128 1 100 -128 127.996 FORMAT "%7.3" ARRAY_SIZE 2 ECU_ADDRESS 0xE44C /end MEASUREMENT
/begin MEASUREMENT wnwi_w "Istwinkel für Nockenwelle (word)" SWORD wkw_sw_b128 1 100 -128 127.996 FORMAT "%7.3" ARRAY_SIZE 2 ECU_ADDRESS 0xE452 /end MEASUREMENT
/begin MEASUREMENT wnwkor_w "Aktueller Korrekturwert für NW-Signal" SWORD wkw_sw_b128 1 100 -128 127.996 FORMAT "%7.3" ECU_ADDRESS 0xE456 /end MEASUREMENT
/begin MEASUREMENT wnws "Sollwinkel für Nockenwelle" UBYTE wkw_ub_q0p25 1 100 0 63.75 FORMAT "%7.4" ECU_ADDRESS 0x38094B /end MEASUREMENT
/begin MEASUREMENT wnwsmx "max. erlaubter variable NWS-Sollwinkel" UBYTE wkw_ub_q0p25 1 100 0 63.75 FORMAT "%7.4" ECU_ADDRESS 0x380D5B /end MEASUREMENT
/begin MEASUREMENT wnwsp_w "Adaptionswinkel Nockenwelle (Spätanschlag)" SWORD wkw_sw_b128 1 100 -128 127.996 FORMAT "%7.3" ARRAY_SIZE 8 ECU_ADDRESS 0x38301C /end MEASUREMENT
/begin MEASUREMENT wnwss "gespeicherter Sollwinkel" UBYTE wkw_ub_q0p25 1 100 0 63.75 FORMAT "%7.4" ECU_ADDRESS 0x380947 /end MEASUREMENT
/begin MEASUREMENT wnwstst "Sollwinkel für Nockenwelle bei Testeranforderung Systemtest" UBYTE wkw_ub_q0p25 1 100 0 63.75 FORMAT "%7.4" ECU_ADDRESS 0x380A0D /end MEASUREMENT
/begin MEASUREMENT wnwue "Winkel Nockenwellenueberschneidung" UBYTE wkw_ub_q0p5 1 100 0 127.5 ECU_ADDRESS 0x380948 /end MEASUREMENT
/begin MEASUREMENT WOUT "ausgegebener Zündwinkel" UBYTE ZWOF 1 100 -119.25 72 FORMAT "%5.1" ECU_ADDRESS 0xF905 /end MEASUREMENT
/begin MEASUREMENT WOUTA "ausgegebener Zündwinkel bei Doppelzündung: erster Zündkreis" UBYTE ZWOF 1 100 -119.25 72 FORMAT "%5.1" ECU_ADDRESS 0xF918 /end MEASUREMENT
/begin MEASUREMENT wphg "Zündwinkel DG-Phasenkorrektur" SBYTE zw_sb_q0p75 1 100 -96 95.25 FORMAT "%5.2" ECU_ADDRESS 0x380A6B /end MEASUREMENT
/begin MEASUREMENT wri_c_um "Fehlerzähler im Dauer-RAM für RAM-Beschreibbarkeits-Prüfung (Diagnose) in der FU" UBYTE dez 1 100 0 255 FORMAT "%5.1" ECU_ADDRESS 0x383136 /end MEASUREMENT
/begin MEASUREMENT x_uc "" UBYTE dez 1 100 0 255 FORMAT "%5.1" ECU_ADDRESS 0x380D01 /end MEASUREMENT
/begin MEASUREMENT y_uc "" UBYTE dez 1 100 0 255 FORMAT "%5.1" ECU_ADDRESS 0x380D02 /end MEASUREMENT
/begin MEASUREMENT zalt_um "Zahnzählerwert des vorhergehenden Berechnungszeitpunkts im 40ms-Raster" UWORD dez 1 100 0 65535 FORMAT "%8.2" ECU_ADDRESS 0x382EA4 /end MEASUREMENT
/begin MEASUREMENT zcap_um "Zahnzählerwert des aktuellen Berechnungszeitpunkts im 40ms-Raster" UWORD dez 1 100 0 65535 FORMAT "%8.2" ECU_ADDRESS 0x382EA6 /end MEASUREMENT
/begin MEASUREMENT zwbas "Basiszündwinkel" SBYTE zw_sb_q0p75 1 100 -96 95.25 FORMAT "%5.2" ECU_ADDRESS 0xFA52 /end MEASUREMENT
/begin MEASUREMENT zwbasar "Basiszündwinkelarray" SBYTE zw_sb_q0p75 1 100 -96 95.25 FORMAT "%5.2" ARRAY_SIZE 4 ECU_ADDRESS 0x380A6C /end MEASUREMENT
/begin MEASUREMENT zwc_c_um "Fehlerzähler für Zündwinkelüberwachung in der Funktionsüberwachung" UBYTE dez 1 100 0 255 FORMAT "%5.1" ECU_ADDRESS 0x382E4E /end MEASUREMENT
/begin MEASUREMENT zwgru "Grundzündwinkel" SBYTE zw_sb_q0p75 1 100 -96 95.25 FORMAT "%5.2" ECU_ADDRESS 0xFA62 /end MEASUREMENT
/begin MEASUREMENT zwist "Ist-Zündwinkel" SBYTE zw_sb_q0p75 1 100 -96 95.25 FORMAT "%5.2" ECU_ADDRESS 0xFA53 /end MEASUREMENT
/begin MEASUREMENT zwkrafld "Bitmuster des zyl.ind. abgelegten B_zwkra" UBYTE dez 1 100 0 255 FORMAT "%5.1" ECU_ADDRESS 0xFA54 /end MEASUREMENT
/begin MEASUREMENT zwks "abs. Zündwinkel aus %KS_W bzw. %ZWKS" SBYTE zw_sb_q0p75 1 100 -96 95.25 FORMAT "%5.2" ECU_ADDRESS 0x380B5D /end MEASUREMENT
/begin MEASUREMENT zwopt_uc "optimaler Zündwinkel im Befehlstest" SBYTE zw_sb_q0p75 1 100 -96 95.25 FORMAT "%5.2" ECU_ADDRESS 0x380D0F /end MEASUREMENT
/begin MEASUREMENT zwopt_um "optimaler Zündwinkel in der Funktionsüberwachung" SBYTE zw_sb_q0p75 1 100 -96 95.25 FORMAT "%5.2" ECU_ADDRESS 0x380CF3 /end MEASUREMENT
/begin MEASUREMENT zwout "Zündwinkel-Ausgabe" SBYTE zw_sb_q0p75 1 100 -96 95.25 FORMAT "%5.2" ECU_ADDRESS 0xFA55 /end MEASUREMENT
/begin MEASUREMENT zwoutar "Zündwinkel-Ausgabe Array" SBYTE zw_sb_q0p75 1 100 -96 95.25 FORMAT "%5.2" ARRAY_SIZE 4 ECU_ADDRESS 0x380A70 /end MEASUREMENT
/begin MEASUREMENT zwoutcpl "Einerkomplement des Zündwinkels für die Funktionsüberwachung" SBYTE zw_sb_q0p75 1 100 -96 95.25 FORMAT "%5.2" ECU_ADDRESS 0x380A74 /end MEASUREMENT
/begin MEASUREMENT zwout_uc "Ausgabe-Zündwinkel im Befehlstest" SBYTE zw_sb_q0p75 1 100 -96 95.25 FORMAT "%5.2" ECU_ADDRESS 0x380D03 /end MEASUREMENT
/begin MEASUREMENT zwout_um "Ausgabe-Zündwinkel für die Funktionsüberwachung" SBYTE zw_sb_q0p75 1 100 -96 95.25 FORMAT "%5.2" ECU_ADDRESS 0x382E4F /end MEASUREMENT
/begin MEASUREMENT zwspae "Spätester Zündwinkel" SBYTE zw_sb_q0p75 1 100 -96 95.25 FORMAT "%5.2" ECU_ADDRESS 0xF84D /end MEASUREMENT
/begin MEASUREMENT zwstt "Zündwinkel im Start" SBYTE zw_sb_q0p75 1 100 -96 95.25 FORMAT "%5.2" ECU_ADDRESS 0x380A18 /end MEASUREMENT
/begin MEASUREMENT zwzyl1 "Zündwinkel Zylinder 1" SBYTE zw_sb_q0p75 1 100 -96 95.25 FORMAT "%5.2" ECU_ADDRESS 0x380A75 /end MEASUREMENT
/begin MEASUREMENT ZYLVEK "Zylindervektor" UBYTE DEZ 1 100 0 255 FORMAT "%5.1" ECU_ADDRESS 0xF910 /end MEASUREMENT
/begin FUNCTION SYS_ROM ""
 /begin DEF_CHARACTERISTIC _2SG _720_DIV_BY_ZYLZA _CCmfaICI _DT_3M8 _DT_3P8 _DT_4M8 _DT_4P8 _DT_5M8 _DT_5P8 _DVEADA _EGAS _EVMB _EVMB2 _EVOFS _FRAME_MAX _FRAME_MIN _FREQ_CPU _IKRSCHWELLE _INGASOS _NWS _PECVFZ_RELOAD _REDMX _SHK_OT _STERHK _STERSY _STERVK _STETLR _TN _TURBO _TWO_ZYLZA _WKW075 _WMAX _WMIN _ZYLMASK _ZYLZA _ZZBANK /end DEF_CHARACTERISTIC
 /begin REF_CHARACTERISTIC /end REF_CHARACTERISTIC
 /begin IN_MEASUREMENT /end IN_MEASUREMENT
 /begin OUT_MEASUREMENT /end OUT_MEASUREMENT
 /begin LOC_MEASUREMENT /end LOC_MEASUREMENT
 /begin SUB_FUNCTION /end SUB_FUNCTION
/end FUNCTION
/begin FUNCTION SY_DFPM3 "" /begin DEF_CHARACTERISTIC /end DEF_CHARACTERISTIC /begin REF_CHARACTERISTIC /end REF_CHARACTERISTIC /begin IN_MEASUREMENT /end IN_MEASUREMENT /begin OUT_MEASUREMENT /end OUT_MEASUREMENT /begin LOC_MEASUREMENT /end LOC_MEASUREMENT /begin SUB_FUNCTION /end SUB_FUNCTION /end FUNCTION
/begin FUNCTION T2DCLA "KWP2000; Adaptionswerte rücksetzen (löschen)" /begin DEF_CHARACTERISTIC /end DEF_CHARACTERISTIC /begin REF_CHARACTERISTIC /end REF_CHARACTERISTIC /begin IN_MEASUREMENT /end IN_MEASUREMENT /begin OUT_MEASUREMENT B_clbacc B_clkatfz /end OUT_MEASUREMENT /begin LOC_MEASUREMENT /end LOC_MEASUREMENT /begin SUB_FUNCTION /end SUB_FUNCTION /end FUNCTION
/begin FUNCTION T2DFA1 "" /begin DEF_CHARACTERISTIC /end DEF_CHARACTERISTIC /begin REF_CHARACTERISTIC /end REF_CHARACTERISTIC /begin IN_MEASUREMENT nmot ti_tvu_w /end IN_MEASUREMENT
 /begin OUT_MEASUREMENT B_bt B_btanskl B_btdmmv B_btdmpm B_btebl B_btekp B_btev1 B_btev2 B_btev3 B_btev4 B_btev5 B_btev6 B_btev7 B_btev8 B_bthdm B_bthsh B_bthsh2 B_bthsv B_bthsv2 B_btkos B_btldp B_btslp B_btslv B_btsta B_bttev B_dmmvet B_dmpmet B_eblet B_ekpet B_etret B_fa B_fadldp B_fadmet B_fadmtle B_fadmtls B_faetr B_faevz B_falls B_falr B_falra B_famls B_fanws B_fanwsd B_fasls B_fates B_hsh2et B_hshet B_hsv2et B_hsvet B_koset B_slpet B_slvet B_staet B_tevet devoff hsh2tim hshtim hsv2tim hsvtim nsolfa tamldia tevtim t_bthsh t_bthsh2 t_bthsv t_bthsv2 t_bttev t_bttim wnwstst /end OUT_MEASUREMENT
 /begin LOC_MEASUREMENT /end LOC_MEASUREMENT
 /begin SUB_FUNCTION /end SUB_FUNCTION
/end FUNCTION
/begin FUNCTION T2DMTL "KWP2000: Request Service DMTL-Systemtest" /begin DEF_CHARACTERISTIC TEFABE TFADTLMX /end DEF_CHARACTERISTIC /begin REF_CHARACTERISTIC /end REF_CHARACTERISTIC
 /begin IN_MEASUREMENT B_admtll B_admtls B_diprfo B_dmkl15 B_dmtge B_dmtke B_dmtlfe B_dtetd B_dtetk B_dubtes B_esdmte B_fadmtle B_fadmtls B_m8te B_nachl B_nmot B_pwf B_stend B_txdmts B_ubdmte B_vdmte isadmtl top_w /end IN_MEASUREMENT
 /begin OUT_MEASUREMENT B_admtllff B_admtllOld B_fadmtl B_fadmtltop B_fadmtltopOld B_fadtlbe B_fadtlbeff B_nom8dmtl stpdmtl stpdmtla stpdmtlm8 T2DMTLbits T2DMTLbitsNOV tfadtlbe /end OUT_MEASUREMENT
 /begin LOC_MEASUREMENT /end LOC_MEASUREMENT
 /begin SUB_FUNCTION /end SUB_FUNCTION
/end FUNCTION
/begin FUNCTION TC1MOD "Testerkommunikation CARB; Mode 1" /begin DEF_CHARACTERISTIC /end DEF_CHARACTERISTIC /begin REF_CHARACTERISTIC CWOBD /end REF_CHARACTERISTIC
 /begin IN_MEASUREMENT B_cdkvs B_cdmd B_lsh B_lsh2 B_lsv B_lsv2 B_sls B_slsfz evsup1 flglrs flglrs2 fr2_w fra2_w fra_w fr_w kmstmil_w mshfm_w nmot_w ready rml tanslin tmotlin ushkj ushkj2 usvkj usvkj2 vfzg wdkba zwzyl1 /end IN_MEASUREMENT
 /begin OUT_MEASUREMENT /end OUT_MEASUREMENT
 /begin LOC_MEASUREMENT /end LOC_MEASUREMENT
 /begin SUB_FUNCTION /end SUB_FUNCTION
/end FUNCTION
/begin FUNCTION TC2MOD "Testerkommunikation CARB; Mode 2" /begin DEF_CHARACTERISTIC /end DEF_CHARACTERISTIC /begin REF_CHARACTERISTIC /end REF_CHARACTERISTIC /begin IN_MEASUREMENT B_xff ffzdfp /end IN_MEASUREMENT /begin OUT_MEASUREMENT /end OUT_MEASUREMENT /begin LOC_MEASUREMENT /end LOC_MEASUREMENT /begin SUB_FUNCTION /end SUB_FUNCTION /end FUNCTION
/begin FUNCTION TC5MOD "Testerkommunikation CARB; Mode 5, Ausgabe Sondenmeßwerte" /begin DEF_CHARACTERISTIC /end DEF_CHARACTERISTIC
 /begin REF_CHARACTERISTIC ATVFETTO ATVFETTU ATVMAGO ATVMAGU TPSVKMN TPSVKMX TUSPNMN TUSPNMX USMNSAMN USMNSAMX USMNSHMN USMNSHMX USMXSAMN USMXSAMX USMXSHMN USMXSHMX USRHKSHJ /end REF_CHARACTERISTIC
 /begin IN_MEASUREMENT atvfett atvfett2 atvmager atvmager2 B_lsh B_lsh2 B_lsv B_lsv2 tpsvlssa tpsvlssa2 tuspnf tuspnf2 usmnsan usmnsan2 usmnshn usmnshn2 usmxsan usmxsan2 usmxshn usmxshn2 usrj /end IN_MEASUREMENT
 /begin OUT_MEASUREMENT /end OUT_MEASUREMENT
 /begin LOC_MEASUREMENT /end LOC_MEASUREMENT
 /begin SUB_FUNCTION /end SUB_FUNCTION
/end FUNCTION
/begin FUNCTION TC6MOD "Testerkommunikation CARB/EOBD; Mode/Service 6, Ausgabe Prüfschwellen" /begin DEF_CHARACTERISTIC /end DEF_CHARACTERISTIC /begin REF_CHARACTERISTIC /end REF_CHARACTERISTIC
 /begin IN_MEASUREMENT B_cddmtl B_cdkat B_cdldp B_cdsls B_cdtes B_cwdslt B_cwdthm m6cddmtl m6cmsl m6cmsl2 m6cmslv m6cmslv2 m6cthm m6sddmtl_w m6smsl2_w m6smslv2_w m6smslv_w m6smsl_w m6sthm m6wddmtl_w m6wmsl2_w m6wmslv2_w m6wmslv_w m6wmsl_w m6wthm tc6katc tc6katc2 tc6kats tc6kats2 tc6katw tc6katw2 tc6ldpc tc6ldps tc6ldpw tc6tesc tc6tess tc6tesw /end IN_MEASUREMENT
 /begin OUT_MEASUREMENT /end OUT_MEASUREMENT
 /begin LOC_MEASUREMENT /end LOC_MEASUREMENT
 /begin SUB_FUNCTION /end SUB_FUNCTION
/end FUNCTION
/begin FUNCTION TC8MOD "Testerkommunikation CARB; Mode 8, Funktionsaktivierungen" /begin DEF_CHARACTERISTIC /end DEF_CHARACTERISTIC /begin REF_CHARACTERISTIC /end REF_CHARACTERISTIC /begin IN_MEASUREMENT B_m8te stpdmtlm8 /end IN_MEASUREMENT /begin OUT_MEASUREMENT /end OUT_MEASUREMENT /begin LOC_MEASUREMENT /end LOC_MEASUREMENT /begin SUB_FUNCTION /end SUB_FUNCTION /end FUNCTION
/begin FUNCTION TC9MOD "Testerkommunikation CARB; Mode 9, Request Vehicle Information" /begin DEF_CHARACTERISTIC /end DEF_CHARACTERISTIC /begin REF_CHARACTERISTIC /end REF_CHARACTERISTIC /begin IN_MEASUREMENT B_cksbrdy B_cksbrdy2 CALIBID1 CALIBID2 cvn cvn2 nmot_w /end IN_MEASUREMENT /begin OUT_MEASUREMENT B_m9cvn B_m9cvnout /end OUT_MEASUREMENT /begin LOC_MEASUREMENT /end LOC_MEASUREMENT /begin SUB_FUNCTION /end SUB_FUNCTION /end FUNCTION
/begin FUNCTION TCSORT "Testerkommunikation CARB; Sortierfunktion" /begin DEF_CHARACTERISTIC /end DEF_CHARACTERISTIC /begin REF_CHARACTERISTIC /end REF_CHARACTERISTIC /begin IN_MEASUREMENT cw_erfil fcmEnd FCMTab ffzdfp /end IN_MEASUREMENT /begin OUT_MEASUREMENT errorCntTcsort /end OUT_MEASUREMENT /begin LOC_MEASUREMENT /end LOC_MEASUREMENT /begin SUB_FUNCTION /end SUB_FUNCTION /end FUNCTION
/begin FUNCTION TEB "Tankentlüftung beladungsabhängig"
 /begin DEF_CHARACTERISTIC DFTEAHB DMSTES DSTEMIN FBTEB FBTEVA FETATEBN FKATEB FQTEFR FQTEPT FQTEVA FRHB FSRFTEF FTEADAB FTEADMX FTEFHB FTEHB FTEINIX FUMRBRK FVERMN FVERZTE KFETATE KFFTEAN KFFTEAX KFQTE KFTATX KFTEKA KHCTEMN KHCTEMX NOBELSTP TFTEINI TQTEAB TQTEDAB TVSATEM ZBTEML ZETATE ZKFTEAD /end DEF_CHARACTERISTIC
 /begin REF_CHARACTERISTIC KUMSRL SDK10TEUB SFR05TEUB SML06TEUB SNM10TEUB TEMIN _EGAS _STERVK /end REF_CHARACTERISTIC
 /begin IN_MEASUREMENT B_evloc B_frmax B_frmax2 B_frmin B_frmin2 B_lr B_lr2 B_nmot B_nswo1 B_qtedab B_sab B_te B_tef B_tei B_ten B_tep esst_sdk10teub esst_sfr05teub esst_sml06teub esst_snm10teub frm2_w frm_w mifa_w miopt_w ml mlsol_w ml_w msdkalm_w mste msteo_w mste_w nmot nmot_w ps_w pte pu rl tans te2_w te_w tmot wdkba /end IN_MEASUREMENT
 /begin OUT_MEASUREMENT B_lrar B_teabb B_tehb B_tehbx etate fkatei frmit_w frmxa fteadf ftead_w ftefva_w mitebg_w mstesoll_w rkte_w /end OUT_MEASUREMENT
 /begin LOC_MEASUREMENT B_gwrte B_teakt dftef_w dkatefrg dkhc_w dstert20_w etateint etatesol fbetate fbkate fgwrte fkateapp fkatefrg fkates fngwrte fregfte frmit frmxaold_w frmxa_w fteadf_w ftefsold_w ftefsoll_w ftefva ftefvab ftefvamx_w fteml fvermte_w imsteini khc_w kteev_w ktetevvz_w ktetev_w mssgin_w msteev_w mstesmx_w pspu qtetemin rlteev_w /end LOC_MEASUREMENT
 /begin SUB_FUNCTION /end SUB_FUNCTION
/end FUNCTION
/begin FUNCTION TEBEB "Einschaltbedingungen Tankentlüftung" /begin DEF_CHARACTERISTIC TMTE TTEAUS /end DEF_CHARACTERISTIC /begin REF_CHARACTERISTIC /end REF_CHARACTERISTIC
 /begin IN_MEASUREMENT B_atmtpa B_dldpte B_dllra B_dmmtev B_dsls B_dteaa B_eobdlr B_fraoan B_ftedab B_lamka B_lamka2 B_lamsdef B_lr B_lr2 B_lrssa B_lrssa2 B_mlrsa B_sbbvk B_sbbvk2 B_sls B_tep lamsons_w tatesoll tmot /end IN_MEASUREMENT
 /begin OUT_MEASUREMENT B_qtedab B_te B_tef B_tei B_ten /end OUT_MEASUREMENT
 /begin LOC_MEASUREMENT /end LOC_MEASUREMENT
 /begin SUB_FUNCTION /end SUB_FUNCTION
/end FUNCTION
/begin FUNCTION TNOT "" /begin DEF_CHARACTERISTIC /end DEF_CHARACTERISTIC /begin REF_CHARACTERISTIC _CCmfaICI _SHK_OT /end REF_CHARACTERISTIC /begin IN_MEASUREMENT B_tnaset /end IN_MEASUREMENT /begin OUT_MEASUREMENT /end OUT_MEASUREMENT /begin LOC_MEASUREMENT /end LOC_MEASUREMENT /begin SUB_FUNCTION /end SUB_FUNCTION /end FUNCTION
/begin FUNCTION TREV_OV "" /begin DEF_CHARACTERISTIC /end DEF_CHARACTERISTIC /begin REF_CHARACTERISTIC /end REF_CHARACTERISTIC /begin IN_MEASUREMENT /end IN_MEASUREMENT /begin OUT_MEASUREMENT B_trev_inc trevovCtr /end OUT_MEASUREMENT /begin LOC_MEASUREMENT /end LOC_MEASUREMENT /begin SUB_FUNCTION /end SUB_FUNCTION /end FUNCTION
/begin FUNCTION UELRST "Übersicht Einspritzung bei Stereolambdaregelung für Normalbetrieb" /begin DEF_CHARACTERISTIC /end DEF_CHARACTERISTIC /begin REF_CHARACTERISTIC /end REF_CHARACTERISTIC /begin IN_MEASUREMENT /end IN_MEASUREMENT /begin OUT_MEASUREMENT /end OUT_MEASUREMENT /begin LOC_MEASUREMENT /end LOC_MEASUREMENT /begin SUB_FUNCTION /end SUB_FUNCTION /end FUNCTION
/begin FUNCTION UETM "Motorübertemperatur-Anzeige" /begin DEF_CHARACTERISTIC DUETMOT TUETM UETMOT /end DEF_CHARACTERISTIC /begin REF_CHARACTERISTIC /end REF_CHARACTERISTIC /begin IN_MEASUREMENT B_kl15 B_pwf B_stend nmot tmot tnst_w /end IN_MEASUREMENT /begin OUT_MEASUREMENT B_uetm B_uetmc UetmNvBits /end OUT_MEASUREMENT /begin LOC_MEASUREMENT B_nouetm /end LOC_MEASUREMENT /begin SUB_FUNCTION /end SUB_FUNCTION /end FUNCTION
/begin FUNCTION UFEING "EGAS Überwachungskonzept: Eing.sig.überw. für Funktionsüberwachung" /begin DEF_CHARACTERISTIC MDIMX_UM /end DEF_CHARACTERISTIC /begin REF_CHARACTERISTIC /end REF_CHARACTERISTIC
 /begin IN_MEASUREMENT B_i_ska_fr B_notlu_fr B_ub_ok evz_austot mifa milsol_w tans tmot vfgr_w /end IN_MEASUREMENT
 /begin OUT_MEASUREMENT evz_aus_um mifa_um milsol_um tans_um tmot_um vfgr_um /end OUT_MEASUREMENT
 /begin LOC_MEASUREMENT /end LOC_MEASUREMENT
 /begin SUB_FUNCTION /end SUB_FUNCTION
/end FUNCTION
/begin FUNCTION UFEINS "" /begin DEF_CHARACTERISTIC NMV08_UM NZWV08_UM RLV08_UM SPSNV08_UM /end DEF_CHARACTERISTIC /begin REF_CHARACTERISTIC /end REF_CHARACTERISTIC /begin IN_MEASUREMENT nmot_um rl_um spsn_um /end IN_MEASUREMENT /begin OUT_MEASUREMENT nmst08_um nzwst08_um rlst08_um spsnst08_um /end OUT_MEASUREMENT /begin LOC_MEASUREMENT /end LOC_MEASUREMENT /begin SUB_FUNCTION /end SUB_FUNCTION /end FUNCTION
/begin FUNCTION UFFGRC "EGAS Überwachungskonzept: FGR-Überwachung der Funktionsüberwachung" /begin DEF_CHARACTERISTIC ACCA_T_UM ACCC_T_UM VMIN_UM /end DEF_CHARACTERISTIC /begin REF_CHARACTERISTIC /end REF_CHARACTERISTIC /begin IN_MEASUREMENT B_acc B_fgr mifa_um vfgr_um /end IN_MEASUREMENT /begin OUT_MEASUREMENT B_fgr_um B_noacc_um ei_accc_um mfgr_um /end OUT_MEASUREMENT /begin LOC_MEASUREMENT alc_old_um macca_c_um maccc_c_um /end LOC_MEASUREMENT /begin SUB_FUNCTION /end SUB_FUNCTION /end FUNCTION
/begin FUNCTION UFFGRE "EGAS Überwachungskonzept: FGR-Eingangsinfos für die Funktionsüberwachung" /begin DEF_CHARACTERISTIC BREMS_T_UM TFGRENUM /end DEF_CHARACTERISTIC /begin REF_CHARACTERISTIC /end REF_CHARACTERISTIC
 /begin IN_MEASUREMENT B_fgrab B_fgrat B_fgren B_fgrhsa B_fgrtbe B_fgrtve B_fgrtwa /end IN_MEASUREMENT
 /begin OUT_MEASUREMENT /end OUT_MEASUREMENT
 /begin LOC_MEASUREMENT brems_c_um tfgrenum_c /end LOC_MEASUREMENT
 /begin SUB_FUNCTION /end SUB_FUNCTION
/end FUNCTION
/begin FUNCTION UFMIST "EGAS Überwachungskonzept: Ist-Moment der Funktionsüberwachung" /begin DEF_CHARACTERISTIC KFMI_UM KFZW_UM KLETAZW_UM /end DEF_CHARACTERISTIC /begin REF_CHARACTERISTIC NZWV08_UM RLV08_UM /end REF_CHARACTERISTIC /begin IN_MEASUREMENT nmot_um nzwst08_um rlst08_um rl_um zwout_um /end IN_MEASUREMENT /begin OUT_MEASUREMENT mi_um /end OUT_MEASUREMENT /begin LOC_MEASUREMENT dzw_um etazw_um miopt_um zwopt_um /end LOC_MEASUREMENT /begin SUB_FUNCTION /end SUB_FUNCTION /end FUNCTION
/begin FUNCTION UFMSRC "EGAS Überwachungskonzept: MSR-Eingriff-Überwachung für die Funktionsüberwachung" /begin DEF_CHARACTERISTIC BZ_MSR_M CWNOMSRU MSRC_T_UM /end DEF_CHARACTERISTIC /begin REF_CHARACTERISTIC /end REF_CHARACTERISTIC /begin IN_MEASUREMENT /end IN_MEASUREMENT /begin OUT_MEASUREMENT ei_msrc_um mmsr_um /end OUT_MEASUREMENT /begin LOC_MEASUREMENT alv_old_um bz_um msrc_c_um /end LOC_MEASUREMENT /begin SUB_FUNCTION /end SUB_FUNCTION /end FUNCTION
/begin FUNCTION UFMVER "EGAS Überwachungskonzept: Momentenvergleich der Funktionsüberwachung" /begin DEF_CHARACTERISTIC MVER_T_UM /end DEF_CHARACTERISTIC /begin REF_CHARACTERISTIC /end REF_CHARACTERISTIC /begin IN_MEASUREMENT B_i_ska_um mi_um mzf_um mzo_um /end IN_MEASUREMENT /begin OUT_MEASUREMENT /end OUT_MEASUREMENT /begin LOC_MEASUREMENT ei_mver_um mdif_w_um mver_c_um mzfo_um /end LOC_MEASUREMENT /begin SUB_FUNCTION /end SUB_FUNCTION /end FUNCTION
/begin FUNCTION UFMZF "EGAS Überwachungskonzept: Momentenfilter für die Funktionsüberwachung" /begin DEF_CHARACTERISTIC MZFFIL_UM MZFTV_UM /end DEF_CHARACTERISTIC /begin REF_CHARACTERISTIC /end REF_CHARACTERISTIC /begin IN_MEASUREMENT mz_um /end IN_MEASUREMENT /begin OUT_MEASUREMENT /end OUT_MEASUREMENT /begin LOC_MEASUREMENT mzf_low_um mzf_ptr_um mzf_reg_um mzf_um /end LOC_MEASUREMENT /begin SUB_FUNCTION /end SUB_FUNCTION /end FUNCTION
/begin FUNCTION UFMZUL "EGAS Überwachungskonzept: zulässiges Moment der Funktionsüberwachung" /begin DEF_CHARACTERISTIC KFMDZOF_UM KFMPED_UM KFMPNS_UM MDV08_UM /end DEF_CHARACTERISTIC /begin REF_CHARACTERISTIC NMV08_UM SPSNV08_UM /end REF_CHARACTERISTIC
 /begin IN_MEASUREMENT mfgr_um milsol_um mmsr_um nmot_um nmst08_um spsnst08_um spsn_um /end IN_MEASUREMENT
 /begin OUT_MEASUREMENT mdst08_um /end OUT_MEASUREMENT
 /begin LOC_MEASUREMENT mped_um mzmax_um mzo_um mz_um /end LOC_MEASUREMENT
 /begin SUB_FUNCTION /end SUB_FUNCTION
/end FUNCTION
/begin FUNCTION UFNC "EGAS Überwachungskonzept: N-Überwachung für die Funktionsüberwachung" /begin DEF_CHARACTERISTIC NC_T_UM NDIF_UM NMIN_UM NZMUL_UM TZTOL_UM /end DEF_CHARACTERISTIC /begin REF_CHARACTERISTIC /end REF_CHARACTERISTIC /begin IN_MEASUREMENT B_i_ska_um nmot /end IN_MEASUREMENT /begin OUT_MEASUREMENT /end OUT_MEASUREMENT
 /begin LOC_MEASUREMENT ei_nc_um nc_c_um nmot_um nz_um talt_um tcap_um zalt_um zcap_um /end LOC_MEASUREMENT
 /begin SUB_FUNCTION /end SUB_FUNCTION
/end FUNCTION
/begin FUNCTION UFNSC "EGAS Überwachungskonzept: Nachstartüberwachung für die Funktionsüberwachung"
 /begin DEF_CHARACTERISTIC NSC_T_UM NSOF_T_UM N_START_UM N_STEND_UM TANSMN_UM TMNSMN_UM /end DEF_CHARACTERISTIC
 /begin REF_CHARACTERISTIC /end REF_CHARACTERISTIC
 /begin IN_MEASUREMENT nmot_um tans_um tmot_um /end IN_MEASUREMENT
 /begin OUT_MEASUREMENT B_mzns_um /end OUT_MEASUREMENT
 /begin LOC_MEASUREMENT nsc_c_um nsof_c_um /end LOC_MEASUREMENT
 /begin SUB_FUNCTION /end SUB_FUNCTION
/end FUNCTION
/begin FUNCTION UFREAC "EGAS Überwachungskonzept: Fehlerreaktionsüberw.d.Funktionsüberwachung" /begin DEF_CHARACTERISTIC KLNPED_UM REAC_T1_UM REAC_T2_UM SKA_DRHZ_UM /end DEF_CHARACTERISTIC /begin REF_CHARACTERISTIC /end REF_CHARACTERISTIC /begin IN_MEASUREMENT B_i_ska_um evz_aus_um nmot_um spsn_um /end IN_MEASUREMENT /begin OUT_MEASUREMENT ei_reac_um /end OUT_MEASUREMENT /begin LOC_MEASUREMENT nska_um reac_c1_um reac_c2_um /end LOC_MEASUREMENT /begin SUB_FUNCTION /end SUB_FUNCTION /end FUNCTION
/begin FUNCTION UFRLC "EGAS Überwachungskonzept: Lastsignalüberw. für Funktionsüberwachung"
 /begin DEF_CHARACTERISTIC IP1A_MX_UM IP2A_MN_UM IPA_T_UM KFRLIP_UM NRLIP_UM RLC_T_UM RLIPFIL_UM RLIPTV_UM RLIP_T_UM RL_BO_UM RL_MO_UM /end DEF_CHARACTERISTIC
 /begin REF_CHARACTERISTIC /end REF_CHARACTERISTIC
 /begin IN_MEASUREMENT B_hfm B_i_ska_um B_wdk2sel iUipoti1_w iUipoti2_w nmot_um rl rl_w udkp1a udkp2a /end IN_MEASUREMENT
 /begin OUT_MEASUREMENT ei_ipa_um ei_rlc_um ei_rlip_um rl_um /end OUT_MEASUREMENT
 /begin LOC_MEASUREMENT ipa_c_um ipsn_um rlc_c_um rlf_ptr_um rlf_reg_um rlipf_low_um rlipf_um rlip_c_um rlip_um rlzo_um rl_w_um /end LOC_MEASUREMENT
 /begin SUB_FUNCTION /end SUB_FUNCTION
/end FUNCTION
/begin FUNCTION UFSPSC "EGAS Überwachungskonzept: Pedal-Sollwert-Ü. für Funktionsüberwachung" /begin DEF_CHARACTERISTIC SP12LL_UM SP12VG_UM SPSC_MIN_UM SPSC_T_UM SPSVG_UM /end DEF_CHARACTERISTIC /begin REF_CHARACTERISTIC /end REF_CHARACTERISTIC
 /begin IN_MEASUREMENT B_i_ska_um B_pwgnotfr B_sp1s B_sp2s B_spsmin iUrefsp1_w iUspoti1_w iUspoti2_w /end IN_MEASUREMENT
 /begin OUT_MEASUREMENT B_pwgnotum ei_spsc_um spsn_um /end OUT_MEASUREMENT
 /begin LOC_MEASUREMENT sp1s_um sp2s_um spsc_c_um /end LOC_MEASUREMENT
 /begin SUB_FUNCTION /end SUB_FUNCTION
/end FUNCTION
/begin FUNCTION UFURAM "" /begin DEF_CHARACTERISTIC RST_TV_UM UMRST_TV_UM WAIT_T_UM /end DEF_CHARACTERISTIC /begin REF_CHARACTERISTIC /end REF_CHARACTERISTIC /begin IN_MEASUREMENT /end IN_MEASUREMENT
 /begin OUT_MEASUREMENT B_i_ska_um n_flags_um reac_c_um romz_c_um r_flags_um srst_c_um s_flags_um umrst_c_um wri_c_um /end OUT_MEASUREMENT
 /begin LOC_MEASUREMENT B_brems_um B_bsl_um B_dcdis_um B_fgrenold B_fgren_um B_i_ska B_kkl_um B_nomsr_um B_notlu b_nsakt_um b_nsend_um B_ub_ska B_vzl_um B_wal_um ram_c_um reset_indication_um romErrPage rst_tv /end LOC_MEASUREMENT
 /begin SUB_FUNCTION /end SUB_FUNCTION
/end FUNCTION
/begin FUNCTION UFZWC "EGAS Überwachungskonzept: ZW-Überwachung für Funktionsüberwachung" /begin DEF_CHARACTERISTIC ZWC_T_UM ZYLANZ_UM /end DEF_CHARACTERISTIC /begin REF_CHARACTERISTIC /end REF_CHARACTERISTIC /begin IN_MEASUREMENT B_i_ska_um zwout zwoutcpl /end IN_MEASUREMENT /begin OUT_MEASUREMENT ei_zwc_um zwout_um /end OUT_MEASUREMENT /begin LOC_MEASUREMENT zwc_c_um /end LOC_MEASUREMENT /begin SUB_FUNCTION /end SUB_FUNCTION /end FUNCTION
/begin FUNCTION UMKOMF "" /begin DEF_CHARACTERISTIC /end DEF_CHARACTERISTIC /begin REF_CHARACTERISTIC UMRST_TV_UM /end REF_CHARACTERISTIC /begin IN_MEASUREMENT rst_tv umrst_c_um /end IN_MEASUREMENT /begin OUT_MEASUREMENT /end OUT_MEASUREMENT /begin LOC_MEASUREMENT uma2_res umErrorCtrFr /end LOC_MEASUREMENT /begin SUB_FUNCTION /end SUB_FUNCTION /end FUNCTION
/begin FUNCTION URADCC "EGAS Überwachungskonzept: AD-Wandler-Test" /begin DEF_CHARACTERISTIC ADCC_T_UM SP1ADC_DIF SP1_STAT SP1_STAT_T /end DEF_CHARACTERISTIC /begin REF_CHARACTERISTIC /end REF_CHARACTERISTIC /begin IN_MEASUREMENT B_i_ska_fr B_i_ska_um B_notlu_fr B_pwgnotum iUspoti1_w /end IN_MEASUREMENT /begin OUT_MEASUREMENT ei_adcc_um /end OUT_MEASUREMENT /begin LOC_MEASUREMENT adcc_c_um sp1p_a_um sp1p_st_um sp1s_a_um sp1s_st_um /end LOC_MEASUREMENT /begin SUB_FUNCTION /end SUB_FUNCTION /end FUNCTION
/begin FUNCTION URAUSG "" /begin DEF_CHARACTERISTIC AUSGH_T_UM AUSG_T_UM AUSZH_T_UM AUSZ_T_UM /end DEF_CHARACTERISTIC /begin REF_CHARACTERISTIC /end REF_CHARACTERISTIC /begin IN_MEASUREMENT /end IN_MEASUREMENT /begin OUT_MEASUREMENT /end OUT_MEASUREMENT /begin LOC_MEASUREMENT ausgh_c_um ausg_c_um auszh_c_um ausz_c_um /end LOC_MEASUREMENT /begin SUB_FUNCTION /end SUB_FUNCTION /end FUNCTION
/begin FUNCTION URCAUS "" /begin DEF_CHARACTERISTIC /end DEF_CHARACTERISTIC /begin REF_CHARACTERISTIC /end REF_CHARACTERISTIC
 /begin IN_MEASUREMENT B_i_ska_uc B_noacc_uc ei_accc_uc ei_msrc_uc ei_mver_uc ei_reac_uc mfgr_uc mi_uc mmsr_uc mped_uc mver_c_uc mzfo_uc reac_c1_uc reac_c2_uc uma2_res /end IN_MEASUREMENT
 /begin OUT_MEASUREMENT /end OUT_MEASUREMENT
 /begin LOC_MEASUREMENT /end LOC_MEASUREMENT
 /begin SUB_FUNCTION /end SUB_FUNCTION
/end FUNCTION
/begin FUNCTION URCEIN ""
 /begin DEF_CHARACTERISTIC ACCALIVE_A_DAT_UC ACCALIVE_DAT_UC ACCBIT_DAT_UC ACCSTAT_DAT_UC ASCALIVE_A_DAT_UC ASCALIVE_DAT_UC ASRL_DAT_UC ASRS_DAT_UC BACC_DAT_UC BFGR_DAT_UC BNOMSR_DAT_UC BREACC_DAT_UC CBIT_DAT_UC CMSR_DAT_UC EVZ_DAT_UC MACCA_DAT_UC MACCC_DAT_UC MDIND_DAT_UC MIFA_DAT_UC MILSOL_DAT_UC MSRC_D_UC MVER_D_UC MZFPTR_DAT_UC MZFREG_DAT_UC MZF_DAT_UC MZL_DAT_UC NFLAGS_D_UC NMOT_DAT_UC REAC_D1_UC REAC_D2_UC RFLAGS_D_UC RL_DAT_UC SFLAGS_D_UC SPSN_DAT_UC VFZG_DAT_UC ZWOUT_DAT_UC /end DEF_CHARACTERISTIC
 /begin REF_CHARACTERISTIC /end REF_CHARACTERISTIC
 /begin IN_MEASUREMENT /end IN_MEASUREMENT
 /begin OUT_MEASUREMENT asc_alive_a_uc asc_alive_uc B_acc_uc B_fgrfr_uc evz_aus_uc mifa_uc milsol_uc nmot_uc rl_uc spsn_uc vfgr_uc zwout_uc /end OUT_MEASUREMENT
 /begin LOC_MEASUREMENT x_uc y_uc /end LOC_MEASUREMENT
 /begin SUB_FUNCTION /end SUB_FUNCTION
/end FUNCTION
/begin FUNCTION URCEINS "" /begin DEF_CHARACTERISTIC NMV08_UC NZWV08_UC RLV08_UC SPSNV08_UC /end DEF_CHARACTERISTIC /begin REF_CHARACTERISTIC /end REF_CHARACTERISTIC /begin IN_MEASUREMENT nmot_uc rl_uc spsn_uc /end IN_MEASUREMENT /begin OUT_MEASUREMENT nmst08_uc nzwst08_uc rlst08_uc spsnst08_uc /end OUT_MEASUREMENT /begin LOC_MEASUREMENT /end LOC_MEASUREMENT /begin SUB_FUNCTION /end SUB_FUNCTION /end FUNCTION
/begin FUNCTION URCFGRC "" /begin DEF_CHARACTERISTIC ACCA_T_UC ACCC_T_UC VMIN_UC /end DEF_CHARACTERISTIC /begin REF_CHARACTERISTIC /end REF_CHARACTERISTIC /begin IN_MEASUREMENT B_acc_uc B_fgrfr_uc mifa_uc s_flags_uc vfgr_uc /end IN_MEASUREMENT /begin OUT_MEASUREMENT B_fgr_uc B_noacc_uc ei_accc_uc mfgr_uc /end OUT_MEASUREMENT /begin LOC_MEASUREMENT alc_old_uc macca_c_uc maccc_c_uc /end LOC_MEASUREMENT /begin SUB_FUNCTION /end SUB_FUNCTION /end FUNCTION
/begin FUNCTION URCMIST "" /begin DEF_CHARACTERISTIC KFMI_UC KFZW_UC KLETAZW_UC /end DEF_CHARACTERISTIC /begin REF_CHARACTERISTIC NZWV08_UC RLV08_UC /end REF_CHARACTERISTIC /begin IN_MEASUREMENT nmot_uc nzwst08_uc rlst08_uc rl_uc zwout_uc /end IN_MEASUREMENT /begin OUT_MEASUREMENT mi_uc /end OUT_MEASUREMENT /begin LOC_MEASUREMENT dzw_uc etazw_uc miopt_uc zwopt_uc /end LOC_MEASUREMENT /begin SUB_FUNCTION /end SUB_FUNCTION /end FUNCTION
/begin FUNCTION URCMSRC "" /begin DEF_CHARACTERISTIC BZ_MSR_UC CWNOMSRU_UC MSRC_T_UC /end DEF_CHARACTERISTIC /begin REF_CHARACTERISTIC /end REF_CHARACTERISTIC /begin IN_MEASUREMENT asc_alive_a_uc asc_alive_uc /end IN_MEASUREMENT /begin OUT_MEASUREMENT ei_msrc_uc mmsr_uc /end OUT_MEASUREMENT /begin LOC_MEASUREMENT bz_uc msrc_c_uc /end LOC_MEASUREMENT /begin SUB_FUNCTION /end SUB_FUNCTION /end FUNCTION
/begin FUNCTION URCMVER "" /begin DEF_CHARACTERISTIC MVER_T_UC /end DEF_CHARACTERISTIC /begin REF_CHARACTERISTIC /end REF_CHARACTERISTIC /begin IN_MEASUREMENT mi_uc mzf_uc mzo_uc /end IN_MEASUREMENT /begin OUT_MEASUREMENT B_i_ska_uc ei_mver_uc /end OUT_MEASUREMENT /begin LOC_MEASUREMENT mdif_w_uc mver_c_uc mzfo_uc /end LOC_MEASUREMENT /begin SUB_FUNCTION /end SUB_FUNCTION /end FUNCTION
/begin FUNCTION URCMZF "" /begin DEF_CHARACTERISTIC MZFFIL_UC MZFTV_UC /end DEF_CHARACTERISTIC /begin REF_CHARACTERISTIC /end REF_CHARACTERISTIC /begin IN_MEASUREMENT mz_uc /end IN_MEASUREMENT /begin OUT_MEASUREMENT mzf_uc /end OUT_MEASUREMENT /begin LOC_MEASUREMENT mzf_low_uc mzf_ptr_uc mzf_reg_uc /end LOC_MEASUREMENT /begin SUB_FUNCTION /end SUB_FUNCTION /end FUNCTION
/begin FUNCTION URCMZUL "" /begin DEF_CHARACTERISTIC KFMDZOF_UC KFMPED_UC KFMPNS_UC MDV08_UC /end DEF_CHARACTERISTIC /begin REF_CHARACTERISTIC NMV08_UC SPSNV08_UC /end REF_CHARACTERISTIC
 /begin IN_MEASUREMENT mfgr_uc milsol_uc mmsr_uc nmot_uc nmst08_uc spsnst08_uc spsn_uc /end IN_MEASUREMENT
 /begin OUT_MEASUREMENT mdst08_uc mzo_uc mz_uc /end OUT_MEASUREMENT
 /begin LOC_MEASUREMENT mped_uc mzmax_uc /end LOC_MEASUREMENT
 /begin SUB_FUNCTION /end SUB_FUNCTION
/end FUNCTION
/begin FUNCTION URCRAM "" /begin DEF_CHARACTERISTIC /end DEF_CHARACTERISTIC /begin REF_CHARACTERISTIC /end REF_CHARACTERISTIC /begin IN_MEASUREMENT /end IN_MEASUREMENT /begin OUT_MEASUREMENT n_flags_uc r_flags_uc s_flags_uc /end OUT_MEASUREMENT /begin LOC_MEASUREMENT /end LOC_MEASUREMENT /begin SUB_FUNCTION /end SUB_FUNCTION /end FUNCTION
/begin FUNCTION URCREAC "" /begin DEF_CHARACTERISTIC KLNPED_UC REAC_T1_UC REAC_T2_UC SKA_DRHZ_UC /end DEF_CHARACTERISTIC /begin REF_CHARACTERISTIC /end REF_CHARACTERISTIC /begin IN_MEASUREMENT B_i_ska_uc evz_aus_uc nmot_uc spsn_uc /end IN_MEASUREMENT /begin OUT_MEASUREMENT ei_reac_uc /end OUT_MEASUREMENT /begin LOC_MEASUREMENT nska_uc reac_c1_uc reac_c2_uc /end LOC_MEASUREMENT /begin SUB_FUNCTION /end SUB_FUNCTION /end FUNCTION
/begin FUNCTION URCREF "" /begin DEF_CHARACTERISTIC /end DEF_CHARACTERISTIC /begin REF_CHARACTERISTIC MZFTV_UC /end REF_CHARACTERISTIC
 /begin IN_MEASUREMENT alc_old_uc macca_c_uc maccc_c_uc msrc_c_uc mver_c_uc mzf_low_uc mzf_ptr_uc mzf_reg_uc mzf_uc reac_c1_uc reac_c2_uc /end IN_MEASUREMENT
 /begin OUT_MEASUREMENT /end OUT_MEASUREMENT
 /begin LOC_MEASUREMENT /end LOC_MEASUREMENT
 /begin SUB_FUNCTION /end SUB_FUNCTION
/end FUNCTION
/begin FUNCTION URROM "EGAS Überwachungskonzept: ROM-Test" /begin DEF_CHARACTERISTIC CW_NOROMCHKRESET ROMRSTA_UM /end DEF_CHARACTERISTIC /begin REF_CHARACTERISTIC /end REF_CHARACTERISTIC /begin IN_MEASUREMENT B_nlsiko swOffDlBits /end IN_MEASUREMENT /begin OUT_MEASUREMENT romRstC_um /end OUT_MEASUREMENT /begin LOC_MEASUREMENT /end LOC_MEASUREMENT /begin SUB_FUNCTION /end SUB_FUNCTION /end FUNCTION
/begin FUNCTION V72111HW "" /begin DEF_CHARACTERISTIC /end DEF_CHARACTERISTIC /begin REF_CHARACTERISTIC CDDMTL CWDTLECK /end REF_CHARACTERISTIC
 /begin IN_MEASUREMENT B_anskl B_btdmmv B_btdmpm B_btebl B_btekp B_bthsh B_bthsh2 B_bthsv B_bthsv2 B_btkos B_btslp B_btslv B_btsta B_bttev B_cddmtl B_dmmvet B_dmmvtp B_dmpmet B_dmtlmv B_dmtlpm B_ebl B_eblet B_eculock B_ekp B_ekpet B_etr B_hdmtl B_hdmttp B_hsh2et B_hshe B_hshe2 B_hshet B_hsv2et B_hsve B_hsve2 B_hsvet B_kl15 B_koe B_koset B_ldpein B_mil B_nl10 B_nocins B_priph B_priph2 B_pripv B_pripv2 B_slp B_slpet B_slv B_slvet B_sta B_staet B_tevet taml tateout tevper udsu_w uhsh uhsh2 uhsv uhsv2 usp1plaus wtans wtka wtmot wub /end IN_MEASUREMENT
 /begin OUT_MEASUREMENT asic_id B_estart S_bls S_brs S_kupp S_ldpr uuptes_w /end OUT_MEASUREMENT
 /begin LOC_MEASUREMENT /end LOC_MEASUREMENT
 /begin SUB_FUNCTION /end SUB_FUNCTION
/end FUNCTION
/begin FUNCTION V72111_t "" /begin DEF_CHARACTERISTIC /end DEF_CHARACTERISTIC /begin REF_CHARACTERISTIC /end REF_CHARACTERISTIC /begin IN_MEASUREMENT B_nachl swOffDlBits synchroCtr /end IN_MEASUREMENT
 /begin OUT_MEASUREMENT bgCtr iniRoutineCtr r1000msCtr r100msCtr r10msCtr r1msCtr r200msCtr r20msCtr r2msCtr r50msCtr /end OUT_MEASUREMENT
 /begin LOC_MEASUREMENT /end LOC_MEASUREMENT
 /begin SUB_FUNCTION /end SUB_FUNCTION
/end FUNCTION
/begin FUNCTION VMAXMD "Drehmomentanforderung von VMAX-Regelung"
 /begin DEF_CHARACTERISTIC CWDVMX KFMIRED KFMIRLR NMINVMX SBF02MFLRSB SBF02MFSB SRL03MFLRUW SRL03MFUW TVMXPR VABSCH VABSCHLR VHYST VHYSTLR VMAXO VMAXOLR VMAXP VMAXPLR VVORH VVORHLR ZBFIL ZIVMAX ZIVMAXLR /end DEF_CHARACTERISTIC
 /begin REF_CHARACTERISTIC MDIMX /end REF_CHARACTERISTIC
 /begin IN_MEASUREMENT bfzgl_b B_lowra mifab_w miist_w nmot rl_w vfgr_w vfzg_w /end IN_MEASUREMENT
 /begin OUT_MEASUREMENT B_vmax esst_sbf02mflrsb esst_sbf02mfsb esst_srl03mflruw esst_srl03mfuw mivmx_w /end OUT_MEASUREMENT
 /begin LOC_MEASUREMENT bfzglf dmvmxi_w dmvmxp_w dvprae_w dvsi_w ivmax mired mivmxs vfzgpr_w /end LOC_MEASUREMENT
 /begin SUB_FUNCTION /end SUB_FUNCTION
/end FUNCTION
/begin FUNCTION VS_VERS "" /begin DEF_CHARACTERISTIC CWVSV /end DEF_CHARACTERISTIC /begin REF_CHARACTERISTIC /end REF_CHARACTERISTIC /begin IN_MEASUREMENT /end IN_MEASUREMENT
 /begin OUT_MEASUREMENT vsdmr vsfpses vsfrk vske vsldtv vsns vsrlmx vsvw vswnws vszw vszwkr /end OUT_MEASUREMENT
 /begin LOC_MEASUREMENT B_mcacti /end LOC_MEASUREMENT
 /begin SUB_FUNCTION /end SUB_FUNCTION
/end FUNCTION
/begin FUNCTION WANWKW "Winkeladaption der Nockenwelle zur Kurbelwelle"
 /begin DEF_CHARACTERISTIC ANWFLMX FNWADS NNWAFMX NNWHYS TAWSP TAWSPE WNWASMN WNWASMX WNWIMN WNWIMX WNWKM WNWKN WNWSPS /end DEF_CHARACTERISTIC
 /begin REF_CHARACTERISTIC /end REF_CHARACTERISTIC
 /begin IN_MEASUREMENT B_nwi B_nwoff B_pwf B_stend jnwfl nmot nwbits t1nwi_w tmot wnwkw_w wnws /end IN_MEASUREMENT
 /begin OUT_MEASUREMENT B_noadv B_nwads B_nwaf B_phad wnwi_w wnwkor_w /end OUT_MEASUREMENT
 /begin LOC_MEASUREMENT wnwsp_w /end LOC_MEASUREMENT
 /begin SUB_FUNCTION /end SUB_FUNCTION
/end FUNCTION
/begin FUNCTION WES3 "" /begin DEF_CHARACTERISTIC /end DEF_CHARACTERISTIC /begin REF_CHARACTERISTIC /end REF_CHARACTERISTIC /begin IN_MEASUREMENT /end IN_MEASUREMENT
 /begin OUT_MEASUREMENT B_auswrt B_eep2err B_eeperr B_ews_ok B_inistw B_kwperr B_motor B_ptyerr B_ramerr B_read_active B_recerr B_resstw B_timerr B_wcerr B_wc_exa B_wc_exn B_write_active B_wuerg EwsNvBits pm_akt pm_fre pm_mod pm_ta pm_td pty_fctr rec_fctr ttimout tweiter twuerg wc_fctr /end OUT_MEASUREMENT
 /begin LOC_MEASUREMENT /end LOC_MEASUREMENT
 /begin SUB_FUNCTION /end SUB_FUNCTION
/end FUNCTION
/begin FUNCTION WNWEIN "Nockenwellensollwinkel für Einlaßnockenwellenpositionsregelung"
 /begin DEF_CHARACTERISTIC DWNWEB KFWNLLK KFWNLLW KFWNSL KFWNWK KFWNWW KFWNWWK NEVFZG NNWMAX NWNWS TANW TMNW TWNWS WNWAIMN2 WNWFVMN WNWMN WNWMX WNWV WNWVLN /end DEF_CHARACTERISTIC
 /begin REF_CHARACTERISTIC /end REF_CHARACTERISTIC
 /begin IN_MEASUREMENT B_fanwtst B_kl15 B_ll B_slp B_vl nmot rl tans tmot tnst_w vfzg vswnws wnwkor_w wnwsp_w wnwstst /end IN_MEASUREMENT
 /begin OUT_MEASUREMENT B_nnwmx B_wnwmxbe B_wnws fnwue wnwam wnws /end OUT_MEASUREMENT
 /begin LOC_MEASUREMENT wnw wnwsmx /end LOC_MEASUREMENT
 /begin SUB_FUNCTION /end SUB_FUNCTION
/end FUNCTION
/begin FUNCTION WNWR "NW-Lageregelung mit Adaptionen"
 /begin DEF_CHARACTERISTIC ANWWSS FLNWVAD FNWTAP FNWVAD FNWVTA ITANWHFM KLFVGNWF TANFANWI TANWF TANWSP TNWCOMN VGNWFM VGNWMN VGNWMX VGNWSM WNWASA WNWEOA WSNW WSNWAF WSNWAS WSNWS ZKWNFIL ZNWVENTM /end DEF_CHARACTERISTIC
 /begin REF_CHARACTERISTIC TWNWS /end REF_CHARACTERISTIC
 /begin IN_MEASUREMENT B_fanwh B_nnwmx B_noadv nmot t1nwi_w t1tvi_w tmot tnst_w wnwam wnwi_w wnws /end IN_MEASUREMENT
 /begin OUT_MEASUREMENT B_fanwhst B_ftv B_ftvold B_ftvsr B_nwi B_nwoff B_stv nwbits t1tvir_w tanwr tvbits wnwem wnwue /end OUT_MEASUREMENT
 /begin LOC_MEASUREMENT anwws B_adhtv B_htv B_nwco B_wnws0 tanwp tanwrhf tznwco vnwadf_w vnwads_w vnwadta_w vnwdsend_w vnwfad_w vnwgsend_w vnwgs_w vnwsad_w wnwgsend_w wnwgs_w wnwss /end LOC_MEASUREMENT
 /begin SUB_FUNCTION /end SUB_FUNCTION
/end FUNCTION
/begin FUNCTION WNWTST "Diagnose Tester Nockenwellenregelung" /begin DEF_CHARACTERISTIC /end DEF_CHARACTERISTIC /begin REF_CHARACTERISTIC WSNW /end REF_CHARACTERISTIC /begin IN_MEASUREMENT B_fanwhst B_fanws B_fanwsd B_ftv B_phad wnwi_w wnwstst /end IN_MEASUREMENT
 /begin OUT_MEASUREMENT B_fanwh B_fanwtst nwsdstat nwsdstat2 nwsstat nwsstat2 tnwsfi tnwsfi2 tnwssi tnwssi2 /end OUT_MEASUREMENT
 /begin LOC_MEASUREMENT /end LOC_MEASUREMENT
 /begin SUB_FUNCTION /end SUB_FUNCTION
/end FUNCTION
/begin FUNCTION ZDPH "" /begin DEF_CHARACTERISTIC /end DEF_CHARACTERISTIC /begin REF_CHARACTERISTIC /end REF_CHARACTERISTIC /begin IN_MEASUREMENT B_stend zrph zrph2 /end IN_MEASUREMENT /begin OUT_MEASUREMENT /end OUT_MEASUREMENT /begin LOC_MEASUREMENT B_ph2mem B_phmem /end LOC_MEASUREMENT /begin SUB_FUNCTION /end SUB_FUNCTION /end FUNCTION
/begin FUNCTION ZIF "" /begin DEF_CHARACTERISTIC CODEINDEX DIAGINDEX DIF_DAT SGFAMILY /end DEF_CHARACTERISTIC /begin REF_CHARACTERISTIC /end REF_CHARACTERISTIC /begin IN_MEASUREMENT /end IN_MEASUREMENT /begin OUT_MEASUREMENT /end OUT_MEASUREMENT /begin LOC_MEASUREMENT /end LOC_MEASUREMENT /begin SUB_FUNCTION /end SUB_FUNCTION /end FUNCTION
/begin FUNCTION ZNDAUS "Zündung: Anforderungen für Ausblendung" /begin DEF_CHARACTERISTIC ANWFOZA /end DEF_CHARACTERISTIC /begin REF_CHARACTERISTIC /end REF_CHARACTERISTIC /begin IN_MEASUREMENT B_fof_m B_sa /end IN_MEASUREMENT /begin OUT_MEASUREMENT B_zndaus /end OUT_MEASUREMENT /begin LOC_MEASUREMENT /end LOC_MEASUREMENT /begin SUB_FUNCTION /end SUB_FUNCTION /end FUNCTION
/begin FUNCTION ZUE258 "" /begin DEF_CHARACTERISTIC WPHN ZWAPPL /end DEF_CHARACTERISTIC /begin REF_CHARACTERISTIC CWMDAPP SNM08__UB _WMAX _WMIN _ZYLZA /end REF_CHARACTERISTIC
 /begin IN_MEASUREMENT B_llrein B_nozwe B_sa B_zwappl dwkr dwkrz dzwwl esst_snm08__ub nmot redist vszw zwgru zwsol zwspae zwstt zzylzue /end IN_MEASUREMENT
 /begin OUT_MEASUREMENT B_zwkra B_zwspae zwbas zwbasar zwist zwkrafld zwout zwoutar zwoutcpl zwzyl1 /end OUT_MEASUREMENT
 /begin LOC_MEASUREMENT wphg /end LOC_MEASUREMENT
 /begin SUB_FUNCTION /end SUB_FUNCTION
/end FUNCTION
/begin FUNCTION ZWGRU "Grundzündwinkel" /begin DEF_CHARACTERISTIC KFZW1 KFZW2 KFZWVL NKLO RLKL WKORA /end DEF_CHARACTERISTIC /begin REF_CHARACTERISTIC SNM24ZUUB SRL03ZUUB SRL16ZUUB /end REF_CHARACTERISTIC
 /begin IN_MEASUREMENT B_kr B_krdws B_stend B_vl dzwoag dzwol esst_snm24zuub esst_srl03zuub esst_srl16zuub fnwue nmot rl tans zwks /end IN_MEASUREMENT
 /begin OUT_MEASUREMENT zwgru /end OUT_MEASUREMENT
 /begin LOC_MEASUREMENT B_wkora /end LOC_MEASUREMENT
 /begin SUB_FUNCTION /end SUB_FUNCTION
/end FUNCTION
/begin FUNCTION ZWKS "Zündwinkel Klopfschutz" /begin DEF_CHARACTERISTIC KFFWK KFKSZW KFWK KSZWE /end DEF_CHARACTERISTIC /begin REF_CHARACTERISTIC SNM24ZUUB SRL16ZUUB /end REF_CHARACTERISTIC /begin IN_MEASUREMENT esst_snm24zuub esst_srl16zuub nmot rl tans tmot /end IN_MEASUREMENT /begin OUT_MEASUREMENT dzwks zwks /end OUT_MEASUREMENT /begin LOC_MEASUREMENT /end LOC_MEASUREMENT /begin SUB_FUNCTION /end SUB_FUNCTION /end FUNCTION
/begin FUNCTION ZWMIN1 "" /begin DEF_CHARACTERISTIC DZWSPM KFZWMN KFZWMNST ZZWMNST /end DEF_CHARACTERISTIC /begin REF_CHARACTERISTIC ETADZW SNM16ZUUB SRL12ZUUB STM06__UB /end REF_CHARACTERISTIC
 /begin IN_MEASUREMENT B_st dzw_kge esst_snm16zuub esst_srl12zuub esst_stm06__ub nmot rl tmot zwopt /end IN_MEASUREMENT
 /begin OUT_MEASUREMENT dzwspae etazwmn zwspae /end OUT_MEASUREMENT
 /begin LOC_MEASUREMENT B_zwmnste /end LOC_MEASUREMENT
 /begin SUB_FUNCTION /end SUB_FUNCTION
/end FUNCTION
/begin FUNCTION ZWSTT "Zündung im Start" /begin DEF_CHARACTERISTIC DZWSTTA FZWSTNM FZWSTTM /end DEF_CHARACTERISTIC /begin REF_CHARACTERISTIC /end REF_CHARACTERISTIC /begin IN_MEASUREMENT B_stend nmot tans tmst /end IN_MEASUREMENT /begin OUT_MEASUREMENT zwstt /end OUT_MEASUREMENT /begin LOC_MEASUREMENT /end LOC_MEASUREMENT /begin SUB_FUNCTION /end SUB_FUNCTION /end FUNCTION
/begin FUNCTION ZWWL "Warmlauf Zündwinkel" /begin DEF_CHARACTERISTIC KFZWWLNM KFZWWLTM /end DEF_CHARACTERISTIC /begin REF_CHARACTERISTIC /end REF_CHARACTERISTIC /begin IN_MEASUREMENT nmot tans tmot tmst /end IN_MEASUREMENT /begin OUT_MEASUREMENT dzwwl /end OUT_MEASUREMENT /begin LOC_MEASUREMENT /end LOC_MEASUREMENT /begin SUB_FUNCTION /end SUB_FUNCTION /end FUNCTION
/begin COMPU_METHOD bfzg_sb_q0p217 "" RAT_FUNC "%6.3" "m/s^2" COEFFS 0 1 0 0 0 0.217 /end COMPU_METHOD
/begin COMPU_METHOD B_TRUE "boolsche Zustände, positive Logik" TAB_VERB "%6.3" "" COMPU_TAB_REF B_TRUE /end COMPU_METHOD
/begin COMPU_VTAB B_TRUE "boolsche Zustände, positive Logik" TAB_VERB 2 0 "----" 1 "TRUE" /end COMPU_VTAB
/begin COMPU_METHOD DEZ "1 : 1 Umrechnug (dez/hex)" RAT_FUNC "%6.2" "" COEFFS 0 1 0 0 0 1 /end COMPU_METHOD
/begin COMPU_METHOD dez "1 : 1 Umrechnug (dez/hex)" RAT_FUNC "%6.2" "" COEFFS 0 1 0 0 0 1 /end COMPU_METHOD
/begin COMPU_METHOD DEZL "Dezimalzahl in 16-Bit-Hexzahl" RAT_FUNC "%6.2" "" COEFFS 0 1 0 0 0 1 /end COMPU_METHOD
/begin COMPU_METHOD dezsub1 "" RAT_FUNC "%6.2" "-" COEFFS 0 1 -1 0 0 1 /end COMPU_METHOD
/begin COMPU_METHOD dez_sb "" RAT_FUNC "%4.1" "Anzahl" COEFFS 0 1 0 0 0 1 /end COMPU_METHOD
/begin COMPU_METHOD FAKTCIFI "Korrekturfaktor für CIFI" RAT_FUNC "%6.3" "" COEFFS 0 512 -384 0 0 1 /end COMPU_METHOD
/begin COMPU_METHOD fak_q0p00195 "" RAT_FUNC "%6.4" "-" COEFFS 0 65536 0 0 0 128 /end COMPU_METHOD
/begin COMPU_METHOD fak_sb_b1 "" RAT_FUNC "%6.4" "-" COEFFS 0 256 0 0 0 2 /end COMPU_METHOD
/begin COMPU_METHOD fak_sb_b16 "" RAT_FUNC "%6.3" "-" COEFFS 0 256 0 0 0 32 /end COMPU_METHOD
/begin COMPU_METHOD fak_sb_b2 "" RAT_FUNC "%6.4" "-" COEFFS 0 256 0 0 0 4 /end COMPU_METHOD
/begin COMPU_METHOD fak_sb_b64 "" RAT_FUNC "%6.3" "-" COEFFS 0 256 0 0 0 128 /end COMPU_METHOD
/begin COMPU_METHOD fak_sb_q0p5 "" RAT_FUNC "%6.3" "-" COEFFS 0 256 0 0 0 128 /end COMPU_METHOD
/begin COMPU_METHOD fak_sw_b2 "" RAT_FUNC "%7.6" "-" COEFFS 0 65536 0 0 0 4 /end COMPU_METHOD
/begin COMPU_METHOD fak_sw_b64 "" RAT_FUNC "%6.4" "-" COEFFS 0 65536 0 0 0 128 /end COMPU_METHOD
/begin COMPU_METHOD fak_ub_b0p03125 "" RAT_FUNC "%6.5" "-" COEFFS 0 256 0 0 0 0.03125 /end COMPU_METHOD
/begin COMPU_METHOD fak_ub_b0p5 "" RAT_FUNC "%6.4" "-" COEFFS 0 256 0 0 0 0.5 /end COMPU_METHOD
/begin COMPU_METHOD fak_ub_b1 "" RAT_FUNC "%6.4" "-" COEFFS 0 256 0 0 0 1 /end COMPU_METHOD
/begin COMPU_METHOD fak_ub_b16 "" RAT_FUNC "%6.4" "-" COEFFS 0 256 0 0 0 16 /end COMPU_METHOD
/begin COMPU_METHOD fak_ub_b1p25_o0p75 "" RAT_FUNC "%6.3" "-" COEFFS 0 1 -0.75 0 0 0.00195313 /end COMPU_METHOD
/begin COMPU_METHOD fak_ub_b2 "" RAT_FUNC "%6.4" "-" COEFFS 0 256 0 0 0 2 /end COMPU_METHOD
/begin COMPU_METHOD fak_ub_b32 "" RAT_FUNC "%6.3" "-" COEFFS 0 256 0 0 0 32 /end COMPU_METHOD
/begin COMPU_METHOD fak_ub_b4 "" RAT_FUNC "%6.4" "-" COEFFS 0 256 0 0 0 4 /end COMPU_METHOD
/begin COMPU_METHOD fak_ub_b64 "" RAT_FUNC "%6.3" "-" COEFFS 0 256 0 0 0 64 /end COMPU_METHOD
/begin COMPU_METHOD fak_ub_q0p00392 "" RAT_FUNC "%6.4" "-" COEFFS 0 255 0 0 0 1 /end COMPU_METHOD
/begin COMPU_METHOD fak_uw_b0p5 "" RAT_FUNC "%8.7" "-" COEFFS 0 65536 0 0 0 0.5 /end COMPU_METHOD
/begin COMPU_METHOD fak_uw_b1 "" RAT_FUNC "%7.6" "-" COEFFS 0 65536 0 0 0 1 /end COMPU_METHOD
/begin COMPU_METHOD fak_uw_b2 "" RAT_FUNC "%7.6" "-" COEFFS 0 65536 0 0 0 2 /end COMPU_METHOD
/begin COMPU_METHOD KennText "" RAT_FUNC "%6.2" "" COEFFS 0 1 0 0 0 1 /end COMPU_METHOD
/begin COMPU_METHOD m_ub_b1020 "" RAT_FUNC "%6.2" "kg/h" COEFFS 0 1 0 0 0 4 /end COMPU_METHOD
/begin COMPU_METHOD m_ub_q0p0444 "" RAT_FUNC "%6.4" "g" COEFFS 0 1 0 0 0 0.0444 /end COMPU_METHOD
/begin COMPU_METHOD m_uw_b25p6 "" RAT_FUNC "%6.5" "kg/h" COEFFS 0 65536 0 0 0 25.6 /end COMPU_METHOD
/begin COMPU_METHOD m_uw_b6553p5 "" RAT_FUNC "%6.3" "kg/h" COEFFS 0 1 0 0 0 0.1 /end COMPU_METHOD
/begin COMPU_METHOD m_uw_q3p2 "" RAT_FUNC "%6.2" "kg/h" COEFFS 0 1 0 0 0 3.2 /end COMPU_METHOD
/begin COMPU_METHOD nmot_ub_q10 "" RAT_FUNC "%6.1" "U/min" COEFFS 0 1 0 0 0 10 /end COMPU_METHOD
/begin COMPU_METHOD nmot_ub_q40 "" RAT_FUNC "%6.1" "Upm" COEFFS 0 1 0 0 0 40 /end COMPU_METHOD
/begin COMPU_METHOD PCENT "Prozent" RAT_FUNC "%6.3" "%" COEFFS 0 256 0 0 0 100 /end COMPU_METHOD
/begin COMPU_METHOD perio_sw_b1p562 "" RAT_FUNC "%7.6" "1/s" COEFFS 0 65536 0 0 0 3.124 /end COMPU_METHOD
/begin COMPU_METHOD perio_sw_b6p125 "" RAT_FUNC "%6.5" "1/s" COEFFS 0 65536 0 0 0 12.25 /end COMPU_METHOD
/begin COMPU_METHOD perio_ub_b0p012207 "" RAT_FUNC "%7.6" "1/s" COEFFS 0 256 0 0 0 0.012207 /end COMPU_METHOD
/begin COMPU_METHOD perio_ub_b6p125 "" RAT_FUNC "%6.4" "1/s" COEFFS 0 256 0 0 0 6.125 /end COMPU_METHOD
/begin COMPU_METHOD p_sb_q32 "" RAT_FUNC "%6.3" "hPa" COEFFS 0 256 0 0 0 64 /end COMPU_METHOD
/begin COMPU_METHOD relDK_ub_b100 "" RAT_FUNC "%6.3" "% DK" COEFFS 0 255 0 0 0 100 /end COMPU_METHOD
/begin COMPU_METHOD rel_q0p00195 "" RAT_FUNC "%6.4" "%" COEFFS 0 65536 0 0 0 128 /end COMPU_METHOD
/begin COMPU_METHOD rel_sb_q0p75 "" RAT_FUNC "%6.3" "%" COEFFS 0 1 0 0 0 0.75 /end COMPU_METHOD
/begin COMPU_METHOD rel_sb_q0p78 "" RAT_FUNC "%6.3" "%" COEFFS 0 1 0 0 0 0.78 /end COMPU_METHOD
/begin COMPU_METHOD rel_sw_b100 "" RAT_FUNC "%6.4" "%" COEFFS 0 32768 0 0 0 100 /end COMPU_METHOD
/begin COMPU_METHOD rel_sw_q0p0468 "" RAT_FUNC "%6.4" "%" COEFFS 0 65536 0 0 0 3072 /end COMPU_METHOD
/begin COMPU_METHOD rel_ub_b100 "" RAT_FUNC "%6.3" "%" COEFFS 0 255 0 0 0 100 /end COMPU_METHOD
/begin COMPU_METHOD rel_ub_b127p5 "" RAT_FUNC "%6.3" "%" COEFFS 0 2 0 0 0 1 /end COMPU_METHOD
/begin COMPU_METHOD rel_ub_b99p6 "" RAT_FUNC "%6.3" "%" COEFFS 0 256 0 0 0 100 /end COMPU_METHOD
/begin COMPU_METHOD rel_ub_q0p00153 "" RAT_FUNC "%6.4" "%" COEFFS 0 256 0 0 0 0.3906 /end COMPU_METHOD
/begin COMPU_METHOD rel_ub_q0p0029 "" RAT_FUNC "%6.4" "%" COEFFS 0 256 0 0 0 0.75 /end COMPU_METHOD
/begin COMPU_METHOD rel_ub_q0p3906 "" RAT_FUNC "%6.3" "%" COEFFS 0 256 0 0 0 100 /end COMPU_METHOD
/begin COMPU_METHOD rel_ub_q0p391 "" RAT_FUNC "%6.3" "%/km/h" COEFFS 0 1 0 0 0 0.391 /end COMPU_METHOD
/begin COMPU_METHOD rel_ub_q0p75 "" RAT_FUNC "%6.3" "%" COEFFS 0 1 0 0 0 0.75 /end COMPU_METHOD
/begin COMPU_METHOD rel_uw_b100 "" RAT_FUNC "%6.4" "%" COEFFS 0 65536 0 0 0 100 /end COMPU_METHOD
/begin COMPU_METHOD rel_uw_b192 "" RAT_FUNC "%6.4" "%" COEFFS 0 65536 0 0 0 192 /end COMPU_METHOD
/begin COMPU_METHOD rel_uw_q0p0234 "" RAT_FUNC "%6.4" "%" COEFFS 0 32 0 0 0 0.75 /end COMPU_METHOD
/begin COMPU_METHOD rgrad_uw_b1280 "" RAT_FUNC "%6.4" "%/s" COEFFS 0 65536 0 0 0 1280 /end COMPU_METHOD
/begin COMPU_METHOD spg_q0p00488 "" RAT_FUNC "%6.4" "V" COEFFS 0 1024 0 0 0 5 /end COMPU_METHOD
/begin COMPU_METHOD spg_ub_q0p0098 "" RAT_FUNC "%6.4" "V" COEFFS 0 256 0 0 0 2.5 /end COMPU_METHOD
/begin COMPU_METHOD spg_ub_q0p019 "" RAT_FUNC "%6.4" "V" COEFFS 0 1 0 0 0 0.019 /end COMPU_METHOD
/begin COMPU_METHOD t100msxs_ub_b25p5 "" RAT_FUNC "%6.3" "s" COEFFS 0 1 0 0 0 0.1 /end COMPU_METHOD
/begin COMPU_METHOD t100msxs_uw_b6553p5 "" RAT_FUNC "%6.3" "s" COEFFS 0 1 0 0 0 0.1 /end COMPU_METHOD
/begin COMPU_METHOD t100msxs_uw_q100 "" RAT_FUNC "%6.3" "s" COEFFS 0 1 0 0 0 0.1 /end COMPU_METHOD
/begin COMPU_METHOD t10msxs_ub_b2p55 "" RAT_FUNC "%6.4" "s" COEFFS 0 1 0 0 0 0.01 /end COMPU_METHOD
/begin COMPU_METHOD t10msxs_uw_b655p35 "" RAT_FUNC "%6.4" "s" COEFFS 0 1 0 0 0 0.01 /end COMPU_METHOD
/begin COMPU_METHOD t1ms_ub_b255 "" RAT_FUNC "%7.3" "ms" COEFFS 0 1 0 0 0 1 /end COMPU_METHOD
/begin COMPU_METHOD t20msxs_ub_b5p1 "" RAT_FUNC "%6.4" "s" COEFFS 0 1 0 0 0 0.02 /end COMPU_METHOD
/begin COMPU_METHOD t20msxs_ub_q0p32 "" RAT_FUNC "%6.3" "s" COEFFS 0 256 0 0 0 81.92 /end COMPU_METHOD
/begin COMPU_METHOD t40msxs_uw_q0p04 "" RAT_FUNC "%6.4" "s" COEFFS 0 1 0 0 0 0.04 /end COMPU_METHOD
/begin COMPU_METHOD t40ms_ub_b10200 "" RAT_FUNC "%7.2" "ms" COEFFS 0 1 0 0 0 40 /end COMPU_METHOD
/begin COMPU_METHOD t6minxmin_q6 "" RAT_FUNC "%6.2" "min" COEFFS 0 1 0 0 0 6 /end COMPU_METHOD
/begin COMPU_METHOD temp_ub_b191p25 "" RAT_FUNC "%6.3" "Grad C" COEFFS 0 1 0 0 0 0.75 /end COMPU_METHOD
/begin COMPU_METHOD temp_ub_q0p75_o48 "" RAT_FUNC "%6.2" "Grad C" COEFFS 0 1 48 0 0 0.75 /end COMPU_METHOD
/begin COMPU_METHOD TEQL "Quantisierung von te, 16 Bit" RAT_FUNC "%6.4" "ms" COEFFS 0 1 0 0 0 0.0032 /end COMPU_METHOD
/begin COMPU_METHOD TQ10 "Zeitquantisierung mit 10 [ms]" RAT_FUNC "%6.4" "sec" COEFFS 0 100 0 0 0 1 /end COMPU_METHOD
/begin COMPU_METHOD TSZ "" RAT_FUNC "%6.3" "ms" COEFFS 0 9.766 0 0 0 1 /end COMPU_METHOD
/begin COMPU_METHOD tv_sb_b50 "" RAT_FUNC "%4.2" "%TV" COEFFS 0 128 0 0 0 50 /end COMPU_METHOD
/begin COMPU_METHOD tv_ub_b100 "" RAT_FUNC "%4.2" "%TV" COEFFS 0 255 0 0 0 100 /end COMPU_METHOD
/begin COMPU_METHOD t_wdt_high "" RAT_FUNC "%6.2" "ms" COEFFS 0 0.610352 0 0 0 1 /end COMPU_METHOD
/begin COMPU_METHOD UBQ "Batteriespannung" RAT_FUNC "%6.3" "V" COEFFS 0 1 0 0 0 0.0942 /end COMPU_METHOD
/begin COMPU_METHOD umf_ub_b7p78 "" RAT_FUNC "%4.3" "1/s" COEFFS 0 255 0 0 0 7.78 /end COMPU_METHOD
/begin COMPU_METHOD vfzg_sw_q0p00781 "" RAT_FUNC "%6.4" "km/h" COEFFS 0 1 0 0 0 0.0078125 /end COMPU_METHOD
/begin COMPU_METHOD vfzg_ub_q1p25 "" RAT_FUNC "%6.2" "km/h" COEFFS 0 1 0 0 0 1.25 /end COMPU_METHOD
/begin COMPU_METHOD vfzg_uw_q0p00781 "" RAT_FUNC "%6.4" "km/h" COEFFS 0 1 0 0 0 0.0078125 /end COMPU_METHOD
/begin COMPU_METHOD vhtvw_sw_b50 "" RAT_FUNC "%7.5" "%/Grad" COEFFS 0 65536 0 0 0 100 /end COMPU_METHOD
/begin COMPU_METHOD vhvtv_sb_b0p02 "" RAT_FUNC "%5.4" "1/%" COEFFS 0 6400 0 0 0 1 /end COMPU_METHOD
/begin COMPU_METHOD vnw_sb_b1000 "" RAT_FUNC "%4.1" "grd/Sek." COEFFS 0 128 0 0 0 1000 /end COMPU_METHOD
/begin COMPU_METHOD vnw_sw_b1000 "" RAT_FUNC "%7.4" "grd/Sek." COEFFS 0 8192 0 0 0 250 /end COMPU_METHOD
/begin COMPU_METHOD wkw_sb_q0p25 "" RAT_FUNC "%7.3" "Grad KW" COEFFS 0 4 0 0 0 1 /end COMPU_METHOD
/begin COMPU_METHOD wkw_sb_q0p5 "" RAT_FUNC "%7.3" "Grad KW" COEFFS 0 2 0 0 0 1 /end COMPU_METHOD
/begin COMPU_METHOD wkw_sw_b128 "" RAT_FUNC "%7.5" "Grad KW" COEFFS 0 256 0 0 0 1 /end COMPU_METHOD
/begin COMPU_METHOD wkw_ub_q0p25 "" RAT_FUNC "%7.3" "Grad KW" COEFFS 0 4 0 0 0 1 /end COMPU_METHOD
/begin COMPU_METHOD wkw_ub_q0p5 "" RAT_FUNC "%7.3" "Grad KW" COEFFS 0 2 0 0 0 1 /end COMPU_METHOD
/begin COMPU_METHOD wkw_uw_b2048 "" RAT_FUNC "%7.4" "grad KW" COEFFS 0 32 0 0 0 1 /end COMPU_METHOD
/begin COMPU_METHOD WQ720 "Kurbelwellenwinkel - Quantisierung" RAT_FUNC "%6.2" "grad KW" COEFFS 0 1 0 0 0 2.813 /end COMPU_METHOD
/begin COMPU_METHOD zk100msxs_ub_b25p5 "" RAT_FUNC "%6.3" "s" COEFFS 0 0 256 0 10 0 /end COMPU_METHOD
/begin COMPU_METHOD zk100msxs_uw_b6553 "" RAT_FUNC "%6.1" "s" COEFFS 0 0 65536 0 10 0 /end COMPU_METHOD
/begin COMPU_METHOD zk10msxs_ub_b2p55 "" RAT_FUNC "%6.4" "s" COEFFS 0 0 255 0 100 0 /end COMPU_METHOD
/begin COMPU_METHOD zk10msxs_uw_b655 "" RAT_FUNC "%10.4" "s" COEFFS 0 0 65536 0 100 0 /end COMPU_METHOD
/begin COMPU_METHOD zk200msxs_uw_b13107 "" RAT_FUNC "%10.2" "s" COEFFS 0 0 13107.2 0 1 0 /end COMPU_METHOD
/begin COMPU_METHOD zk40ms_ub_b10200 "" RAT_FUNC "%6.1" "ms" COEFFS 0 0 10240 0 1 40 /end COMPU_METHOD
/begin COMPU_METHOD zv_uw_b9p765em4 "" RAT_FUNC "%10.9" "min" COEFFS 0 65536 0 0 0 0.0009765 /end COMPU_METHOD
/begin COMPU_METHOD ZWOF "Zündwinkel mit Offset" RAT_FUNC "%6.2" "grad KW" COEFFS 0 1 -72 0 0 -0.75 /end COMPU_METHOD
/begin COMPU_METHOD zw_sb_q0p75 "" RAT_FUNC "%6.3" "grad KW" COEFFS 0 255 0 0 0 191.25 /end COMPU_METHOD
/begin COMPU_METHOD zw_sb_q6 "" RAT_FUNC "%6.2" "Grad KW" COEFFS 0 1 0 0 0 6 /end COMPU_METHOD
/begin COMPU_METHOD zw_ub_q0p75 "" RAT_FUNC "%6.3" "Grad KW" COEFFS 0 255 0 0 0 191.25 /end COMPU_METHOD
/begin COMPU_METHOD default "" RAT_FUNC "%6.2" "" COEFFS 0 1 0 0 0 1 /end COMPU_METHOD
/begin COMPU_METHOD defaultAscii "" RAT_FUNC "%6.2" "" COEFFS 0 1 0 0 0 1 /end COMPU_METHOD
/begin RECORD_LAYOUT DI__Kwub__________ FNC_VALUES 1 UBYTE COLUMN_DIR DIRECT /end RECORD_LAYOUT
/begin RECORD_LAYOUT DI__Kwuw__________ FNC_VALUES 1 UWORD COLUMN_DIR DIRECT /end RECORD_LAYOUT
/begin RECORD_LAYOUT FklWUb FNC_VALUES 1 UBYTE COLUMN_DIR DIRECT /end RECORD_LAYOUT
/begin RECORD_LAYOUT GkfWSb FNC_VALUES 1 SBYTE COLUMN_DIR DIRECT /end RECORD_LAYOUT
/begin RECORD_LAYOUT GkfWUb FNC_VALUES 1 UBYTE COLUMN_DIR DIRECT /end RECORD_LAYOUT
/begin RECORD_LAYOUT GklWSb FNC_VALUES 1 SBYTE COLUMN_DIR DIRECT /end RECORD_LAYOUT
/begin RECORD_LAYOUT GklWUb FNC_VALUES 1 UBYTE COLUMN_DIR DIRECT /end RECORD_LAYOUT
/begin RECORD_LAYOUT KfAxUbAyUbSstxUbSstyUbWSb NO_AXIS_PTS_X 1 UBYTE NO_AXIS_PTS_Y 2 UBYTE AXIS_PTS_X 3 UBYTE INDEX_INCR DIRECT AXIS_PTS_Y 4 UBYTE INDEX_INCR DIRECT FNC_VALUES 5 SBYTE COLUMN_DIR DIRECT /end RECORD_LAYOUT
/begin RECORD_LAYOUT KfAxUbAyUbSstxUbSstyUbWUb NO_AXIS_PTS_X 1 UBYTE NO_AXIS_PTS_Y 2 UBYTE AXIS_PTS_X 3 UBYTE INDEX_INCR DIRECT AXIS_PTS_Y 4 UBYTE INDEX_INCR DIRECT FNC_VALUES 5 UBYTE COLUMN_DIR DIRECT /end RECORD_LAYOUT
/begin RECORD_LAYOUT KfAxUbAyUbSstxUwSstyUbWUb NO_AXIS_PTS_X 1 UBYTE NO_AXIS_PTS_Y 2 UBYTE AXIS_PTS_X 3 UWORD INDEX_INCR DIRECT AXIS_PTS_Y 4 UBYTE INDEX_INCR DIRECT FNC_VALUES 5 UBYTE COLUMN_DIR DIRECT /end RECORD_LAYOUT
/begin RECORD_LAYOUT KfAxUwAyUwSstxSwSstyUwWUw NO_AXIS_PTS_X 1 UWORD NO_AXIS_PTS_Y 2 UWORD AXIS_PTS_X 3 SWORD INDEX_INCR DIRECT AXIS_PTS_Y 4 UWORD INDEX_INCR DIRECT FNC_VALUES 5 UWORD COLUMN_DIR DIRECT /end RECORD_LAYOUT
/begin RECORD_LAYOUT KfWUb FNC_VALUES 1 UBYTE COLUMN_DIR DIRECT /end RECORD_LAYOUT
/begin RECORD_LAYOUT KlAUbSstSbWSb NO_AXIS_PTS_X 1 UBYTE AXIS_PTS_X 2 SBYTE INDEX_INCR DIRECT FNC_VALUES 3 SBYTE COLUMN_DIR DIRECT /end RECORD_LAYOUT
/begin RECORD_LAYOUT KlAUbSstUbWSb NO_AXIS_PTS_X 1 UBYTE AXIS_PTS_X 2 UBYTE INDEX_INCR DIRECT FNC_VALUES 3 SBYTE COLUMN_DIR DIRECT /end RECORD_LAYOUT
/begin RECORD_LAYOUT KlAUbSstUbWUb NO_AXIS_PTS_X 1 UBYTE AXIS_PTS_X 2 UBYTE INDEX_INCR DIRECT FNC_VALUES 3 UBYTE COLUMN_DIR DIRECT /end RECORD_LAYOUT
/begin RECORD_LAYOUT KlAUwSstUwWUw NO_AXIS_PTS_X 1 UWORD AXIS_PTS_X 2 UWORD INDEX_INCR DIRECT FNC_VALUES 3 UWORD COLUMN_DIR DIRECT /end RECORD_LAYOUT
/begin RECORD_LAYOUT KwbUb FNC_VALUES 1 UBYTE COLUMN_DIR DIRECT /end RECORD_LAYOUT
/begin RECORD_LAYOUT KwbUw FNC_VALUES 1 UWORD COLUMN_DIR DIRECT /end RECORD_LAYOUT
/begin RECORD_LAYOUT KwSb FNC_VALUES 1 SBYTE COLUMN_DIR DIRECT /end RECORD_LAYOUT
/begin RECORD_LAYOUT KwSw FNC_VALUES 1 SWORD COLUMN_DIR DIRECT /end RECORD_LAYOUT
/begin RECORD_LAYOUT KwUb FNC_VALUES 1 UBYTE COLUMN_DIR DIRECT /end RECORD_LAYOUT
/begin RECORD_LAYOUT KwUw FNC_VALUES 1 UWORD COLUMN_DIR DIRECT /end RECORD_LAYOUT
/begin RECORD_LAYOUT SstAUbSstSb NO_AXIS_PTS_X 1 UBYTE AXIS_PTS_X 2 SBYTE INDEX_INCR DIRECT /end RECORD_LAYOUT
/begin RECORD_LAYOUT SstAUbSstUb NO_AXIS_PTS_X 1 UBYTE AXIS_PTS_X 2 UBYTE INDEX_INCR DIRECT /end RECORD_LAYOUT
/begin RECORD_LAYOUT SstAUwSstUw NO_AXIS_PTS_X 1 UWORD AXIS_PTS_X 2 UWORD INDEX_INCR DIRECT /end RECORD_LAYOUT
/end MODULE
/end PROJECT
