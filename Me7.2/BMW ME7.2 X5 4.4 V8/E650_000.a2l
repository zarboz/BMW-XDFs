ASAP2_VERSION 1 3
/begin PROJECT _7211165 "195"
/begin HEADER "" VERSION "_7211165" PROJECT_NO _7211165 /end HEADER
/begin MODULE DIM ""
/begin MOD_COMMON "" BYTE_ORDER MSB_LAST ALIGNMENT_BYTE 1 ALIGNMENT_WORD 2 ALIGNMENT_LONG 2 /end MOD_COMMON
/begin CHARACTERISTIC AFSTB "Anzahl rasterabh. Entprellung Fuellstandsbedingungen" VALUE 0x81A70B KwUb 255.0 dez 0.00 255.0 FORMAT "%5.1" /end CHARACTERISTIC
/begin CHARACTERISTIC AIMV "Anzahl Geschwindigkeitsimpulse pro km für Normierung v-Signal" VALUE 0x8142F4 KwUl 71999999983.236191 aimv_ul_b5p76e11 16.763806346981742 72000000000.000000 FORMAT "%19.7" /end CHARACTERISTIC
/begin CHARACTERISTIC ANZRIBEH "Anzahl der Ri-Berechnungen hinter KAT" VALUE 0x810A32 KwUb 255.0 dez 0.00 255.0 FORMAT "%5.1" /end CHARACTERISTIC
/begin CHARACTERISTIC ANZRIBEV "Anzahl der Ri-Berechnungen vor KAT" VALUE 0x810094 KwUb 255.0 dez 0.00 255.0 FORMAT "%5.1" /end CHARACTERISTIC
/begin CHARACTERISTIC BNWPOL "Polarität der Flanken des NW-Signals" VAL_BLK 0x810006 KwbUb 255.0 dez 0.00 255.0 FORMAT "%5.1" NUMBER 2 /end CHARACTERISTIC
/begin CHARACTERISTIC CWBWEEN "Codewort zur Deaktivierung der Bewegungserkennung" VALUE 0x810132 KwUb 255.0 dez 0.00 255.0 FORMAT "%5.1" /end CHARACTERISTIC
/begin CHARACTERISTIC CWGGEGAS "Codewort für GGEGAS" VALUE 0x819C87 KwUb 255.0 dez 0.00 255.0 FORMAT "%5.1" /end CHARACTERISTIC
/begin CHARACTERISTIC CWGGFST "Codewort Gebergroesse Fuellstand" VALUE 0x81A70C KwUb 255.0 dez 0.00 255.0 FORMAT "%5.1" /end CHARACTERISTIC
/begin CHARACTERISTIC CWGGLSH "Codeword für Ri-Auswertung für Sonde hinter KAT (Heizung nicht voll ein)" VALUE 0x8193E7 KwUb 255.0 dez 0.00 255.0 FORMAT "%5.1" /end CHARACTERISTIC
/begin CHARACTERISTIC CWGGLSV "Codeword für Ri-Auswertung für Sonde vor KAT (Heizung nicht voll ein)" VALUE 0x819BE4 KwUb 255.0 dez 0.00 255.0 FORMAT "%5.1" /end CHARACTERISTIC
/begin CHARACTERISTIC CWGGMFL "Codewort für %GGMFL ( Auswertung Multifunktionslenkrad)" VALUE 0x810167 KwUb 255.0 dez 0.00 255.0 FORMAT "%5.1" /end CHARACTERISTIC
/begin CHARACTERISTIC CWHDMTL "Codewort HDMTL-Funktion" VALUE 0x81A726 KwUb 255.0 dez 0.00 255.0 FORMAT "%5.1" /end CHARACTERISTIC
/begin CHARACTERISTIC CWKHMD "Codewort für Drehmomentenreserve bei Katheizen" VALUE 0x81A40C KwUb 255.0 dez 0.00 255.0 FORMAT "%5.1" /end CHARACTERISTIC
/begin CHARACTERISTIC CWMDAPP "Codewort Applikation ohne Drehmomentfunktionen" VALUE 0x810180 KwUb 255.0 dez 0.00 255.0 FORMAT "%5.1" /end CHARACTERISTIC
/begin CHARACTERISTIC DKROKD "Obere Drehzahlschwelle für Nulltest-Diagnose Klopfregelung" VALUE 0x810030 KwUb 10200. nmot_ub_q40 0.00 10200. FORMAT "%5.0" /end CHARACTERISTIC
/begin CHARACTERISTIC DKROKMX "Maximaler Offsetkompensationswert" VALUE 0x810031 KwUb 4.980 spg_ub_b5 0.00 4.980 FORMAT "%5.3" /end CHARACTERISTIC
/begin CHARACTERISTIC DKROKO "Obere Drehzahlschwelle für Ermittlung Offsetkompensationswert" VALUE 0x810032 KwUb 10200. nmot_ub_q40 0.00 10200. FORMAT "%5.0" /end CHARACTERISTIC
/begin CHARACTERISTIC DTLRTML "Bewertungsfaktor Zeitdekrementierung für Erreichen tmot-Einschaltschwelle LR" CURVE 0x81A2F5 KlAUbSstUbWUb 99.61 rel_ub_b99p6 0.00 99.61 FORMAT "%5.2"
 /begin AXIS_DESCR STD_AXIS ml m_ub_b1020 7 0.00 1020. FORMAT "%5.0" DEPOSIT ABSOLUTE /end AXIS_DESCR
/end CHARACTERISTIC
/begin CHARACTERISTIC DTMDMA "Abstand Motortemperaturmodell zur Starttemperatur" VALUE 0x81A304 KwUb 191.3 temp_ub_b191p25 0.00 191.3 FORMAT "%5.1" /end CHARACTERISTIC
/begin CHARACTERISTIC DTMDNPO "Abstand Motortemperaturmodell zur oberen Unplausibilitätsschwelle" VALUE 0x81A305 KwUb 191.3 temp_ub_b191p25 0.00 191.3 FORMAT "%5.1" /end CHARACTERISTIC
/begin CHARACTERISTIC DTMSRT "Delta Motortemp.zu Starttemp. f.Retrigg. Modelle (Blockheater-Erkennung)" VALUE 0x81A306 KwUb 191.3 temp_ub_b191p25 0.00 191.3 FORMAT "%5.1" /end CHARACTERISTIC
/begin CHARACTERISTIC DUPW12 "Zulässige Spannungsabweichung zwischen PWG-Poti 1 und 2" VALUE 0x810133 KwUb 4.980 spg_ub_b5 0.00 4.980 FORMAT "%5.3" /end CHARACTERISTIC
/begin CHARACTERISTIC DUPW12BE "notweniger Spannungsweg von Poti 2 zur Bewegungserkennung" VALUE 0x8142CC KwUw 4.995117 spg_uw_q0p00488 0.00 4.995117 FORMAT "%8.6" /end CHARACTERISTIC
/begin CHARACTERISTIC DUPW12TG "Zulässige Spannungsabweichung zwischen PWG Poti 1 und  2 im Teilgasbereich" VALUE 0x810134 KwUb 4.980 spg_ub_b5 0.00 4.980 FORMAT "%5.3" /end CHARACTERISTIC
/begin CHARACTERISTIC DUPW12VG "Zulässige Spannungsabweichung zwischen PWG-Poti 1 und 2 im Vollgasbereich" VALUE 0x810135 KwUb 4.980 spg_ub_b5 0.00 4.980 FORMAT "%5.3" /end CHARACTERISTIC
/begin CHARACTERISTIC DUPWGHY "Spannungshysterese bei Entjitterung der PWG-Spannung" VALUE 0x8142CE KwUw 4.995117 spg_uw_q0p00488 0.00 4.995117 FORMAT "%8.6" /end CHARACTERISTIC
/begin CHARACTERISTIC DUSRIH "Delta Sondenspannung h. Kat zwischen Neu-und Altwert im Raster für Ri-Messung" VALUE 0x813D5E KwSw 319.9951 spg_sw_q0p00488 -160.0000 159.9951 FORMAT "%8.4" /end CHARACTERISTIC
/begin CHARACTERISTIC DUSRIV "Delta Sondenspannung vor Kat zwischen Neu-und Altwert im Raster für Ri-Messung" VALUE 0x81577C KwSw 319.9951 spg_sw_q0p00488 -160.0000 159.9951 FORMAT "%8.4" /end CHARACTERISTIC
/begin CHARACTERISTIC DUSSPH "Delta Sondensp. hinter Kat zwischen Neu-und 2 Altwerten für Sonden Sprungmessung" VALUE 0x813D60 KwSw 319.9951 spg_sw_q0p00488 -160.0000 159.9951 FORMAT "%8.4" /end CHARACTERISTIC
/begin CHARACTERISTIC DUSSPV "Delta Sondensp. vor Kat zwischen Neu-und Altwert für Sonden Sprungmessung" VALUE 0x81577E KwSw 319.9951 spg_sw_q0p00488 -160.0000 159.9951 FORMAT "%8.4" /end CHARACTERISTIC
/begin CHARACTERISTIC DVFZBEG "Delta-Geschwindigkeit für Änderungsbegrenzung" VALUE 0x8142F8 KwUw 511.9922 vfzg_uw_b512 0.00 511.9922 FORMAT "%8.4" /end CHARACTERISTIC
/begin CHARACTERISTIC DWPMXNOT "Maximal zulässige Pedalwerterhöhung pro Rechenschritt im PWG-Ersatzbetrieb" VALUE 0x8142D0 KwUw 100.0000 relPED_uw_b100 0.00 100.0000 FORMAT "%8.4" /end CHARACTERISTIC
/begin CHARACTERISTIC FABSTT "Faktor Abstellzeit für Modelltemparatur" CURVE 0x81B7E6 KlAUwSstUwWUw 1.999969 fak_uw_b2 0.00 1.999969 FORMAT "%8.6"
 /begin AXIS_DESCR STD_AXIS tabst_w t1sxs_uw_q1 5 0.00 65535.00 FORMAT "%8.2" DEPOSIT ABSOLUTE /end AXIS_DESCR
/end CHARACTERISTIC
/begin CHARACTERISTIC FMDKHFH "Höhenkorrektur Drehmomentenreserve für Katheizen" CURVE 0x81B900 KlAUwSstUwWUw 1.999969 fak_uw_b2 0.00 1.999969 FORMAT "%8.6"
 /begin AXIS_DESCR STD_AXIS fho_w fak_uw_b4 4 0.00 3.999939 FORMAT "%8.6" DEPOSIT ABSOLUTE /end AXIS_DESCR
/end CHARACTERISTIC
/begin CHARACTERISTIC FMDKHFH2 "Höhenkorrektur Drehmomentreserve, ohne Kat" CURVE 0x81B912 KlAUwSstUwWUw 1.999969 fak_uw_b2 0.00 1.999969 FORMAT "%8.6"
 /begin AXIS_DESCR STD_AXIS fho_w fak_uw_b4 4 0.00 3.999939 FORMAT "%8.6" DEPOSIT ABSOLUTE /end AXIS_DESCR
/end CHARACTERISTIC
/begin CHARACTERISTIC FMDKHTM "tmot-Korrektur Drehmomentenresrve für Katheizen" CURVE 0x81A40D KlAUbSstUbWUb 1.992 fak_ub_b2 0.00 1.992 FORMAT "%5.3"
 /begin AXIS_DESCR STD_AXIS tmot temp_ub_q0p75_o48 8 -48.00 143.3 FORMAT "%5.1" DEPOSIT ABSOLUTE /end AXIS_DESCR
/end CHARACTERISTIC
/begin CHARACTERISTIC FMDKHTM2 "tmot-Korrektur Drehmomentreserve, ohne Kat" CURVE 0x81A41E KlAUbSstUbWUb 1.992 fak_ub_b2 0.00 1.992 FORMAT "%5.3"
 /begin AXIS_DESCR STD_AXIS tmot temp_ub_q0p75_o48 8 -48.00 143.3 FORMAT "%5.1" DEPOSIT ABSOLUTE /end AXIS_DESCR
/end CHARACTERISTIC
/begin CHARACTERISTIC FMFKR "Mittenfrequenz für Bandpaßfilter Klopfregelung" VALUE 0x8190DB KwUb 16.00 fmfkr_dez 0.00 16.00 /end CHARACTERISTIC
/begin CHARACTERISTIC FQFSTT "Quantisierungsfaktor Fuellstand" VALUE 0x81A70D KwUb 25.50 vol_q0p1_l 0.00 25.50 FORMAT "%5.2" /end CHARACTERISTIC
/begin CHARACTERISTIC FRINOF "Faktor für Bewertung alter Ri-Wert ohne Filter" VALUE 0x810A33 KwUb 15.94 fak_ub_b16 0.00 15.94 FORMAT "%5.2" /end CHARACTERISTIC
/begin CHARACTERISTIC FSTDMN "minimaler Tankfuellstand fuer Tankdiagnosefunktionen" VALUE 0x81BC4C KwUw 6553.500 vol_q0p1_l 0.00 6553.500 FORMAT "%8.3" /end CHARACTERISTIC
/begin CHARACTERISTIC FSTDMX "maximaler Tankfuellstand fuer Tankdiagnosefunktionen" VALUE 0x81BC4E KwUw 6553.500 vol_q0p1_l 0.00 6553.500 FORMAT "%8.3" /end CHARACTERISTIC
/begin CHARACTERISTIC FSTDTOL "Toleranz Fuellstandsdynamik" VALUE 0x81BC50 KwUw 6553.500 vol_q0p1_l 0.00 6553.500 FORMAT "%8.3" /end CHARACTERISTIC
/begin CHARACTERISTIC FSTHYS "Hysterese fuer Tankfuellstandsschwellen B_tal, B_tav, etc." VALUE 0x81BC52 KwUw 6553.500 vol_q0p1_l 0.00 6553.500 FORMAT "%8.3" /end CHARACTERISTIC
/begin CHARACTERISTIC FSTTAL "Tankfuellstand fuer ""Tank leer"" Erkennung" VALUE 0x81BC54 KwUw 6553.500 vol_q0p1_l 0.00 6553.500 FORMAT "%8.3" /end CHARACTERISTIC
/begin CHARACTERISTIC FSTTAL1 "Tankfuellstand fuer ""Tank leer"" Erkennung Tank1" VALUE 0x81BC56 KwUw 6553.500 vol_q0p1_l 0.00 6553.500 FORMAT "%8.3" /end CHARACTERISTIC
/begin CHARACTERISTIC FSTTAV "Tankfuellstand fuer ""Tank voll"" Erkennung" VALUE 0x81BC58 KwUw 6553.500 vol_q0p1_l 0.00 6553.500 FORMAT "%8.3" /end CHARACTERISTIC
/begin CHARACTERISTIC FSTTEW "Ersatzwert Fuellstand Kraftstofftank" VALUE 0x81BC5A KwUw 6553.500 vol_q0p1_l 0.00 6553.500 FORMAT "%8.3" /end CHARACTERISTIC
/begin CHARACTERISTIC FSTTMX "maximaler Tankinhalt" VALUE 0x81BC5C KwUw 319.9951 vol_q4p8828Em3_l 0.00 319.9951 FORMAT "%8.4" /end CHARACTERISTIC
/begin CHARACTERISTIC GVTMX "Gasvolumen Tank maximal" VALUE 0x81BC5E KwUw 319.9951 vol_q4p8828Em3_l 0.00 319.9951 FORMAT "%8.4" /end CHARACTERISTIC
/begin CHARACTERISTIC IMTUMGTA "Schwelle integrierte Luftmasse für Bestimmung Umgebungstemperatur" VALUE 0x81A39B KwUb 23.21 m_ub_b23p3 0.00 23.21 FORMAT "%5.2" /end CHARACTERISTIC
/begin CHARACTERISTIC KEMLN "Messfensterlänge für Klopfregelung" CURVE 0x8190DC GklWUb 191.3 zw_ub_q0p75 0.00 191.3 FORMAT "%5.1"
 /begin AXIS_DESCR COM_AXIS nmot nmot_ub_q40 16 0.00 10200. AXIS_PTS_REF SNM16KRUB /end AXIS_DESCR
/end CHARACTERISTIC
/begin CHARACTERISTIC KFBS "Kennfeld für banksel. Gemischfaktor" MAP 0x813BEC KfAxUbAyUbSstxUbSstyUbWSb 0.4980 fak_sb_b0p25 -0.2500 0.2480
 /begin AXIS_DESCR STD_AXIS nmot nmot_ub_q40 16 0.00 10200. FORMAT "%5.0" DEPOSIT ABSOLUTE /end AXIS_DESCR
 /begin AXIS_DESCR STD_AXIS rl rel_ub_q0p75 16 0.00 191.3 FORMAT "%5.1" DEPOSIT ABSOLUTE /end AXIS_DESCR
/end CHARACTERISTIC
/begin CHARACTERISTIC KFDTMTE "Kennfeld Motortemperaturgradient für Ersatztemperatur" MAP 0x81B7FC KfAxUbAyUbSstxUbSstyUbWSb 0.1868 temp_sb_b0p093 -0.09375 0.09302 FORMAT "%7.5"
 /begin AXIS_DESCR STD_AXIS ml m_ub_b1020 5 0.00 1020. FORMAT "%5.0" DEPOSIT ABSOLUTE /end AXIS_DESCR
 /begin AXIS_DESCR STD_AXIS tmew temp_ub_q0p75_o48 4 -48.00 143.3 FORMAT "%5.1" DEPOSIT ABSOLUTE /end AXIS_DESCR
/end CHARACTERISTIC
/begin CHARACTERISTIC KFDTMTR "Kennfeld Motortemperaturgradient für Referenztemperatur" MAP 0x81B81C KfAxUbAyUbSstxUbSstyUbWSb 0.1868 temp_sb_b0p093 -0.09375 0.09302 FORMAT "%7.5"
 /begin AXIS_DESCR STD_AXIS ml m_ub_b1020 5 0.00 1020. FORMAT "%5.0" DEPOSIT ABSOLUTE /end AXIS_DESCR
 /begin AXIS_DESCR STD_AXIS tmrw temp_ub_q0p75_o48 4 -48.00 143.3 FORMAT "%5.1" DEPOSIT ABSOLUTE /end AXIS_DESCR
/end CHARACTERISTIC
/begin CHARACTERISTIC KFDTMTU "Kennfeld Korrekturgradient Motortemperatur bei geringer Erwärmung" MAP 0x81B83C KfAxUbAyUbSstxUbSstyUbWSb 0.1868 temp_sb_b0p093 -0.09375 0.09302 FORMAT "%7.5"
 /begin AXIS_DESCR STD_AXIS ml m_ub_b1020 5 0.00 1020. FORMAT "%5.0" DEPOSIT ABSOLUTE /end AXIS_DESCR
 /begin AXIS_DESCR STD_AXIS tumginp temp_ub_q0p75_o48 4 -48.00 143.3 FORMAT "%5.1" DEPOSIT ABSOLUTE /end AXIS_DESCR
/end CHARACTERISTIC
/begin CHARACTERISTIC KFKHFM "Korrekturkennfeld für HFM" MAP 0x810556 KfAxUbAyUbSstxUbSstyUbWUb 1.992 fak_ub_b2 0.00 1.992 FORMAT "%5.3"
 /begin AXIS_DESCR STD_AXIS nmot nmot_ub_q40 14 0.00 10200. FORMAT "%5.0" DEPOSIT ABSOLUTE /end AXIS_DESCR
 /begin AXIS_DESCR STD_AXIS rl rel_ub_q0p75 14 0.00 191.3 FORMAT "%5.1" DEPOSIT ABSOLUTE /end AXIS_DESCR
/end CHARACTERISTIC
/begin CHARACTERISTIC KFKWTMP "Kennfeld Drehmomentenreserve für Kat warmhalten, zeitweise" MAP 0x81B924 KfAxUwAyUwSstxUwSstyUwWUw 99.99847 rel_uw_b100 0.00 99.99847 FORMAT "%8.5"
 /begin AXIS_DESCR STD_AXIS nmot_w nmot_uw_q0p25 4 0.00 16383.75 FORMAT "%8.2" DEPOSIT ABSOLUTE /end AXIS_DESCR
 /begin AXIS_DESCR STD_AXIS mifakh_w rel_uw_b100 4 0.00 99.99847 FORMAT "%8.5" DEPOSIT ABSOLUTE /end AXIS_DESCR
/end CHARACTERISTIC
/begin CHARACTERISTIC KFMAKR "Kennfeld Meßfensteranfang Klopfregelung" MAP 0x8190EC GkfWUb 191.3 zw_ub_q0p75 0.00 191.3 FORMAT "%5.1"
 /begin AXIS_DESCR COM_AXIS nmot nmot_ub_q40 16 0.00 10200. AXIS_PTS_REF SNM16KRUB /end AXIS_DESCR
 /begin AXIS_DESCR COM_AXIS rl rel_ub_q0p75 4 0.00 191.3 AXIS_PTS_REF SRL04KRUB /end AXIS_DESCR
/end CHARACTERISTIC
/begin CHARACTERISTIC KFMDDSLA "Kennfeld Drehmomentenreserve bei Testereingriff Sekundärluftdiagnose" MAP 0x81B958 KfAxUwAyUwSstxUwSstyUwWUw 99.99847 rel_uw_b100 0.00 99.99847 FORMAT "%8.5"
 /begin AXIS_DESCR STD_AXIS nmot_w nmot_uw_q0p25 4 0.00 16383.75 FORMAT "%8.2" DEPOSIT ABSOLUTE /end AXIS_DESCR
 /begin AXIS_DESCR STD_AXIS mifakh_w rel_uw_b100 4 0.00 99.99847 FORMAT "%8.5" DEPOSIT ABSOLUTE /end AXIS_DESCR
/end CHARACTERISTIC
/begin CHARACTERISTIC KFMDKH "Kennfeld Drehmomentenreserve für Katheizen" MAP 0x81B98C KfAxUwAyUwSstxUwSstyUwWUw 99.99847 rel_uw_b100 0.00 99.99847 FORMAT "%8.5"
 /begin AXIS_DESCR STD_AXIS nmot_w nmot_uw_q0p25 8 0.00 16383.75 FORMAT "%8.2" DEPOSIT ABSOLUTE /end AXIS_DESCR
 /begin AXIS_DESCR STD_AXIS mifakh_w rel_uw_b100 8 0.00 99.99847 FORMAT "%8.5" DEPOSIT ABSOLUTE /end AXIS_DESCR
/end CHARACTERISTIC
/begin CHARACTERISTIC KFMDKH2 "Kennfeld Drehmomentreserve, ohne Kat" MAP 0x81BA30 KfAxUwAyUwSstxUwSstyUwWUw 99.99847 rel_uw_b100 0.00 99.99847 FORMAT "%8.5"
 /begin AXIS_DESCR STD_AXIS nmot_w nmot_uw_q0p25 8 0.00 16383.75 FORMAT "%8.2" DEPOSIT ABSOLUTE /end AXIS_DESCR
 /begin AXIS_DESCR STD_AXIS mifakh_w rel_uw_b100 8 0.00 99.99847 FORMAT "%8.5" DEPOSIT ABSOLUTE /end AXIS_DESCR
/end CHARACTERISTIC
/begin CHARACTERISTIC KFPU "Pulsations - Kennfeld" MAP 0x810638 KfAxUbAyUbSstxUbSstyUbWUb 1.992 fak_ub_b2 0.00 1.992 FORMAT "%5.3"
 /begin AXIS_DESCR STD_AXIS nmotkor nmot_ub_q40 14 0.00 10200. FORMAT "%5.0" DEPOSIT ABSOLUTE /end AXIS_DESCR
 /begin AXIS_DESCR STD_AXIS wdkba relDK_ub_b100 14 0.00 100.0 FORMAT "%5.1" DEPOSIT ABSOLUTE /end AXIS_DESCR
/end CHARACTERISTIC
/begin CHARACTERISTIC KFPU2SU "Pulsationskennfeld bei aktiver Saugrohrumschaltung sumode=2" MAP 0x81071A KfAxUbAyUbSstxUbSstyUbWUb 1.992 fak_ub_b2 0.00 1.992 FORMAT "%5.3"
 /begin AXIS_DESCR STD_AXIS nmotkor nmot_ub_q40 14 0.00 10200. FORMAT "%5.0" DEPOSIT ABSOLUTE /end AXIS_DESCR
 /begin AXIS_DESCR STD_AXIS wdkba relDK_ub_b100 14 0.00 100.0 FORMAT "%5.1" DEPOSIT ABSOLUTE /end AXIS_DESCR
/end CHARACTERISTIC
/begin CHARACTERISTIC KFPU3SU "Pulsationskennfeld bei aktiver Saugrohrumschaltung sumode=3" MAP 0x8107FC KfAxUbAyUbSstxUbSstyUbWUb 1.992 fak_ub_b2 0.00 1.992 FORMAT "%5.3"
 /begin AXIS_DESCR STD_AXIS nmotkor nmot_ub_q40 14 0.00 10200. FORMAT "%5.0" DEPOSIT ABSOLUTE /end AXIS_DESCR
 /begin AXIS_DESCR STD_AXIS wdkba relDK_ub_b100 14 0.00 100.0 FORMAT "%5.1" DEPOSIT ABSOLUTE /end AXIS_DESCR
/end CHARACTERISTIC
/begin CHARACTERISTIC KFPUSU "Pulsationskennfeld bei aktiver Saugrohrumschaltung sumode=1" MAP 0x8108DE KfAxUbAyUbSstxUbSstyUbWUb 1.992 fak_ub_b2 0.00 1.992 FORMAT "%5.3"
 /begin AXIS_DESCR STD_AXIS nmotkor nmot_ub_q40 14 0.00 10200. FORMAT "%5.0" DEPOSIT ABSOLUTE /end AXIS_DESCR
 /begin AXIS_DESCR STD_AXIS wdkba relDK_ub_b100 14 0.00 100.0 FORMAT "%5.1" DEPOSIT ABSOLUTE /end AXIS_DESCR
/end CHARACTERISTIC
/begin CHARACTERISTIC KLDTMRS "Kennlinie Motortemperatur-Gradient im Schub für Referenzmodell" CURVE 0x81B85C KlAUbSstUbWSb 0.1868 temp_sb_b0p093 -0.09375 0.09302 FORMAT "%7.5"
 /begin AXIS_DESCR STD_AXIS tmrw temp_ub_q0p75_o48 5 -48.00 143.3 FORMAT "%5.1" DEPOSIT ABSOLUTE /end AXIS_DESCR
/end CHARACTERISTIC
/begin CHARACTERISTIC LIMTKOA "Zeitschwelle um den Kompressor unbegrenzt auszuschalten" VALUE 0x812B79 KwUb 51.00 t200msxs_ub_b51 0.00 51.00 FORMAT "%5.2" /end CHARACTERISTIC
/begin CHARACTERISTIC MDKOAN "Drehmomentschwelle um den Klimakompressor abzuschalten" CURVE 0x812B7A GklWUb 99.61 rel_ub_b99p6 0.00 99.61 FORMAT "%5.2"
 /begin AXIS_DESCR COM_AXIS nmot nmot_ub_q40 8 0.00 10200. AXIS_PTS_REF SNM08KOUB /end AXIS_DESCR
/end CHARACTERISTIC
/begin CHARACTERISTIC MDKOEN "Drehmomentschwelle um den Klimakompressor einzuschalten" CURVE 0x812B82 GklWUb 99.61 rel_ub_b99p6 0.00 99.61 FORMAT "%5.2"
 /begin AXIS_DESCR COM_AXIS nmot nmot_ub_q40 8 0.00 10200. AXIS_PTS_REF SNM08KOUB /end AXIS_DESCR
/end CHARACTERISTIC
/begin CHARACTERISTIC MLHFM "Linearisierung der Heißfilmspannung" CURVE 0x8132A6 FklWUw 6553.500 m_uw_b6553p5 0.00 6553.500 FORMAT "%8.3"
 /begin AXIS_DESCR FIX_AXIS uhfm_w spg_uw_q0p00488 512 0.00 4.995117 FORMAT "%8.6" FIX_AXIS_PAR 0 1 512 /end AXIS_DESCR
/end CHARACTERISTIC
/begin CHARACTERISTIC MLOFS "Kennlinienoffset HFM 5" VALUE 0x81425A KwUw 6553.500 m_uw_b6553p5 0.00 6553.500 FORMAT "%8.3" /end CHARACTERISTIC
/begin CHARACTERISTIC NTUMGTA "Schwelle Drehzahl für Bestimmung Umgebungstemperatur aus TANS" VALUE 0x81A39C KwUb 10200. nmot_ub_q40 0.00 10200. FORMAT "%5.0" /end CHARACTERISTIC
/begin CHARACTERISTIC PUKANS "Pulsationskorrektur abhängig von Ansauglufttemperatur" CURVE 0x8109C0 KlAUbSstUbWUb 1.992 fak_ub_b2 0.00 1.992 FORMAT "%5.3"
 /begin AXIS_DESCR STD_AXIS tans temp_ub_q0p75_o48 8 -48.00 143.3 FORMAT "%5.1" DEPOSIT ABSOLUTE /end AXIS_DESCR
/end CHARACTERISTIC
/begin CHARACTERISTIC RBEL "Belastungswiderstand für Pumpstrom-Erzeugung" VALUE 0x813D62 KwUw 131070.0 r_uw_q2 0.00 131070.0 FORMAT "%8.1" /end CHARACTERISTIC
/begin CHARACTERISTIC RINHMX "Innenwiderstand Ri der Nernstsonde hinter KAT auf Maximalwert begrenzen" VALUE 0x813D64 KwUw 131070.0 r_uw_q2 0.00 131070.0 FORMAT "%8.1" /end CHARACTERISTIC
/begin CHARACTERISTIC RINVMX "Innenwiderstand Ri der Nernstsonde auf Maximalwert begrenzen" VALUE 0x815780 KwUw 131070.0 r_uw_q2 0.00 131070.0 FORMAT "%8.1" /end CHARACTERISTIC
/begin CHARACTERISTIC RKSP "Widerstand zwischen kongurierende Spannung und Sondensignal" VALUE 0x813D66 KwUw 131070.0 r_uw_q2 0.00 131070.0 FORMAT "%8.1" /end CHARACTERISTIC
/begin CHARACTERISTIC SENZZYL0 "Klopfsensor für SW-Zylinderzähler 0" VALUE 0x81912C KwUb 3.000 dezsub1 1.000 4.000 FORMAT "%5.3" /end CHARACTERISTIC
/begin CHARACTERISTIC SENZZYL1 "Klopfsensor für SW-Zylinderzähler 1" VALUE 0x81912D KwUb 3.000 dezsub1 1.000 4.000 FORMAT "%5.3" /end CHARACTERISTIC
/begin CHARACTERISTIC SENZZYL2 "Klopfsensor für SW-Zylinderzähler 2" VALUE 0x81912E KwUb 3.000 dezsub1 1.000 4.000 FORMAT "%5.3" /end CHARACTERISTIC
/begin CHARACTERISTIC SENZZYL3 "Klopfsensor für SW-Zylinderzähler 3" VALUE 0x81912F KwUb 3.000 dezsub1 1.000 4.000 FORMAT "%5.3" /end CHARACTERISTIC
/begin CHARACTERISTIC SENZZYL4 "Klopfsensor für SW-Zylinderzähler 4" VALUE 0x819130 KwUb 3.000 dezsub1 1.000 4.000 FORMAT "%5.3" /end CHARACTERISTIC
/begin CHARACTERISTIC SENZZYL5 "Klopfsensor für SW-Zylinderzähler 5" VALUE 0x819131 KwUb 3.000 dezsub1 1.000 4.000 FORMAT "%5.3" /end CHARACTERISTIC
/begin CHARACTERISTIC SENZZYL6 "Klopfsensor für SW-Zylinderzähler 6" VALUE 0x819132 KwUb 3.000 dezsub1 1.000 4.000 FORMAT "%5.3" /end CHARACTERISTIC
/begin CHARACTERISTIC SENZZYL7 "Klopfsensor für SW-Zylinderzähler 7" VALUE 0x819133 KwUb 3.000 dezsub1 1.000 4.000 FORMAT "%5.3" /end CHARACTERISTIC
/begin AXIS_PTS SNM08KOUB "Stützstellenverteilung für Klimakompressorsteuerung  8  nmot" 0x812B8A nmot SstAUbSstUb 10200. nmot_ub_q40 8 0.00 10200. FORMAT "%5.0" DEPOSIT ABSOLUTE /end AXIS_PTS
/begin AXIS_PTS SNM16KRUB "Stützstellenverteilung Drehzahl, 16 Sst." 0x819872 nmot SstAUbSstUb 10200. nmot_ub_q40 16 0.00 10200. FORMAT "%5.0" DEPOSIT ABSOLUTE /end AXIS_PTS
/begin AXIS_PTS SRL04KRUB "Stützstellenverteilung relative Füllung, 4 Sst." 0x819883 rl SstAUbSstUb 191.3 rel_ub_q0p75 4 0.00 191.3 FORMAT "%5.1" DEPOSIT ABSOLUTE /end AXIS_PTS
/begin CHARACTERISTIC STNSG1 "Stützstellenverteilung nmot-1 SG-Temperaturhistogramm" VALUE 0x81A36B KwUb 10200. nmot_ub_q40 0.00 10200. FORMAT "%5.0" /end CHARACTERISTIC
/begin CHARACTERISTIC STNSG2 "Stützstellenverteilung nmot-2 SG-Temperaturhistogramm" VALUE 0x81A36C KwUb 10200. nmot_ub_q40 0.00 10200. FORMAT "%5.0" /end CHARACTERISTIC
/begin CHARACTERISTIC STNSG3 "Stützstellenverteilung nmot-3 SG-Temperaturhistogramm" VALUE 0x81A36D KwUb 10200. nmot_ub_q40 0.00 10200. FORMAT "%5.0" /end CHARACTERISTIC
/begin CHARACTERISTIC STNSG4 "Stützstellenverteilung nmot-4 SG-Temperaturhistogramm" VALUE 0x81A36E KwUb 10200. nmot_ub_q40 0.00 10200. FORMAT "%5.0" /end CHARACTERISTIC
/begin CHARACTERISTIC STNSG5 "Stützstellenverteilung nmot-5 SG-Temperaturhistogramm" VALUE 0x81A36F KwUb 10200. nmot_ub_q40 0.00 10200. FORMAT "%5.0" /end CHARACTERISTIC
/begin CHARACTERISTIC STTSG1 "Stützstellenverteilung 1 tsg  SG-Temperaturhistogramm" VALUE 0x81A370 KwUb 191.3 temp_ub_q0p75_o48 -48.00 143.3 FORMAT "%5.1" /end CHARACTERISTIC
/begin CHARACTERISTIC STTSG2 "Stützstellenverteilung 2 tsg  SG-Temperaturhistogramm" VALUE 0x81A371 KwUb 191.3 temp_ub_q0p75_o48 -48.00 143.3 FORMAT "%5.1" /end CHARACTERISTIC
/begin CHARACTERISTIC STTSG3 "Stützstellenverteilung 3 tsg  SG-Temperaturhistogramm" VALUE 0x81A372 KwUb 191.3 temp_ub_q0p75_o48 -48.00 143.3 FORMAT "%5.1" /end CHARACTERISTIC
/begin CHARACTERISTIC STTSG4 "Stützstellenverteilung 4 tsg  SG-Temperaturhistogramm" VALUE 0x81A373 KwUb 191.3 temp_ub_q0p75_o48 -48.00 143.3 FORMAT "%5.1" /end CHARACTERISTIC
/begin CHARACTERISTIC STTSG5 "Stützstellenverteilung 5 tsg  SG-Temperaturhistogramm" VALUE 0x81A374 KwUb 191.3 temp_ub_q0p75_o48 -48.00 143.3 FORMAT "%5.1" /end CHARACTERISTIC
/begin CHARACTERISTIC TADE "Ersatzgröße Lufttemperatur im Fehlerfall" VALUE 0x81A2C6 KwUb 191.3 temp_ub_q0p75_o48 -48.00 143.3 FORMAT "%5.1" /end CHARACTERISTIC
/begin CHARACTERISTIC TADMM "1. Stufenbreite (Zeit) für Motortemperaturmodell" VALUE 0x81B868 KwUw 6553.500 t100msxs_uw_b6553p5 0.00 6553.500 FORMAT "%8.3" /end CHARACTERISTIC
/begin CHARACTERISTIC TADMN "Ansauglufttemperatur min." VALUE 0x81A2C7 KwUb 191.3 temp_ub_q0p75_o48 -48.00 143.3 FORMAT "%5.1" /end CHARACTERISTIC
/begin CHARACTERISTIC TADMX "Ansauglufttemperatur max." VALUE 0x81A2C8 KwUb 191.3 temp_ub_q0p75_o48 -48.00 143.3 FORMAT "%5.1" /end CHARACTERISTIC
/begin CHARACTERISTIC TANSELI "Temperatur Ansaugluft-Erfassung u. Linearisierung, Inverskennlinie" CURVE 0x81A2C9 KlAUbSstUbWUb 191.3 temp_ub_q0p75_o48 -48.00 143.3 FORMAT "%5.1"
 /begin AXIS_DESCR STD_AXIS wtans spg_ub_b5 20 0.00 4.980 FORMAT "%5.3" DEPOSIT ABSOLUTE /end AXIS_DESCR
/end CHARACTERISTIC
/begin CHARACTERISTIC TDMFL "Verzögerungszeit MFL-Fehler" VALUE 0x810168 KwUb 2.450 t10msxs_ub_b2p55 0.1000 2.550 FORMAT "%5.3" /end CHARACTERISTIC
/begin CHARACTERISTIC TDMFLH "Verzögerungszeit MFL-Fehler-Heilung" VALUE 0x810169 KwUb 2.450 t10msxs_ub_b2p55 0.1000 2.550 FORMAT "%5.3" /end CHARACTERISTIC
/begin CHARACTERISTIC TDNSTA "Auspufferwärmzeit ab Start, für TANS - Diagnose" VALUE 0x81A2F2 KwUb 255.0 t1sxs_ub_b255 0.00 255.0 FORMAT "%5.1" /end CHARACTERISTIC
/begin CHARACTERISTIC TDNSUB "Batterie - Erholzeit ab Start, für UBATT - Diagnose" VALUE 0x811B29 KwUb 255.0 t100msxs_ub_b255 0.00 255.0 FORMAT "%5.1" /end CHARACTERISTIC
/begin CHARACTERISTIC TDTA "Entprellzeit Fehlererkennung TANS" VALUE 0x81A2F3 KwUb 25.50 t100msxs_ub_b25p5 0.00 25.50 FORMAT "%5.2" /end CHARACTERISTIC
/begin CHARACTERISTIC TDTAL "TANS Fehlererkennung / Zeitsperre ab B_LL = 1" VALUE 0x81A2F4 KwUb 255.0 t1sxs_ub_b255 0.00 255.0 FORMAT "%5.1" /end CHARACTERISTIC
/begin CHARACTERISTIC TDTKAUS "Entprellzeit Fehlererkennung Temperatur Kühlerausgang" VALUE 0x81A342 KwUb 25.50 t100msxs_ub_b25p5 0.00 25.50 FORMAT "%5.2" /end CHARACTERISTIC
/begin CHARACTERISTIC TDTM "Entprellzeit Fehlererkennung TMOT" VALUE 0x81B86A KwUw 6553.500 t100msxs_uw_b6553p5 0.00 6553.500 FORMAT "%8.3" /end CHARACTERISTIC
/begin CHARACTERISTIC TDTMMA "Verzögerungszeit Anfangswert Motortemperaturmodell" VALUE 0x81B86C KwUw 6553.500 t100msxs_uw_b6553p5 0.00 6553.500 FORMAT "%8.3" /end CHARACTERISTIC
/begin CHARACTERISTIC TDTUM "Entprellzeit Fehlererkennung Umgebungslufttemperatur TUM" VALUE 0x81A39D KwUb 25.50 t100msxs_ub_b25p5 0.00 25.50 FORMAT "%5.2" /end CHARACTERISTIC
/begin CHARACTERISTIC TDTUMNF "Entprellzeit für i.O.-Erkennung Umgebungslufttemperatur TUM" VALUE 0x81A39E KwUb 25.50 t100msxs_ub_b25p5 0.00 25.50 FORMAT "%5.2" /end CHARACTERISTIC
/begin CHARACTERISTIC TDUB "Wartezeit für UBATT-Diagnose" VALUE 0x811B2A KwUb 25.50 t100msxs_ub_b25p5 0.00 25.50 FORMAT "%5.2" /end CHARACTERISTIC
/begin CHARACTERISTIC TFGRBTOFF "Zeit Null-Taste betätigt (FGR. Mainswitchnachbildung ausschalten)" VALUE 0x81016A KwUb 5.080 t20msxs_ub_b5p1 0.02000 5.100 FORMAT "%5.3" /end CHARACTERISTIC
/begin CHARACTERISTIC TFGRBTON "Zeit Null-Taste betätigt (FGR. Mainswitchnachbildung einschalten)" VALUE 0x81016B KwUb 5.080 t20msxs_ub_b5p1 0.02000 5.100 FORMAT "%5.3" /end CHARACTERISTIC
/begin CHARACTERISTIC TFGRBTUBT "Zeit Null-Taste min. nicht betätigt" VALUE 0x81016C KwUb 5.080 t20msxs_ub_b5p1 0.02000 5.100 FORMAT "%5.3" /end CHARACTERISTIC
/begin CHARACTERISTIC TFGRMNLE "Min. Zeit für FGR-Lampe an (im Fehlerfall)" VALUE 0x81016D KwUb 5.080 t20msxs_ub_b5p1 0.02000 5.100 FORMAT "%5.3" /end CHARACTERISTIC
/begin CHARACTERISTIC TFGRVRAB "FGR: Zeit für Geschwindigkeitsabschaltung über vroh =0" VALUE 0x810012 KwUb 2.550 t10msxs_ub_b2p55 0.00 2.550 FORMAT "%5.3" /end CHARACTERISTIC
/begin CHARACTERISTIC TFGRVZG "Zeit nach Kl.15 ein bis Mainswitch aktiv werden kann" VALUE 0x812C6A KwUw 655.3400 t10msxs_uw_b655p35 0.01000000 655.3500 FORMAT "%8.4" /end CHARACTERISTIC
/begin CHARACTERISTIC TFPWG2 "Filterzeit zur Filterung von Poti 2 bei der Bewegungserkennung" VALUE 0x8142D2 KwUw 655.350000 zk10msxs_uw_b655 0.0100001526 655.360000 FORMAT "%10.6" /end CHARACTERISTIC
/begin CHARACTERISTIC TGGLS "Zeitdauer für ADC nach Interrupt im Funktionsrechner (Asic)" VALUE 0x810A34 KwUb 2.000 t1msxms_q1 3.000 5.000 FORMAT "%5.3" /end CHARACTERISTIC
/begin CHARACTERISTIC THEH "Zeit für maximale Sondenheizung nach Start hinter Kat" VALUE 0x81AB5A KwUw 6553.500 t100msxs_uw_b6553p6 0.00 6553.500 FORMAT "%8.3" /end CHARACTERISTIC
/begin CHARACTERISTIC THEV "Zeit für maximale Sondenheizung nach Start vor Kat" VALUE 0x81AB5C KwUw 6553.500 t100msxs_uw_b6553p6 0.00 6553.500 FORMAT "%8.3" /end CHARACTERISTIC
/begin CHARACTERISTIC THHA "Auszeit für Reduzierung der Heizleistung Sonde hinter Kat bei 13V" VALUE 0x819502 KwUb 2.550 t10msxs_q0p01_o0p05 -0.05000 2.500 FORMAT "%5.3" /end CHARACTERISTIC
/begin CHARACTERISTIC THHA2 "Auszeit für Reduzierung der Heizleistung Sonde2 hinter Kat bei 13V" VALUE 0x819503 KwUb 2.550 t10msxs_q0p01_o0p05 -0.05000 2.500 FORMAT "%5.3" /end CHARACTERISTIC
/begin CHARACTERISTIC THHAWU "Ausschaltzeit während Leistungsreduzierung Sondenheizung hinter Kat" VALUE 0x819504 KwUb 2.550 t10msxs_ub_b2p55 0.00 2.550 FORMAT "%5.3" /end CHARACTERISTIC
/begin CHARACTERISTIC THOPP1 "Fehlerzeit bei Hochohmigkeitsprüfung Poti 1" VALUE 0x810136 KwUb 2.550 t10msxs_ub_b2p55 0.00 2.550 FORMAT "%5.3" /end CHARACTERISTIC
/begin CHARACTERISTIC THOPP2 "Fehlerzeit bei Hochohmigkeitsprüfung Poti 2" VALUE 0x810137 KwUb 2.550 t10msxs_ub_b2p55 0.00 2.550 FORMAT "%5.3" /end CHARACTERISTIC
/begin CHARACTERISTIC THSHKTK "Kennlinie für die Ausschaltdauer der Sondenheizung abh. v.d. Abgastemp. h.Kat" CURVE 0x819505 KlAUbSstUbWUb 2.550 t10msxs_q0p01_o0p05 -0.05000 2.500 FORMAT "%5.3"
 /begin AXIS_DESCR STD_AXIS tkatm temp_ub_q5_o50 8 -50.00 1225. FORMAT "%5.0" DEPOSIT ABSOLUTE /end AXIS_DESCR
/end CHARACTERISTIC
/begin CHARACTERISTIC THSHKTK2 "Kennlinie für die Ausschaltdauer der Sondenheizung2 abh. v.d. Abgastemp. h.Kat" CURVE 0x819516 KlAUbSstUbWUb 2.550 t10msxs_q0p01_o0p05 -0.05000 2.500 FORMAT "%5.3"
 /begin AXIS_DESCR STD_AXIS tkatm2 temp_ub_q5_o50 8 -50.00 1225. FORMAT "%5.0" DEPOSIT ABSOLUTE /end AXIS_DESCR
/end CHARACTERISTIC
/begin CHARACTERISTIC THSRIH "Zeitverzög. Bereitschaft der Ri-Messung nach eingesch. Sondenheizung hinter KAT" VALUE 0x813D68 KwUw 655.3500 t10msxs_uw_b655p35 0.00 655.3500 FORMAT "%8.4" /end CHARACTERISTIC
/begin CHARACTERISTIC THSRIV "Zeitverzögerte Bereitschaft der Ri-Messung nach eingesch. Sondenheizung vor KAT" VALUE 0x815782 KwUw 655.3500 t10msxs_uw_b655p35 0.00 655.3500 FORMAT "%8.4" /end CHARACTERISTIC
/begin CHARACTERISTIC THSVKTA "Kennlinie für die Ausschaltdauer der Sondenheizung abh. v.d. Abgastemp. vor Kat" CURVE 0x819527 KlAUbSstUbWUb 2.550 t10msxs_q0p01_o0p05 -0.05000 2.500 FORMAT "%5.3"
 /begin AXIS_DESCR STD_AXIS tabgm temp_ub_q5_o50 8 -50.00 1225. FORMAT "%5.0" DEPOSIT ABSOLUTE /end AXIS_DESCR
/end CHARACTERISTIC
/begin CHARACTERISTIC THSVKTA2 "Kennlinie für die Ausschaltdauer der Sondenheizung2 abh. v.d. Abgastemp. vor Kat" CURVE 0x819538 KlAUbSstUbWUb 2.550 t10msxs_q0p01_o0p05 -0.05000 2.500 FORMAT "%5.3"
 /begin AXIS_DESCR STD_AXIS tabgm2 temp_ub_q5_o50 8 -50.00 1225. FORMAT "%5.0" DEPOSIT ABSOLUTE /end AXIS_DESCR
/end CHARACTERISTIC
/begin CHARACTERISTIC THVA "Auszeit für Reduzierung der Heizleistung Sonde vor Kat bei 13V" VALUE 0x819549 KwUb 2.550 t10msxs_q0p01_o0p05 -0.05000 2.500 FORMAT "%5.3" /end CHARACTERISTIC
/begin CHARACTERISTIC THVA2 "Auszeit für Reduzierung der Heizleistung Sonde2 vor Kat bei 13V" VALUE 0x81954A KwUb 2.550 t10msxs_q0p01_o0p05 -0.05000 2.500 FORMAT "%5.3" /end CHARACTERISTIC
/begin CHARACTERISTIC THVAWU "Ausschaltzeit während Leistungsreduzierung Sondenheizung vor Kat" VALUE 0x81954B KwUb 2.550 t10msxs_ub_b2p55 0.00 2.550 FORMAT "%5.3" /end CHARACTERISTIC
/begin CHARACTERISTIC TKAELI "Temperatur Kühlerausgang Erfassung und Linearisierung" CURVE 0x81A343 KlAUbSstUbWUb 191.3 temp_ub_q0p75_o48 -48.00 143.3 FORMAT "%5.1"
 /begin AXIS_DESCR STD_AXIS wtka spg_ub_b5 18 0.00 4.980 FORMAT "%5.3" DEPOSIT ABSOLUTE /end AXIS_DESCR
/end CHARACTERISTIC
/begin CHARACTERISTIC TKAUSDE "Ersatzgröße Temperatur Kühlerausgang im Fehlerfall" VALUE 0x81A368 KwUb 191.3 temp_ub_q0p75_o48 -48.00 143.3 FORMAT "%5.1" /end CHARACTERISTIC
/begin CHARACTERISTIC TKAUSDMN "Min. Temperatur Kühlerausgang" VALUE 0x81A369 KwUb 191.3 temp_ub_q0p75_o48 -48.00 143.3 FORMAT "%5.1" /end CHARACTERISTIC
/begin CHARACTERISTIC TKAUSDMX "Max. Temperatur Kühlerausgang" VALUE 0x81A36A KwUb 191.3 temp_ub_q0p75_o48 -48.00 143.3 FORMAT "%5.1" /end CHARACTERISTIC
/begin CHARACTERISTIC TKOAMNN "Minimale Abschaltzeit des Klimakompressors" CURVE 0x812B93 GklWUb 51.00 t200msxs_ub_b51 0.00 51.00 FORMAT "%5.2"
 /begin AXIS_DESCR COM_AXIS nmot nmot_ub_q40 8 0.00 10200. AXIS_PTS_REF SNM08KOUB /end AXIS_DESCR
/end CHARACTERISTIC
/begin CHARACTERISTIC TKOAMXN "Maximale Abschaltzeit des Klimakompressors" CURVE 0x812B9B GklWUb 51.00 t200msxs_ub_b51 0.00 51.00 FORMAT "%5.2"
 /begin AXIS_DESCR COM_AXIS nmot nmot_ub_q40 8 0.00 10200. AXIS_PTS_REF SNM08KOUB /end AXIS_DESCR
/end CHARACTERISTIC
/begin CHARACTERISTIC TKOEMNN "Minimale Einschaltzeit des Klimakompressors" CURVE 0x812BA3 GklWUb 51.00 t200msxs_ub_b51 0.00 51.00 FORMAT "%5.2"
 /begin AXIS_DESCR COM_AXIS nmot nmot_ub_q40 8 0.00 10200. AXIS_PTS_REF SNM08KOUB /end AXIS_DESCR
/end CHARACTERISTIC
/begin CHARACTERISTIC TMDMMA "Anfangstemperatur für Motortemperaturmodell" VALUE 0x81A307 KwUb 191.3 temp_ub_q0p75_o48 -48.00 143.3 FORMAT "%5.1" /end CHARACTERISTIC
/begin CHARACTERISTIC TMDMMAT "Ersatztemperatur abh. Abstellzeit während TDTMMA" CURVE 0x81B86E KlAUwSstUwWUw 191.2500 temp_uw_q0p75_o48 -48.00000 143.2500 FORMAT "%8.4"
 /begin AXIS_DESCR STD_AXIS tabst_w t1sxs_uw_q1 3 0.00 65535.00 FORMAT "%8.2" DEPOSIT ABSOLUTE /end AXIS_DESCR
/end CHARACTERISTIC
/begin CHARACTERISTIC TMDMMAU "Unterster Anfangswert aus tans für Motortemperaturmodell" VALUE 0x81A308 KwUb 191.3 temp_ub_q0p75_o48 -48.00 143.3 FORMAT "%5.1" /end CHARACTERISTIC
/begin CHARACTERISTIC TMDMMEE "Endtemperatur für Ersatzwert Motortemperatur" VALUE 0x81A309 KwUb 191.3 temp_ub_q0p75_o48 -48.00 143.3 FORMAT "%5.1" /end CHARACTERISTIC
/begin CHARACTERISTIC TMDMMER "Endtemperatur für Referenzwert Motortemperatur" VALUE 0x81A30A KwUb 191.3 temp_ub_q0p75_o48 -48.00 143.3 FORMAT "%5.1" /end CHARACTERISTIC
/begin CHARACTERISTIC TMDMN "Motortemperatur min." VALUE 0x81A30B KwUb 191.3 temp_ub_q0p75_o48 -48.00 143.3 FORMAT "%5.1" /end CHARACTERISTIC
/begin CHARACTERISTIC TMDMX "Motortemperatur max." VALUE 0x81A30C KwUb 191.3 temp_ub_q0p75_o48 -48.00 143.3 FORMAT "%5.1" /end CHARACTERISTIC
/begin CHARACTERISTIC TMFLBE "Fehlerentprellung keine neue MFL-Botschaft empfangen" VALUE 0x8100A0 KwUb 2.540 t10msxs_ub_b2p55 0.01000 2.550 FORMAT "%5.3" /end CHARACTERISTIC
/begin CHARACTERISTIC TMFLFQE "Fehlerentprellung: Telegrammfrequenz ausserhalb des Toleranzbandes" VALUE 0x8100A1 KwUb 2.540 t10msxs_ub_b2p55 0.01000 2.550 FORMAT "%5.3" /end CHARACTERISTIC
/begin CHARACTERISTIC TMFLTC "Fehlerentprellung: Toggelbit-Check" VALUE 0x8100A2 KwUb 2.540 t10msxs_ub_b2p55 0.01000 2.550 FORMAT "%5.3" /end CHARACTERISTIC
/begin CHARACTERISTIC TMKOAO "Obere Motortemperaturschwelle für Kompressorabschaltung" VALUE 0x812BAB KwUb 191.3 temp_ub_q0p75_o48 -48.00 143.3 FORMAT "%5.1" /end CHARACTERISTIC
/begin CHARACTERISTIC TMKOAU "Untere Motortemperaturschwelle für Kompressorabschaltung" VALUE 0x812BAC KwUb 191.3 temp_ub_q0p75_o48 -48.00 143.3 FORMAT "%5.1" /end CHARACTERISTIC
/begin CHARACTERISTIC TMLRTMS "Motortemperaturschwelle für LR ein abh. von Starttemperatur" CURVE 0x81A30D KlAUbSstUbWUb 191.3 temp_ub_q0p75_o48 -48.00 143.3 FORMAT "%5.1"
 /begin AXIS_DESCR STD_AXIS tmst temp_ub_q0p75_o48 4 -48.00 143.3 FORMAT "%5.1" DEPOSIT ABSOLUTE /end AXIS_DESCR
/end CHARACTERISTIC
/begin CHARACTERISTIC TMMXRT "max. Motortemperatur f. Retrigg. Modelle (Blockheater-Erkennung)" VALUE 0x81A316 KwUb 191.3 temp_ub_q0p75_o48 -48.00 143.3 FORMAT "%5.1" /end CHARACTERISTIC
/begin CHARACTERISTIC TMOHSMN "Motortemperatur für Reduzierung Sondenheizung" VALUE 0x81954C KwUb 191.3 temp_ub_q0p75_o48 -48.00 143.3 FORMAT "%5.1" /end CHARACTERISTIC
/begin CHARACTERISTIC TMOTELI "Temperatur Motor Erfassung u. Linearisierung, Inverskennlinie" CURVE 0x81A317 KlAUbSstUbWUb 191.3 temp_ub_q0p75_o48 -48.00 143.3 FORMAT "%5.1"
 /begin AXIS_DESCR STD_AXIS wtmot spg_ub_b5 20 0.00 4.980 FORMAT "%5.3" DEPOSIT ABSOLUTE /end AXIS_DESCR
/end CHARACTERISTIC
/begin CHARACTERISTIC TNSRT "Max.-Zeit ab Start für Retriggerung Berechnung Motortemperaturmodell" VALUE 0x81A340 KwUb 255.0 t1sxs_ub_b255 0.00 255.0 FORMAT "%5.1" /end CHARACTERISTIC
/begin CHARACTERISTIC TNSTKO "Unterdrückungszeit des Kompressors nach dem Start" VALUE 0x812BAD KwUb 51.00 t200msxs_ub_b51 0.00 51.00 FORMAT "%5.2" /end CHARACTERISTIC
/begin CHARACTERISTIC TRIAKTH "Zeitdauer für Ri-Berechnung aktuell hinter KAT" VALUE 0x813D6A KwUw 6553.500 t100msxs_uw_b6553p5 0.00 6553.500 FORMAT "%8.3" /end CHARACTERISTIC
/begin CHARACTERISTIC TRIAKTV "Zeitdauer für Ri-Berechnung aktuell vor KAT" VALUE 0x815784 KwUw 6553.500 t100msxs_uw_b6553p5 0.00 6553.500 FORMAT "%8.3" /end CHARACTERISTIC
/begin CHARACTERISTIC TRIIMPH "Zeitdauer für Pumpimpuls für beide Bänke hinter KAT" VALUE 0x813D6C KwUw 655.3500 t10msxs_uw_b655p35 0.00 655.3500 FORMAT "%8.4" /end CHARACTERISTIC
/begin CHARACTERISTIC TRIIMPV "Zeitdauer für Pumpimpuls für beide Bänke vor KAT" VALUE 0x815786 KwUw 655.3500 t10msxs_uw_b655p35 0.00 655.3500 FORMAT "%8.4" /end CHARACTERISTIC
/begin CHARACTERISTIC TSGELI "Temperatur Steuergerät- Erfassung und Linearisierung" CURVE 0x81A375 KlAUbSstUbWUb 191.3 temp_ub_q0p75_o48 -48.00 143.3 FORMAT "%5.1"
 /begin AXIS_DESCR STD_AXIS wtsg spg_ub_b5 18 0.00 4.980 FORMAT "%5.3" DEPOSIT ABSOLUTE /end AXIS_DESCR
/end CHARACTERISTIC
/begin CHARACTERISTIC TSTAEBR "Zeit für Steckerabfall-Erkennung Bremse" VALUE 0x81B3E2 KwUw 6553.500 t100msxs_uw_b6553p5 0.00 6553.500 FORMAT "%8.3" /end CHARACTERISTIC
/begin CHARACTERISTIC TSTSG "Zeitintervall für Erfassung SG-Temperatur-Histogramm" VALUE 0x81A39A KwUb 254.0 t1sxs_ub_b255 1.000 255.0 FORMAT "%5.1" /end CHARACTERISTIC
/begin CHARACTERISTIC TUMDETM "Umgebungslufttemperatur-Ersatzwert für Motortemperatur-Modell" VALUE 0x81A341 KwUb 191.3 temp_ub_q0p75_o48 -48.00 143.3 FORMAT "%5.1" /end CHARACTERISTIC
/begin CHARACTERISTIC TUMGTAI "Initialisierungswert Umgebungstemperatur" VALUE 0x81A39F KwUb 191.3 temp_ub_q0p75_o48 -48.00 143.3 FORMAT "%5.1" /end CHARACTERISTIC
/begin CHARACTERISTIC TUPWBWF "Fehlerzeit bei Bewegungserkennung" VALUE 0x810138 KwUb 2.550 t10msxs_ub_b2p55 0.00 2.550 FORMAT "%5.3" /end CHARACTERISTIC
/begin CHARACTERISTIC TUPWBWV "Zeitverzögerung zum Einspeichern eines neuen Poti 2 Wertes" VALUE 0x810139 KwUb 2.550 t10msxs_ub_b2p55 0.00 2.550 FORMAT "%5.3" /end CHARACTERISTIC
/begin CHARACTERISTIC TUPWG12 "Fehlerzeit bei Vergleich von PWG-Poti 1 und 2" VALUE 0x81013A KwUb 2.550 t10msxs_ub_b2p55 0.00 2.550 FORMAT "%5.3" /end CHARACTERISTIC
/begin CHARACTERISTIC TUPWG1O "Fehlerzeit bei Bereichsverletzung von PWG-Poti 1 nach oben" VALUE 0x81013B KwUb 2.550 t10msxs_ub_b2p55 0.00 2.550 FORMAT "%5.3" /end CHARACTERISTIC
/begin CHARACTERISTIC TUPWG1U "Fehlerzeit bei Bereichsverletzung von PWG-Poti 1 nach unten" VALUE 0x81013C KwUb 2.550 t10msxs_ub_b2p55 0.00 2.550 FORMAT "%5.3" /end CHARACTERISTIC
/begin CHARACTERISTIC TUPWG2O "Fehlerzeit bei Bereichsverletzung von PWG-Poti 2 nach oben" VALUE 0x81013D KwUb 2.550 t10msxs_ub_b2p55 0.00 2.550 FORMAT "%5.3" /end CHARACTERISTIC
/begin CHARACTERISTIC TUPWG2U "Fehlerzeit bei Bereichsverletzung von PWG-Poti 2 nach unten" VALUE 0x81013E KwUb 2.550 t10msxs_ub_b2p55 0.00 2.550 FORMAT "%5.3" /end CHARACTERISTIC
/begin CHARACTERISTIC TUSBELH "Zeit für Festhaltung der Sondenspannung nach Impulsbelastung  hinter KAT" VALUE 0x810A35 KwUb 2.550 t10msxs_ub_b2p55 0.00 2.550 FORMAT "%5.3" /end CHARACTERISTIC
/begin CHARACTERISTIC TUSBELV "Zeit für Festhaltung der Sondenspannung nach Impulsbelastung  vor KAT" VALUE 0x810095 KwUb 2.550 t10msxs_ub_b2p55 0.00 2.550 FORMAT "%5.3" /end CHARACTERISTIC
/begin CHARACTERISTIC TVERBR "Verzögerungszeit für Bremsschalter-Plausibilitätsprüfung" VALUE 0x819C88 KwUb 25.50 t100msxs_ub_b25p5 0.00 25.50 FORMAT "%5.2" /end CHARACTERISTIC
/begin CHARACTERISTIC TVHALT "Verzoegerungszeit nach Fahrzeughalt" VALUE 0x81BC60 KwUw 6553.500 t100msxs_uw_b6553p5 0.00 6553.500 FORMAT "%8.3" /end CHARACTERISTIC
/begin CHARACTERISTIC TVHSH "Einschaltverzögerung der Sondenheizung hinter Kat" VALUE 0x81954D KwUb 25.50 t100msxs_ub_b25p5 0.00 25.50 FORMAT "%5.2" /end CHARACTERISTIC
/begin CHARACTERISTIC TVHSV "Einschaltverzögerung der Sondenheizung vor Kat" VALUE 0x81954E KwUb 25.50 t100msxs_ub_b25p5 0.00 25.50 FORMAT "%5.2" /end CHARACTERISTIC
/begin CHARACTERISTIC TVKL15 "Verzoegerungszeit Klemme 15" VALUE 0x81BC62 KwUw 6553.500 t100msxs_uw_b6553p5 0.00 6553.500 FORMAT "%8.3" /end CHARACTERISTIC
/begin CHARACTERISTIC TVKOE "Verzögerungszeit für Kompressor EIN" VALUE 0x812BAE KwUb 51.00 t200msxs_ub_b51 0.00 51.00 FORMAT "%5.2" /end CHARACTERISTIC
/begin CHARACTERISTIC TVKUP "Verzögerungszeit für B_kupplv" VALUE 0x810085 KwUb 5.100 t20msxs_ub_b5p1 0.00 5.100 FORMAT "%5.3" /end CHARACTERISTIC
/begin CHARACTERISTIC TWLRTMS "Wartezeit für Diagnose TMOT-Einschaltbedingung lambda-Regelung" CURVE 0x81B87C KlAUbSstUbWUw 6553.500 t100msxs_uw_b6553p5 0.00 6553.500 FORMAT "%8.3"
 /begin AXIS_DESCR STD_AXIS tmst temp_ub_q0p75_o48 4 -48.00 143.3 FORMAT "%5.1" DEPOSIT ABSOLUTE /end AXIS_DESCR
/end CHARACTERISTIC
/begin CHARACTERISTIC TWNWS "Zeit für Nockenwellensollwinkel-Spätumschaltung" VALUE 0x814258 KwUw 655.3500 TQ10 0.00 655.3500 FORMAT "%8.4" /end CHARACTERISTIC
/begin CHARACTERISTIC UBDE "Ubatt - Ersatzwert bei defektem AD - Kanal" VALUE 0x814294 KwUw 1542.366 spg_ubatt_w 0.00 1542.366 FORMAT "%8.3" /end CHARACTERISTIC
/begin CHARACTERISTIC UBDLS "Batteriespannungsschwelle zur Freigabe der Sonden-Diagnose" VALUE 0x810096 KwUb 24.02 spg_ubatt 0.00 24.02 FORMAT "%5.2" /end CHARACTERISTIC
/begin CHARACTERISTIC UBDMN1 "Batteriespannung min. (Netz)" VALUE 0x811B2B KwUb 24.02 spg_ubatt 0.00 24.02 FORMAT "%5.2" /end CHARACTERISTIC
/begin CHARACTERISTIC UBDMN2 "Batteriespannung min. (ADC)" VALUE 0x811B2C KwUb 24.02 spg_ubatt 0.00 24.02 FORMAT "%5.2" /end CHARACTERISTIC
/begin CHARACTERISTIC UBDMX "Batteriespannung max." VALUE 0x811B2D KwUb 24.02 spg_ubatt 0.00 24.02 FORMAT "%5.2" /end CHARACTERISTIC
/begin CHARACTERISTIC UBHS "Batteriespannungsschwelle für Abschalten der Sondenheizung" VALUE 0x81018A KwUb 24.02 spg_ubatt 0.00 24.02 FORMAT "%5.2" /end CHARACTERISTIC
/begin CHARACTERISTIC UBMFLMN "min. UB-Schwelle für Erkennung defektes MFL" VALUE 0x81016E KwUb 24.02 spg_ubatt 0.00 24.02 FORMAT "%5.2" /end CHARACTERISTIC
/begin CHARACTERISTIC UBNACHL "Ub-Ersatzwert im Nachlauf" VALUE 0x814296 KwUw 1542.366 spg_ubatt_w 0.00 1542.366 FORMAT "%8.3" /end CHARACTERISTIC
/begin CHARACTERISTIC UHSN "Nennspannung für die Sondenheizung" VALUE 0x81954F KwUb 24.02 spg_ubatt 0.00 24.02 FORMAT "%5.2" /end CHARACTERISTIC
/begin CHARACTERISTIC UPW1LLMX "Maximale Spannung von Poti 1 im Leergaspunkt" VALUE 0x81013F KwUb 4.980 spg_ub_b5 0.00 4.980 FORMAT "%5.3" /end CHARACTERISTIC
/begin CHARACTERISTIC UPWG12U "Untere Begrenzung PWG-Poti-Spannung vor Vergleich Poti 1 und 2" VALUE 0x810140 KwUb 4.980 spg_ub_b5 0.00 4.980 FORMAT "%5.3" /end CHARACTERISTIC
/begin CHARACTERISTIC UPWG1O "Obere Schranke für PWG-Poti-1-Spannung" VALUE 0x810141 KwUb 4.980 spg_ub_b5 0.00 4.980 FORMAT "%5.3" /end CHARACTERISTIC
/begin CHARACTERISTIC UPWG1U "Untere Schranke für PWG-Poti-1-Spannung" VALUE 0x810142 KwUb 4.980 spg_ub_b5 0.00 4.980 FORMAT "%5.3" /end CHARACTERISTIC
/begin CHARACTERISTIC UPWG2O "Obere Schranke für PWG-Poti-2-Spannung" VALUE 0x810143 KwUb 4.980 spg_ub_b5 0.00 4.980 FORMAT "%5.3" /end CHARACTERISTIC
/begin CHARACTERISTIC UPWG2U "Untere Schranke für PWG-Poti-2-Spannung" VALUE 0x810144 KwUb 4.980 spg_ub_b5 0.00 4.980 FORMAT "%5.3" /end CHARACTERISTIC
/begin CHARACTERISTIC UPWGKDO "Oberer Hysterese-Schaltpunkt zur Kick-Down-Erkennung aus Potispannung" VALUE 0x810145 KwUb 4.980 spg_ub_b5 0.00 4.980 FORMAT "%5.3" /end CHARACTERISTIC
/begin CHARACTERISTIC UPWGKDU "Unterer Hysterese-Schaltpunkt zur Kick-Down-Erkennung aus Potispannung" VALUE 0x810146 KwUb 4.980 spg_ub_b5 0.00 4.980 FORMAT "%5.3" /end CHARACTERISTIC
/begin CHARACTERISTIC UPWGO "Oberer PWG-Spannungswert für Umnormierung auf Pedalwert" VALUE 0x810147 KwUb 4.980 spg_ub_b5 0.00 4.980 FORMAT "%5.3" /end CHARACTERISTIC
/begin CHARACTERISTIC UPWGTG "PWG-Spannungsschwelle für Teilgasbereich" VALUE 0x810148 KwUb 4.980 spg_ub_b5 0.00 4.980 FORMAT "%5.3" /end CHARACTERISTIC
/begin CHARACTERISTIC UPWGTL "Teillastschwelle der PWG-Spannung in Hochohmigkeitsprüfung" VALUE 0x810149 KwUb 4.980 spg_ub_b5 0.00 4.980 FORMAT "%5.3" /end CHARACTERISTIC
/begin CHARACTERISTIC UPWGU "Unterer PWG-Spannungswert für Umnormierung auf Pedalwert" VALUE 0x81014A KwUb 4.980 spg_ub_b5 0.00 4.980 FORMAT "%5.3" /end CHARACTERISTIC
/begin CHARACTERISTIC UPWGUBF "Unterer Spannungswert zur Umnormierung bei erkanntem Bewegungsfehler" VALUE 0x81014B KwUb 4.980 spg_ub_b5 0.00 4.980 FORMAT "%5.3" /end CHARACTERISTIC
/begin CHARACTERISTIC UPWGVG "PWG-Spannungsschwelle für Vollgasbereich" VALUE 0x81014C KwUb 4.980 spg_ub_b5 0.00 4.980 FORMAT "%5.3" /end CHARACTERISTIC
/begin CHARACTERISTIC USRIMINH "Mindest Spannungs-Schwelle für Ri-Messung der Sonde hinter KAT" VALUE 0x813D6E KwUw 319.9951 spg_uw_q0p00488_o1 -1.000000 318.9951 FORMAT "%8.4" /end CHARACTERISTIC
/begin CHARACTERISTIC USRIMINV "Mindest Spannungs-Schwelle für Ri-Messung der Sonde vor KAT" VALUE 0x815788 KwUw 319.9951 spg_uw_q0p00488_o1 -1.000000 318.9951 FORMAT "%8.4" /end CHARACTERISTIC
/begin CHARACTERISTIC USRIOH "Obere Spannungs-Schwelle für Ri-Messung der Sonde hinter KAT" VALUE 0x813D70 KwUw 319.9951 spg_uw_q0p00488_o1 -1.000000 318.9951 FORMAT "%8.4" /end CHARACTERISTIC
/begin CHARACTERISTIC USRIOV "Obere Spannungs-Schwelle für Ri-Messung der Sonde vor KAT" VALUE 0x81578A KwUw 319.9951 spg_uw_q0p00488_o1 -1.000000 318.9951 FORMAT "%8.4" /end CHARACTERISTIC
/begin CHARACTERISTIC USRIUH "Untere Spannungs-Schwelle für Ri-Messung der Sonde hinter KAT" VALUE 0x813D72 KwUw 319.9951 spg_uw_q0p00488_o1 -1.000000 318.9951 FORMAT "%8.4" /end CHARACTERISTIC
/begin CHARACTERISTIC USRIUV "Untere Spannungs-Schwelle für Ri-Messung der Sonde vor KAT" VALUE 0x81578C KwUw 319.9951 spg_uw_q0p00488_o1 -1.000000 318.9951 FORMAT "%8.4" /end CHARACTERISTIC
/begin CHARACTERISTIC VFZMN "Erkennen Fahren-Stehen" VALUE 0x8142FA KwUw 511.9922 vfzg_uw_b512 0.00 511.9922 FORMAT "%8.4" /end CHARACTERISTIC
/begin CHARACTERISTIC VKOAO "Obere Geschwindigkeitsschwelle für Kompressorabschaltung" VALUE 0x812BAF KwUb 318.8 vfzg_ub_q1p25 0.00 318.8 FORMAT "%5.1" /end CHARACTERISTIC
/begin CHARACTERISTIC VMDUB "Geschwindigkeitsschwelle min. für Batteriespannungs-Diagnose" VALUE 0x811B2E KwUb 318.8 vfzg_ub_q1p25 0.00 318.8 FORMAT "%5.1" /end CHARACTERISTIC
/begin CHARACTERISTIC VRFGRMN "Untere Schwelle vroh_w für FGR-Abschaltung über vfzg_w = 0" VALUE 0x8142FC KwUw 511.9922 vfzg_uw_b512 0.00 511.9922 FORMAT "%8.4" /end CHARACTERISTIC
/begin CHARACTERISTIC VTUMGTA "Schwelle Fahrzeuggeschwindigkeit für TANS -> Umgebungstemperatur" VALUE 0x81A3A0 KwUb 318.8 vfzg_ub_q1p25 0.00 318.8 FORMAT "%5.1" /end CHARACTERISTIC
/begin CHARACTERISTIC WPMXNOT "Maximal zulässiger Fahrpedalwert im PWG-Notfahren" VALUE 0x81014D KwUb 100.0 relPED_ub_b100 0.00 100.0 FORMAT "%5.1" /end CHARACTERISTIC
/begin CHARACTERISTIC ZBWF "Zählerstand für Fehlereintrag Bewegungserkennung" VALUE 0x81014E KwUb 255.0 dez 0.00 255.0 FORMAT "%5.1" /end CHARACTERISTIC
/begin CHARACTERISTIC ZERBR "Fehlerzähler für Bremsschalter-Unplausibilitäten" VALUE 0x819C89 KwUb 255.0 dez 0.00 255.0 FORMAT "%5.1" /end CHARACTERISTIC
/begin CHARACTERISTIC ZFRIH "Abschwächungsfaktor für Innenwiderstand Ri-Nernst-Filter hinter KAT" VALUE 0x813D74 KwUw 0.9999847 fak_uw_b1 0.00 0.9999847 FORMAT "%9.7" /end CHARACTERISTIC
/begin CHARACTERISTIC ZFRIV "Abschwächungsfaktor für Innenwiderstand Ri-Nernst-Filter vor KAT" VALUE 0x81578E KwUw 0.9999847 fak_uw_b1 0.00 0.9999847 FORMAT "%9.7" /end CHARACTERISTIC
/begin CHARACTERISTIC ZFV "Zeitkonstante für Filterung des Geschwindigkeitssignals" VALUE 0x8142FE KwUw 655.350000 zk10msxs_uw_b655 0.0100001526 655.360000 FORMAT "%10.6" /end CHARACTERISTIC
/begin CHARACTERISTIC ZKDFST "Zeitkonstante DT1-Filter Tankfuellstand" VALUE 0x81BC64 KwUw 6553.4999985 zk100msxs_uw_b6553 0.10000152590 6553.6000000 FORMAT "%12.7" /end CHARACTERISTIC
/begin CHARACTERISTIC ZKFSTV "Kennlinie Zeitkonstante Fuellstandssignal-Filter" CURVE 0x81BC66 KlAUwSstUwWUw 6553.4999985 zk100msxs_uw_b6553 0.10000152590 6553.6000000 FORMAT "%12.7"
 /begin AXIS_DESCR STD_AXIS vfzg vfzg_ub_q1p25 4 0.00 81918.75 FORMAT "%8.2" DEPOSIT ABSOLUTE /end AXIS_DESCR
/end CHARACTERISTIC
/begin MEASUREMENT acc_stat "ACC-Status (CAN-Signal)" UBYTE dez 1 100 0 255 FORMAT "%5.1" ECU_ADDRESS 0x380B44 /end MEASUREMENT
/begin MEASUREMENT anzti "ti-Einspritzzähler" UBYTE dez 1 100 0 255 FORMAT "%5.1" ECU_ADDRESS 0x380A39 /end MEASUREMENT
/begin MEASUREMENT atv "aktueller Lernkennfeld-Integratorwert der Regelung hinter Kat" SBYTE t100msxs_sb_q0p01 1 100 -1.28 1.27 FORMAT "%5.3" ECU_ADDRESS 0x382FDC /end MEASUREMENT
/begin MEASUREMENT atv2 "aktueller Lernkennfeld-Integratorwert der Regelung hinter Kat Bank2" SBYTE t100msxs_sb_q0p01 1 100 -1.28 1.27 FORMAT "%5.3" ECU_ADDRESS 0x382FDD /end MEASUREMENT
/begin MEASUREMENT bfzgl_b "Fahrzeuglängsbeschleunigung" SBYTE bfzg_sb_q0p217 1 100 -27.776 27.559 FORMAT "%5.2" ECU_ADDRESS 0x380A45 /end MEASUREMENT
/begin MEASUREMENT B_acc "Bedingung: ACC-Steuergerät vorhanden" UWORD B_TRUE 1 100 0 1 BIT_MASK 0x4 FORMAT "%13.11" ECU_ADDRESS 0xFD50 /end MEASUREMENT
/begin MEASUREMENT B_accdme "Bedingung Quittierung der ACC-Anforderung" UWORD B_TRUE 1 100 0 1 BIT_MASK 0x8 FORMAT "%13.11" ECU_ADDRESS 0xFD50 /end MEASUREMENT
/begin MEASUREMENT B_acres "Bedingung für Aufbau einer Drehmomentenreserve bei Klimabereitschaft" UWORD B_TRUE 1 100 0 1 BIT_MASK 0x400 FORMAT "%13.11" ECU_ADDRESS 0xFDE0 /end MEASUREMENT
/begin MEASUREMENT B_anfw "Bedingung Anfangswertübernahme (TMOT-Modell)" UBYTE B_TRUE 1 100 0 1 BIT_MASK 0x10 FORMAT "%13.11" ECU_ADDRESS 0x380C9E /end MEASUREMENT
/begin MEASUREMENT B_asrext "Bedingung für externe ASR-Anforderung" UWORD B_TRUE 1 100 0 1 BIT_MASK 0x4000 FORMAT "%13.11" ECU_ADDRESS 0xFD58 /end MEASUREMENT
/begin MEASUREMENT B_atmtpa "Bedingung Taupunkt vor Kat ueberschritten" UWORD B_TRUE 1 100 0 1 BIT_MASK 0x20 FORMAT "%13.11" ECU_ADDRESS 0xFD2E /end MEASUREMENT
/begin MEASUREMENT B_atmtpa2 "Bedingung Taupunkt2 vor Kat ueberschritten" UWORD B_TRUE 1 100 0 1 BIT_MASK 0x40 FORMAT "%13.11" ECU_ADDRESS 0xFD2E /end MEASUREMENT
/begin MEASUREMENT B_atmtpk "Bedingung Taupunkt hinter Kat ueberschritten" UWORD B_TRUE 1 100 0 1 BIT_MASK 0x80 FORMAT "%13.11" ECU_ADDRESS 0xFD2E /end MEASUREMENT
/begin MEASUREMENT B_atmtpk2 "Bedingung Taupunkt2 hinter Kat ueberschritten" UWORD B_TRUE 1 100 0 1 BIT_MASK 0x100 FORMAT "%13.11" ECU_ADDRESS 0xFD2E /end MEASUREMENT
/begin MEASUREMENT B_bl "Bedingung Bremslichtschalter betätigt" UWORD B_TRUE 1 100 0 1 BIT_MASK 0x4000 FORMAT "%13.11" ECU_ADDRESS 0xFD88 /end MEASUREMENT
/begin MEASUREMENT B_br "Bedingung Bremstestschalter betätigt" UWORD B_TRUE 1 100 0 1 BIT_MASK 0x8000 FORMAT "%13.11" ECU_ADDRESS 0xFD88 /end MEASUREMENT
/begin MEASUREMENT B_br2k "Bedingung Bremse betätigt 2-kanalig erkannt" UWORD B_TRUE 1 100 0 1 BIT_MASK 0x1 FORMAT "%13.11" ECU_ADDRESS 0xFD8A /end MEASUREMENT
/begin MEASUREMENT B_brems "Bedingung Bremse betätigt" UWORD B_TRUE 1 100 0 1 BIT_MASK 0x4000 FORMAT "%13.11" ECU_ADDRESS 0xFD46 /end MEASUREMENT
/begin MEASUREMENT B_bwf "Bedingung: Bewegungserkennung hat Fehler erkannt" UWORD B_TRUE 1 100 0 1 BIT_MASK 0x4 FORMAT "%13.11" ECU_ADDRESS 0xFD56 /end MEASUREMENT
/begin MEASUREMENT B_bwunpl "Bedingung Unplausibilität bei Bewegungserkennung" UWORD B_TRUE 1 100 0 1 BIT_MASK 0x8 FORMAT "%13.11" ECU_ADDRESS 0xFD56 /end MEASUREMENT
/begin MEASUREMENT B_c95bf0 "Ansteuersignal zum Einstellen der Filtermittenfrequenz des CC195 (Pin BF0)" UWORD B_TRUE 1 100 0 1 BIT_MASK 0x2000 FORMAT "%13.11" ECU_ADDRESS 0xFD3E /end MEASUREMENT
/begin MEASUREMENT B_c95bf1 "Ansteuersignal zum Einstellen der Filtermittenfrequenz des CC195 (Pin BF1)" UWORD B_TRUE 1 100 0 1 BIT_MASK 0x4000 FORMAT "%13.11" ECU_ADDRESS 0xFD3E /end MEASUREMENT
/begin MEASUREMENT B_c95bf2 "Ansteuersignal zum Einstellen der Filtermittenfrequenz des CC195 (Pin BF2)" UWORD B_TRUE 1 100 0 1 BIT_MASK 0x8000 FORMAT "%13.11" ECU_ADDRESS 0xFD3E /end MEASUREMENT
/begin MEASUREMENT B_c95bf3 "Ansteuersignal zum Eintstellen der Filtermittenfrequenz des CC195 (Pin BF3)" UWORD B_TRUE 1 100 0 1 BIT_MASK 0x1 FORMAT "%13.11" ECU_ADDRESS 0xFD40 /end MEASUREMENT
/begin MEASUREMENT B_c95ks3 "Ansteuersignal für den Nulltest des CC195" UWORD B_TRUE 1 100 0 1 BIT_MASK 0x2 FORMAT "%13.11" ECU_ADDRESS 0xFD40 /end MEASUREMENT
/begin MEASUREMENT B_ctunp "Bedingung Fehler in CAN-Signal Umgebungstemperatur" UBYTE B_TRUE 1 100 0 1 BIT_MASK 0x4 FORMAT "%13.11" ECU_ADDRESS 0x380CA8 /end MEASUREMENT
/begin MEASUREMENT B_cvt "Bedingung continuously variable transmission" UWORD B_TRUE 1 100 0 1 BIT_MASK 0x20 FORMAT "%13.11" ECU_ADDRESS 0xFD48 /end MEASUREMENT
/begin MEASUREMENT B_dash "Bedingung: Dashpot-Änderungsbegrenzung aktiv" UWORD B_TRUE 1 100 0 1 BIT_MASK 0x1 FORMAT "%13.11" ECU_ADDRESS 0xFD22 /end MEASUREMENT
/begin MEASUREMENT B_dcdisr "Bedingung: DV-E-Endstufenabschaltung wird angefordert" UWORD B_TRUE 1 100 0 1 BIT_MASK 0x400 FORMAT "%13.11" ECU_ADDRESS 0xFD44 /end MEASUREMENT
/begin MEASUREMENT B_dkaden "Bedingung: DK-Sollwert aus DK-Adaption und -Prüfung verwenden" UWORD B_TRUE 1 100 0 1 BIT_MASK 0x800 FORMAT "%13.11" ECU_ADDRESS 0xFD44 /end MEASUREMENT
/begin MEASUREMENT B_dknolu "Bedingung Drosselklappensteller stromlos" UWORD B_TRUE 1 100 0 1 BIT_MASK 0x1000 FORMAT "%13.11" ECU_ADDRESS 0xFD40 /end MEASUREMENT
/begin MEASUREMENT B_dkpiu "Bedingung: irreversible SKA" UWORD B_TRUE 1 100 0 1 BIT_MASK 0x2000 FORMAT "%13.11" ECU_ADDRESS 0xFD40 /end MEASUREMENT
/begin MEASUREMENT B_dkpu "Bedingung Sicherheitskraftstoffabschaltung (SKA)" UWORD B_TRUE 1 100 0 1 BIT_MASK 0x4000 FORMAT "%13.11" ECU_ADDRESS 0xFD40 /end MEASUREMENT
/begin MEASUREMENT B_dktlp "Umschaltung der Lambdaregelungsparameter angefordert" UWORD B_TRUE 1 100 0 1 BIT_MASK 0x8000 FORMAT "%13.11" ECU_ADDRESS 0xFD3A /end MEASUREMENT
/begin MEASUREMENT B_dlrien "Bedingung: keine temp. Begrenzung des I-Anteils im DLR durchführen" UWORD B_TRUE 1 100 0 1 BIT_MASK 0x1000 FORMAT "%13.11" ECU_ADDRESS 0xFD44 /end MEASUREMENT
/begin MEASUREMENT B_dnt "Aktive Diagnose: Klopfregelung Nulltest" UWORD B_TRUE 1 100 0 1 BIT_MASK 0x2000 FORMAT "%13.11" ECU_ADDRESS 0xFD26 /end MEASUREMENT
/begin MEASUREMENT B_dntb "Bedingung Diagnose: Bereitschaft zum Nulltest (Nulltest im nächsten MF)" UWORD B_TRUE 1 100 0 1 BIT_MASK 0x4000 FORMAT "%13.11" ECU_ADDRESS 0xFD26 /end MEASUREMENT
/begin MEASUREMENT B_dsls "Aktive Diagnose: Sekundärluft-System" UWORD B_TRUE 1 100 0 1 BIT_MASK 0x20 FORMAT "%13.11" ECU_ADDRESS 0xFD42 /end MEASUREMENT
/begin MEASUREMENT B_dteaa "Bedingung Aufsteuerprüfung für TEV Diagnose aktiv" UWORD B_TRUE 1 100 0 1 BIT_MASK 0x8000 FORMAT "%13.11" ECU_ADDRESS 0xFD4C /end MEASUREMENT
/begin MEASUREMENT B_dtes "Aktive Diagnose: Tankentlüftungssystem" UWORD B_TRUE 1 100 0 1 BIT_MASK 0x1 FORMAT "%13.11" ECU_ADDRESS 0xFD4E /end MEASUREMENT
/begin MEASUREMENT B_dtest "Start für TEV-Ansteuerung" UWORD B_TRUE 1 100 0 1 BIT_MASK 0x2 FORMAT "%13.11" ECU_ADDRESS 0xFD4E /end MEASUREMENT
/begin MEASUREMENT B_dtp "Aktive Diagnose: Klopfregelung Testimpuls" UWORD B_TRUE 1 100 0 1 BIT_MASK 0x8000 FORMAT "%13.11" ECU_ADDRESS 0xFD26 /end MEASUREMENT
/begin MEASUREMENT B_dtpb "Bedingung Diagnose: Bereitschaft zum Testpuls (Testpuls im nächsten MF)" UWORD B_TRUE 1 100 0 1 BIT_MASK 0x1 FORMAT "%13.11" ECU_ADDRESS 0xFD28 /end MEASUREMENT
/begin MEASUREMENT B_dupw "Bedingung Abweichung zwischen Poti 1 und 2 zu groß" UWORD B_TRUE 1 100 0 1 BIT_MASK 0x10 FORMAT "%13.11" ECU_ADDRESS 0xFD56 /end MEASUREMENT
/begin MEASUREMENT B_dupw12 "Bedingung zulässige Abweichung zwischen PWG-Poti 1 und 2 überschritten" UWORD B_TRUE 1 100 0 1 BIT_MASK 0x20 FORMAT "%13.11" ECU_ADDRESS 0xFD56 /end MEASUREMENT
/begin MEASUREMENT B_dveada "Bedingung: DV-E-Adaption sperrt Einspritzung" UWORD B_TRUE 1 100 0 1 BIT_MASK 0x2000 FORMAT "%13.11" ECU_ADDRESS 0xFD44 /end MEASUREMENT
/begin MEASUREMENT B_eculock "Verriegelungsanforderung Wegfahrsperre" UWORD B_TRUE 1 100 0 1 BIT_MASK 0x20 FORMAT "%13.11" ECU_ADDRESS 0xFD4A /end MEASUREMENT
/begin MEASUREMENT B_edkvs "Bedingung Adaptionsfehlerschwellen aktuell überschritten" UWORD B_TRUE 1 100 0 1 BIT_MASK 0x8 FORMAT "%13.11" ECU_ADDRESS 0xFD42 /end MEASUREMENT
/begin MEASUREMENT B_edkvs2 "Bedingung Adaptionsfehlerschwellen Bank 2 aktuell überschritten" UWORD B_TRUE 1 100 0 1 BIT_MASK 0x10 FORMAT "%13.11" ECU_ADDRESS 0xFD42 /end MEASUREMENT
/begin MEASUREMENT B_enrinh "Bedingung enable für Ri-Nernst mit Filter hinter KAT" UWORD B_TRUE 1 100 0 1 BIT_MASK 0x100 FORMAT "%13.11" ECU_ADDRESS 0xFD5E /end MEASUREMENT
/begin MEASUREMENT B_enrinh2 "Bedingung enable für Ri-Nernst mit Filter hinter KAT Bank2" UWORD B_TRUE 1 100 0 1 BIT_MASK 0x200 FORMAT "%13.11" ECU_ADDRESS 0xFD5E /end MEASUREMENT
/begin MEASUREMENT B_enrinv "Bedingung enable für Ri-Nernst mit Filter vor KAT" UWORD B_TRUE 1 100 0 1 BIT_MASK 0x80 FORMAT "%13.11" ECU_ADDRESS 0xFD8E /end MEASUREMENT
/begin MEASUREMENT B_enrinv2 "Bedingung enable für Ri-Nernst mit Filter vor KAT Bank2" UWORD B_TRUE 1 100 0 1 BIT_MASK 0x100 FORMAT "%13.11" ECU_ADDRESS 0xFD8E /end MEASUREMENT
/begin MEASUREMENT b_enw "" UWORD default 1 100 0 1 BIT_MASK 0x400 FORMAT "%5.3" ECU_ADDRESS 0xFD20 /end MEASUREMENT
/begin MEASUREMENT b_enw2 "" UWORD default 1 100 0 1 BIT_MASK 0x800 FORMAT "%5.3" ECU_ADDRESS 0xFD20 /end MEASUREMENT
/begin MEASUREMENT b_enwfrst "" UWORD default 1 100 0 1 BIT_MASK 0x1000 FORMAT "%5.3" ECU_ADDRESS 0xFD20 /end MEASUREMENT
/begin MEASUREMENT b_enwfrst2 "" UWORD default 1 100 0 1 BIT_MASK 0x4000 FORMAT "%5.3" ECU_ADDRESS 0xFD20 /end MEASUREMENT
/begin MEASUREMENT b_enwini "" UWORD default 1 100 0 1 BIT_MASK 0x2000 FORMAT "%5.3" ECU_ADDRESS 0xFD20 /end MEASUREMENT
/begin MEASUREMENT b_enwini2 "" UWORD default 1 100 0 1 BIT_MASK 0x8000 FORMAT "%5.3" ECU_ADDRESS 0xFD20 /end MEASUREMENT
/begin MEASUREMENT B_epcl "Bedingung für Ansteuerung EGAS-Fehlerlampe" UWORD B_TRUE 1 100 0 1 BIT_MASK 0x10 FORMAT "%13.11" ECU_ADDRESS 0xFD50 /end MEASUREMENT
/begin MEASUREMENT B_erbr "Bedingung Bremsschaltersignale unplausibel" UWORD B_TRUE 1 100 0 1 BIT_MASK 0x2 FORMAT "%13.11" ECU_ADDRESS 0xFD8A /end MEASUREMENT
/begin MEASUREMENT B_erinofh "Bedingung enable für Ri-Nernst ohne Filter hinter KAT" UWORD B_TRUE 1 100 0 1 BIT_MASK 0x400 FORMAT "%13.11" ECU_ADDRESS 0xFD5E /end MEASUREMENT
/begin MEASUREMENT B_erinofh2 "Bedingung enable für Ri-Nernst ohne Filter hinter KAT Bank2" UWORD B_TRUE 1 100 0 1 BIT_MASK 0x800 FORMAT "%13.11" ECU_ADDRESS 0xFD5E /end MEASUREMENT
/begin MEASUREMENT B_erinofv "Bedingung enable für Ri-Nernst ohne Filter vor KAT" UWORD B_TRUE 1 100 0 1 BIT_MASK 0x200 FORMAT "%13.11" ECU_ADDRESS 0xFD8E /end MEASUREMENT
/begin MEASUREMENT B_erinofv2 "Bedingung enable für Ri-Nernst ohne Filter vor KAT Bank2" UWORD B_TRUE 1 100 0 1 BIT_MASK 0x400 FORMAT "%13.11" ECU_ADDRESS 0xFD8E /end MEASUREMENT
/begin MEASUREMENT B_esls "Bedingung Falschluft durch Fehler im Sekundärluftsystem" UWORD B_TRUE 1 100 0 1 BIT_MASK 0x40 FORMAT "%13.11" ECU_ADDRESS 0xFD42 /end MEASUREMENT
/begin MEASUREMENT B_etum "Bedingung Fehler in Umgebungstemperatur" UBYTE B_TRUE 1 100 0 1 BIT_MASK 0x1 FORMAT "%13.11" ECU_ADDRESS 0x380CA8 /end MEASUREMENT
/begin MEASUREMENT B_fa "Bedingung Funktionsanforderung allgemein" UWORD B_TRUE 1 100 0 1 BIT_MASK 0x4000 FORMAT "%13.11" ECU_ADDRESS 0xFD4A /end MEASUREMENT
/begin MEASUREMENT B_faevz "Bedingung Zylinderausblendung durch Tester" UWORD B_TRUE 1 100 0 1 BIT_MASK 0x8000 FORMAT "%13.11" ECU_ADDRESS 0xFD4A /end MEASUREMENT
/begin MEASUREMENT B_fakvs "Funktionsaufforderung Diagnose Kraftstoffsystem für Schnelltest" UWORD B_TRUE 1 100 0 1 BIT_MASK 0x40 FORMAT "%13.11" ECU_ADDRESS 0xFD48 /end MEASUREMENT
/begin MEASUREMENT B_falls "Bedingung: Funktionsanforderung Drehzahländerung durch Tester" UWORD B_TRUE 1 100 0 1 BIT_MASK 0x1 FORMAT "%13.11" ECU_ADDRESS 0xFD4C /end MEASUREMENT
/begin MEASUREMENT B_falsh "Bedingung Funktionsanforderung Lambda-Sonde hinter KAT" UWORD B_TRUE 1 100 0 1 BIT_MASK 0x80 FORMAT "%13.11" ECU_ADDRESS 0xFD48 /end MEASUREMENT
/begin MEASUREMENT B_falsh2 "Bedingung Funktionsanforderung Lambda-Sonde hinter KAT Bank2" UWORD B_TRUE 1 100 0 1 BIT_MASK 0x100 FORMAT "%13.11" ECU_ADDRESS 0xFD48 /end MEASUREMENT
/begin MEASUREMENT B_fgr "Bedingung FGR (Tempomat) aktiv" UWORD B_TRUE 1 100 0 1 BIT_MASK 0x2 FORMAT "%13.11" ECU_ADDRESS 0xFD22 /end MEASUREMENT
/begin MEASUREMENT B_fgrai "Bedingung FGR-Abschaltung irreversibel" UWORD B_TRUE 1 100 0 1 BIT_MASK 0x20 FORMAT "%13.11" ECU_ADDRESS 0xFD50 /end MEASUREMENT
/begin MEASUREMENT B_fgras "Bedingung: FGR-Abschaltung schnell" UWORD B_TRUE 1 100 0 1 BIT_MASK 0x40 FORMAT "%13.11" ECU_ADDRESS 0xFD50 /end MEASUREMENT
/begin MEASUREMENT B_fgrat "Bedingung: Tip-Schalter Aus am FGR-Bedienteil betätigt" UWORD B_TRUE 1 100 0 1 BIT_MASK 0x100 FORMAT "%13.11" ECU_ADDRESS 0xFD52 /end MEASUREMENT
/begin MEASUREMENT B_fgren "Bedingung Fahrgeschwindigkeitsregelung aktiv (Enable)" UWORD B_TRUE 1 100 0 1 BIT_MASK 0x2 FORMAT "%13.11" ECU_ADDRESS 0xFD42 /end MEASUREMENT
/begin MEASUREMENT B_fgrhe "Bedingung: FGR-Bedienteil-Fehler" UWORD B_TRUE 1 100 0 1 BIT_MASK 0x200 FORMAT "%13.11" ECU_ADDRESS 0xFD52 /end MEASUREMENT
/begin MEASUREMENT B_fgrhsa "Bedingung: FGR-Hauptschalter aus" UWORD B_TRUE 1 100 0 1 BIT_MASK 0x10 FORMAT "%13.11" ECU_ADDRESS 0xFD28 /end MEASUREMENT
/begin MEASUREMENT B_fgrtbe "Bedingung FGR-Taste Beschleunigen" UWORD B_TRUE 1 100 0 1 BIT_MASK 0x400 FORMAT "%13.11" ECU_ADDRESS 0xFD52 /end MEASUREMENT
/begin MEASUREMENT B_fgrtse "Bedingung FGR-Taste Setzen" UWORD B_TRUE 1 100 0 1 BIT_MASK 0x800 FORMAT "%13.11" ECU_ADDRESS 0xFD52 /end MEASUREMENT
/begin MEASUREMENT B_fgrtve "Bedingung FGR-Taste Verzögern" UWORD B_TRUE 1 100 0 1 BIT_MASK 0x1000 FORMAT "%13.11" ECU_ADDRESS 0xFD52 /end MEASUREMENT
/begin MEASUREMENT B_fgrtwa "Bedingung FGR-Taste Wiederaufnahme" UWORD B_TRUE 1 100 0 1 BIT_MASK 0x2000 FORMAT "%13.11" ECU_ADDRESS 0xFD52 /end MEASUREMENT
/begin MEASUREMENT B_fil "Bedingung PT1-Filter für SAWE aktiv" UWORD B_TRUE 1 100 0 1 BIT_MASK 0x4 FORMAT "%13.11" ECU_ADDRESS 0xFD22 /end MEASUREMENT
/begin MEASUREMENT B_fpwdkap "DK-Steuerung direkt über Fahrpedal" UWORD B_TRUE 1 100 0 1 BIT_MASK 0x200 FORMAT "%13.11" ECU_ADDRESS 0xFD48 /end MEASUREMENT
/begin MEASUREMENT B_frini "Bedingung Regelfaktor fr initialisieren" UWORD B_TRUE 1 100 0 1 BIT_MASK 0x2000 FORMAT "%13.11" ECU_ADDRESS 0xFD2E /end MEASUREMENT
/begin MEASUREMENT B_frini2 "Bedingung Regelfaktor fr initialisieren, Bank 2" UWORD B_TRUE 1 100 0 1 BIT_MASK 0x4000 FORMAT "%13.11" ECU_ADDRESS 0xFD2E /end MEASUREMENT
/begin MEASUREMENT B_fs "Bedingung Fahrstufe" UWORD B_TRUE 1 100 0 1 BIT_MASK 0x2 FORMAT "%13.11" ECU_ADDRESS 0xFD20 /end MEASUREMENT
/begin MEASUREMENT B_fspclr "Bedingung Fehlerspeicher wurde gelöscht" UWORD B_TRUE 1 100 0 1 BIT_MASK 0x400 FORMAT "%13.11" ECU_ADDRESS 0xFD48 /end MEASUREMENT
/begin MEASUREMENT B_fstdmn "Bedingung minimaler Tankfuellstand fuer Diagnosefunkionen" UWORD B_TRUE 1 100 0 1 BIT_MASK 0x1 FORMAT "%13.11" ECU_ADDRESS 0x38269A /end MEASUREMENT
/begin MEASUREMENT B_fstdmx "Bedingung maximaler Tankfuellstand fuer Diagnosefunktionen" UWORD B_TRUE 1 100 0 1 BIT_MASK 0x2 FORMAT "%13.11" ECU_ADDRESS 0x38269A /end MEASUREMENT
/begin MEASUREMENT B_fstdy "Bedingung Tankfuellstand dynamisch" UWORD B_TRUE 1 100 0 1 BIT_MASK 0x20 FORMAT "%13.11" ECU_ADDRESS 0xFDD0 /end MEASUREMENT
/begin MEASUREMENT B_fststa "Bedingung Fuellstand nach Start" UWORD B_TRUE 1 100 0 1 BIT_MASK 0x40 FORMAT "%13.11" ECU_ADDRESS 0xFDD0 /end MEASUREMENT
/begin MEASUREMENT B_fsttal "Bedigung Fuellstand Tank leer" UWORD B_TRUE 1 100 0 1 BIT_MASK 0x20 FORMAT "%13.11" ECU_ADDRESS 0x38269A /end MEASUREMENT
/begin MEASUREMENT B_fsttew "Bedingung Ersatzwert Tankfuellstand" UWORD B_TRUE 1 100 0 1 BIT_MASK 0x80 FORMAT "%13.11" ECU_ADDRESS 0xFDD0 /end MEASUREMENT
/begin MEASUREMENT B_fsttg "Fuellstand Tank gueltig (auch im Steuergerdtenachlauf)" UWORD B_TRUE 1 100 0 1 BIT_MASK 0x100 FORMAT "%13.11" ECU_ADDRESS 0x38269A /end MEASUREMENT
/begin MEASUREMENT B_fsttsh "Bedingung Tankfuellstandssignal Sample/Hold" UWORD B_TRUE 1 100 0 1 BIT_MASK 0x4 FORMAT "%13.11" ECU_ADDRESS 0x38269A /end MEASUREMENT
/begin MEASUREMENT B_fsttval "Bedingung Fuellstand Tank validiert" UWORD B_TRUE 1 100 0 1 BIT_MASK 0x8 FORMAT "%13.11" ECU_ADDRESS 0x38269A /end MEASUREMENT
/begin MEASUREMENT B_gasp "Bedingung Grundadaption gesperrt" UWORD B_TRUE 1 100 0 1 BIT_MASK 0x1 FORMAT "%13.11" ECU_ADDRESS 0xFD3A /end MEASUREMENT
/begin MEASUREMENT B_glf "Bedingung Gleichlauf zwischen Poti 1 und Poti 2 verletzt" UWORD B_TRUE 1 100 0 1 BIT_MASK 0x40 FORMAT "%13.11" ECU_ADDRESS 0xFD56 /end MEASUREMENT
/begin MEASUREMENT B_hdmtl "Bedingung Heizung DM-TL" UBYTE B_TRUE 1 100 0 1 BIT_MASK 0x1 FORMAT "%13.11" ECU_ADDRESS 0x380D59 /end MEASUREMENT
/begin MEASUREMENT B_hfm "Bedingung HFM messbereit" UWORD B_TRUE 1 100 0 1 BIT_MASK 0x40 FORMAT "%13.11" ECU_ADDRESS 0xFD26 /end MEASUREMENT
/begin MEASUREMENT B_holp1 "Bedingung Hochohmigkeit im Leerlauf an PWG-Poti 1 erkannt" UWORD B_TRUE 1 100 0 1 BIT_MASK 0x80 FORMAT "%13.11" ECU_ADDRESS 0xFD56 /end MEASUREMENT
/begin MEASUREMENT B_holp1a "Bedingung Hochohmigkeit im Leerlauf an PWG-Poti 1 im aktuellen Fahrzyklus" UWORD B_TRUE 1 100 0 1 BIT_MASK 0x100 FORMAT "%13.11" ECU_ADDRESS 0xFD56 /end MEASUREMENT
/begin MEASUREMENT B_holp1l "Bedingung Hochohmigkeit im Leerlauf an PWG-Poti 1 im letzten Fahrzyklus" UBYTE B_TRUE 1 100 0 1 BIT_MASK 0x1 FORMAT "%13.11" ECU_ADDRESS 0x382FDE /end MEASUREMENT
/begin MEASUREMENT B_holp2 "Bedingung Hochohmigkeit im Leerlauf an PWG-Poti 2 erkannt" UWORD B_TRUE 1 100 0 1 BIT_MASK 0x200 FORMAT "%13.11" ECU_ADDRESS 0xFD56 /end MEASUREMENT
/begin MEASUREMENT B_holp2a "Bedingung Hochohmigkeit im Leerlauf an PWG-Poti 2 im aktuellen Fahrzyklus" UWORD B_TRUE 1 100 0 1 BIT_MASK 0x400 FORMAT "%13.11" ECU_ADDRESS 0xFD56 /end MEASUREMENT
/begin MEASUREMENT B_holp2l "Bedingung Hochohmigkeit im Leerlauf an PWG-Poti 2 im letzten Fahrzyklus" UBYTE B_TRUE 1 100 0 1 BIT_MASK 0x2 FORMAT "%13.11" ECU_ADDRESS 0x382FDE /end MEASUREMENT
/begin MEASUREMENT B_hop1mn "Bedingung Bereichsverletzung nach unten an Poti 1 in Hochohmigkeitsprüfung" UWORD B_TRUE 1 100 0 1 BIT_MASK 0x800 FORMAT "%13.11" ECU_ADDRESS 0xFD56 /end MEASUREMENT
/begin MEASUREMENT B_hop2mn "Bedingung Bereichsverletzung nach unten an Poti 2 in Hochohmigkeitsprüfung" UWORD B_TRUE 1 100 0 1 BIT_MASK 0x1000 FORMAT "%13.11" ECU_ADDRESS 0xFD56 /end MEASUREMENT
/begin MEASUREMENT B_hopakt "Bedingung Hochohmigkeitsprüfung aktiv" UWORD B_TRUE 1 100 0 1 BIT_MASK 0x2000 FORMAT "%13.11" ECU_ADDRESS 0xFD56 /end MEASUREMENT
/begin MEASUREMENT B_hsh "Bedingung Heizung Sonde hinter Kat einschaltbereit" UWORD B_TRUE 1 100 0 1 BIT_MASK 0x2 FORMAT "%13.11" ECU_ADDRESS 0xFD46 /end MEASUREMENT
/begin MEASUREMENT B_hsh2 "Bedingung Heizung Sonde 2 hinter Kat einschaltbereit" UWORD B_TRUE 1 100 0 1 BIT_MASK 0x4 FORMAT "%13.11" ECU_ADDRESS 0xFD46 /end MEASUREMENT
/begin MEASUREMENT B_hshe "Bedingung Endstufe Sondenheizung hinter Kat angesteuert" UWORD B_TRUE 1 100 0 1 BIT_MASK 0x8000 FORMAT "%13.11" ECU_ADDRESS 0xFD36 /end MEASUREMENT
/begin MEASUREMENT B_hshe2 "Bedingung Endstufe Sondenheizung2 hinter Kat angesteuert" UWORD B_TRUE 1 100 0 1 BIT_MASK 0x1 FORMAT "%13.11" ECU_ADDRESS 0xFD38 /end MEASUREMENT
/begin MEASUREMENT B_hshmx "Bedingung maximale Leistung der Sondenheizung hinter Kat" UWORD B_TRUE 1 100 0 1 BIT_MASK 0x8 FORMAT "%13.11" ECU_ADDRESS 0xFD46 /end MEASUREMENT
/begin MEASUREMENT B_hshmx2 "Bedingung maximale Leistung der Sondenheizung 2  hinter Kat" UWORD B_TRUE 1 100 0 1 BIT_MASK 0x10 FORMAT "%13.11" ECU_ADDRESS 0xFD46 /end MEASUREMENT
/begin MEASUREMENT B_hsv "Bedingung Heizung Sonde vor Kat einschaltbereit" UWORD B_TRUE 1 100 0 1 BIT_MASK 0x20 FORMAT "%13.11" ECU_ADDRESS 0xFD46 /end MEASUREMENT
/begin MEASUREMENT B_hsv2 "Bedingung Heizung Sonde2 vor Kat einschaltbereit" UWORD B_TRUE 1 100 0 1 BIT_MASK 0x40 FORMAT "%13.11" ECU_ADDRESS 0xFD46 /end MEASUREMENT
/begin MEASUREMENT B_hsve "Bedingung Endstufe Sondenheizung vor Kat angesteuert" UWORD B_TRUE 1 100 0 1 BIT_MASK 0x2 FORMAT "%13.11" ECU_ADDRESS 0xFD38 /end MEASUREMENT
/begin MEASUREMENT B_hsve2 "Bedingung Endstufe Sondenheizung2 vor Kat angesteuert" UWORD B_TRUE 1 100 0 1 BIT_MASK 0x4 FORMAT "%13.11" ECU_ADDRESS 0xFD38 /end MEASUREMENT
/begin MEASUREMENT B_hsvmx "Bedingung maximale Leistung der Sondenheizung vor Kat" UWORD B_TRUE 1 100 0 1 BIT_MASK 0x80 FORMAT "%13.11" ECU_ADDRESS 0xFD46 /end MEASUREMENT
/begin MEASUREMENT B_hsvmx2 "Bedingung maximale Leistung der Sondenheizung 2 vor Kat" UWORD B_TRUE 1 100 0 1 BIT_MASK 0x100 FORMAT "%13.11" ECU_ADDRESS 0xFD46 /end MEASUREMENT
/begin MEASUREMENT B_info_0 "" UWORD B_TRUE 1 100 0 1 BIT_MASK 0x4000 FORMAT "%13.11" ECU_ADDRESS 0xFD52 /end MEASUREMENT
/begin MEASUREMENT B_kd "Bedingung Kick-Down" UWORD B_TRUE 1 100 0 1 BIT_MASK 0x4000 FORMAT "%13.11" ECU_ADDRESS 0xFD56 /end MEASUREMENT
/begin MEASUREMENT B_kh "Bedingung Kat-Heizung" UWORD B_TRUE 1 100 0 1 BIT_MASK 0x10 FORMAT "%13.11" ECU_ADDRESS 0xFD2A /end MEASUREMENT
/begin MEASUREMENT B_koa "Bedingung für Kompressorausschalten" UWORD B_TRUE 1 100 0 1 BIT_MASK 0x800 FORMAT "%13.11" ECU_ADDRESS 0xFDE0 /end MEASUREMENT
/begin MEASUREMENT B_koe "Bedingung für Kompressoreinschalten" UWORD B_TRUE 1 100 0 1 BIT_MASK 0x20 FORMAT "%13.11" ECU_ADDRESS 0xFD26 /end MEASUREMENT
/begin MEASUREMENT B_koena "Bedingung Kompressor freigegeben" UWORD B_TRUE 1 100 0 1 BIT_MASK 0x1000 FORMAT "%13.11" ECU_ADDRESS 0xFDE0 /end MEASUREMENT
/begin MEASUREMENT B_komnoff "Bedingung Kompresszor-Mindestabschaltzeit abgelaufen" UWORD B_TRUE 1 100 0 1 BIT_MASK 0x2000 FORMAT "%13.11" ECU_ADDRESS 0xFDE0 /end MEASUREMENT
/begin MEASUREMENT B_komnon "Bedingung Kompresszor-Mindesteinschaltzeit abgelaufen" UWORD B_TRUE 1 100 0 1 BIT_MASK 0x4000 FORMAT "%13.11" ECU_ADDRESS 0xFDE0 /end MEASUREMENT
/begin MEASUREMENT B_komxoff "Bedingung Kompresszor-Höchstabschaltzeit abgelaufen" UWORD B_TRUE 1 100 0 1 BIT_MASK 0x8000 FORMAT "%13.11" ECU_ADDRESS 0xFDE0 /end MEASUREMENT
/begin MEASUREMENT B_kooff "Bedingung für hartes Kompressorabschalten" UWORD B_TRUE 1 100 0 1 BIT_MASK 0x1 FORMAT "%13.11" ECU_ADDRESS 0xFDE2 /end MEASUREMENT
/begin MEASUREMENT B_kosta "Bedingung für Einfrieren des aktuellen Kompressorzustandes" UWORD B_TRUE 1 100 0 1 BIT_MASK 0x2 FORMAT "%13.11" ECU_ADDRESS 0xFDE2 /end MEASUREMENT
/begin MEASUREMENT B_krdws "Bedingung Klopfregelung Sicherheitsspätverstellung" UWORD B_TRUE 1 100 0 1 BIT_MASK 0x10 FORMAT "%13.11" ECU_ADDRESS 0xFD2E /end MEASUREMENT
/begin MEASUREMENT B_kuppl "Bedingung Kupplung betätigt" UWORD B_TRUE 1 100 0 1 BIT_MASK 0x8000 FORMAT "%13.11" ECU_ADDRESS 0xFD46 /end MEASUREMENT
/begin MEASUREMENT B_kupplv "Bedingung Kupplung betätigt verzögert" UWORD B_TRUE 1 100 0 1 BIT_MASK 0x4 FORMAT "%13.11" ECU_ADDRESS 0xFD8A /end MEASUREMENT
/begin MEASUREMENT B_kw "Bedingung Kat warmhalten" UWORD B_TRUE 1 100 0 1 BIT_MASK 0x20 FORMAT "%13.11" ECU_ADDRESS 0xFD2A /end MEASUREMENT
/begin MEASUREMENT B_ll "Bedingung Leerlauf" UWORD B_TRUE 1 100 0 1 BIT_MASK 0x8 FORMAT "%13.11" ECU_ADDRESS 0xFD22 /end MEASUREMENT
/begin MEASUREMENT B_llrein "Bedingung LLR ist aktiv" UWORD B_TRUE 1 100 0 1 BIT_MASK 0x8000 FORMAT "%13.11" ECU_ADDRESS 0xFD44 /end MEASUREMENT
/begin MEASUREMENT B_lr "LREB: Bedingung Lambdaregelung (vor Kat); (Bank 1)" UWORD B_TRUE 1 100 0 1 BIT_MASK 0x200 FORMAT "%13.11" ECU_ADDRESS 0xFD2E /end MEASUREMENT
/begin MEASUREMENT B_lr2 "Bedingung Lambdaregelung (vor Kat); Bank 2" UWORD B_TRUE 1 100 0 1 BIT_MASK 0x400 FORMAT "%13.11" ECU_ADDRESS 0xFD2E /end MEASUREMENT
/begin MEASUREMENT B_lra "Bedingung Gemischadaption freigegeben" UWORD B_TRUE 1 100 0 1 BIT_MASK 0x2 FORMAT "%13.11" ECU_ADDRESS 0xFD3A /end MEASUREMENT
/begin MEASUREMENT B_lra2 "Bedingung Gemischadaption 2 freigegeben" UWORD B_TRUE 1 100 0 1 BIT_MASK 0x4 FORMAT "%13.11" ECU_ADDRESS 0xFD3A /end MEASUREMENT
/begin MEASUREMENT B_lrhk "Bedingung Lambdaregelung hinter Kat" UWORD B_TRUE 1 100 0 1 BIT_MASK 0x40 FORMAT "%13.11" ECU_ADDRESS 0xFD5E /end MEASUREMENT
/begin MEASUREMENT B_lrhk2 "Bedingung Lambdaregelung hinter Kat (Bank 2)" UWORD B_TRUE 1 100 0 1 BIT_MASK 0x80 FORMAT "%13.11" ECU_ADDRESS 0xFD5E /end MEASUREMENT
/begin MEASUREMENT B_lrnd "Steuerbit LR aktiv setzen; Anforderung ""NORMAL-"" oder ""DIAGNOSE-Betrieb""" UWORD B_TRUE 1 100 0 1 BIT_MASK 0x800 FORMAT "%13.11" ECU_ADDRESS 0xFD2E /end MEASUREMENT
/begin MEASUREMENT B_lrnd2 "Steuerbit LR aktiv setzen; Anforderung ""NORMAL-"" oder ""DIAGNOSE"" z.B. bei SLS" UWORD B_TRUE 1 100 0 1 BIT_MASK 0x1000 FORMAT "%13.11" ECU_ADDRESS 0xFD2E /end MEASUREMENT
/begin MEASUREMENT B_lrnrdy "Lernen ist beendet" UWORD B_TRUE 1 100 0 1 BIT_MASK 0x4000 FORMAT "%13.11" ECU_ADDRESS 0xFD44 /end MEASUREMENT
/begin MEASUREMENT B_lsd "Bedingung: Pos. Lastschlagdämpfung aktiv" UWORD B_TRUE 1 100 0 1 BIT_MASK 0x10 FORMAT "%13.11" ECU_ADDRESS 0xFD22 /end MEASUREMENT
/begin MEASUREMENT B_lsh "Bedingung Lambda-Sonde hinter Kat verbaut, 2. Sonde nach Auslaß (Bank1)" UWORD B_TRUE 1 100 0 1 BIT_MASK 0x400 FORMAT "%13.11" ECU_ADDRESS 0xFD50 /end MEASUREMENT
/begin MEASUREMENT B_lsh2 "Bedingung Lambda-Sonde hinter Kat verbaut, 2. Sonde nach Auslaß (Bank2)" UWORD B_TRUE 1 100 0 1 BIT_MASK 0x800 FORMAT "%13.11" ECU_ADDRESS 0xFD50 /end MEASUREMENT
/begin MEASUREMENT B_lsv "Bedingung Lambda-Sonde vor Kat verbaut, 1. Sonde nach Auslaß (Bank1)" UWORD B_TRUE 1 100 0 1 BIT_MASK 0x1000 FORMAT "%13.11" ECU_ADDRESS 0xFD50 /end MEASUREMENT
/begin MEASUREMENT B_lsv2 "Bedingung Lambda-Sonde vor Kat verbaut, 1. Sonde nach Auslaß (Bank2)" UWORD B_TRUE 1 100 0 1 BIT_MASK 0x2000 FORMAT "%13.11" ECU_ADDRESS 0xFD50 /end MEASUREMENT
/begin MEASUREMENT B_mflex "" UWORD B_TRUE 1 100 0 1 BIT_MASK 0x8000 FORMAT "%13.11" ECU_ADDRESS 0xFD52 /end MEASUREMENT
/begin MEASUREMENT B_mflfrqe "Bedingung MFL-Telegrammlänge ausserhalb des Toleranzbandes" UWORD B_TRUE 1 100 0 1 BIT_MASK 0x1 FORMAT "%13.11" ECU_ADDRESS 0xFD54 /end MEASUREMENT
/begin MEASUREMENT B_mflpt "" UWORD B_TRUE 1 100 0 1 BIT_MASK 0x2 FORMAT "%13.11" ECU_ADDRESS 0xFD54 /end MEASUREMENT
/begin MEASUREMENT B_mflst "" UWORD B_TRUE 1 100 0 1 BIT_MASK 0x4 FORMAT "%13.11" ECU_ADDRESS 0xFD54 /end MEASUREMENT
/begin MEASUREMENT B_mfltr "" UWORD B_TRUE 1 100 0 1 BIT_MASK 0x8 FORMAT "%13.11" ECU_ADDRESS 0xFD54 /end MEASUREMENT
/begin MEASUREMENT B_mnmflv "Bedingung MFL-Signal weist Frequenzfehler auf" UWORD B_TRUE 1 100 0 1 BIT_MASK 0x10 FORMAT "%13.11" ECU_ADDRESS 0xFD54 /end MEASUREMENT
/begin MEASUREMENT B_msrext "Bedingung für externe Anforderung MSR" UWORD B_TRUE 1 100 0 1 BIT_MASK 0x8000 FORMAT "%13.11" ECU_ADDRESS 0xFD58 /end MEASUREMENT
/begin MEASUREMENT B_mxmflv "Bedingung MFL-Signal weist Toggelbitfehler auf" UWORD B_TRUE 1 100 0 1 BIT_MASK 0x20 FORMAT "%13.11" ECU_ADDRESS 0xFD54 /end MEASUREMENT
/begin MEASUREMENT B_mxmntm "Bedingung min-oder max-Fehler Motortemperaturfühler vorhanden" UBYTE B_TRUE 1 100 0 1 BIT_MASK 0x2 FORMAT "%13.11" ECU_ADDRESS 0x380C9E /end MEASUREMENT
/begin MEASUREMENT B_nac "Bedingung für erhöhte LL-Drehzahl bei Klimaanlage" UWORD B_TRUE 1 100 0 1 BIT_MASK 0x4 FORMAT "%13.11" ECU_ADDRESS 0xFDE2 /end MEASUREMENT
/begin MEASUREMENT B_nmot "Bedingung Motordrehzahl: n > NMIN" UWORD B_TRUE 1 100 0 1 BIT_MASK 0x40 FORMAT "%13.11" ECU_ADDRESS 0xFD20 /end MEASUREMENT
/begin MEASUREMENT B_nnwmx "Drehzahlschwelle für NW-Regelung überschritten" UWORD B_TRUE 1 100 0 1 BIT_MASK 0x10 FORMAT "%13.11" ECU_ADDRESS 0xFD26 /end MEASUREMENT
/begin MEASUREMENT B_nokatfz "Bedingung Nicht-KAT Fahrzeug" UWORD B_TRUE 1 100 0 1 BIT_MASK 0x2000 FORMAT "%13.11" ECU_ADDRESS 0xFDDC /end MEASUREMENT
/begin MEASUREMENT B_npmflv "Bedingung MFL-Signal nicht plausibel" UWORD B_TRUE 1 100 0 1 BIT_MASK 0x40 FORMAT "%13.11" ECU_ADDRESS 0xFD54 /end MEASUREMENT
/begin MEASUREMENT B_nswo1 "Bedingung Drehzahl > NSWO1" UWORD B_TRUE 1 100 0 1 BIT_MASK 0x800 FORMAT "%13.11" ECU_ADDRESS 0xFD48 /end MEASUREMENT
/begin MEASUREMENT B_nswo2 "Bedingung Drehzahl > NSWO2" UWORD B_TRUE 1 100 0 1 BIT_MASK 0x1000 FORMAT "%13.11" ECU_ADDRESS 0xFD48 /end MEASUREMENT
/begin MEASUREMENT B_nswo3 "" UWORD B_TRUE 1 100 0 1 BIT_MASK 0x2000 FORMAT "%13.11" ECU_ADDRESS 0xFD48 /end MEASUREMENT
/begin MEASUREMENT B_ntini "KR: Bedingung für Initialisierungs-Nulltest" UWORD B_TRUE 1 100 0 1 BIT_MASK 0x2 FORMAT "%13.11" ECU_ADDRESS 0xFD28 /end MEASUREMENT
/begin MEASUREMENT B_pn "Bedingung für Fahrstufe P oder N" UWORD B_TRUE 1 100 0 1 BIT_MASK 0x4 FORMAT "%13.11" ECU_ADDRESS 0xFD20 /end MEASUREMENT
/begin MEASUREMENT B_priph "Bedingung Port schalten für Pumpimpuls hinter KAT" UWORD B_TRUE 1 100 0 1 BIT_MASK 0x1000 FORMAT "%13.11" ECU_ADDRESS 0xFD5E /end MEASUREMENT
/begin MEASUREMENT B_priph2 "Bedingung Port schalten für Pumpimpuls hinter KAT Bank2" UWORD B_TRUE 1 100 0 1 BIT_MASK 0x2000 FORMAT "%13.11" ECU_ADDRESS 0xFD5E /end MEASUREMENT
/begin MEASUREMENT B_pripv "Bedingung Port schalten für Pumpimpuls vor KAT" UWORD B_TRUE 1 100 0 1 BIT_MASK 0x800 FORMAT "%13.11" ECU_ADDRESS 0xFD8E /end MEASUREMENT
/begin MEASUREMENT B_pripv2 "Bedingung Port schalten für Pumpimpuls vor KAT Bank2" UWORD B_TRUE 1 100 0 1 BIT_MASK 0x1000 FORMAT "%13.11" ECU_ADDRESS 0xFD8E /end MEASUREMENT
/begin MEASUREMENT B_pump "" UWORD B_TRUE 1 100 0 1 BIT_MASK 0x4000 FORMAT "%13.11" ECU_ADDRESS 0xFD5E /end MEASUREMENT
/begin MEASUREMENT B_pwf "Bedingung Powerfail" UWORD B_TRUE 1 100 0 1 BIT_MASK 0x10 FORMAT "%13.11" ECU_ADDRESS 0xFD4A /end MEASUREMENT
/begin MEASUREMENT B_pwgbwf "Bedingung PWG-Bewegungsfehler" UWORD B_TRUE 1 100 0 1 BIT_MASK 0x8000 FORMAT "%13.11" ECU_ADDRESS 0xFD56 /end MEASUREMENT
/begin MEASUREMENT B_pwgnotfr "FR-Fehlerreaktion PWG-Notfahren" UWORD B_TRUE 1 100 0 1 BIT_MASK 0x1 FORMAT "%13.11" ECU_ADDRESS 0xFD58 /end MEASUREMENT
/begin MEASUREMENT B_qtedab "Bedingung schnelle Absteuerung der Spülrate" UWORD B_TRUE 1 100 0 1 BIT_MASK 0x8 FORMAT "%13.11" ECU_ADDRESS 0xFD3A /end MEASUREMENT
/begin MEASUREMENT B_rehs "Restart Sondenheizung" UWORD B_TRUE 1 100 0 1 BIT_MASK 0x8 FORMAT "%13.11" ECU_ADDRESS 0xFD38 /end MEASUREMENT
/begin MEASUREMENT B_riakh "Bedingung für Strom-Pumpen aktualisiert hinter KAT" UWORD B_TRUE 1 100 0 1 BIT_MASK 0x8000 FORMAT "%13.11" ECU_ADDRESS 0xFD5E /end MEASUREMENT
/begin MEASUREMENT B_riakh2 "Bedingung für Strom-Pumpen aktualisiert hinter KAT Bank2" UWORD B_TRUE 1 100 0 1 BIT_MASK 0x1 FORMAT "%13.11" ECU_ADDRESS 0xFD60 /end MEASUREMENT
/begin MEASUREMENT B_riakv "Bedingung für Strom-Pumpen aktualisiert vor KAT" UWORD B_TRUE 1 100 0 1 BIT_MASK 0x2000 FORMAT "%13.11" ECU_ADDRESS 0xFD8E /end MEASUREMENT
/begin MEASUREMENT B_riakv2 "Bedingung für Strom-Pumpen aktualisiert vor KAT Bank2" UWORD B_TRUE 1 100 0 1 BIT_MASK 0x4000 FORMAT "%13.11" ECU_ADDRESS 0xFD8E /end MEASUREMENT
/begin MEASUREMENT B_ribeh "Bedingung Innenwiderstand Ri berechnen für Sonde hinter KAT" UWORD B_TRUE 1 100 0 1 BIT_MASK 0x2 FORMAT "%13.11" ECU_ADDRESS 0xFD60 /end MEASUREMENT
/begin MEASUREMENT B_ribeh2 "Bedingung Innenwiderstand Ri berechnen für Sonde hinter KAT Bank2" UWORD B_TRUE 1 100 0 1 BIT_MASK 0x4 FORMAT "%13.11" ECU_ADDRESS 0xFD60 /end MEASUREMENT
/begin MEASUREMENT B_ribev "Bedingung Innenwiderstand Ri berechnen für Sonde vor KAT" UWORD B_TRUE 1 100 0 1 BIT_MASK 0x8000 FORMAT "%13.11" ECU_ADDRESS 0xFD8E /end MEASUREMENT
/begin MEASUREMENT B_ribev2 "Bedingung Resultat für Innenwiderstand Ri für Sonde vor KAT Bank2" UWORD B_TRUE 1 100 0 1 BIT_MASK 0x1 FORMAT "%13.11" ECU_ADDRESS 0xFD90 /end MEASUREMENT
/begin MEASUREMENT B_riibh "Bedingung Sondenspannung im zulässigen Band für Strompumpen hinter KAT" UWORD B_TRUE 1 100 0 1 BIT_MASK 0x8 FORMAT "%13.11" ECU_ADDRESS 0xFD60 /end MEASUREMENT
/begin MEASUREMENT B_riibh2 "Bedingung Sondenspannung im zulässigen Band für Strompumpen hinter KAT Bank2" UWORD B_TRUE 1 100 0 1 BIT_MASK 0x10 FORMAT "%13.11" ECU_ADDRESS 0xFD60 /end MEASUREMENT
/begin MEASUREMENT B_riibv "Bedingung Sondenspannung im zulässigen Band für Strompumpen vor KAT" UWORD B_TRUE 1 100 0 1 BIT_MASK 0x2 FORMAT "%13.11" ECU_ADDRESS 0xFD90 /end MEASUREMENT
/begin MEASUREMENT B_riibv2 "Bedingung Sondenspannung im zulässigen Band für Strompumpen vor KAT Bank2" UWORD B_TRUE 1 100 0 1 BIT_MASK 0x4 FORMAT "%13.11" ECU_ADDRESS 0xFD90 /end MEASUREMENT
/begin MEASUREMENT B_riimph "Bedingung Impuls für Strom-Pumpen hinter KAT" UWORD B_TRUE 1 100 0 1 BIT_MASK 0x20 FORMAT "%13.11" ECU_ADDRESS 0xFD60 /end MEASUREMENT
/begin MEASUREMENT B_riimpv "Bedingung Impuls für Strom-Pumpen vor KAT" UWORD B_TRUE 1 100 0 1 BIT_MASK 0x8 FORMAT "%13.11" ECU_ADDRESS 0xFD90 /end MEASUREMENT
/begin MEASUREMENT B_rimh "Bedingung (ADC-Trigger) für Messen belastete Sondenspannung hinter KAT" UWORD B_TRUE 1 100 0 1 BIT_MASK 0x40 FORMAT "%13.11" ECU_ADDRESS 0xFD60 /end MEASUREMENT
/begin MEASUREMENT B_rimh2 "Bedingung (ADC-Trigger) für Messen belastete Sondenspannung hinter KAT Bank2" UWORD B_TRUE 1 100 0 1 BIT_MASK 0x80 FORMAT "%13.11" ECU_ADDRESS 0xFD60 /end MEASUREMENT
/begin MEASUREMENT B_rimv "Bedingung (ADC-Trigger) für Messen belastete Sondenspannung vor KAT" UWORD B_TRUE 1 100 0 1 BIT_MASK 0x10 FORMAT "%13.11" ECU_ADDRESS 0xFD90 /end MEASUREMENT
/begin MEASUREMENT B_rimv2 "Bedingung (ADC-Trigger) für Messen belastete Sondenspannung vor KAT Bank2" UWORD B_TRUE 1 100 0 1 BIT_MASK 0x20 FORMAT "%13.11" ECU_ADDRESS 0xFD90 /end MEASUREMENT
/begin MEASUREMENT B_rinh "Bedingung Innenwiderstand Ri-Messung der Nernstsonde aktiv hinter Kat" UWORD B_TRUE 1 100 0 1 BIT_MASK 0x100 FORMAT "%13.11" ECU_ADDRESS 0xFD60 /end MEASUREMENT
/begin MEASUREMENT B_rinh2 "Bedingung Innenwiderstand Ri-Messung der Nernstsonde aktiv hinter KAT Bank2" UWORD B_TRUE 1 100 0 1 BIT_MASK 0x200 FORMAT "%13.11" ECU_ADDRESS 0xFD60 /end MEASUREMENT
/begin MEASUREMENT B_rinv "Bedingung Innenwiderstand Ri-Messung der Nernstsonde aktiv vor Kat" UWORD B_TRUE 1 100 0 1 BIT_MASK 0x40 FORMAT "%13.11" ECU_ADDRESS 0xFD90 /end MEASUREMENT
/begin MEASUREMENT B_rinv2 "Bedingung Innenwiderstand Ri-Messung der Nernstsonde aktiv vor Kat Bank2" UWORD B_TRUE 1 100 0 1 BIT_MASK 0x80 FORMAT "%13.11" ECU_ADDRESS 0xFD90 /end MEASUREMENT
/begin MEASUREMENT B_ripuh "Bedingung Strom-Pumpen für Sonde hinter KAT" UWORD B_TRUE 1 100 0 1 BIT_MASK 0x400 FORMAT "%13.11" ECU_ADDRESS 0xFD60 /end MEASUREMENT
/begin MEASUREMENT B_ripuh2 "Bedingung Strom-Pumpen für Sonde hinter KAT Bank2" UWORD B_TRUE 1 100 0 1 BIT_MASK 0x800 FORMAT "%13.11" ECU_ADDRESS 0xFD60 /end MEASUREMENT
/begin MEASUREMENT B_ripuv "Bedingung Strom-Pumpen für Sonde vor KAT" UWORD B_TRUE 1 100 0 1 BIT_MASK 0x100 FORMAT "%13.11" ECU_ADDRESS 0xFD90 /end MEASUREMENT
/begin MEASUREMENT B_ripuv2 "Bedingung Strom-Pumpen für Sonde vor KAT Bank2" UWORD B_TRUE 1 100 0 1 BIT_MASK 0x200 FORMAT "%13.11" ECU_ADDRESS 0xFD90 /end MEASUREMENT
/begin MEASUREMENT B_rireh "Bedingung Resultat für Innenwiderstand Ri für Sonde hinter KAT" UWORD B_TRUE 1 100 0 1 BIT_MASK 0x1000 FORMAT "%13.11" ECU_ADDRESS 0xFD60 /end MEASUREMENT
/begin MEASUREMENT B_rireh2 "Bedingung Resultat für Innenwiderstand Ri für Sonde hinter KAT Bank2" UWORD B_TRUE 1 100 0 1 BIT_MASK 0x2000 FORMAT "%13.11" ECU_ADDRESS 0xFD60 /end MEASUREMENT
/begin MEASUREMENT B_rirev "Bedingung Resultat für Innenwiderstand Ri für Sonde vor KAT" UWORD B_TRUE 1 100 0 1 BIT_MASK 0x400 FORMAT "%13.11" ECU_ADDRESS 0xFD90 /end MEASUREMENT
/begin MEASUREMENT B_rirev2 "Bedingung Resultat für Innenwiderstand Ri für Sonde vor KAT Bank2" UWORD B_TRUE 1 100 0 1 BIT_MASK 0x800 FORMAT "%13.11" ECU_ADDRESS 0xFD90 /end MEASUREMENT
/begin MEASUREMENT B_risph "Bedingung Sondensprung hinter KAT" UWORD B_TRUE 1 100 0 1 BIT_MASK 0x4000 FORMAT "%13.11" ECU_ADDRESS 0xFD60 /end MEASUREMENT
/begin MEASUREMENT B_risph2 "Bedingung Sondensprung hinter KAT Bank2" UWORD B_TRUE 1 100 0 1 BIT_MASK 0x8000 FORMAT "%13.11" ECU_ADDRESS 0xFD60 /end MEASUREMENT
/begin MEASUREMENT B_rispv "Bedingung Sondensprung vor KAT" UWORD B_TRUE 1 100 0 1 BIT_MASK 0x1000 FORMAT "%13.11" ECU_ADDRESS 0xFD90 /end MEASUREMENT
/begin MEASUREMENT B_rispv2 "Bedingung Sondensprung vor KAT Bank2" UWORD B_TRUE 1 100 0 1 BIT_MASK 0x2000 FORMAT "%13.11" ECU_ADDRESS 0xFD90 /end MEASUREMENT
/begin MEASUREMENT B_sacvt "Bedingung Schubabschaltunterstützung für CVT-Getriebe" UWORD B_TRUE 1 100 0 1 BIT_MASK 0x4000 FORMAT "%13.11" ECU_ADDRESS 0xFD48 /end MEASUREMENT
/begin MEASUREMENT B_savfgr "Bedingung: Schubabschalteverbot durch FGR" UWORD B_TRUE 1 100 0 1 BIT_MASK 0x4 FORMAT "%13.11" ECU_ADDRESS 0xFD42 /end MEASUREMENT
/begin MEASUREMENT B_sbbhk "Bedingung Sonde betriebsbereit hinter Kat" UWORD B_TRUE 1 100 0 1 BIT_MASK 0x1 FORMAT "%13.11" ECU_ADDRESS 0xFD5A /end MEASUREMENT
/begin MEASUREMENT B_sbbhk2 "Bedingung Sonde betriebsbereit hinter Kat Bank2" UWORD B_TRUE 1 100 0 1 BIT_MASK 0x2 FORMAT "%13.11" ECU_ADDRESS 0xFD5A /end MEASUREMENT
/begin MEASUREMENT B_sbbvk "Bedingung Sonde betriebsbereit vor Kat" UWORD B_TRUE 1 100 0 1 BIT_MASK 0x10 FORMAT "%13.11" ECU_ADDRESS 0xFD3E /end MEASUREMENT
/begin MEASUREMENT B_sbbvk2 "Bedingung Sonde betriebsbereit vor Kat, Bank 2" UWORD B_TRUE 1 100 0 1 BIT_MASK 0x20 FORMAT "%13.11" ECU_ADDRESS 0xFD3E /end MEASUREMENT
/begin MEASUREMENT B_shuerf "Bedingung Sondenspannung hinter KAT erfassen" UWORD B_TRUE 1 100 0 1 BIT_MASK 0x80 FORMAT "%13.11" ECU_ADDRESS 0xFD50 /end MEASUREMENT
/begin MEASUREMENT B_shuerf2 "Bedingung Sondenspannung hinter KAT erfassen Bank2" UWORD B_TRUE 1 100 0 1 BIT_MASK 0x100 FORMAT "%13.11" ECU_ADDRESS 0xFD50 /end MEASUREMENT
/begin MEASUREMENT B_simflv "Bedingung MFL-Signal Timeout" UWORD B_TRUE 1 100 0 1 BIT_MASK 0x80 FORMAT "%13.11" ECU_ADDRESS 0xFD54 /end MEASUREMENT
/begin MEASUREMENT B_sls "Bedingung Sekundärluft aktiv" UWORD B_TRUE 1 100 0 1 BIT_MASK 0x800 FORMAT "%13.11" ECU_ADDRESS 0xFD2C /end MEASUREMENT
/begin MEASUREMENT B_sp1s "Mitteilung an SR: SP1S ist Führungsgröße." UWORD B_TRUE 1 100 0 1 BIT_MASK 0x2 FORMAT "%13.11" ECU_ADDRESS 0xFD58 /end MEASUREMENT
/begin MEASUREMENT B_sp2s "Mitteilung an SR:Poti2 SP2S Führungsgröße,Poti1 Ober-oder Untergrenze überschr." UWORD B_TRUE 1 100 0 1 BIT_MASK 0x4 FORMAT "%13.11" ECU_ADDRESS 0xFD58 /end MEASUREMENT
/begin MEASUREMENT B_spsmin "Mitteilung an SR: '1'= PWG-Notfahren mit SPSMIN" UWORD B_TRUE 1 100 0 1 BIT_MASK 0x8 FORMAT "%13.11" ECU_ADDRESS 0xFD58 /end MEASUREMENT
/begin MEASUREMENT B_st "Bedingung Start" UWORD B_TRUE 1 100 0 1 BIT_MASK 0x1 FORMAT "%13.11" ECU_ADDRESS 0xFD48 /end MEASUREMENT
/begin MEASUREMENT B_staebr "Bedingung Steckerabfall-Erkennung Bremse" UWORD B_TRUE 1 100 0 1 BIT_MASK 0x8 FORMAT "%13.11" ECU_ADDRESS 0xFD8A /end MEASUREMENT
/begin MEASUREMENT B_su "Bedingung Saugrohrumschaltung" UWORD B_TRUE 1 100 0 1 BIT_MASK 0x8000 FORMAT "%13.11" ECU_ADDRESS 0xFD48 /end MEASUREMENT
/begin MEASUREMENT B_svuerf "Bedingung Sondenspannung vor KAT erfassen" UWORD B_TRUE 1 100 0 1 BIT_MASK 0x4000 FORMAT "%13.11" ECU_ADDRESS 0xFD50 /end MEASUREMENT
/begin MEASUREMENT B_svuerf2 "Bedingung Sondenspannung vor KAT erfassen Bank2" UWORD B_TRUE 1 100 0 1 BIT_MASK 0x8000 FORMAT "%13.11" ECU_ADDRESS 0xFD50 /end MEASUREMENT
/begin MEASUREMENT B_synph "Bedingung Synchronisation Phase" UWORD B_TRUE 1 100 0 1 BIT_MASK 0x1 FORMAT "%13.11" ECU_ADDRESS 0xFD4A /end MEASUREMENT
/begin MEASUREMENT B_tal "Bedingung Tank leer bzw. Reserve" UWORD B_TRUE 1 100 0 1 BIT_MASK 0x40 FORMAT "%13.11" ECU_ADDRESS 0x38269A /end MEASUREMENT
/begin MEASUREMENT B_talval "Bedingung : Bit Tank leer gültig" UWORD B_TRUE 1 100 0 1 BIT_MASK 0x80 FORMAT "%13.11" ECU_ADDRESS 0x38269A /end MEASUREMENT
/begin MEASUREMENT B_tav "Bedingung Tank voll" UWORD B_TRUE 1 100 0 1 BIT_MASK 0x10 FORMAT "%13.11" ECU_ADDRESS 0x38269A /end MEASUREMENT
/begin MEASUREMENT B_tctoggel "" UWORD B_TRUE 1 100 0 1 BIT_MASK 0x100 FORMAT "%13.11" ECU_ADDRESS 0xFD54 /end MEASUREMENT
/begin MEASUREMENT B_te "Bedingung Tankentlüftung" UWORD B_TRUE 1 100 0 1 BIT_MASK 0x10 FORMAT "%13.11" ECU_ADDRESS 0xFD3A /end MEASUREMENT
/begin MEASUREMENT B_tei "Bedingung Tankentlüftung funktionsintern" UWORD B_TRUE 1 100 0 1 BIT_MASK 0x20 FORMAT "%13.11" ECU_ADDRESS 0xFD3A /end MEASUREMENT
/begin MEASUREMENT B_ten "Bedingung Tankentlüftung im Notlaufbetrieb (ohne Lambdaregelung)" UWORD B_TRUE 1 100 0 1 BIT_MASK 0x40 FORMAT "%13.11" ECU_ADDRESS 0xFD3A /end MEASUREMENT
/begin MEASUREMENT B_tmdmme "Bedingung Endtemperatur von Motortemperaturmodell erreicht" UBYTE B_TRUE 1 100 0 1 BIT_MASK 0x1 FORMAT "%13.11" ECU_ADDRESS 0x380C9E /end MEASUREMENT
/begin MEASUREMENT B_tmmn "Bedingung: Blockheater erkannt" UBYTE B_TRUE 1 100 0 1 BIT_MASK 0x8 FORMAT "%13.11" ECU_ADDRESS 0x380C9E /end MEASUREMENT
/begin MEASUREMENT B_tmsrt "Bedingung Retriggerung Motortemperaturmodell nach Start" UBYTE B_TRUE 1 100 0 1 BIT_MASK 0x4 FORMAT "%13.11" ECU_ADDRESS 0x380C9E /end MEASUREMENT
/begin MEASUREMENT B_tnaset "" UWORD B_TRUE 1 100 0 1 BIT_MASK 0x2 FORMAT "%13.11" ECU_ADDRESS 0xFD4A /end MEASUREMENT
/begin MEASUREMENT B_tpnt_aw "KR: Auswahl Nulltest oder Testimpuls" UWORD B_TRUE 1 100 0 1 BIT_MASK 0x4 FORMAT "%13.11" ECU_ADDRESS 0xFD40 /end MEASUREMENT
/begin MEASUREMENT B_tpnt_e "KR: Nulltest/Testimpuls freigegeben" UWORD B_TRUE 1 100 0 1 BIT_MASK 0x4 FORMAT "%13.11" ECU_ADDRESS 0xFD28 /end MEASUREMENT
/begin MEASUREMENT B_tumbk "" UBYTE B_TRUE 1 100 0 1 BIT_MASK 0x2 FORMAT "%13.11" ECU_ADDRESS 0x380CA8 /end MEASUREMENT
/begin MEASUREMENT B_upw12e "Bedingung: Fehler bei Vergleich der beiden normierten PWG-Poti-Spannungen" UWORD B_TRUE 1 100 0 1 BIT_MASK 0x10 FORMAT "%13.11" ECU_ADDRESS 0xFD58 /end MEASUREMENT
/begin MEASUREMENT B_upw1mn "Bedingung: Spannung PWG-Poti 1 unterhalb Minimalwert" UWORD B_TRUE 1 100 0 1 BIT_MASK 0x20 FORMAT "%13.11" ECU_ADDRESS 0xFD58 /end MEASUREMENT
/begin MEASUREMENT B_upw1mx "Bedingung: Spannung PWG-Poti 1 oberhalb Maximalwert" UWORD B_TRUE 1 100 0 1 BIT_MASK 0x40 FORMAT "%13.11" ECU_ADDRESS 0xFD58 /end MEASUREMENT
/begin MEASUREMENT B_upw2mn "Bedingung: Spannung PWG-Poti 2 unterhalb Minimalwert" UWORD B_TRUE 1 100 0 1 BIT_MASK 0x80 FORMAT "%13.11" ECU_ADDRESS 0xFD58 /end MEASUREMENT
/begin MEASUREMENT B_upw2mx "Bedingung: Spannung PWG-Poti 2 oberhalb Maximalwert" UWORD B_TRUE 1 100 0 1 BIT_MASK 0x100 FORMAT "%13.11" ECU_ADDRESS 0xFD58 /end MEASUREMENT
/begin MEASUREMENT B_upwbwf "Bewegungserkennung hat im aktuellen Fahrzyklus einen Fehler erkannt" UWORD B_TRUE 1 100 0 1 BIT_MASK 0x2000 FORMAT "%13.11" ECU_ADDRESS 0xFD3A /end MEASUREMENT
/begin MEASUREMENT B_upwg1o "Bedingung Bereichsverletzung an PWG-Poti 1 nach oben" UWORD B_TRUE 1 100 0 1 BIT_MASK 0x200 FORMAT "%13.11" ECU_ADDRESS 0xFD58 /end MEASUREMENT
/begin MEASUREMENT B_upwg1u "Bedingung Bereichsverletzung an PWG-Poti 1 nach unten" UWORD B_TRUE 1 100 0 1 BIT_MASK 0x400 FORMAT "%13.11" ECU_ADDRESS 0xFD58 /end MEASUREMENT
/begin MEASUREMENT B_upwg2o "Bedingung Bereichsverletzung an PWG-Poti 2 nach oben" UWORD B_TRUE 1 100 0 1 BIT_MASK 0x800 FORMAT "%13.11" ECU_ADDRESS 0xFD58 /end MEASUREMENT
/begin MEASUREMENT B_upwg2u "Bedingung Bereichsverletzung an PWG-Poti 2 nach unten" UWORD B_TRUE 1 100 0 1 BIT_MASK 0x1000 FORMAT "%13.11" ECU_ADDRESS 0xFD58 /end MEASUREMENT
/begin MEASUREMENT B_usbeh "Bedingung für Zeitzähler zur Ausblendung der Sondenbelastung hinter KAT" UWORD B_TRUE 1 100 0 1 BIT_MASK 0x1 FORMAT "%13.11" ECU_ADDRESS 0xFD62 /end MEASUREMENT
/begin MEASUREMENT B_usbeh2 "Bedingung für Zeitzähler zur Ausblendung der Sondenbelastung hinter KAT Bank2" UWORD B_TRUE 1 100 0 1 BIT_MASK 0x2 FORMAT "%13.11" ECU_ADDRESS 0xFD62 /end MEASUREMENT
/begin MEASUREMENT B_usbev "Bedingung für Zeitzähler zur Ausblendung der Sondenbelastung vor KAT" UWORD B_TRUE 1 100 0 1 BIT_MASK 0x4000 FORMAT "%13.11" ECU_ADDRESS 0xFD90 /end MEASUREMENT
/begin MEASUREMENT B_usbev2 "Bedingung für Zeitzähler zur Ausblendung der Sondenbelastung vor KAT Bank 2" UWORD B_TRUE 1 100 0 1 BIT_MASK 0x8000 FORMAT "%13.11" ECU_ADDRESS 0xFD90 /end MEASUREMENT
/begin MEASUREMENT B_vl "Bedingung Vollast" UWORD B_TRUE 1 100 0 1 BIT_MASK 0x8 FORMAT "%13.11" ECU_ADDRESS 0xFD48 /end MEASUREMENT
/begin MEASUREMENT B_vnull "Bedingung Fahrzeug steht" UWORD B_TRUE 1 100 0 1 BIT_MASK 0x8000 FORMAT "%13.11" ECU_ADDRESS 0xFD40 /end MEASUREMENT
/begin MEASUREMENT B_wdksap "DK-Steuerung über Festwert, Bit 1 hat Priorität" UWORD B_TRUE 1 100 0 1 BIT_MASK 0x4 FORMAT "%13.11" ECU_ADDRESS 0xFD4A /end MEASUREMENT
/begin MEASUREMENT B_wk "Bedingung: Wandlerkupplung überbrückt" UWORD B_TRUE 1 100 0 1 BIT_MASK 0x8 FORMAT "%13.11" ECU_ADDRESS 0xFD20 /end MEASUREMENT
/begin MEASUREMENT B_zwappl "Bedingung Zündwinkelapplikation ohne Drehmomenteingriffe" UWORD B_TRUE 1 100 0 1 BIT_MASK 0x8 FORMAT "%13.11" ECU_ADDRESS 0xFD4A /end MEASUREMENT
/begin MEASUREMENT cd_bits1_w "" UWORD dez 1 100 0 65535 FORMAT "%8.2" ECU_ADDRESS 0x38104A /end MEASUREMENT
/begin MEASUREMENT cd_bits2_w "" UWORD dez 1 100 0 65535 FORMAT "%8.2" ECU_ADDRESS 0x38104C /end MEASUREMENT
/begin MEASUREMENT ctrbwf "Fehlerzähler Bewegungserkennung" UBYTE dez 1 100 0 255 FORMAT "%5.1" ECU_ADDRESS 0x380A50 /end MEASUREMENT
/begin MEASUREMENT ctrerbr "Fehlerzähler für Bremsschalter-Plausibilisierung" UBYTE dez 1 100 0 255 FORMAT "%5.1" ECU_ADDRESS 0x380C60 /end MEASUREMENT
/begin MEASUREMENT devoff "EV-Ausblendmaske bei Testeranforderung" UBYTE dez 1 100 0 255 FORMAT "%5.1" ECU_ADDRESS 0x380B51 /end MEASUREMENT
/begin MEASUREMENT dkpstg_w "Steigung DK-Poti (% DK / V)" UWORD rel_uw_b40 1 100 0 39.9994 FORMAT "%8.5" ECU_ADDRESS 0xF88C /end MEASUREMENT
/begin MEASUREMENT dmlllmn_w "Reservemomentschwelle für Lufteingriffe" SWORD rel_sw_b100 1 100 -100 99.9969 FORMAT "%8.4" ECU_ADDRESS 0x381416 /end MEASUREMENT
/begin MEASUREMENT dmllrz_w "geforderte MD-Änderung von der LLR (PD-Zündungsanteil)" SWORD rel_sw_b100 1 100 -100 99.9969 FORMAT "%8.4" ECU_ADDRESS 0x381086 /end MEASUREMENT
/begin MEASUREMENT dmllr_w "geforderte Drehmomentänderung von der LLR (PD-Anteil)" SWORD rel_sw_b100 1 100 -100 99.9969 FORMAT "%8.4" ECU_ADDRESS 0x381088 /end MEASUREMENT
/begin MEASUREMENT dmrdsls_w "Momentenreserve für Diagnose Sekundärluft" UWORD rel_uw_b100 1 100 0 99.9985 FORMAT "%8.5" ECU_ADDRESS 0x382340 /end MEASUREMENT
/begin MEASUREMENT dmrkh "Momenten-Reserve für Katheizen" UBYTE rel_ub_b99p6 1 100 0 99.6094 FORMAT "%5.2" ECU_ADDRESS 0x380B5C /end MEASUREMENT
/begin MEASUREMENT dmrkhz_w "Momentenreserve für Katheizen" UWORD rel_uw_b100 1 100 0 99.9985 FORMAT "%8.5" ECU_ADDRESS 0x382342 /end MEASUREMENT
/begin MEASUREMENT dmrkh_w "Momentenreserve für Katheizen" UWORD rel_uw_b100 1 100 0 99.9985 FORMAT "%8.5" ECU_ADDRESS 0x382344 /end MEASUREMENT
/begin MEASUREMENT dmrkt_w "Momentenreserve im Kurztrip" UWORD rel_uw_b100 1 100 0 99.9985 FORMAT "%8.5" ECU_ADDRESS 0x381476 /end MEASUREMENT
/begin MEASUREMENT dmrllr_w "Momenten-Reserve für Leerlaufregelung" UWORD rel_q0p09726 1 100 0 6399.3 FORMAT "%8.3" ECU_ADDRESS 0x381418 /end MEASUREMENT
/begin MEASUREMENT drkwtmp_w "Momentenreserve für Kat warmhalten, zeitweise" UWORD rel_uw_b100 1 100 0 99.9985 FORMAT "%8.5" ECU_ADDRESS 0x382346 /end MEASUREMENT
/begin MEASUREMENT drlfue_w "Lastkorrektur des Füllungsreglers" SWORD rel_sw_q0p0234 1 100 -768 767.977 FORMAT "%8.4" ECU_ADDRESS 0x380090 /end MEASUREMENT
/begin MEASUREMENT dwped "Gradient des normierten Fahrpedalwinkels" SBYTE rel_sb_q0p39 1 100 -49.9968 49.6062 FORMAT "%5.2" ECU_ADDRESS 0x380A51 /end MEASUREMENT
/begin MEASUREMENT dwped_w "Gradient des normierten Fahrpedalwinkels" SWORD rel_sw_b50 1 100 -50 49.9985 FORMAT "%8.5" ECU_ADDRESS 0x3813B8 /end MEASUREMENT
/begin MEASUREMENT dzwnwsu "" SBYTE zw_sb_q0p75 1 100 -96 95.25 FORMAT "%5.2" ECU_ADDRESS 0x38008C /end MEASUREMENT
/begin MEASUREMENT dzwwl "Delta Zuendwinkel aus Warmlauf" SBYTE zw_sb_q0p75 1 100 -96 95.25 FORMAT "%5.2" ECU_ADDRESS 0x380A09 /end MEASUREMENT
/begin MEASUREMENT enwbas_w "" UWORD DEZL 1 100 0 65535 FORMAT "%8.2" ECU_ADDRESS 0x381040 /end MEASUREMENT
/begin MEASUREMENT esst_snm08koub "" UWORD rel_ub_b99p6 1 100 0 25599.6 FORMAT "%8.2" ECU_ADDRESS 0x38282A /end MEASUREMENT
/begin MEASUREMENT esst_snm16feuw "" UWORD dez 1 100 0 65535 FORMAT "%8.2" ECU_ADDRESS 0xE458 /end MEASUREMENT
/begin MEASUREMENT esst_snm16opuw "" UWORD dez 1 100 0 65535 FORMAT "%8.2" ECU_ADDRESS 0xE45A /end MEASUREMENT
/begin MEASUREMENT esst_snm16zuub "" UWORD dez 1 100 0 65535 FORMAT "%8.2" ECU_ADDRESS 0xE45C /end MEASUREMENT
/begin MEASUREMENT esst_snm24zuub "" UWORD dez 1 100 0 65535 FORMAT "%8.2" ECU_ADDRESS 0xE45E /end MEASUREMENT
/begin MEASUREMENT esst_srl03zuub "" UWORD dez 1 100 0 65535 FORMAT "%8.2" ECU_ADDRESS 0xE460 /end MEASUREMENT
/begin MEASUREMENT esst_srl12zuub "" UWORD dez 1 100 0 65535 FORMAT "%8.2" ECU_ADDRESS 0xE462 /end MEASUREMENT
/begin MEASUREMENT esst_srl16zuub "" UWORD dez 1 100 0 65535 FORMAT "%8.2" ECU_ADDRESS 0xE464 /end MEASUREMENT
/begin MEASUREMENT esst_swn10feub "" UWORD dez 1 100 0 65535 FORMAT "%8.2" ECU_ADDRESS 0xE466 /end MEASUREMENT
/begin MEASUREMENT esst_swp08opub "" UWORD dez 1 100 0 65535 FORMAT "%8.2" ECU_ADDRESS 0xE468 /end MEASUREMENT
/begin MEASUREMENT falrdkt "Anforderung Katdiagnose: Modifikation der Lambdregelungsamplitude" UBYTE fak_ub_b8 1 100 0 7.96875 FORMAT "%5.3" ECU_ADDRESS 0x380A19 /end MEASUREMENT
/begin MEASUREMENT fgru "Faktor Grundvorsteuerung" UBYTE fak_ub_b2 1 100 0 1.99219 FORMAT "%5.3" ECU_ADDRESS 0x380A49 /end MEASUREMENT
/begin MEASUREMENT fho_w "Korrekturfaktor Höhe (word)" UWORD fak_uw_b4 1 100 0 3.99994 FORMAT "%8.6" ECU_ADDRESS 0x38148E /end MEASUREMENT
/begin MEASUREMENT fkhfm "HFM-Korrekturfaktor" UBYTE fak_ub_b2 1 100 0 1.99219 FORMAT "%5.3" ECU_ADDRESS 0x38092C /end MEASUREMENT
/begin MEASUREMENT fks "Faktor Klopfschutz" UWORD fak_uw_b256 1 100 0 255.996 FORMAT "%7.3" ECU_ADDRESS 0x3811B6 /end MEASUREMENT
/begin MEASUREMENT flgtiab "Statusflag ti-Abschaltung bei kat.schädigenden Aussetzerraten" UBYTE dez 1 100 0 255 FORMAT "%5.1" ECU_ADDRESS 0x380A4A /end MEASUREMENT
/begin MEASUREMENT flr_ap "LR: Fettverschiebung durch TV-Verstellung mittels VS23" UBYTE dez 1 100 0 255 FORMAT "%5.1" ECU_ADDRESS 0x38008D /end MEASUREMENT
/begin MEASUREMENT fmkhfho_w "Höhenkorrektur der Drehmomentenreserve bei Katheizen" UWORD fak_uw_b2 1 100 0 1.99997 FORMAT "%8.6" ECU_ADDRESS 0x382348 /end MEASUREMENT
/begin MEASUREMENT fmkhtm "tmot-Korrektur der Drehmomentreserve bei Katheizen" UBYTE fak_ub_b2 1 100 0 1.99219 FORMAT "%5.3" ECU_ADDRESS 0x380CB2 /end MEASUREMENT
/begin MEASUREMENT fns "Faktor Nachstart" UBYTE fak_ub_b4 1 100 0 3.98438 FORMAT "%5.3" ECU_ADDRESS 0x380B03 /end MEASUREMENT
/begin MEASUREMENT fnwue "Gewichtungsfaktor Nockenwellenüberschneidung (Einlaß)" UBYTE fak_ub_b1 1 100 0 0.996094 ECU_ADDRESS 0x380949 /end MEASUREMENT
/begin MEASUREMENT fpuk "HFM-Korrekturfaktor im Pulsationsbereich" UBYTE fak_ub_b2 1 100 0 1.99219 FORMAT "%5.3" ECU_ADDRESS 0x38092D /end MEASUREMENT
/begin MEASUREMENT fpvdkds "Faktor Druck vor Drosselklappe von Drucksensor" UBYTE fak_ub_b4 1 100 0 3.98438 FORMAT "%5.3" ECU_ADDRESS 0x380A3A /end MEASUREMENT
/begin MEASUREMENT fpvdkds_w "Faktor Druck vor Drosselklappe von Drucksensor (word)" UWORD fak_uw_b4 1 100 0 3.99994 FORMAT "%8.6" ECU_ADDRESS 0x381490 /end MEASUREMENT
/begin MEASUREMENT frini2_w "Initialisierungswert für Regelfaktor Lambdaregelung, Bank 2" UWORD fak_uw_b2 1 100 0 1.99997 FORMAT "%8.6" ECU_ADDRESS 0x3811EE /end MEASUREMENT
/begin MEASUREMENT frini_w "Initialisierungswert für Regelfaktor Lambdaregelung" UWORD fak_uw_b2 1 100 0 1.99997 FORMAT "%8.6" ECU_ADDRESS 0x3811F0 /end MEASUREMENT
/begin MEASUREMENT frkte "Faktor Umrechnung rel. Kraftstoffmasse rk effekt. Einspritzzeit te" UBYTE rkti_sy 1 100 0 0.544 ECU_ADDRESS 0x380B02 /end MEASUREMENT
/begin MEASUREMENT fstadf_w "Tankfuellstand DT1-gefiltert" UWORD vol_q0p1_l 1 100 0 6553.5 FORMAT "%8.3" ECU_ADDRESS 0x382694 /end MEASUREMENT
/begin MEASUREMENT fstt "Fuellstand Kraftstofftank" UBYTE vol_q1_l 1 100 0 255 FORMAT "%5.1" ECU_ADDRESS 0x380D40 /end MEASUREMENT
/begin MEASUREMENT fsttaf_w "Tankfuellstand gefiltert" UWORD vol_q0p1_l 1 100 0 6553.5 FORMAT "%8.3" ECU_ADDRESS 0x382696 /end MEASUREMENT
/begin MEASUREMENT fsttval_w "Fuellstand Kraftstofftank validiert" UWORD vol_q0p1_l 1 100 0 6553.5 FORMAT "%8.3" ECU_ADDRESS 0x383EB8 /end MEASUREMENT
/begin MEASUREMENT fstt_w "Fuellstand Kraftstofftank" UWORD vol_q0p1_l 1 100 0 6553.5 FORMAT "%8.3" ECU_ADDRESS 0x382698 /end MEASUREMENT
/begin MEASUREMENT fst_w "Faktor Starteinspritzung" UWORD fak_uw_b64 1 100 0 63.999 FORMAT "%8.5" ECU_ADDRESS 0x381246 /end MEASUREMENT
/begin MEASUREMENT ftbr_w "Faktor Temperaturkorrektur im Brennraum" UWORD fak_uw_b2 1 100 0 1.99997 FORMAT "%8.6" ECU_ADDRESS 0x38148C /end MEASUREMENT
/begin MEASUREMENT ftsr "Korrekturfaktor Lufttemperatur im Saugrohr" UBYTE fak_ub_b2 1 100 0 1.99219 FORMAT "%5.3" ECU_ADDRESS 0xF85C /end MEASUREMENT
/begin MEASUREMENT ftvdk "Korrekturfaktor Temperatur vor Drosselklappe" UBYTE fak_ub_b2 1 100 0 1.99219 FORMAT "%5.3" ECU_ADDRESS 0xF85D /end MEASUREMENT
/begin MEASUREMENT fvst_w "Faktor Vorsteuerung" UWORD fak_uw_b64 1 100 0 63.999 FORMAT "%8.5" ECU_ADDRESS 0x38117C /end MEASUREMENT
/begin MEASUREMENT fwl "Faktor Warmlauf" UBYTE fak_ub_b2 1 100 0 1.99219 FORMAT "%5.3" ECU_ADDRESS 0x380B04 /end MEASUREMENT
/begin MEASUREMENT fwnw "Gemischfaktor Nockenwellenstellung" UBYTE fak_ub_b2 1 100 0 1.99219 FORMAT "%5.3" ECU_ADDRESS 0x380A0A /end MEASUREMENT
/begin MEASUREMENT gangi "Ist-Gang" UBYTE dez 1 100 0 255 FORMAT "%5.1" ECU_ADDRESS 0x380B05 /end MEASUREMENT
/begin MEASUREMENT GGFSTTBits "" UWORD dez 1 100 0 65535 FORMAT "%8.2" ECU_ADDRESS 0x38269A /end MEASUREMENT
/begin MEASUREMENT GGPEDnonVolbits "" UBYTE dez 1 100 0 255 FORMAT "%5.1" ECU_ADDRESS 0x382FDE /end MEASUREMENT
/begin MEASUREMENT GGTFMBits2 "" UBYTE dez 1 100 0 255 FORMAT "%5.1" ECU_ADDRESS 0x380C9E /end MEASUREMENT
/begin MEASUREMENT ggtfumgbits "" UBYTE dez 1 100 0 255 FORMAT "%5.1" ECU_ADDRESS 0x380CA8 /end MEASUREMENT
/begin MEASUREMENT gvtaf_w "freies Gasvolumen Kraftstofftank" UWORD vol_q0p1_l 1 100 0 6553.5 FORMAT "%8.3" ECU_ADDRESS 0x38269C /end MEASUREMENT
/begin MEASUREMENT igod_w "Integratorgradient für Nulltest-Diagnose Klopfregelung" SWORD spgg_sw_b3052 1 100 -3051.76 3051.67 FORMAT "%8.3" ECU_ADDRESS 0x381186 /end MEASUREMENT
/begin MEASUREMENT igokr_w "Integratorgradient für Offsetkorrektur Klopfregelung (Word)" SWORD spgg_sw_b3052 1 100 -3051.76 3051.67 FORMAT "%8.3" ECU_ADDRESS 0x381188 /end MEASUREMENT
/begin MEASUREMENT ikr "Integratorwert Klopfregelung offsetkorrigiert" UBYTE spg_ub_b5 1 100 0 4.98047 FORMAT "%5.3" ARRAY_SIZE 8 ECU_ADDRESS 0xF85E /end MEASUREMENT
/begin MEASUREMENT ikrma "Integratorwert Klopfregelung Meßfensteranfang" UBYTE spg_ub_b5 1 100 0 4.98047 FORMAT "%5.3" ECU_ADDRESS 0x38094F /end MEASUREMENT
/begin MEASUREMENT ikrme "Integratorwert Klopfregelung Meßfensterende" UBYTE spg_ub_b5 1 100 0 4.98047 FORMAT "%5.3" ARRAY_SIZE 8 ECU_ADDRESS 0xF866 /end MEASUREMENT
/begin MEASUREMENT ikrmen "Integratorwert Klopfregelung Meßfensterende Nulltest" UBYTE spg_ub_b5 1 100 0 4.98047 FORMAT "%5.3" ECU_ADDRESS 0x380950 /end MEASUREMENT
/begin MEASUREMENT ikrmet "Integratorwert Klopfregelung Meßfensterende Testimpuls" UBYTE spg_ub_b5 1 100 0 4.98047 FORMAT "%5.3" ECU_ADDRESS 0x380951 /end MEASUREMENT
/begin MEASUREMENT ikr_tst "Integratorwert Klopfregelung offsetkorregiert rollierend mit Zyl.zähler" UBYTE spg_ub_b5 1 100 0 4.98047 FORMAT "%5.3" ECU_ADDRESS 0x380952 /end MEASUREMENT
/begin MEASUREMENT iokkr "Integratoroffsetkorrektur Klopfregelung" UBYTE spg_ub_b5 1 100 0 4.98047 FORMAT "%5.3" ECU_ADDRESS 0x380953 /end MEASUREMENT
/begin MEASUREMENT jnwfl "Nummer der aktuellen NW-Flanke" UBYTE default 1 100 0 255 FORMAT "%5.1" ARRAY_SIZE 2 ECU_ADDRESS 0xE508 /end MEASUREMENT
/begin MEASUREMENT ks_sym "Eingang des Klopfauswerte-IC" UBYTE dez 1 100 0 255 FORMAT "%5.1" ARRAY_SIZE 4 ECU_ADDRESS 0xF86E /end MEASUREMENT
/begin MEASUREMENT lambas "Basis-Lambda" UBYTE fak_ub_b2 1 100 0 1.99219 FORMAT "%5.3" ECU_ADDRESS 0x380B00 /end MEASUREMENT
/begin MEASUREMENT lamnswl_w "Lambda-Motor-Soll für Nachstart und Warmlauf" UWORD fak_uw_b16 1 100 0 15.9998 FORMAT "%8.5" ECU_ADDRESS 0x3811D2 /end MEASUREMENT
/begin MEASUREMENT lamsbg2_w "Lambdasoll Begrenzung (word) Bank2" UWORD fak_uw_b16 1 100 0 15.9998 FORMAT "%8.5" ECU_ADDRESS 0x3811CA /end MEASUREMENT
/begin MEASUREMENT lamsbg_w "Lambdasoll Begrenzung (word)" UWORD fak_uw_b16 1 100 0 15.9998 FORMAT "%8.5" ECU_ADDRESS 0x3811CC /end MEASUREMENT
/begin MEASUREMENT lamsons2_w "Lambda-Sollwert bezogen auf Einbauort Lambda-Sensor Bank2" UWORD fak_uw_b16 1 100 0 15.9998 FORMAT "%8.5" ECU_ADDRESS 0x3811CE /end MEASUREMENT
/begin MEASUREMENT lamsons_w "Lambda-Sollwert bezogen auf Einbauort Lambda-Sensor" UWORD fak_uw_b16 1 100 0 15.9998 FORMAT "%8.5" ECU_ADDRESS 0x3811D0 /end MEASUREMENT
/begin MEASUREMENT L_fgr "Status FGR-Bereitschafts-Leuchte" UWORD B_TRUE 1 100 0 1 BIT_MASK 0x20 FORMAT "%13.11" ECU_ADDRESS 0xFD28 /end MEASUREMENT
/begin MEASUREMENT mdverl_w "Motor-Verlustmoment" UWORD rel_uw_b100 1 100 0 99.9985 FORMAT "%8.5" ECU_ADDRESS 0x3810D0 /end MEASUREMENT
/begin MEASUREMENT mflcnt "" UBYTE dez 1 100 0 255 FORMAT "%5.1" ECU_ADDRESS 0x380B3D /end MEASUREMENT
/begin MEASUREMENT mflroh "Rohdaten des MFL (serielle Daten in mflroh kopiert)" UBYTE dez 1 100 0 255 FORMAT "%5.1" ECU_ADDRESS 0x380B3E /end MEASUREMENT
/begin MEASUREMENT mflroh_a "" UBYTE dez 1 100 0 255 FORMAT "%5.1" ECU_ADDRESS 0x380B3F /end MEASUREMENT
/begin MEASUREMENT mflroh_n "" UBYTE dez 1 100 0 255 FORMAT "%5.1" ECU_ADDRESS 0x380B40 /end MEASUREMENT
/begin MEASUREMENT miasrl_w "Indiziertes Soll-Motormoment ASR für langsamen Eingriff" UWORD rel_uw_b100 1 100 0 99.9985 FORMAT "%8.5" ECU_ADDRESS 0x381028 /end MEASUREMENT
/begin MEASUREMENT miasrs_w "Indiziertes Soll-Motormoment ASR für schnellen Eingriff" UWORD rel_uw_b100 1 100 0 99.9985 FORMAT "%8.5" ECU_ADDRESS 0x38102A /end MEASUREMENT
/begin MEASUREMENT mibgr_w "indiziertes soll-Moment für gangabhängige Kupplungsmomentbegrenzung" UWORD rel_uw_b100 1 100 0 99.9985 FORMAT "%8.5" ECU_ADDRESS 0x3813D8 /end MEASUREMENT
/begin MEASUREMENT mifa "indiziertes Motormoment Fahrerwunsch" UBYTE rel_ub_b99p6 1 100 0 99.6094 FORMAT "%5.2" ECU_ADDRESS 0x380910 /end MEASUREMENT
/begin MEASUREMENT mifakh_w "indiziertes Motormoment für Katheizen" UWORD rel_uw_b100 1 100 0 99.9985 FORMAT "%8.5" ECU_ADDRESS 0x38234A /end MEASUREMENT
/begin MEASUREMENT mifal_w "Indiziertes Fahrerwunschmoment für Momentenkoordination Füllung" UWORD rel_uw_b100 1 100 0 99.9985 FORMAT "%8.5" ECU_ADDRESS 0x381478 /end MEASUREMENT
/begin MEASUREMENT mifa_w "indiziertes Motormoment Fahrerwunsch" UWORD rel_uw_b100 1 100 0 99.9985 FORMAT "%8.5" ECU_ADDRESS 0x38147A /end MEASUREMENT
/begin MEASUREMENT miges_w "Indiziertes Soll-Motormoment für Getriebeschutz" UWORD rel_uw_b100 1 100 0 99.9985 FORMAT "%8.5" ECU_ADDRESS 0x3813DA /end MEASUREMENT
/begin MEASUREMENT migs_w "Indiziertes Soll-Motormoment GS für schnellen Eingriff" UWORD rel_uw_b100 1 100 0 99.9985 FORMAT "%8.5" ECU_ADDRESS 0x38102E /end MEASUREMENT
/begin MEASUREMENT mimax_w "maximal erreichbares indiziertes Moment" UWORD rel_uw_b100 1 100 0 99.9985 FORMAT "%8.5" ECU_ADDRESS 0x381058 /end MEASUREMENT
/begin MEASUREMENT mimsr_w "Indiziertes Soll-Motormoment MSR" UWORD rel_uw_b100 1 100 0 99.9985 FORMAT "%8.5" ECU_ADDRESS 0x38102C /end MEASUREMENT
/begin MEASUREMENT miszul_w "Maximal zulässiges indiziertes Moment" UWORD rel_uw_b100 1 100 0 99.9985 FORMAT "%8.5" ECU_ADDRESS 0x38105A /end MEASUREMENT
/begin MEASUREMENT mivmx_w "Indiziertes Sollmoment der VMAX-Regelung" UWORD rel_uw_b100 1 100 0 99.9985 FORMAT "%8.5" ECU_ADDRESS 0x3813A4 /end MEASUREMENT
/begin MEASUREMENT mlhfma_w "Luftmassenabtastwert von HFM 16-Bit" UWORD m_uw_b6553p5 1 100 0 6553.5 FORMAT "%8.3" ECU_ADDRESS 0xF7A0 /end MEASUREMENT
/begin MEASUREMENT mlhfmm_w "Luftmassen HFM-Mittelwert 16Bit-Wert" UWORD m_uw_b6553p5 1 100 0 6553.5 FORMAT "%8.3" ECU_ADDRESS 0x38111C /end MEASUREMENT
/begin MEASUREMENT mrfamx_w "Relatives Fahrerwunschmoment Maximalwert" UWORD rel_uw_b200 1 100 0 199.997 FORMAT "%8.4" ECU_ADDRESS 0x38147C /end MEASUREMENT
/begin MEASUREMENT mrfa_w "Relatives Fahrerwunschmoment aus FGR und Pedal" UWORD rel_uw_b200 1 100 0 199.997 FORMAT "%8.4" ECU_ADDRESS 0x38147E /end MEASUREMENT
/begin MEASUREMENT mrfuemx_w "max. erreichbares rel. Fahrerwunschmoment für Pedalüberweg" UWORD rel_uw_b200 1 100 0 199.997 FORMAT "%8.4" ECU_ADDRESS 0x381480 /end MEASUREMENT
/begin MEASUREMENT mrfue_w "Relatives Fahrerwunschmoment im Pedalüberweg" UWORD rel_uw_b200 1 100 0 199.997 FORMAT "%8.4" ECU_ADDRESS 0x381482 /end MEASUREMENT
/begin MEASUREMENT mshfm_w "Massenstrom HFM 16-Bit Größe" UWORD m_uw_b6553p5 1 100 0 6553.5 FORMAT "%8.3" ECU_ADDRESS 0xFA12 /end MEASUREMENT
/begin MEASUREMENT nmotkor "Motordrehzahl ansaugluftkorrigiert (zur Pulsationskorrektur)" UBYTE nmot_ub_q40 1 100 0 10200 FORMAT "%5.0" ECU_ADDRESS 0x38092E /end MEASUREMENT
/begin MEASUREMENT nokatfz_flg "" UBYTE dez 1 100 0 255 FORMAT "%5.1" ECU_ADDRESS 0x38315E /end MEASUREMENT
/begin MEASUREMENT phlsnh "normierte Heizleistung der Lambdasonde hinter Kat" UBYTE fak_ub_q0p01 1 100 0 2.55 FORMAT "%5.3" ECU_ADDRESS 0x380A76 /end MEASUREMENT
/begin MEASUREMENT phlsnh2 "normierte Heizleistung der Lambdasonde 2 hinter Kat" UBYTE fak_ub_q0p01 1 100 0 2.55 FORMAT "%5.3" ECU_ADDRESS 0x380A77 /end MEASUREMENT
/begin MEASUREMENT phlsnv "normierte Heizleistung der Lambdasonde vor Kat" UBYTE fak_ub_q0p01 1 100 0 2.55 FORMAT "%5.3" ECU_ADDRESS 0x380A78 /end MEASUREMENT
/begin MEASUREMENT phlsnv2 "normierte Heizleistung der Lambdasonde 2 vor Kat" UBYTE fak_ub_q0p01 1 100 0 2.55 FORMAT "%5.3" ECU_ADDRESS 0x380A79 /end MEASUREMENT
/begin MEASUREMENT psagr_w "Partialdruck durch externes Restgas (Restluft+Inertgas)" UWORD p_uw_q0p039 1 100 0 2559.96 FORMAT "%8.3" ECU_ADDRESS 0x380092 /end MEASUREMENT
/begin MEASUREMENT pu_w "Umgebungsdruck" UWORD p_uw_q0p039 1 100 0 2559.96 FORMAT "%8.3" ECU_ADDRESS 0x381492 /end MEASUREMENT
/begin MEASUREMENT pvdkds_w "Druck vor Drosselklappe von Drucksensor (word)" UWORD p_uw_q0p039 1 100 0 2559.96 FORMAT "%8.3" ECU_ADDRESS 0x381494 /end MEASUREMENT
/begin MEASUREMENT rfstt "relativer Fuellstand Kraftstofftank" UBYTE rel_ub_b127p5 1 100 0 127.5 FORMAT "%5.1" ECU_ADDRESS 0x380D41 /end MEASUREMENT
/begin MEASUREMENT rgvtaf "relatives freies Gasvolumen Kraftstofftank" UBYTE rel_ub_b127p5 1 100 0 127.5 FORMAT "%5.1" ECU_ADDRESS 0x380D42 /end MEASUREMENT
/begin MEASUREMENT rinh2_w "Istwert (word) Innenwiderstand Ri-Nernstzelle der Lambdasonde hinter KAT Bank2" UWORD r_uw_q2 1 100 0 131070 FORMAT "%8.1" ECU_ADDRESS 0x380DD4 /end MEASUREMENT
/begin MEASUREMENT rinh_w "Istwert (word) Innenwiderstand Ri-Nernstzelle der Lambdasonde hinter KAT" UWORD r_uw_q2 1 100 0 131070 FORMAT "%8.1" ECU_ADDRESS 0x380DD6 /end MEASUREMENT
/begin MEASUREMENT rinofh2_w "Innenwiderstand (word) Ri Nernst ohne Filterung hinter KAT Bank2" UWORD r_uw_q2 1 100 0 131070 FORMAT "%8.1" ECU_ADDRESS 0x380DD8 /end MEASUREMENT
/begin MEASUREMENT rinofha2_w "Innenwiderstand (word) Ri Nernst (alter Wert) ohne Filterung hinter KAT Bank2" UWORD r_uw_q2 1 100 0 131070 FORMAT "%8.1" ECU_ADDRESS 0x380DDA /end MEASUREMENT
/begin MEASUREMENT rinofha_w "Innenwiderstand (word) Ri Nernst (alter Wert) ohne Filterung hinter KAT" UWORD r_uw_q2 1 100 0 131070 FORMAT "%8.1" ECU_ADDRESS 0x380DDC /end MEASUREMENT
/begin MEASUREMENT rinofh_w "Innenwiderstand (word) Ri Nernst ohne Filterung hinter KAT" UWORD r_uw_q2 1 100 0 131070 FORMAT "%8.1" ECU_ADDRESS 0x380DDE /end MEASUREMENT
/begin MEASUREMENT rinofv2_w "Innenwiderstand (word) Ri Nernst ohne Filterung vor KAT Bank2" UWORD r_uw_q2 1 100 0 131070 FORMAT "%8.1" ECU_ADDRESS 0x381FF4 /end MEASUREMENT
/begin MEASUREMENT rinofva2_w "Innenwiderstand (word) Ri Nernst (alter Wert) ohne Filterung vor KAT Bank2" UWORD r_uw_q2 1 100 0 131070 FORMAT "%8.1" ECU_ADDRESS 0x381FF6 /end MEASUREMENT
/begin MEASUREMENT rinofva_w "Innenwiderstand (word) Ri Nernst (alter Wert) ohne Filterung vor KAT" UWORD r_uw_q2 1 100 0 131070 FORMAT "%8.1" ECU_ADDRESS 0x381FF8 /end MEASUREMENT
/begin MEASUREMENT rinofv_w "Innenwiderstand (word) Ri Nernst ohne Filterung vor KAT" UWORD r_uw_q2 1 100 0 131070 FORMAT "%8.1" ECU_ADDRESS 0x381FFA /end MEASUREMENT
/begin MEASUREMENT rinv2_w "Istwert (word) Innenwiderstand Ri-Nernstzelle der Lambdasonde vor KAT Bank2" UWORD r_uw_q2 1 100 0 131070 FORMAT "%8.1" ECU_ADDRESS 0x381FFC /end MEASUREMENT
/begin MEASUREMENT rinv_w "Istwert (word) Innenwiderstand Ri-Nernstzelle der Lambdasonde vor KAT" UWORD r_uw_q2 1 100 0 131070 FORMAT "%8.1" ECU_ADDRESS 0x381FFE /end MEASUREMENT
/begin MEASUREMENT rk2_w "relative Kraftstoffmasse Bank2" UWORD rel_uw_b3072 1 100 0 3071.95 FORMAT "%8.3" ECU_ADDRESS 0xFA4E /end MEASUREMENT
/begin MEASUREMENT rkaco_w "Additive Korrektur der rel. Kraftstoffmasse für LL-CO einstellen" SWORD rel_sw_b1536 1 100 -1536 1535.95 FORMAT "%8.3" ECU_ADDRESS 0x3813DE /end MEASUREMENT
/begin MEASUREMENT rkkva2_w "relative Kraftstoffmasse (für Kraftstoff-Verbrauchs-Anzeige Bank 2)" UWORD rel_uw_b3072 1 100 0 3071.95 FORMAT "%8.3" ECU_ADDRESS 0x38117E /end MEASUREMENT
/begin MEASUREMENT rkkva_w "relative Kraftstoffmasse (für Kraftstoff-Verbrauchs-Anzeige Bank 1)" UWORD rel_uw_b3072 1 100 0 3071.95 FORMAT "%8.3" ECU_ADDRESS 0x381180 /end MEASUREMENT
/begin MEASUREMENT rk_w "relative Kraftstoffmasse" UWORD rel_uw_b3072 1 100 0 3071.95 FORMAT "%8.3" ECU_ADDRESS 0xFA50 /end MEASUREMENT
/begin MEASUREMENT rlmax_w "maximal erreichbare Füllung bei Turbo" UWORD rel_uw_q0p0234 1 100 0 1535.98 FORMAT "%8.3" ECU_ADDRESS 0x380094 /end MEASUREMENT
/begin MEASUREMENT sen_c95 "Klopfsensoreingang am Klopfauswerte-IC" UBYTE dezsub1 1 100 1 256 FORMAT "%5.1" ARRAY_SIZE 8 ECU_ADDRESS 0x380954 /end MEASUREMENT
/begin MEASUREMENT state_fgrhs "" UBYTE dez 1 100 0 255 FORMAT "%5.1" ECU_ADDRESS 0x380929 /end MEASUREMENT
/begin MEASUREMENT stat_md_e "CAN-Signal: Status Momenteneingriff" UBYTE dez 1 100 0 255 FORMAT "%5.1" ECU_ADDRESS 0x380B50 /end MEASUREMENT
/begin MEASUREMENT sumode "Zustand der Saugrohrumschaltung" UBYTE dez 1 100 0 255 FORMAT "%5.1" ECU_ADDRESS 0x38008E /end MEASUREMENT
/begin MEASUREMENT t1nwi_w "Zeit des Auftretens der NW-Flanke" UWORD tsquant 1 100 0 52428 FORMAT "%8.2" ARRAY_SIZE 2 ECU_ADDRESS 0xE438 /end MEASUREMENT
/begin MEASUREMENT t1tvi_w "Zeitpunkt des TV-Interrupts" UWORD tsquant 1 100 0 52428 FORMAT "%8.2" ARRAY_SIZE 2 ECU_ADDRESS 0x381002 /end MEASUREMENT
/begin MEASUREMENT tabgm "Abgastemperatur vor Kat aus Modell" UBYTE temp_ub_q5_o50 1 100 -50 1225 FORMAT "%5.0" ECU_ADDRESS 0x3809B2 /end MEASUREMENT
/begin MEASUREMENT tabgm2 "Abgastemperatur vor Kat aus Modell Bank2" UBYTE temp_ub_q5_o50 1 100 -50 1225 FORMAT "%5.0" ECU_ADDRESS 0x3809B3 /end MEASUREMENT
/begin MEASUREMENT tadtea "TEV-Tastverhältnis aus Tankentlüftungsdiagnose" UBYTE rel_ub_b100 1 100 0 100 FORMAT "%5.1" ECU_ADDRESS 0x380B3A /end MEASUREMENT
/begin MEASUREMENT tans "Ansaugluft - Temperatur" UBYTE temp_ub_q0p75_o48 1 100 -48 143.25 FORMAT "%5.1" ECU_ADDRESS 0x380A10 /end MEASUREMENT
/begin MEASUREMENT tansab "Ansauglufttemperatur beim Abstellen" UBYTE temp_ub_q0p75_o48 1 100 -48 143.25 FORMAT "%5.1" ECU_ADDRESS 0x383127 /end MEASUREMENT
/begin MEASUREMENT tanslin "Ansauglufttemperatur, linearisiert und umgerechnet" UBYTE temp_ub_q0p75_o48 1 100 -48 143.25 FORMAT "%5.1" ECU_ADDRESS 0x380C9D /end MEASUREMENT
/begin MEASUREMENT tdlrtm_w "Diagnosezeit für Überschreitung Motortemperaturschwelle für Lambda-Regelung" UWORD t100msxs_uw_b6553p5 1 100 0 6553.5 FORMAT "%8.3" ECU_ADDRESS 0x3822DA /end MEASUREMENT
/begin MEASUREMENT tfst2nq_dez "" UWORD dez 1 100 0 65535 FORMAT "%8.2" ECU_ADDRESS 0x38269E /end MEASUREMENT
/begin MEASUREMENT tfst2nq_w "Tankfuellstand mit Standard-Quantisierung Tank2" UWORD vol_q0p1_l 1 100 0 6553.5 FORMAT "%8.3" ECU_ADDRESS 0x3826A0 /end MEASUREMENT
/begin MEASUREMENT tfst2_dez "Dezimalwert von Fuellstandswert Tank 2" UWORD dez 1 100 0 65535 FORMAT "%8.2" ECU_ADDRESS 0x3826A2 /end MEASUREMENT
/begin MEASUREMENT tfstnf_w "Tankfuellstand nach Tiefpa?" UWORD vol_q0p1_l 1 100 0 6553.5 FORMAT "%8.3" ECU_ADDRESS 0x3826A4 /end MEASUREMENT
/begin MEASUREMENT tfstnq_dez "Dezimalwert der neuen Qunatisierung Fuellstandswert Tank 1" UWORD dez 1 100 0 65535 FORMAT "%8.2" ECU_ADDRESS 0x3826A6 /end MEASUREMENT
/begin MEASUREMENT tfstnq_w "Tankfuellstand mit Standard-Quantisierung" UWORD vol_q0p1_l 1 100 0 6553.5 FORMAT "%8.3" ECU_ADDRESS 0x3826A8 /end MEASUREMENT
/begin MEASUREMENT tfst_dez "Dezimalwert von Fuellstandswert Tank 1" UWORD dez 1 100 0 65535 FORMAT "%8.2" ECU_ADDRESS 0x3826AA /end MEASUREMENT
/begin MEASUREMENT tfst_w "Tankfuellstand" UWORD vol_q0p1_l 1 100 0 6553.5 FORMAT "%8.3" ECU_ADDRESS 0x3826AC /end MEASUREMENT
/begin MEASUREMENT thhaist "Auszeit für Sondenheizung hinter Kat" UBYTE t10msxs_ub_b2p55 1 100 0 2.55 FORMAT "%5.3" ECU_ADDRESS 0x3809DB /end MEASUREMENT
/begin MEASUREMENT thhaist2 "Auszeit für Sondenheizung2 hinter Kat" UBYTE t10msxs_ub_b2p55 1 100 0 2.55 FORMAT "%5.3" ECU_ADDRESS 0x3809DC /end MEASUREMENT
/begin MEASUREMENT thhat "unkorrigierte Ausschaltzeit der Sondenheizung hinter Kat" UBYTE t10msxs_q0p01_o0p05 1 100 -0.05 2.5 FORMAT "%5.3" ECU_ADDRESS 0x380A7A /end MEASUREMENT
/begin MEASUREMENT thhat2 "unkorrigierte Ausschaltzeit der Sondenheizung 2 hinter Kat" UBYTE t10msxs_q0p01_o0p05 1 100 -0.05 2.5 FORMAT "%5.3" ECU_ADDRESS 0x380A7B /end MEASUREMENT
/begin MEASUREMENT thvaist "Auszeit für Sondenheizung vor Kat" UBYTE t10msxs_ub_b2p55 1 100 0 2.55 FORMAT "%5.3" ECU_ADDRESS 0x3809DD /end MEASUREMENT
/begin MEASUREMENT thvaist2 "Auszeit für Sondenheizung2 vor Kat" UBYTE t10msxs_ub_b2p55 1 100 0 2.55 FORMAT "%5.3" ECU_ADDRESS 0x3809DE /end MEASUREMENT
/begin MEASUREMENT thvat "unkorrigierte Ausschaltzeit der Sondenheizung vor Kat" UBYTE t10msxs_q0p01_o0p05 1 100 -0.05 2.5 FORMAT "%5.3" ECU_ADDRESS 0x380A7C /end MEASUREMENT
/begin MEASUREMENT thvat2 "unkorrigierte Ausschaltzeit der Sondenheizung 2 vor Kat" UBYTE t10msxs_q0p01_o0p05 1 100 -0.05 2.5 FORMAT "%5.3" ECU_ADDRESS 0x380A7D /end MEASUREMENT
/begin MEASUREMENT tka "Temperatur Motorkühlerausgang (Kühlmittel)" UBYTE temp_ub_q0p75_o48 1 100 -48 143.25 FORMAT "%5.1" ECU_ADDRESS 0x380CA5 /end MEASUREMENT
/begin MEASUREMENT tkalin "Temperatur Kühlerausgang linearisiert und umgerechnet" UBYTE temp_ub_q0p75_o48 1 100 -48 143.25 FORMAT "%5.1" ECU_ADDRESS 0x380CA6 /end MEASUREMENT
/begin MEASUREMENT tkatm "Katalysatortemperatur aus Modell" UBYTE temp_ub_q5_o50 1 100 -50 1225 FORMAT "%5.0" ECU_ADDRESS 0x3809B4 /end MEASUREMENT
/begin MEASUREMENT tkatm2 "Katalysatortemperatur aus Modell,  Bank2" UBYTE temp_ub_q5_o50 1 100 -50 1225 FORMAT "%5.0" ECU_ADDRESS 0x3809B5 /end MEASUREMENT
/begin MEASUREMENT tmew "Motortemperatur-Ersatzwert aus Modell" UBYTE temp_ub_q0p75_o48 1 100 -48 143.25 FORMAT "%5.1" ECU_ADDRESS 0x380C9F /end MEASUREMENT
/begin MEASUREMENT tmewab "Motortemperatur-Ersatzwert aus Modell beim Abstellen" UBYTE temp_ub_q0p75_o48 1 100 -48 143.25 FORMAT "%5.1" ECU_ADDRESS 0x383128 /end MEASUREMENT
/begin MEASUREMENT tmfa_w "Meßfensteranfang Klopfregelung" UWORD tknockcon_sy 1 100 0 0.209712 FORMAT "%9.7" ECU_ADDRESS 0x38118A /end MEASUREMENT
/begin MEASUREMENT tmflb "Zeit Multifunktionslenkrad betätigt (unbetätigt)" UBYTE t20msxs_ub_b5p1 1 100 0 5.1 FORMAT "%5.3" ECU_ADDRESS 0x38092A /end MEASUREMENT
/begin MEASUREMENT tmflbe_ctr "Timer für MFL-Timeout" UBYTE t10msxs_ub_b2p55 1 100 0 2.55 FORMAT "%5.3" ECU_ADDRESS 0x380B41 /end MEASUREMENT
/begin MEASUREMENT tmflfqe_ctr "" UBYTE t10msxs_ub_b2p55 1 100 0 2.55 FORMAT "%5.3" ECU_ADDRESS 0x380B42 /end MEASUREMENT
/begin MEASUREMENT tmfln_w "Meßfensterlänge Klopfregelung Nulltest" UWORD tknockcon_sy 1 100 0 0.209712 FORMAT "%9.7" ECU_ADDRESS 0x38118C /end MEASUREMENT
/begin MEASUREMENT tmfltc_ctr "Timer für Toggelbitcheck" UBYTE t10msxs_ub_b2p55 1 100 0 2.55 FORMAT "%5.3" ECU_ADDRESS 0x380B43 /end MEASUREMENT
/begin MEASUREMENT tmfl_w "Meßfensterlänge Klopfregelung" UWORD tknockcon_sy 1 100 0 0.209712 FORMAT "%9.7" ECU_ADDRESS 0x38118E /end MEASUREMENT
/begin MEASUREMENT tmot "Motor-Temperatur" UBYTE temp_ub_q0p75_o48 1 100 -48 143.25 FORMAT "%5.1" ECU_ADDRESS 0x380A1A /end MEASUREMENT
/begin MEASUREMENT tmotab "Motortemperatur beim Abstellen" UBYTE temp_ub_q0p75_o48 1 100 -48 143.25 FORMAT "%5.1" ECU_ADDRESS 0x383129 /end MEASUREMENT
/begin MEASUREMENT tmotlin "Motortemperatur, linearisiert und umgerechnet" UBYTE temp_ub_q0p75_o48 1 100 -48 143.25 FORMAT "%5.1" ECU_ADDRESS 0x380CA0 /end MEASUREMENT
/begin MEASUREMENT tmotvt "Motortemperatur vor Tiefpaßfilter" UBYTE temp_ub_q0p75_o48 1 100 -48 143.25 FORMAT "%5.1" ECU_ADDRESS 0x380CA1 /end MEASUREMENT
/begin MEASUREMENT tmrw "Motortemperatur-Referenzwert aus Modell" UBYTE temp_ub_q0p75_o48 1 100 -48 143.25 FORMAT "%5.1" ECU_ADDRESS 0x380CA2 /end MEASUREMENT
/begin MEASUREMENT tmrwend "Endwert für Referenzwert Motortemperatur-Modell" UBYTE temp_ub_q0p75_o48 1 100 -48 143.25 FORMAT "%5.1" ECU_ADDRESS 0x380CA3 /end MEASUREMENT
/begin MEASUREMENT tmst "Motorstarttemperatur" UBYTE temp_ub_q0p75_o48 1 100 -48 143.25 FORMAT "%5.1" ECU_ADDRESS 0x380A1B /end MEASUREMENT
/begin MEASUREMENT tnst_w "Zeit nach Startende" UWORD t10msxs_uw_b655p35 1 100 0 655.35 FORMAT "%8.4" ECU_ADDRESS 0x3813DC /end MEASUREMENT
/begin MEASUREMENT tpnt_aktiv "Aktivierung von KR-Funktionen" UBYTE dez 1 100 0 255 FORMAT "%5.1" ECU_ADDRESS 0x38095C /end MEASUREMENT
/begin MEASUREMENT tsg "Steuergerätetemperatur" UBYTE temp_ub_q0p75_o48 1 100 -48 143.25 FORMAT "%5.1" ECU_ADDRESS 0x380CA7 /end MEASUREMENT
/begin MEASUREMENT tumg "Umgebungstemperatur" UBYTE temp_ub_q0p75_o48 1 100 -48 143.25 FORMAT "%5.1" ECU_ADDRESS 0x380CA9 /end MEASUREMENT
/begin MEASUREMENT tumginp "" UBYTE temp_ub_q0p75_o48 1 100 -48 143.25 FORMAT "%5.1" ECU_ADDRESS 0x380CA4 /end MEASUREMENT
/begin MEASUREMENT tumgta "Umgebungstemperatur aus Ansauglufttemperatur" UBYTE temp_ub_q0p75_o48 1 100 -48 143.25 FORMAT "%5.1" ECU_ADDRESS 0x38312A /end MEASUREMENT
/begin MEASUREMENT tvlrh "LRHK: Korrekturwert für verzögerte Reglerumschaltung tv" SBYTE t100msxs_sb_q0p01 1 100 -1.28 1.27 FORMAT "%5.3" ECU_ADDRESS 0x3809BC /end MEASUREMENT
/begin MEASUREMENT tvlrh2 "LRHK: Korrekturwert für verzögerte Reglerumschaltung tv 2" SBYTE t100msxs_sb_q0p01 1 100 -1.28 1.27 FORMAT "%5.3" ECU_ADDRESS 0x3809BD /end MEASUREMENT
/begin MEASUREMENT tvlrhi "I-Anteil für verzögerte Reglerumschaltung tv, gewichtet" SBYTE t100msxs_sb_q0p01 1 100 -1.28 1.27 FORMAT "%5.3" ECU_ADDRESS 0x3809BE /end MEASUREMENT
/begin MEASUREMENT tvlrhi2 "Bank2: I-Anteil für verzögerte Reglerumschaltung tv, gewichtet" SBYTE t100msxs_sb_q0p01 1 100 -1.28 1.27 FORMAT "%5.3" ECU_ADDRESS 0x3809BF /end MEASUREMENT
/begin MEASUREMENT tvu_w "Batteriespannungskorrektur" UWORD tinjection_sy 1 100 0 209.712 FORMAT "%8.4" ECU_ADDRESS 0x3811B8 /end MEASUREMENT
/begin MEASUREMENT UADKI "eingelesener Integratorwert von Klopfauswerteschaltung" UWORD dez 1 100 0 65535 FORMAT "%8.2" ECU_ADDRESS 0xF876 /end MEASUREMENT
/begin MEASUREMENT ub "Batteriespannung" UBYTE spg_ubatt 1 100 0 24.021 FORMAT "%5.2" ECU_ADDRESS 0x380A0B /end MEASUREMENT
/begin MEASUREMENT ubsq "Bordnetzspannung, umgerechnet in Standard-Quantisierung" UBYTE spg_q0p1 1 100 0 25.5 FORMAT "%5.2" ECU_ADDRESS 0x380C45 /end MEASUREMENT
/begin MEASUREMENT ubsqf "Bordnetzspannung, umgerechnet in Standard-Quantisierung und gefiltert" UBYTE spg_q0p1 1 100 0 25.5 FORMAT "%5.2" ECU_ADDRESS 0x380C46 /end MEASUREMENT
/begin MEASUREMENT ubsqf_w "Bordnetzspannung, umgerechnet in Standard-Quantisierung und gefiltert" UWORD spg_q0p00039 1 100 0 25.5996 FORMAT "%8.5" ECU_ADDRESS 0x382056 /end MEASUREMENT
/begin MEASUREMENT ubsq_w "Bordnetzspannung, umgerechnet in Standard-Quantisierung" UWORD spg_q0p00039 1 100 0 25.5996 FORMAT "%8.5" ECU_ADDRESS 0x382058 /end MEASUREMENT
/begin MEASUREMENT udkp1a_w "Spannung DK-Poti 1 am unteren Anschlag" UWORD spg_uw_q0p001222 1 100 0 80.0838 FORMAT "%8.5" ECU_ADDRESS 0xF88E /end MEASUREMENT
/begin MEASUREMENT udkp1sv "Maximalwert DK-Poti 1 für Verwendung des verstärkten Signals" UBYTE spg_ub_b5 1 100 0 4.98047 FORMAT "%5.3" ECU_ADDRESS 0xF850 /end MEASUREMENT
/begin MEASUREMENT udkp1vo_w "Spannungsoffset Verstärker DK-Poti 1" SWORD spg_sw_q0p001222 1 100 -40.0425 40.0413 FORMAT "%8.5" ECU_ADDRESS 0xF890 /end MEASUREMENT
/begin MEASUREMENT udkp1vv_w "Verstärkung DK-Poti 1" UWORD fak_q0p0039 1 100 0 255.996 FORMAT "%8.4" ECU_ADDRESS 0xF892 /end MEASUREMENT
/begin MEASUREMENT udkp2a_w "Spannung DK-Poti 2 am unteren Anschlag" UWORD spg_uw_q0p001222 1 100 0 80.0838 FORMAT "%8.5" ECU_ADDRESS 0xF894 /end MEASUREMENT
/begin MEASUREMENT upw2ll_w "Spannungswert von PWG-Poti 2 vor der Bewegung" UWORD spg_uw_q0p00488 1 100 0 319.995 FORMAT "%8.4" ECU_ADDRESS 0x38301A /end MEASUREMENT
/begin MEASUREMENT upwg1_w "Spannung PWG-Poti 1 (Word)" UWORD spg_uw_b5 1 100 0 319.995 FORMAT "%8.4" ECU_ADDRESS 0x3813D4 /end MEASUREMENT
/begin MEASUREMENT upwg2d_w "Verdoppelte PWG-Poti-2-Spannung (Word)" UWORD spg_uw_q0p00488 1 100 0 319.995 FORMAT "%8.4" ECU_ADDRESS 0x3813BA /end MEASUREMENT
/begin MEASUREMENT upwg2fil_w "Gefilterte Poti 2 Spannung" UWORD spg_uw_q0p00488 1 100 0 319.995 FORMAT "%8.4" ECU_ADDRESS 0x3813BC /end MEASUREMENT
/begin MEASUREMENT upwg2_w "Spannung PWG-Poti 2 (Word)" UWORD spg_uw_b5 1 100 0 319.995 FORMAT "%8.4" ECU_ADDRESS 0x3813D6 /end MEASUREMENT
/begin MEASUREMENT upwgej_w "Entjitterte PWG-Poti-Spannung" UWORD spg_uw_q0p00488 1 100 0 319.995 FORMAT "%8.4" ECU_ADDRESS 0x3813BE /end MEASUREMENT
/begin MEASUREMENT upwg_w "Resultierende PWG-Poti-Spannung nach Plausibilitätsprüfung" UWORD spg_uw_q0p00488 1 100 0 319.995 FORMAT "%8.4" ECU_ADDRESS 0x3813C0 /end MEASUREMENT
/begin MEASUREMENT usbeh2_w "Spannung (word) Lambdasonde mit Widerstand belastet hinter KAT Bank2" UWORD spg_uw_q0p00488_o1 1 100 -1 318.995 FORMAT "%8.4" ECU_ADDRESS 0x380DE0 /end MEASUREMENT
/begin MEASUREMENT usbeh_w "Spannung (word) Lambdasonde mit Widerstand belastet hinter KAT" UWORD spg_uw_q0p00488_o1 1 100 -1 318.995 FORMAT "%8.4" ECU_ADDRESS 0x380DE2 /end MEASUREMENT
/begin MEASUREMENT usbev2_w "Spannung (word) Lambdasonde mit Widerstand belastet vor KAT Bank2" UWORD spg_uw_q0p00488_o1 1 100 -1 318.995 FORMAT "%8.4" ECU_ADDRESS 0x382000 /end MEASUREMENT
/begin MEASUREMENT usbev_w "Spannung (word) Lambdasonde mit Widerstand belastet vor KAT" UWORD spg_uw_q0p00488_o1 1 100 -1 318.995 FORMAT "%8.4" ECU_ADDRESS 0x382002 /end MEASUREMENT
/begin MEASUREMENT ushb2_w "Spannung (word) Lambdasonde mit Widerstand belastet hinter KAT Bank2" UWORD spg_uw_q0p00488_o1 1 100 -1 318.995 FORMAT "%8.4" ECU_ADDRESS 0x380DE4 /end MEASUREMENT
/begin MEASUREMENT ushb_w "Spannung (word) Lambdasonde mit Widerstand belastet hinter KAT" UWORD spg_uw_q0p00488_o1 1 100 -1 318.995 FORMAT "%8.4" ECU_ADDRESS 0x380DE6 /end MEASUREMENT
/begin MEASUREMENT ushk "Spannung Lambdasonde hinter Katalysator" UBYTE spg_ub_q0p0052_o0p2 1 100 -0.2 1.13 FORMAT "%5.3" ECU_ADDRESS 0x380B45 /end MEASUREMENT
/begin MEASUREMENT ushk2 "Spannung Lambdasonde hinter Katalysator 2" UBYTE spg_ub_q0p0052_o0p2 1 100 -0.2 1.13 FORMAT "%5.3" ECU_ADDRESS 0x380B46 /end MEASUREMENT
/begin MEASUREMENT ushk2_w "Spannung Lambdasonde (4.88mV/LSB) hinter Katalysator 2" UWORD spg_uw_q0p00488_o1 1 100 -1 318.995 FORMAT "%8.4" ECU_ADDRESS 0x380DE8 /end MEASUREMENT
/begin MEASUREMENT ushkr2_w "Spannung (word) Lambdasonde Rohwert hinter KAT Bank2" UWORD spg_uw_q0p00488_o1 1 100 -1 318.995 FORMAT "%8.4" ECU_ADDRESS 0x380DEA /end MEASUREMENT
/begin MEASUREMENT ushkr_w "Spannung (word) Lambdasonde Rohwert hinter KAT Bank2" UWORD spg_uw_q0p00488_o1 1 100 -1 318.995 FORMAT "%8.4" ECU_ADDRESS 0x380DEC /end MEASUREMENT
/begin MEASUREMENT ushk_w "Spannung Lambdasonde (4.88mV/LSB) hinter Katalysator" UWORD spg_uw_q0p00488_o1 1 100 -1 318.995 FORMAT "%8.4" ECU_ADDRESS 0x380DEE /end MEASUREMENT
/begin MEASUREMENT ushmb2_w "Spannung (word,10 ms-Raster) Lambdasonde mit Widerst. belastet hinter KAT Bank2" UWORD spg_uw_q0p00488_o1 1 100 -1 318.995 FORMAT "%8.4" ECU_ADDRESS 0x380DF0 /end MEASUREMENT
/begin MEASUREMENT ushmb_w "Spannung (word, 10 ms-Raster) Lambdasonde mit Widerstand belastet hinter KAT" UWORD spg_uw_q0p00488_o1 1 100 -1 318.995 FORMAT "%8.4" ECU_ADDRESS 0x380DF2 /end MEASUREMENT
/begin MEASUREMENT ushob2_w "Spannung (word, 10 ms-Raster) Lambdasonde ohne Belastung hinter KAT Bank2" UWORD spg_uw_q0p00488_o1 1 100 -1 318.995 FORMAT "%8.4" ECU_ADDRESS 0x380DF4 /end MEASUREMENT
/begin MEASUREMENT ushob_w "Spannung (word, 10 ms-Raster) Lambdasonde ohne Belastung hinter KAT" UWORD spg_uw_q0p00488_o1 1 100 -1 318.995 FORMAT "%8.4" ECU_ADDRESS 0x380DF6 /end MEASUREMENT
/begin MEASUREMENT usobh2_w "Spannung (word) Lambdasonde ohne Belastung hinter KAT Bank2" UWORD spg_uw_q0p00488_o1 1 100 -1 318.995 FORMAT "%8.4" ECU_ADDRESS 0x380DF8 /end MEASUREMENT
/begin MEASUREMENT usobh_w "Spannung (word) Lambdasonde ohne Belastung hinter KAT" UWORD spg_uw_q0p00488_o1 1 100 -1 318.995 FORMAT "%8.4" ECU_ADDRESS 0x380DFA /end MEASUREMENT
/begin MEASUREMENT usobv2_w "Spannung (word) Lambdasonde ohne Belastung vor KAT Bank2" UWORD spg_uw_q0p00488_o1 1 100 -1 318.995 FORMAT "%8.4" ECU_ADDRESS 0x382004 /end MEASUREMENT
/begin MEASUREMENT usobv_w "Spannung (word) Lambdasonde ohne Belastung vor KAT" UWORD spg_uw_q0p00488_o1 1 100 -1 318.995 FORMAT "%8.4" ECU_ADDRESS 0x382006 /end MEASUREMENT
/begin MEASUREMENT usrhk "aktuelle Regelschwelle Lambdasignal h.K." UBYTE spg_ub_q0p0052_o0p2 1 100 -0.2 1.13 FORMAT "%5.3" ECU_ADDRESS 0x3809C0 /end MEASUREMENT
/begin MEASUREMENT usrhk2 "aktuelle Regelschwelle Lambdasignal h.K., Bank 2" UBYTE spg_ub_q0p0052_o0p2 1 100 -0.2 1.13 FORMAT "%5.3" ECU_ADDRESS 0x3809C1 /end MEASUREMENT
/begin MEASUREMENT usvb2_w "Spannung (word) Lambdasonde mit Widerstand belastet vor KAT" UWORD spg_uw_q0p00488_o1 1 100 -1 318.995 FORMAT "%8.4" ECU_ADDRESS 0x382008 /end MEASUREMENT
/begin MEASUREMENT usvb_w "Spannung (word) Lambdasonde mit Widerstand belastet vor KAT" UWORD spg_uw_q0p00488_o1 1 100 -1 318.995 FORMAT "%8.4" ECU_ADDRESS 0x38200A /end MEASUREMENT
/begin MEASUREMENT usvk "Spannung Lambdasonde vor Kat" UBYTE spg_ub_q0p0052_o0p2 1 100 -0.2 1.13 FORMAT "%5.3" ECU_ADDRESS 0x380B3B /end MEASUREMENT
/begin MEASUREMENT usvk2 "Spannung Lambdasonde vor Kat 2" UBYTE spg_ub_q0p0052_o0p2 1 100 -0.2 1.13 FORMAT "%5.3" ECU_ADDRESS 0x380B3C /end MEASUREMENT
/begin MEASUREMENT usvk2_w "Spannung Lambdasonde (4.88mV/LSB) vor Kat 2" UWORD spg_uw_q0p00488_o1 1 100 -1 318.995 FORMAT "%8.4" ECU_ADDRESS 0x38200C /end MEASUREMENT
/begin MEASUREMENT usvkr2_w "Spannung (word) Lambdasonde Rohwert vor KAT Bank2" UWORD spg_uw_q0p00488_o1 1 100 -1 318.995 FORMAT "%8.4" ECU_ADDRESS 0x38200E /end MEASUREMENT
/begin MEASUREMENT usvkr_w "Spannung (word) Lambdasonde Rohwert vor Kat" UWORD spg_uw_q0p00488_o1 1 100 -1 318.995 FORMAT "%8.4" ECU_ADDRESS 0x382010 /end MEASUREMENT
/begin MEASUREMENT usvk_w "Spannung Lambdasonde (4.88mV/LSB) vor Kat" UWORD spg_uw_q0p00488_o1 1 100 -1 318.995 FORMAT "%8.4" ECU_ADDRESS 0x382012 /end MEASUREMENT
/begin MEASUREMENT usvmb2_w "Spannung (word, 10 ms-Raster) Lambdasonde mit Widerstand belastet vor KAT Bank2" UWORD spg_uw_q0p00488_o1 1 100 -1 318.995 FORMAT "%8.4" ECU_ADDRESS 0x382014 /end MEASUREMENT
/begin MEASUREMENT usvmb_w "Spannung (word, 10 ms-Raster) Lambdasonde mit Widerstand belastet vor KAT" UWORD spg_uw_q0p00488_o1 1 100 -1 318.995 FORMAT "%8.4" ECU_ADDRESS 0x382016 /end MEASUREMENT
/begin MEASUREMENT usvob2_w "Spannung (word, 10 ms-Raster) Lambdasonde ohne Belastung vor KAT Bank2" UWORD spg_uw_q0p00488_o1 1 100 -1 318.995 FORMAT "%8.4" ECU_ADDRESS 0x382018 /end MEASUREMENT
/begin MEASUREMENT usvob_w "Spannung (word, 10 ms-Raster) Lambdasonde ohne Belastung vor KAT" UWORD spg_uw_q0p00488_o1 1 100 -1 318.995 FORMAT "%8.4" ECU_ADDRESS 0x38201A /end MEASUREMENT
/begin MEASUREMENT uushmb2_w "Spannung (word,1 ms-Raster) Lambdasonde mit Widerstand belastet hinter KAT Bank2" UWORD spg_uw_q0p00488 1 100 0 319.995 FORMAT "%8.4" ECU_ADDRESS 0xFA56 /end MEASUREMENT
/begin MEASUREMENT uushmb_w "Spannung (word, 1 ms-Raster) Lambdasonde mit Widerstand belastet hinter KAT" UWORD spg_uw_q0p00488 1 100 0 319.995 FORMAT "%8.4" ECU_ADDRESS 0xFA58 /end MEASUREMENT
/begin MEASUREMENT uushob2_w "ADC-Spannung (word, 1 ms-Raster) Sonde ohne Belastung hinter Katalysator Bank2" UWORD spg_uw_q0p00488 1 100 0 319.995 FORMAT "%8.4" ECU_ADDRESS 0xFA5A /end MEASUREMENT
/begin MEASUREMENT uushob_w "ADC-Spannung (word, 1 ms-Raster) Sonde ohne Belastung hinter Katalysator" UWORD spg_uw_q0p00488 1 100 0 319.995 FORMAT "%8.4" ECU_ADDRESS 0xFA5C /end MEASUREMENT
/begin MEASUREMENT uusvmb2_w "Spannung (word, 1 ms-Raster) Lambdasonde mit Widerstand belastet vor KAT Bank2" UWORD spg_uw_q0p00488 1 100 0 319.995 FORMAT "%8.4" ECU_ADDRESS 0x38123E /end MEASUREMENT
/begin MEASUREMENT uusvmb_w "Spannung (word, 1 ms-Raster) Lambdasonde mit Widerstand belastet vor KAT" UWORD spg_uw_q0p00488 1 100 0 319.995 FORMAT "%8.4" ECU_ADDRESS 0x381240 /end MEASUREMENT
/begin MEASUREMENT uusvob2_w "ADC-Spannung (word, 1 ms-Raster) Sonde ohne Belastung vor Katalysator Bank2" UWORD spg_uw_q0p00488 1 100 0 319.995 FORMAT "%8.4" ECU_ADDRESS 0x381242 /end MEASUREMENT
/begin MEASUREMENT uusvob_w "ADC-Spannung (word, 1 ms-Raster) Sonde ohne Belastung vor Katalysator" UWORD spg_uw_q0p00488 1 100 0 319.995 FORMAT "%8.4" ECU_ADDRESS 0x381244 /end MEASUREMENT
/begin MEASUREMENT vfil_w "gefilterte Geschwindigkeit (16-Bit)" UWORD vfzg_uw_b512 1 100 0 511.992 FORMAT "%8.4" ECU_ADDRESS 0x381392 /end MEASUREMENT
/begin MEASUREMENT vfzg "Fahrzeuggeschwindigkeit" UBYTE vfzg_ub_q1p25 1 100 0 318.75 FORMAT "%5.1" ECU_ADDRESS 0xF8CE /end MEASUREMENT
/begin MEASUREMENT vfzg_w "Fahrzeuggeschwindigkeit" UWORD vfzg_uw_b512 1 100 0 511.992 FORMAT "%8.4" ECU_ADDRESS 0xF9FC /end MEASUREMENT
/begin MEASUREMENT vfzroh_w "Fahrzeuggeschwindigkeit Ausgabewert an SCAN-Tool" UWORD vfzg_uw_b512 1 100 0 511.992 FORMAT "%8.4" ECU_ADDRESS 0x381394 /end MEASUREMENT
/begin MEASUREMENT vroh_w "Fahrzeuggeschwindigkeit ungefiltert" UWORD vfzg_uw_b512 1 100 0 511.992 FORMAT "%8.4" ECU_ADDRESS 0x381396 /end MEASUREMENT
/begin MEASUREMENT vsdmr "Vorgabe Drehmomentreserve über Verstellsystem VSxy" UBYTE rel_ub_q0p3906 1 100 0 99.6094 FORMAT "%5.2" ECU_ADDRESS 0x380900 /end MEASUREMENT
/begin MEASUREMENT vske "verstellbarer Offset für Klopferkennungsschwelle über VS20" SBYTE fak_ub_b16 1 100 -8 7.9375 FORMAT "%5.3" ECU_ADDRESS 0x380901 /end MEASUREMENT
/begin MEASUREMENT vstlr "Anpassung tv-Zeit  (Testerschnittstelle)" SBYTE t10msxs_sb_q0p01 1 100 -1.28 1.27 FORMAT "%5.3" ECU_ADDRESS 0x38008F /end MEASUREMENT
/begin MEASUREMENT vszw "Zündwinkelkorrektur durch Verstellsystem" SBYTE zw_sb_q0p75 1 100 -96 95.25 FORMAT "%5.2" ECU_ADDRESS 0x380902 /end MEASUREMENT
/begin MEASUREMENT vszwkr "Zylinderindividuelle ZW-Verstellung durch Verstellsystem" SBYTE zw_sb_q0p75 1 100 -96 95.25 FORMAT "%5.2" ARRAY_SIZE 8 ECU_ADDRESS 0x380903 /end MEASUREMENT
/begin MEASUREMENT wdkada_w "Sollwert DK-Winkel, aus DV-E Adaption- und Prüffunktion" UWORD relDK_uw_b100 1 100 0 100 FORMAT "%8.4" ECU_ADDRESS 0x3813B4 /end MEASUREMENT
/begin MEASUREMENT wdkbap_w "fuer Einspritzung praedizierter Drosselklappenwinkel (Word)" UWORD rel_uw_b100 1 100 0 99.9985 FORMAT "%8.5" ECU_ADDRESS 0x381348 /end MEASUREMENT
/begin MEASUREMENT wdknlp_w "DK-Winkel der Notluftposition" UWORD relDK_uw_b100 1 100 0 100 FORMAT "%8.4" ECU_ADDRESS 0x3813B6 /end MEASUREMENT
/begin MEASUREMENT wea "Winkelmarke Einspritzabbruch" UBYTE zw_ub_q6 1 100 0 1530 FORMAT "%5.0" ECU_ADDRESS 0x380AFB /end MEASUREMENT
/begin MEASUREMENT wee "Winkel Einspritzende im Normalbetrieb" UBYTE zw_ub_q6 1 100 0 1530 FORMAT "%5.0" ECU_ADDRESS 0x380AFC /end MEASUREMENT
/begin MEASUREMENT weer "Winkel Einspritzende resultierend" UBYTE WQ720 1 100 0 717.315 FORMAT "%5.1" ECU_ADDRESS 0x380AFD /end MEASUREMENT
/begin MEASUREMENT wmfa "Meßfensteranfang in Grad Kurbelwinkel" UBYTE zw_ub_q0p75 1 100 0 191.25 FORMAT "%5.1" ECU_ADDRESS 0x38095D /end MEASUREMENT
/begin MEASUREMENT wmfl "Meßfensterlänge in Grad Kurbelwinkel" UBYTE zw_ub_q0p75 1 100 0 191.25 FORMAT "%5.1" ECU_ADDRESS 0x38095E /end MEASUREMENT
/begin MEASUREMENT wnwam "Nockenwellenwinkel Auslaß (Mittelwert)" UBYTE wkw_ub_q0p5 1 100 0 127.5 ECU_ADDRESS 0x38094A /end MEASUREMENT
/begin MEASUREMENT wnwkw_w "Winkel der NW-Flanken relativ zur Kurbelwelle" UWORD wkw_uw_b2048 1 100 0 2047.97 FORMAT "%7.2" ARRAY_SIZE 2 ECU_ADDRESS 0xE43C /end MEASUREMENT
/begin MEASUREMENT wnws "Sollwinkel für Nockenwelle" UBYTE wkw_ub_q0p25 1 100 0 63.75 FORMAT "%7.4" ECU_ADDRESS 0x38094B /end MEASUREMENT
/begin MEASUREMENT wped "Normierter Fahrpedalwinkel" UBYTE relPED_ub_b100 1 100 0 100 FORMAT "%5.1" ECU_ADDRESS 0x380A52 /end MEASUREMENT
/begin MEASUREMENT wpedv_w "Normierter Fahrpedalwinkel vor Berücksichtigung der Begrenzungen im Notfahren" UWORD relPED_uw_b100 1 100 0 100 FORMAT "%8.4" ECU_ADDRESS 0x3813C2 /end MEASUREMENT
/begin MEASUREMENT wped_w "Normierter Fahrpedalwinkel" UWORD relPED_uw_b100 1 100 0 100 FORMAT "%8.4" ECU_ADDRESS 0x3813C4 /end MEASUREMENT
/begin MEASUREMENT zaaccflag "Zustandsautomat Positionsflag" UBYTE dez 1 100 0 255 FORMAT "%5.1" ECU_ADDRESS 0x38092B /end MEASUREMENT
/begin MEASUREMENT zkfstf "Zeitkonstante Fuellstandssignalfilter" UWORD zk100msxs_uw_b6553 1 100 0.100002 6553.6 FORMAT "%8.3" ECU_ADDRESS 0x3826AE /end MEASUREMENT
/begin MEASUREMENT zriberh "Ri-Berechnungszähler nach Start hinter KAT" UBYTE dez 1 100 0 255 FORMAT "%5.1" ECU_ADDRESS 0x380964 /end MEASUREMENT
/begin MEASUREMENT zriberh2 "Ri-Berechnungszähler nach Start hinter KAT Bank2" UBYTE dez 1 100 0 255 FORMAT "%5.1" ECU_ADDRESS 0x380965 /end MEASUREMENT
/begin MEASUREMENT zriberv "Ri-Berechnungszähler nach Start vor KAT" UBYTE dez 1 100 0 255 FORMAT "%5.1" ECU_ADDRESS 0x380C3C /end MEASUREMENT
/begin MEASUREMENT zriberv2 "Ri-Berechnungszähler nach Start vor KAT Bank2" UBYTE dez 1 100 0 255 FORMAT "%5.1" ECU_ADDRESS 0x380C3D /end MEASUREMENT
/begin MEASUREMENT zrinh2_w "Zeitzähler zur Bereitstellung der aktuellen Bedingung Ri-Nernst hinter KAT Bank2" UWORD t100msxs_uw_b6553p5 1 100 0 6553.5 FORMAT "%8.3" ECU_ADDRESS 0x380DFC /end MEASUREMENT
/begin MEASUREMENT zrinh_w "Zeitzähler zur Bereitstellung der aktuellen Bedingung Ri-Nernst hinter KAT" UWORD t100msxs_uw_b6553p5 1 100 0 6553.5 FORMAT "%8.3" ECU_ADDRESS 0x380DFE /end MEASUREMENT
/begin MEASUREMENT zrinv2_w "Zeitzähler zur Bereitstellung der aktuellen Bedingung Ri-Nernst vor KAT Bank2" UWORD t100msxs_uw_b6553p5 1 100 0 6553.5 FORMAT "%8.3" ECU_ADDRESS 0x38201C /end MEASUREMENT
/begin MEASUREMENT zrinv_w "Zeitzähler zur Bereitstellung der aktuellen Bedingung Ri-Nernst vor KAT" UWORD t100msxs_uw_b6553p5 1 100 0 6553.5 FORMAT "%8.3" ECU_ADDRESS 0x38201E /end MEASUREMENT
/begin MEASUREMENT zrph "Zähler Raster Phasensignal" UBYTE dez 1 100 0 255 FORMAT "%5.1" ECU_ADDRESS 0xFA00 /end MEASUREMENT
/begin MEASUREMENT zrph2 "Zähler Raster Phasensignal 2" UBYTE dez 1 100 0 255 FORMAT "%5.1" ECU_ADDRESS 0xFA24 /end MEASUREMENT
/begin MEASUREMENT ztpnt_a "KR: Zähler für die Freigabe von Nulltest oder Testimpuls" UBYTE dez 1 100 0 255 FORMAT "%5.1" ECU_ADDRESS 0x38095F /end MEASUREMENT
/begin MEASUREMENT zwks "abs. Zündwinkel aus %KS_W bzw. %ZWKS" SBYTE zw_sb_q0p75 1 100 -96 95.25 FORMAT "%5.2" ECU_ADDRESS 0x380B5D /end MEASUREMENT
/begin MEASUREMENT zwstt "Zündwinkel im Start" SBYTE zw_sb_q0p75 1 100 -96 95.25 FORMAT "%5.2" ECU_ADDRESS 0x380A18 /end MEASUREMENT
/begin MEASUREMENT zzylkr "Zylinderzähler für die KR" UBYTE dez 1 100 0 255 FORMAT "%5.1" ECU_ADDRESS 0xF872 /end MEASUREMENT
/begin FUNCTION GGEGAS "Gebergröße Brems- und Kupplungsschalter" /begin DEF_CHARACTERISTIC CWGGEGAS TSTAEBR TVERBR TVKUP ZERBR /end DEF_CHARACTERISTIC /begin REF_CHARACTERISTIC /end REF_CHARACTERISTIC /begin IN_MEASUREMENT B_autget B_pwf S_bls S_brs S_kupp /end IN_MEASUREMENT /begin OUT_MEASUREMENT B_br2k B_brems B_kuppl B_kupplv ctrerbr /end OUT_MEASUREMENT /begin LOC_MEASUREMENT B_bl B_br B_erbr B_staebr /end LOC_MEASUREMENT /begin SUB_FUNCTION /end SUB_FUNCTION /end FUNCTION
/begin FUNCTION GGFSTT "Gebergroesse Fuellstandsgeber Tank"
 /begin DEF_CHARACTERISTIC AFSTB CWGGFST FQFSTT FSTDMN FSTDMX FSTDTOL FSTHYS FSTTAL FSTTAL1 FSTTAV FSTTEW FSTTMX GVTMX TVHALT TVKL15 ZKDFST ZKFSTV /end DEF_CHARACTERISTIC
 /begin REF_CHARACTERISTIC /end REF_CHARACTERISTIC
 /begin IN_MEASUREMENT B_kl15 B_pwf B_talcan tfst tfst2 vfzg /end IN_MEASUREMENT
 /begin OUT_MEASUREMENT B_fstdmn B_fstdmx B_fsttal B_fsttg B_fsttsh B_fsttval B_tal B_talval B_tav fstt fstt_w GGFSTTBits gvtaf_w rfstt rgvtaf /end OUT_MEASUREMENT
 /begin LOC_MEASUREMENT B_fstdy B_fststa B_fsttew fstadf_w fsttaf_w fsttval_w tfst2nq_dez tfst2nq_w tfst2_dez tfstnf_w tfstnq_dez tfstnq_w tfst_dez tfst_w zkfstf /end LOC_MEASUREMENT
 /begin SUB_FUNCTION /end SUB_FUNCTION
/end FUNCTION
/begin FUNCTION GGHFM "Gebersignal HFM" /begin DEF_CHARACTERISTIC KFKHFM KFPU KFPU2SU KFPU3SU KFPUSU MLHFM MLOFS PUKANS /end DEF_CHARACTERISTIC /begin REF_CHARACTERISTIC /end REF_CHARACTERISTIC /begin IN_MEASUREMENT nmot rl sumode tans uhfm_w wdkba /end IN_MEASUREMENT /begin OUT_MEASUREMENT fkhfm fpuk mlhfma_w mlhfmm_w mshfm_w nmotkor /end OUT_MEASUREMENT /begin LOC_MEASUREMENT /end LOC_MEASUREMENT /begin SUB_FUNCTION /end SUB_FUNCTION /end FUNCTION
/begin FUNCTION GGKS "Gebergröße Klopfsensor"
 /begin DEF_CHARACTERISTIC DKROKD DKROKMX DKROKO FMFKR KEMLN KFMAKR SENZZYL0 SENZZYL1 SENZZYL2 SENZZYL3 SENZZYL4 SENZZYL5 SENZZYL6 SENZZYL7 /end DEF_CHARACTERISTIC
 /begin REF_CHARACTERISTIC CWDKRTP KRFHT SNM16KRUB SRL04KRUB TMKR _WKW075 _ZYLZA /end REF_CHARACTERISTIC
 /begin IN_MEASUREMENT B_kr B_st B_stend B_tmkr esst_snm16krub esst_srl04krub nmot rl tmot tn2 xzskrnt xzskrof xzskrtp /end IN_MEASUREMENT
 /begin OUT_MEASUREMENT B_c95bf0 B_c95bf1 B_c95bf2 B_c95bf3 B_c95ks3 B_dnt B_dntb B_dtp B_dtpb B_ntini B_tpnt_aw B_tpnt_e igod_w igokr_w ikr ikrma ikrme ikrmen ikrmet ikr_tst iokkr ks_sym sen_c95 tmfa_w tmfln_w tmfl_w tpnt_aktiv UADKI wmfa wmfl ztpnt_a zzylkr /end OUT_MEASUREMENT
 /begin LOC_MEASUREMENT /end LOC_MEASUREMENT
 /begin SUB_FUNCTION /end SUB_FUNCTION
/end FUNCTION
/begin FUNCTION GGLSH "Gebergröße Lambdasonde hinter Kat"
 /begin DEF_CHARACTERISTIC ANZRIBEH CWGGLSH DUSRIH DUSSPH FRINOF RBEL RINHMX RKSP TGGLS THSRIH TRIAKTH TRIIMPH TUSBELH USRIMINH USRIOH USRIUH ZFRIH /end DEF_CHARACTERISTIC
 /begin REF_CHARACTERISTIC _STERHK _STERVK _STETLR /end REF_CHARACTERISTIC
 /begin IN_MEASUREMENT B_lsh B_lsh2 B_lsv B_lsv2 B_ripuv B_ripuv2 B_sa B_svuerf B_svuerf2 B_ttbmhh B_ttbmhh2 uushk2_w uushk_w uusvk2_w uusvk_w uusvmb2_w uusvmb_w uusvob2_w uusvob_w /end IN_MEASUREMENT
 /begin OUT_MEASUREMENT B_priph B_priph2 B_pump B_rinh B_rinh2 B_shuerf B_shuerf2 rinh2_w rinh_w ushk ushk2 ushk2_w ushk_w /end OUT_MEASUREMENT
 /begin LOC_MEASUREMENT B_enrinh B_enrinh2 B_erinofh B_erinofh2 B_riakh B_riakh2 B_ribeh B_ribeh2 B_riibh B_riibh2 B_riimph B_rimh B_rimh2 B_ripuh B_ripuh2 B_rireh B_rireh2 B_risph B_risph2 B_usbeh B_usbeh2 rinofh2_w rinofha2_w rinofha_w rinofh_w usbeh2_w usbeh_w ushb2_w ushb_w ushkr2_w ushkr_w ushmb2_w ushmb_w ushob2_w ushob_w usobh2_w usobh_w uushmb2_w uushmb_w uushob2_w uushob_w zriberh zriberh2 zrinh2_w zrinh_w /end LOC_MEASUREMENT
 /begin SUB_FUNCTION /end SUB_FUNCTION
/end FUNCTION
/begin FUNCTION GGLSV "Gebergröße Lambdasonde vor KAT"
 /begin DEF_CHARACTERISTIC ANZRIBEV CWGGLSV DUSRIV DUSSPV RINVMX THSRIV TRIAKTV TRIIMPV TUSBELV USRIMINV USRIOV USRIUV ZFRIV /end DEF_CHARACTERISTIC
 /begin REF_CHARACTERISTIC FRINOF RBEL RKSP TGGLS /end REF_CHARACTERISTIC
 /begin IN_MEASUREMENT B_lsv B_lsv2 B_sa B_shuerf B_shuerf2 B_ttbmh B_ttbmh2 uusvk2_w uusvk_w /end IN_MEASUREMENT
 /begin OUT_MEASUREMENT B_pripv B_pripv2 B_rinv B_rinv2 B_svuerf B_svuerf2 rinofv2_w rinofv_w rinv2_w rinv_w usvb2_w usvb_w usvk usvk2 usvk2_w usvk_w uusvmb2_w uusvmb_w uusvob2_w uusvob_w /end OUT_MEASUREMENT
 /begin LOC_MEASUREMENT B_enrinv B_enrinv2 B_erinofv B_erinofv2 B_riakv B_riakv2 B_ribev B_ribev2 B_riibv B_riibv2 B_riimpv B_rimv B_rimv2 B_ripuv B_ripuv2 B_rirev B_rirev2 B_rispv B_rispv2 B_usbev B_usbev2 rinofva2_w rinofva_w usbev2_w usbev_w usobv2_w usobv_w usvkr2_w usvkr_w usvmb2_w usvmb_w usvob2_w usvob_w zriberv zriberv2 zrinv2_w zrinv_w /end LOC_MEASUREMENT
 /begin SUB_FUNCTION /end SUB_FUNCTION
/end FUNCTION
/begin FUNCTION GGMFL "Gebergröße Multifunktionslenkrad"
 /begin DEF_CHARACTERISTIC CWGGMFL TDMFL TDMFLH TFGRBTOFF TFGRBTON TFGRBTUBT TFGRMNLE TFGRVZG TMFLBE TMFLFQE TMFLTC UBMFLMN /end DEF_CHARACTERISTIC
 /begin REF_CHARACTERISTIC _DT_3M8 _DT_3P8 _DT_4M8 _DT_4P8 _DT_5M8 _DT_5P8 _FRAME_MAX _FRAME_MIN /end REF_CHARACTERISTIC
 /begin IN_MEASUREMENT B_lowra B_mflai B_mflal B_mflar B_mflas B_mflen ub /end IN_MEASUREMENT
 /begin OUT_MEASUREMENT B_fgrat B_fgrhe B_fgrhsa B_fgrtbe B_fgrtse B_fgrtve B_fgrtwa B_info_0 B_mflex B_mflfrqe B_mflpt B_mflst B_mfltr B_tctoggel L_fgr mflcnt mflroh mflroh_a mflroh_n state_fgrhs tmflb tmflbe_ctr tmflfqe_ctr tmfltc_ctr zaaccflag /end OUT_MEASUREMENT
 /begin LOC_MEASUREMENT B_mnmflv B_mxmflv B_npmflv B_simflv /end LOC_MEASUREMENT
 /begin SUB_FUNCTION /end SUB_FUNCTION
/end FUNCTION
/begin FUNCTION GGPED "Gebergröße Fahrpedal"
 /begin DEF_CHARACTERISTIC CWBWEEN DUPW12 DUPW12BE DUPW12TG DUPW12VG DUPWGHY DWPMXNOT TFPWG2 THOPP1 THOPP2 TUPWBWF TUPWBWV TUPWG12 TUPWG1O TUPWG1U TUPWG2O TUPWG2U UPW1LLMX UPWG12U UPWG1O UPWG1U UPWG2O UPWG2U UPWGKDO UPWGKDU UPWGO UPWGTG UPWGTL UPWGU UPWGUBF UPWGVG WPMXNOT ZBWF /end DEF_CHARACTERISTIC
 /begin REF_CHARACTERISTIC TPNSE /end REF_CHARACTERISTIC
 /begin IN_MEASUREMENT B_brems B_pwf B_pwgnotum B_stend B_ubpvg upwg1_w upwg2_w /end IN_MEASUREMENT
 /begin OUT_MEASUREMENT B_kd B_pwgnotfr B_upwbwf dwped dwped_w wped wped_w /end OUT_MEASUREMENT
 /begin LOC_MEASUREMENT B_bwf B_bwunpl B_dupw B_dupw12 B_glf B_holp1 B_holp1a B_holp1l B_holp2 B_holp2a B_holp2l B_hop1mn B_hop2mn B_hopakt B_pwgbwf B_sp1s B_sp2s B_spsmin B_upw12e B_upw1mn B_upw1mx B_upw2mn B_upw2mx B_upwg1o B_upwg1u B_upwg2o B_upwg2u ctrbwf GGPEDnonVolbits upw2ll_w upwg2d_w upwg2fil_w upwgej_w upwg_w wpedv_w /end LOC_MEASUREMENT
 /begin SUB_FUNCTION /end SUB_FUNCTION
/end FUNCTION
/begin FUNCTION GGPEDV "Aufbereitung Poti-Signale von PWG für GGPED" /begin DEF_CHARACTERISTIC /end DEF_CHARACTERISTIC /begin REF_CHARACTERISTIC /end REF_CHARACTERISTIC /begin IN_MEASUREMENT ADC_Urefsp1_w ADC_Urefsp2_w ADC_Uspoti1_w ADC_Uspoti2_w /end IN_MEASUREMENT /begin OUT_MEASUREMENT upwg1_w upwg2_w /end OUT_MEASUREMENT /begin LOC_MEASUREMENT /end LOC_MEASUREMENT /begin SUB_FUNCTION /end SUB_FUNCTION /end FUNCTION
/begin FUNCTION GGTFA "15.10     Gebergröße TFA Temperaturfühler Ansaugluft" /begin DEF_CHARACTERISTIC TADE TADMN TADMX TANSELI TDNSTA TDTA TDTAL /end DEF_CHARACTERISTIC /begin REF_CHARACTERISTIC /end REF_CHARACTERISTIC /begin IN_MEASUREMENT B_ll B_pwf B_sa B_stend wtans /end IN_MEASUREMENT /begin OUT_MEASUREMENT tans tansab tanslin /end OUT_MEASUREMENT /begin LOC_MEASUREMENT /end LOC_MEASUREMENT /begin SUB_FUNCTION /end SUB_FUNCTION /end FUNCTION
/begin FUNCTION GGTFM "Gebergröße TFM Temperaturfühler Motor (/-Kühlmittel)"
 /begin DEF_CHARACTERISTIC DTLRTML DTMDMA DTMDNPO DTMSRT FABSTT KFDTMTE KFDTMTR KFDTMTU KLDTMRS TADMM TDTM TDTMMA TMDMMA TMDMMAT TMDMMAU TMDMMEE TMDMMER TMDMN TMDMX TMLRTMS TMMXRT TMOTELI TNSRT TUMDETM TWLRTMS /end DEF_CHARACTERISTIC
 /begin REF_CHARACTERISTIC /end REF_CHARACTERISTIC
 /begin IN_MEASUREMENT B_etol B_etum B_nmin B_nmot B_nokatfz B_pwf B_sa B_st B_stend ml tabst_w tans tnst_w tol tumg wtmot /end IN_MEASUREMENT
 /begin OUT_MEASUREMENT B_anfw B_mxmntm B_tmdmme B_tmmn B_tmsrt GGTFMBits2 tdlrtm_w tmew tmewab tmot tmotab tmotlin tmotvt tmrw tmrwend tmst tumginp /end OUT_MEASUREMENT
 /begin LOC_MEASUREMENT /end LOC_MEASUREMENT
 /begin SUB_FUNCTION /end SUB_FUNCTION
/end FUNCTION
/begin FUNCTION GGTFUMG "Gebergröße TFUMG Temperaturfühler Umgebung (/-sluft)" /begin DEF_CHARACTERISTIC IMTUMGTA NTUMGTA TDTUM TDTUMNF TUMGTAI VTUMGTA /end DEF_CHARACTERISTIC /begin REF_CHARACTERISTIC DTUMTA /end REF_CHARACTERISTIC /begin IN_MEASUREMENT B_ins3cok B_pwf B_tfu imlatm nmot tans tumgcan vfzg /end IN_MEASUREMENT /begin OUT_MEASUREMENT B_ctunp B_etum B_tumbk ggtfumgbits tumg /end OUT_MEASUREMENT /begin LOC_MEASUREMENT tumgta /end LOC_MEASUREMENT /begin SUB_FUNCTION /end SUB_FUNCTION /end FUNCTION
/begin FUNCTION GGTKA "Gebergröße TKA Temperatur Kühlerausgang" /begin DEF_CHARACTERISTIC TDTKAUS TKAELI TKAUSDE TKAUSDMN TKAUSDMX /end DEF_CHARACTERISTIC /begin REF_CHARACTERISTIC /end REF_CHARACTERISTIC /begin IN_MEASUREMENT wtka /end IN_MEASUREMENT /begin OUT_MEASUREMENT tka tkalin /end OUT_MEASUREMENT /begin LOC_MEASUREMENT /end LOC_MEASUREMENT /begin SUB_FUNCTION /end SUB_FUNCTION /end FUNCTION
/begin FUNCTION GGTSG "Gebergröße und Dokumentation Temperatur Steuergerät"
 /begin DEF_CHARACTERISTIC STNSG1 STNSG2 STNSG3 STNSG4 STNSG5 STTSG1 STTSG2 STTSG3 STTSG4 STTSG5 TSGELI TSTSG /end DEF_CHARACTERISTIC
 /begin REF_CHARACTERISTIC /end REF_CHARACTERISTIC
 /begin IN_MEASUREMENT nmot wtsg /end IN_MEASUREMENT
 /begin OUT_MEASUREMENT tsg /end OUT_MEASUREMENT
 /begin LOC_MEASUREMENT /end LOC_MEASUREMENT
 /begin SUB_FUNCTION /end SUB_FUNCTION
/end FUNCTION
/begin FUNCTION GGUB "Gebergröße Batteriespannung, inkl.Diagnose" /begin DEF_CHARACTERISTIC TDNSUB TDUB UBDE UBDMN1 UBDMN2 UBDMX UBNACHL VMDUB /end DEF_CHARACTERISTIC /begin REF_CHARACTERISTIC /end REF_CHARACTERISTIC /begin IN_MEASUREMENT B_stend vfzg wub wub_w /end IN_MEASUREMENT /begin OUT_MEASUREMENT ub ubsq ubsqf ubsqf_w ubsq_w /end OUT_MEASUREMENT /begin LOC_MEASUREMENT /end LOC_MEASUREMENT /begin SUB_FUNCTION /end SUB_FUNCTION /end FUNCTION
/begin FUNCTION GGVFZG "Gebergröße Fahrzeuggeschwindigkeit" /begin DEF_CHARACTERISTIC AIMV DVFZBEG TFGRVRAB VFZMN VRFGRMN ZFV /end DEF_CHARACTERISTIC /begin REF_CHARACTERISTIC _PECVFZ_RELOAD /end REF_CHARACTERISTIC /begin IN_MEASUREMENT /end IN_MEASUREMENT /begin OUT_MEASUREMENT bfzgl_b B_vnull vfzg vfzg_w vfzroh_w /end OUT_MEASUREMENT /begin LOC_MEASUREMENT vfil_w vroh_w /end LOC_MEASUREMENT /begin SUB_FUNCTION /end SUB_FUNCTION /end FUNCTION
/begin FUNCTION GK "Gemischkontrolle" /begin DEF_CHARACTERISTIC KFBS /end DEF_CHARACTERISTIC /begin REF_CHARACTERISTIC /end REF_CHARACTERISTIC
 /begin IN_MEASUREMENT fgru fks fns fr2_w fra2_w fra_w fr_w fst_w fwe fwl fwnw lamnswl_w lamsbg2_w lamsbg_w nmot rka2_w rkaco_w rka_w rkte_w rkukg_w rl rlp_w /end IN_MEASUREMENT
 /begin OUT_MEASUREMENT rk2_w rkkva2_w rkkva_w rk_w /end OUT_MEASUREMENT
 /begin LOC_MEASUREMENT fvst_w /end LOC_MEASUREMENT
 /begin SUB_FUNCTION /end SUB_FUNCTION
/end FUNCTION
/begin FUNCTION HDMTL "Heizung DM-TL" /begin DEF_CHARACTERISTIC CWHDMTL /end DEF_CHARACTERISTIC /begin REF_CHARACTERISTIC NGLMHEMX TABTESMN TMSDMTLU /end REF_CHARACTERISTIC
 /begin IN_MEASUREMENT B_bthdm B_cddmtl B_desee B_dmdiptge B_dmdiptke B_dmktke B_fstdmn B_fsttg B_nmot B_stend nglmhe tabst_w tmst /end IN_MEASUREMENT
 /begin OUT_MEASUREMENT B_hdmtl /end OUT_MEASUREMENT
 /begin LOC_MEASUREMENT /end LOC_MEASUREMENT
 /begin SUB_FUNCTION /end SUB_FUNCTION
/end FUNCTION
/begin FUNCTION HIROM "" /begin DEF_CHARACTERISTIC CWMDAPP TWNWS UBDLS /end DEF_CHARACTERISTIC /begin REF_CHARACTERISTIC /end REF_CHARACTERISTIC /begin IN_MEASUREMENT /end IN_MEASUREMENT
 /begin OUT_MEASUREMENT acc_stat anzti atv atv2 B_acc B_accdme B_asrext B_atmtpa B_atmtpa2 B_atmtpk B_atmtpk2 B_brems B_cvt B_dash B_dcdisr B_dkaden B_dknolu B_dkpiu B_dkpu B_dktlp B_dlrien B_dsls B_dteaa B_dtes B_dtest B_dveada B_edkvs B_edkvs2 B_epcl B_esls B_fa B_faevz B_fakvs B_falls B_falsh B_falsh2 B_fgr B_fgrai B_fgras B_fgren B_fpwdkap B_frini B_frini2 B_fs B_fspclr B_gasp B_hfm B_kh B_koe B_krdws B_kuppl B_kw B_ll B_llrein B_lr B_lr2 B_lra B_lra2 B_lrhk B_lrhk2 B_lrnd B_lrnd2 B_lsd B_lsh B_lsh2 B_lsv B_lsv2 B_msrext B_nmot B_nnwmx B_nswo1 B_nswo2 B_nswo3 B_pn B_pwf B_qtedab B_sacvt B_savfgr B_sbbhk B_sbbhk2 B_sbbvk B_sbbvk2 B_sls B_st B_su B_svuerf B_svuerf2 B_synph B_te B_tei B_ten B_tnaset B_vl B_wdksap B_wk B_zwappl cd_bits1_w cd_bits2_w devoff dkpstg_w dmlllmn_w dmllrz_w dmllr_w dmrkh dmrkt_w dmrllr_w drlfue_w dzwnwsu dzwwl esst_snm16feuw esst_snm16opuw esst_snm16zuub esst_snm24zuub esst_srl03zuub esst_srl12zuub esst_srl16zuub esst_swn10feub esst_swp08opub falrdkt fgru fho_w fks flgtiab flr_ap fns fnwue fpvdkds fpvdkds_w frini2_w frini_w frkte fst_w ftbr_w ftsr ftvdk fwl fwnw gangi lambas lamnswl_w lamsbg2_w lamsbg_w lamsons2_w lamsons_w mdverl_w miasrl_w miasrs_w mibgr_w mifa mifal_w mifa_w miges_w migs_w mimax_w mimsr_w miszul_w mivmx_w mrfamx_w mrfa_w mrfuemx_w mrfue_w psagr_w pu_w pvdkds_w rkaco_w rlmax_w stat_md_e sumode t1tvi_w tabgm tabgm2 tadtea tans tkatm tkatm2 tmot tmst tnst_w tvlrh tvlrh2 tvlrhi tvlrhi2 tvu_w ub udkp1a_w udkp1sv udkp1vo_w udkp1vv_w udkp2a_w upwg1_w upwg2_w usrhk usrhk2 usvk usvk2 uusvmb2_w uusvmb_w uusvob2_w uusvob_w vsdmr vske vstlr vszw vszwkr wdkada_w wdkbap_w wdknlp_w wea wee weer wnwam wnws zwks zwstt /end OUT_MEASUREMENT
 /begin LOC_MEASUREMENT B_fil B_lrnrdy /end LOC_MEASUREMENT
 /begin SUB_FUNCTION /end SUB_FUNCTION
/end FUNCTION
/begin FUNCTION HLS "Heizung Lambdasonde"
 /begin DEF_CHARACTERISTIC THEH THEV THHA THHA2 THHAWU THSHKTK THSHKTK2 THSVKTA THSVKTA2 THVA THVA2 THVAWU TMOHSMN TVHSH TVHSV UBHS UHSN /end DEF_CHARACTERISTIC
 /begin REF_CHARACTERISTIC _STERHK _STERVK /end REF_CHARACTERISTIC
 /begin IN_MEASUREMENT B_atmtpa B_atmtpa2 B_atmtpk B_atmtpk2 B_sbbhk B_sbbhk2 B_sbbvk B_sbbvk2 B_stend tabgm tabgm2 tkatm tkatm2 tmot ub /end IN_MEASUREMENT
 /begin OUT_MEASUREMENT B_hshe B_hshe2 B_hsve B_hsve2 phlsnh phlsnh2 phlsnv phlsnv2 /end OUT_MEASUREMENT
 /begin LOC_MEASUREMENT B_hsh B_hsh2 B_hshmx B_hshmx2 B_hsv B_hsv2 B_hsvmx B_hsvmx2 B_rehs thhaist thhaist2 thhat thhat2 thvaist thvaist2 thvat thvat2 /end LOC_MEASUREMENT
 /begin SUB_FUNCTION /end SUB_FUNCTION
/end FUNCTION
/begin FUNCTION ims111 "" /begin DEF_CHARACTERISTIC /end DEF_CHARACTERISTIC /begin REF_CHARACTERISTIC /end REF_CHARACTERISTIC /begin IN_MEASUREMENT B_ews_ok B_ez B_zndaus /end IN_MEASUREMENT /begin OUT_MEASUREMENT B_eculock /end OUT_MEASUREMENT /begin LOC_MEASUREMENT /end LOC_MEASUREMENT /begin SUB_FUNCTION /end SUB_FUNCTION /end FUNCTION
/begin FUNCTION INDEX_ADVE "" /begin DEF_CHARACTERISTIC /end DEF_CHARACTERISTIC /begin REF_CHARACTERISTIC /end REF_CHARACTERISTIC /begin IN_MEASUREMENT /end IN_MEASUREMENT /begin OUT_MEASUREMENT /end OUT_MEASUREMENT /begin LOC_MEASUREMENT /end LOC_MEASUREMENT /begin SUB_FUNCTION /end SUB_FUNCTION /end FUNCTION
/begin FUNCTION INDEX_BGDVE "" /begin DEF_CHARACTERISTIC /end DEF_CHARACTERISTIC /begin REF_CHARACTERISTIC /end REF_CHARACTERISTIC /begin IN_MEASUREMENT /end IN_MEASUREMENT /begin OUT_MEASUREMENT /end OUT_MEASUREMENT /begin LOC_MEASUREMENT /end LOC_MEASUREMENT /begin SUB_FUNCTION /end SUB_FUNCTION /end FUNCTION
/begin FUNCTION INDEX_BGRBS "" /begin DEF_CHARACTERISTIC /end DEF_CHARACTERISTIC /begin REF_CHARACTERISTIC /end REF_CHARACTERISTIC /begin IN_MEASUREMENT /end IN_MEASUREMENT /begin OUT_MEASUREMENT /end OUT_MEASUREMENT /begin LOC_MEASUREMENT /end LOC_MEASUREMENT /begin SUB_FUNCTION /end SUB_FUNCTION /end FUNCTION
/begin FUNCTION INDEX_DACC "" /begin DEF_CHARACTERISTIC /end DEF_CHARACTERISTIC /begin REF_CHARACTERISTIC /end REF_CHARACTERISTIC /begin IN_MEASUREMENT /end IN_MEASUREMENT /begin OUT_MEASUREMENT /end OUT_MEASUREMENT /begin LOC_MEASUREMENT /end LOC_MEASUREMENT /begin SUB_FUNCTION /end SUB_FUNCTION /end FUNCTION
/begin FUNCTION INDEX_DASC "" /begin DEF_CHARACTERISTIC /end DEF_CHARACTERISTIC /begin REF_CHARACTERISTIC /end REF_CHARACTERISTIC /begin IN_MEASUREMENT /end IN_MEASUREMENT /begin OUT_MEASUREMENT /end OUT_MEASUREMENT /begin LOC_MEASUREMENT /end LOC_MEASUREMENT /begin SUB_FUNCTION /end SUB_FUNCTION /end FUNCTION
/begin FUNCTION INDEX_DCACC "" /begin DEF_CHARACTERISTIC /end DEF_CHARACTERISTIC /begin REF_CHARACTERISTIC /end REF_CHARACTERISTIC /begin IN_MEASUREMENT /end IN_MEASUREMENT /begin OUT_MEASUREMENT /end OUT_MEASUREMENT /begin LOC_MEASUREMENT /end LOC_MEASUREMENT /begin SUB_FUNCTION /end SUB_FUNCTION /end FUNCTION
/begin FUNCTION INDEX_DCAS "" /begin DEF_CHARACTERISTIC /end DEF_CHARACTERISTIC /begin REF_CHARACTERISTIC /end REF_CHARACTERISTIC /begin IN_MEASUREMENT /end IN_MEASUREMENT /begin OUT_MEASUREMENT /end OUT_MEASUREMENT /begin LOC_MEASUREMENT /end LOC_MEASUREMENT /begin SUB_FUNCTION /end SUB_FUNCTION /end FUNCTION
/begin FUNCTION INDEX_DCGE "" /begin DEF_CHARACTERISTIC /end DEF_CHARACTERISTIC /begin REF_CHARACTERISTIC /end REF_CHARACTERISTIC /begin IN_MEASUREMENT /end IN_MEASUREMENT /begin OUT_MEASUREMENT /end OUT_MEASUREMENT /begin LOC_MEASUREMENT /end LOC_MEASUREMENT /begin SUB_FUNCTION /end SUB_FUNCTION /end FUNCTION
/begin FUNCTION INDEX_DCINS "" /begin DEF_CHARACTERISTIC /end DEF_CHARACTERISTIC /begin REF_CHARACTERISTIC /end REF_CHARACTERISTIC /begin IN_MEASUREMENT /end IN_MEASUREMENT /begin OUT_MEASUREMENT /end OUT_MEASUREMENT /begin LOC_MEASUREMENT /end LOC_MEASUREMENT /begin SUB_FUNCTION /end SUB_FUNCTION /end FUNCTION
/begin FUNCTION INDEX_DCTXU "" /begin DEF_CHARACTERISTIC /end DEF_CHARACTERISTIC /begin REF_CHARACTERISTIC /end REF_CHARACTERISTIC /begin IN_MEASUREMENT /end IN_MEASUREMENT /begin OUT_MEASUREMENT /end OUT_MEASUREMENT /begin LOC_MEASUREMENT /end LOC_MEASUREMENT /begin SUB_FUNCTION /end SUB_FUNCTION /end FUNCTION
/begin FUNCTION INDEX_DDG "" /begin DEF_CHARACTERISTIC /end DEF_CHARACTERISTIC /begin REF_CHARACTERISTIC /end REF_CHARACTERISTIC /begin IN_MEASUREMENT /end IN_MEASUREMENT /begin OUT_MEASUREMENT /end OUT_MEASUREMENT /begin LOC_MEASUREMENT /end LOC_MEASUREMENT /begin SUB_FUNCTION /end SUB_FUNCTION /end FUNCTION
/begin FUNCTION INDEX_DDMPME "" /begin DEF_CHARACTERISTIC /end DEF_CHARACTERISTIC /begin REF_CHARACTERISTIC /end REF_CHARACTERISTIC /begin IN_MEASUREMENT /end IN_MEASUREMENT /begin OUT_MEASUREMENT /end OUT_MEASUREMENT /begin LOC_MEASUREMENT /end LOC_MEASUREMENT /begin SUB_FUNCTION /end SUB_FUNCTION /end FUNCTION
/begin FUNCTION INDEX_DDMTL "" /begin DEF_CHARACTERISTIC /end DEF_CHARACTERISTIC /begin REF_CHARACTERISTIC /end REF_CHARACTERISTIC /begin IN_MEASUREMENT /end IN_MEASUREMENT /begin OUT_MEASUREMENT /end OUT_MEASUREMENT /begin LOC_MEASUREMENT /end LOC_MEASUREMENT /begin SUB_FUNCTION /end SUB_FUNCTION /end FUNCTION
/begin FUNCTION INDEX_DEKON "" /begin DEF_CHARACTERISTIC /end DEF_CHARACTERISTIC /begin REF_CHARACTERISTIC /end REF_CHARACTERISTIC /begin IN_MEASUREMENT /end IN_MEASUREMENT /begin OUT_MEASUREMENT /end OUT_MEASUREMENT /begin LOC_MEASUREMENT /end LOC_MEASUREMENT /begin SUB_FUNCTION /end SUB_FUNCTION /end FUNCTION
/begin FUNCTION INDEX_DFPM "" /begin DEF_CHARACTERISTIC /end DEF_CHARACTERISTIC /begin REF_CHARACTERISTIC /end REF_CHARACTERISTIC /begin IN_MEASUREMENT /end IN_MEASUREMENT /begin OUT_MEASUREMENT /end OUT_MEASUREMENT /begin LOC_MEASUREMENT /end LOC_MEASUREMENT /begin SUB_FUNCTION /end SUB_FUNCTION /end FUNCTION
/begin FUNCTION INDEX_DFSTT "" /begin DEF_CHARACTERISTIC /end DEF_CHARACTERISTIC /begin REF_CHARACTERISTIC /end REF_CHARACTERISTIC /begin IN_MEASUREMENT /end IN_MEASUREMENT /begin OUT_MEASUREMENT /end OUT_MEASUREMENT /begin LOC_MEASUREMENT /end LOC_MEASUREMENT /begin SUB_FUNCTION /end SUB_FUNCTION /end FUNCTION
/begin FUNCTION INDEX_DGLOR "" /begin DEF_CHARACTERISTIC /end DEF_CHARACTERISTIC /begin REF_CHARACTERISTIC /end REF_CHARACTERISTIC /begin IN_MEASUREMENT /end IN_MEASUREMENT /begin OUT_MEASUREMENT /end OUT_MEASUREMENT /begin LOC_MEASUREMENT /end LOC_MEASUREMENT /begin SUB_FUNCTION /end SUB_FUNCTION /end FUNCTION
/begin FUNCTION INDEX_DHFM "" /begin DEF_CHARACTERISTIC /end DEF_CHARACTERISTIC /begin REF_CHARACTERISTIC /end REF_CHARACTERISTIC /begin IN_MEASUREMENT /end IN_MEASUREMENT /begin OUT_MEASUREMENT /end OUT_MEASUREMENT /begin LOC_MEASUREMENT /end LOC_MEASUREMENT /begin SUB_FUNCTION /end SUB_FUNCTION /end FUNCTION
/begin FUNCTION INDEX_DHLS "" /begin DEF_CHARACTERISTIC /end DEF_CHARACTERISTIC /begin REF_CHARACTERISTIC /end REF_CHARACTERISTIC /begin IN_MEASUREMENT /end IN_MEASUREMENT /begin OUT_MEASUREMENT /end OUT_MEASUREMENT /begin LOC_MEASUREMENT /end LOC_MEASUREMENT /begin SUB_FUNCTION /end SUB_FUNCTION /end FUNCTION
/begin FUNCTION INDEX_DKAT "" /begin DEF_CHARACTERISTIC /end DEF_CHARACTERISTIC /begin REF_CHARACTERISTIC /end REF_CHARACTERISTIC /begin IN_MEASUREMENT /end IN_MEASUREMENT /begin OUT_MEASUREMENT /end OUT_MEASUREMENT /begin LOC_MEASUREMENT /end LOC_MEASUREMENT /begin SUB_FUNCTION /end SUB_FUNCTION /end FUNCTION
/begin FUNCTION INDEX_DKRNT "" /begin DEF_CHARACTERISTIC /end DEF_CHARACTERISTIC /begin REF_CHARACTERISTIC /end REF_CHARACTERISTIC /begin IN_MEASUREMENT /end IN_MEASUREMENT /begin OUT_MEASUREMENT /end OUT_MEASUREMENT /begin LOC_MEASUREMENT /end LOC_MEASUREMENT /begin SUB_FUNCTION /end SUB_FUNCTION /end FUNCTION
/begin FUNCTION INDEX_DKRS "" /begin DEF_CHARACTERISTIC /end DEF_CHARACTERISTIC /begin REF_CHARACTERISTIC /end REF_CHARACTERISTIC /begin IN_MEASUREMENT /end IN_MEASUREMENT /begin OUT_MEASUREMENT /end OUT_MEASUREMENT /begin LOC_MEASUREMENT /end LOC_MEASUREMENT /begin SUB_FUNCTION /end SUB_FUNCTION /end FUNCTION
/begin FUNCTION INDEX_DKRTP "" /begin DEF_CHARACTERISTIC /end DEF_CHARACTERISTIC /begin REF_CHARACTERISTIC /end REF_CHARACTERISTIC /begin IN_MEASUREMENT /end IN_MEASUREMENT /begin OUT_MEASUREMENT /end OUT_MEASUREMENT /begin LOC_MEASUREMENT /end LOC_MEASUREMENT /begin SUB_FUNCTION /end SUB_FUNCTION /end FUNCTION
/begin FUNCTION INDEX_DKUPPL "" /begin DEF_CHARACTERISTIC /end DEF_CHARACTERISTIC /begin REF_CHARACTERISTIC /end REF_CHARACTERISTIC /begin IN_MEASUREMENT /end IN_MEASUREMENT /begin OUT_MEASUREMENT /end OUT_MEASUREMENT /begin LOC_MEASUREMENT /end LOC_MEASUREMENT /begin SUB_FUNCTION /end SUB_FUNCTION /end FUNCTION
/begin FUNCTION INDEX_DKVS "" /begin DEF_CHARACTERISTIC /end DEF_CHARACTERISTIC /begin REF_CHARACTERISTIC /end REF_CHARACTERISTIC /begin IN_MEASUREMENT /end IN_MEASUREMENT /begin OUT_MEASUREMENT /end OUT_MEASUREMENT /begin LOC_MEASUREMENT /end LOC_MEASUREMENT /begin SUB_FUNCTION /end SUB_FUNCTION /end FUNCTION
/begin FUNCTION INDEX_DLDP "" /begin DEF_CHARACTERISTIC /end DEF_CHARACTERISTIC /begin REF_CHARACTERISTIC /end REF_CHARACTERISTIC /begin IN_MEASUREMENT /end IN_MEASUREMENT /begin OUT_MEASUREMENT /end OUT_MEASUREMENT /begin LOC_MEASUREMENT /end LOC_MEASUREMENT /begin SUB_FUNCTION /end SUB_FUNCTION /end FUNCTION
/begin FUNCTION INDEX_DLLR "" /begin DEF_CHARACTERISTIC /end DEF_CHARACTERISTIC /begin REF_CHARACTERISTIC /end REF_CHARACTERISTIC /begin IN_MEASUREMENT /end IN_MEASUREMENT /begin OUT_MEASUREMENT /end OUT_MEASUREMENT /begin LOC_MEASUREMENT /end LOC_MEASUREMENT /begin SUB_FUNCTION /end SUB_FUNCTION /end FUNCTION
/begin FUNCTION INDEX_DLSA "" /begin DEF_CHARACTERISTIC /end DEF_CHARACTERISTIC /begin REF_CHARACTERISTIC /end REF_CHARACTERISTIC /begin IN_MEASUREMENT /end IN_MEASUREMENT /begin OUT_MEASUREMENT /end OUT_MEASUREMENT /begin LOC_MEASUREMENT /end LOC_MEASUREMENT /begin SUB_FUNCTION /end SUB_FUNCTION /end FUNCTION
/begin FUNCTION INDEX_DLSAHK "" /begin DEF_CHARACTERISTIC /end DEF_CHARACTERISTIC /begin REF_CHARACTERISTIC /end REF_CHARACTERISTIC /begin IN_MEASUREMENT /end IN_MEASUREMENT /begin OUT_MEASUREMENT /end OUT_MEASUREMENT /begin LOC_MEASUREMENT /end LOC_MEASUREMENT /begin SUB_FUNCTION /end SUB_FUNCTION /end FUNCTION
/begin FUNCTION INDEX_DLSH "" /begin DEF_CHARACTERISTIC /end DEF_CHARACTERISTIC /begin REF_CHARACTERISTIC /end REF_CHARACTERISTIC /begin IN_MEASUREMENT /end IN_MEASUREMENT /begin OUT_MEASUREMENT /end OUT_MEASUREMENT /begin LOC_MEASUREMENT /end LOC_MEASUREMENT /begin SUB_FUNCTION /end SUB_FUNCTION /end FUNCTION
/begin FUNCTION INDEX_DLSV "" /begin DEF_CHARACTERISTIC /end DEF_CHARACTERISTIC /begin REF_CHARACTERISTIC /end REF_CHARACTERISTIC /begin IN_MEASUREMENT /end IN_MEASUREMENT /begin OUT_MEASUREMENT /end OUT_MEASUREMENT /begin LOC_MEASUREMENT /end LOC_MEASUREMENT /begin SUB_FUNCTION /end SUB_FUNCTION /end FUNCTION
/begin FUNCTION INDEX_DLSVV "" /begin DEF_CHARACTERISTIC /end DEF_CHARACTERISTIC /begin REF_CHARACTERISTIC /end REF_CHARACTERISTIC /begin IN_MEASUREMENT /end IN_MEASUREMENT /begin OUT_MEASUREMENT /end OUT_MEASUREMENT /begin LOC_MEASUREMENT /end LOC_MEASUREMENT /begin SUB_FUNCTION /end SUB_FUNCTION /end FUNCTION
/begin FUNCTION INDEX_DMDMIL "" /begin DEF_CHARACTERISTIC /end DEF_CHARACTERISTIC /begin REF_CHARACTERISTIC /end REF_CHARACTERISTIC /begin IN_MEASUREMENT /end IN_MEASUREMENT /begin OUT_MEASUREMENT /end OUT_MEASUREMENT /begin LOC_MEASUREMENT /end LOC_MEASUREMENT /begin SUB_FUNCTION /end SUB_FUNCTION /end FUNCTION
/begin FUNCTION INDEX_DMFL "" /begin DEF_CHARACTERISTIC /end DEF_CHARACTERISTIC /begin REF_CHARACTERISTIC /end REF_CHARACTERISTIC /begin IN_MEASUREMENT /end IN_MEASUREMENT /begin OUT_MEASUREMENT /end OUT_MEASUREMENT /begin LOC_MEASUREMENT /end LOC_MEASUREMENT /begin SUB_FUNCTION /end SUB_FUNCTION /end FUNCTION
/begin FUNCTION INDEX_DNWS "" /begin DEF_CHARACTERISTIC /end DEF_CHARACTERISTIC /begin REF_CHARACTERISTIC /end REF_CHARACTERISTIC /begin IN_MEASUREMENT /end IN_MEASUREMENT /begin OUT_MEASUREMENT /end OUT_MEASUREMENT /begin LOC_MEASUREMENT /end LOC_MEASUREMENT /begin SUB_FUNCTION /end SUB_FUNCTION /end FUNCTION
/begin FUNCTION INDEX_DPH "" /begin DEF_CHARACTERISTIC /end DEF_CHARACTERISTIC /begin REF_CHARACTERISTIC /end REF_CHARACTERISTIC /begin IN_MEASUREMENT /end IN_MEASUREMENT /begin OUT_MEASUREMENT /end OUT_MEASUREMENT /begin LOC_MEASUREMENT /end LOC_MEASUREMENT /begin SUB_FUNCTION /end SUB_FUNCTION /end FUNCTION
/begin FUNCTION INDEX_DSLSLR "" /begin DEF_CHARACTERISTIC /end DEF_CHARACTERISTIC /begin REF_CHARACTERISTIC /end REF_CHARACTERISTIC /begin IN_MEASUREMENT /end IN_MEASUREMENT /begin OUT_MEASUREMENT /end OUT_MEASUREMENT /begin LOC_MEASUREMENT /end LOC_MEASUREMENT /begin SUB_FUNCTION /end SUB_FUNCTION /end FUNCTION
/begin FUNCTION INDEX_DSTA "" /begin DEF_CHARACTERISTIC /end DEF_CHARACTERISTIC /begin REF_CHARACTERISTIC /end REF_CHARACTERISTIC /begin IN_MEASUREMENT /end IN_MEASUREMENT /begin OUT_MEASUREMENT /end OUT_MEASUREMENT /begin LOC_MEASUREMENT /end LOC_MEASUREMENT /begin SUB_FUNCTION /end SUB_FUNCTION /end FUNCTION
/begin FUNCTION INDEX_DSTS "" /begin DEF_CHARACTERISTIC /end DEF_CHARACTERISTIC /begin REF_CHARACTERISTIC /end REF_CHARACTERISTIC /begin IN_MEASUREMENT /end IN_MEASUREMENT /begin OUT_MEASUREMENT /end OUT_MEASUREMENT /begin LOC_MEASUREMENT /end LOC_MEASUREMENT /begin SUB_FUNCTION /end SUB_FUNCTION /end FUNCTION
/begin FUNCTION INDEX_DTEVN "" /begin DEF_CHARACTERISTIC /end DEF_CHARACTERISTIC /begin REF_CHARACTERISTIC /end REF_CHARACTERISTIC /begin IN_MEASUREMENT /end IN_MEASUREMENT /begin OUT_MEASUREMENT /end OUT_MEASUREMENT /begin LOC_MEASUREMENT /end LOC_MEASUREMENT /begin SUB_FUNCTION /end SUB_FUNCTION /end FUNCTION
/begin FUNCTION INDEX_DTHM "" /begin DEF_CHARACTERISTIC /end DEF_CHARACTERISTIC /begin REF_CHARACTERISTIC /end REF_CHARACTERISTIC /begin IN_MEASUREMENT /end IN_MEASUREMENT /begin OUT_MEASUREMENT /end OUT_MEASUREMENT /begin LOC_MEASUREMENT /end LOC_MEASUREMENT /begin SUB_FUNCTION /end SUB_FUNCTION /end FUNCTION
/begin FUNCTION INDEX_DU5REF "" /begin DEF_CHARACTERISTIC /end DEF_CHARACTERISTIC /begin REF_CHARACTERISTIC /end REF_CHARACTERISTIC /begin IN_MEASUREMENT /end IN_MEASUREMENT /begin OUT_MEASUREMENT /end OUT_MEASUREMENT /begin LOC_MEASUREMENT /end LOC_MEASUREMENT /begin SUB_FUNCTION /end SUB_FUNCTION /end FUNCTION
/begin FUNCTION INDEX_DUF "" /begin DEF_CHARACTERISTIC /end DEF_CHARACTERISTIC /begin REF_CHARACTERISTIC /end REF_CHARACTERISTIC /begin IN_MEASUREMENT /end IN_MEASUREMENT /begin OUT_MEASUREMENT /end OUT_MEASUREMENT /begin LOC_MEASUREMENT /end LOC_MEASUREMENT /begin SUB_FUNCTION /end SUB_FUNCTION /end FUNCTION
/begin FUNCTION INDEX_DUR "" /begin DEF_CHARACTERISTIC /end DEF_CHARACTERISTIC /begin REF_CHARACTERISTIC /end REF_CHARACTERISTIC /begin IN_MEASUREMENT /end IN_MEASUREMENT /begin OUT_MEASUREMENT /end OUT_MEASUREMENT /begin LOC_MEASUREMENT /end LOC_MEASUREMENT /begin SUB_FUNCTION /end SUB_FUNCTION /end FUNCTION
/begin FUNCTION INDEX_DVFZ "" /begin DEF_CHARACTERISTIC /end DEF_CHARACTERISTIC /begin REF_CHARACTERISTIC /end REF_CHARACTERISTIC /begin IN_MEASUREMENT /end IN_MEASUREMENT /begin OUT_MEASUREMENT /end OUT_MEASUREMENT /begin LOC_MEASUREMENT /end LOC_MEASUREMENT /begin SUB_FUNCTION /end SUB_FUNCTION /end FUNCTION
/begin FUNCTION INDEX_EGFE "" /begin DEF_CHARACTERISTIC /end DEF_CHARACTERISTIC /begin REF_CHARACTERISTIC /end REF_CHARACTERISTIC /begin IN_MEASUREMENT /end IN_MEASUREMENT /begin OUT_MEASUREMENT /end OUT_MEASUREMENT /begin LOC_MEASUREMENT /end LOC_MEASUREMENT /begin SUB_FUNCTION /end SUB_FUNCTION /end FUNCTION
/begin FUNCTION INDEX_EWS3 "" /begin DEF_CHARACTERISTIC /end DEF_CHARACTERISTIC /begin REF_CHARACTERISTIC /end REF_CHARACTERISTIC /begin IN_MEASUREMENT /end IN_MEASUREMENT /begin OUT_MEASUREMENT /end OUT_MEASUREMENT /begin LOC_MEASUREMENT /end LOC_MEASUREMENT /begin SUB_FUNCTION /end SUB_FUNCTION /end FUNCTION
/begin FUNCTION INDEX_GGDSAS "" /begin DEF_CHARACTERISTIC /end DEF_CHARACTERISTIC /begin REF_CHARACTERISTIC /end REF_CHARACTERISTIC /begin IN_MEASUREMENT /end IN_MEASUREMENT /begin OUT_MEASUREMENT /end OUT_MEASUREMENT /begin LOC_MEASUREMENT /end LOC_MEASUREMENT /begin SUB_FUNCTION /end SUB_FUNCTION /end FUNCTION
/begin FUNCTION INDEX_GGDVE "" /begin DEF_CHARACTERISTIC /end DEF_CHARACTERISTIC /begin REF_CHARACTERISTIC /end REF_CHARACTERISTIC /begin IN_MEASUREMENT /end IN_MEASUREMENT /begin OUT_MEASUREMENT /end OUT_MEASUREMENT /begin LOC_MEASUREMENT /end LOC_MEASUREMENT /begin SUB_FUNCTION /end SUB_FUNCTION /end FUNCTION
/begin FUNCTION INDEX_GGEGAS "" /begin DEF_CHARACTERISTIC /end DEF_CHARACTERISTIC /begin REF_CHARACTERISTIC /end REF_CHARACTERISTIC /begin IN_MEASUREMENT /end IN_MEASUREMENT /begin OUT_MEASUREMENT /end OUT_MEASUREMENT /begin LOC_MEASUREMENT /end LOC_MEASUREMENT /begin SUB_FUNCTION /end SUB_FUNCTION /end FUNCTION
/begin FUNCTION INDEX_GGPED "" /begin DEF_CHARACTERISTIC /end DEF_CHARACTERISTIC /begin REF_CHARACTERISTIC /end REF_CHARACTERISTIC /begin IN_MEASUREMENT /end IN_MEASUREMENT /begin OUT_MEASUREMENT /end OUT_MEASUREMENT /begin LOC_MEASUREMENT /end LOC_MEASUREMENT /begin SUB_FUNCTION /end SUB_FUNCTION /end FUNCTION
/begin FUNCTION INDEX_GGTFA "" /begin DEF_CHARACTERISTIC /end DEF_CHARACTERISTIC /begin REF_CHARACTERISTIC /end REF_CHARACTERISTIC /begin IN_MEASUREMENT /end IN_MEASUREMENT /begin OUT_MEASUREMENT /end OUT_MEASUREMENT /begin LOC_MEASUREMENT /end LOC_MEASUREMENT /begin SUB_FUNCTION /end SUB_FUNCTION /end FUNCTION
/begin FUNCTION INDEX_GGTFM "" /begin DEF_CHARACTERISTIC /end DEF_CHARACTERISTIC /begin REF_CHARACTERISTIC /end REF_CHARACTERISTIC /begin IN_MEASUREMENT /end IN_MEASUREMENT /begin OUT_MEASUREMENT /end OUT_MEASUREMENT /begin LOC_MEASUREMENT /end LOC_MEASUREMENT /begin SUB_FUNCTION /end SUB_FUNCTION /end FUNCTION
/begin FUNCTION INDEX_GGTFUMG "" /begin DEF_CHARACTERISTIC /end DEF_CHARACTERISTIC /begin REF_CHARACTERISTIC /end REF_CHARACTERISTIC /begin IN_MEASUREMENT /end IN_MEASUREMENT /begin OUT_MEASUREMENT /end OUT_MEASUREMENT /begin LOC_MEASUREMENT /end LOC_MEASUREMENT /begin SUB_FUNCTION /end SUB_FUNCTION /end FUNCTION
/begin FUNCTION INDEX_GGTKA "" /begin DEF_CHARACTERISTIC /end DEF_CHARACTERISTIC /begin REF_CHARACTERISTIC /end REF_CHARACTERISTIC /begin IN_MEASUREMENT /end IN_MEASUREMENT /begin OUT_MEASUREMENT /end OUT_MEASUREMENT /begin LOC_MEASUREMENT /end LOC_MEASUREMENT /begin SUB_FUNCTION /end SUB_FUNCTION /end FUNCTION
/begin FUNCTION INDEX_GGUB "" /begin DEF_CHARACTERISTIC /end DEF_CHARACTERISTIC /begin REF_CHARACTERISTIC /end REF_CHARACTERISTIC /begin IN_MEASUREMENT /end IN_MEASUREMENT /begin OUT_MEASUREMENT /end OUT_MEASUREMENT /begin LOC_MEASUREMENT /end LOC_MEASUREMENT /begin SUB_FUNCTION /end SUB_FUNCTION /end FUNCTION
/begin FUNCTION INDEX_MDKOG "" /begin DEF_CHARACTERISTIC /end DEF_CHARACTERISTIC /begin REF_CHARACTERISTIC /end REF_CHARACTERISTIC /begin IN_MEASUREMENT /end IN_MEASUREMENT /begin OUT_MEASUREMENT /end OUT_MEASUREMENT /begin LOC_MEASUREMENT /end LOC_MEASUREMENT /begin SUB_FUNCTION /end SUB_FUNCTION /end FUNCTION
/begin FUNCTION INDEX_SWADP111 "" /begin DEF_CHARACTERISTIC /end DEF_CHARACTERISTIC /begin REF_CHARACTERISTIC /end REF_CHARACTERISTIC /begin IN_MEASUREMENT /end IN_MEASUREMENT /begin OUT_MEASUREMENT /end OUT_MEASUREMENT /begin LOC_MEASUREMENT /end LOC_MEASUREMENT /begin SUB_FUNCTION /end SUB_FUNCTION /end FUNCTION
/begin FUNCTION IW2NW1 "" /begin DEF_CHARACTERISTIC /end DEF_CHARACTERISTIC /begin REF_CHARACTERISTIC /end REF_CHARACTERISTIC /begin IN_MEASUREMENT /end IN_MEASUREMENT /begin OUT_MEASUREMENT zrph2 /end OUT_MEASUREMENT /begin LOC_MEASUREMENT b_enwfrst2 b_enwini2 /end LOC_MEASUREMENT /begin SUB_FUNCTION /end SUB_FUNCTION /end FUNCTION
/begin FUNCTION IWNW1 "" /begin DEF_CHARACTERISTIC BNWPOL /end DEF_CHARACTERISTIC /begin REF_CHARACTERISTIC /end REF_CHARACTERISTIC /begin IN_MEASUREMENT /end IN_MEASUREMENT /begin OUT_MEASUREMENT jnwfl t1nwi_w wnwkw_w zrph /end OUT_MEASUREMENT /begin LOC_MEASUREMENT b_enw b_enw2 b_enwfrst b_enwini enwbas_w /end LOC_MEASUREMENT /begin SUB_FUNCTION /end SUB_FUNCTION /end FUNCTION
/begin FUNCTION JMPR "" /begin DEF_CHARACTERISTIC /end DEF_CHARACTERISTIC /begin REF_CHARACTERISTIC /end REF_CHARACTERISTIC /begin IN_MEASUREMENT /end IN_MEASUREMENT /begin OUT_MEASUREMENT /end OUT_MEASUREMENT /begin LOC_MEASUREMENT /end LOC_MEASUREMENT /begin SUB_FUNCTION /end SUB_FUNCTION /end FUNCTION
/begin FUNCTION KATV "Variantenerkennung (Fahrzeug mit/ohne Kat und Lambdasonden)" /begin DEF_CHARACTERISTIC /end DEF_CHARACTERISTIC /begin REF_CHARACTERISTIC CDHSV UHDMX /end REF_CHARACTERISTIC /begin IN_MEASUREMENT B_clkatfz B_pwf uhsv uhsv2 /end IN_MEASUREMENT /begin OUT_MEASUREMENT B_nokatfz nokatfz_flg /end OUT_MEASUREMENT /begin LOC_MEASUREMENT /end LOC_MEASUREMENT /begin SUB_FUNCTION /end SUB_FUNCTION /end FUNCTION
/begin FUNCTION KDATR111 "" /begin DEF_CHARACTERISTIC /end DEF_CHARACTERISTIC
 /begin REF_CHARACTERISTIC NUEMAX STNSG1 STNSG2 STNSG3 STNSG4 STNSG5 STTSG1 STTSG2 STTSG3 STTSG4 STTSG5 /end REF_CHARACTERISTIC
 /begin IN_MEASUREMENT anznmax anzpbr_w B_acc B_admtll B_agrrdy B_cdagr B_cdhsv B_cdlsv B_cdsls B_cdtes B_dkpu B_dldpte B_ebl B_ekp B_estart B_etr B_ews_ok B_fgrat B_fgrhsa B_fgrtbe B_fgrtse B_fgrtve B_fgrtwa B_fhz B_hshe B_hshe2 B_hsrdy B_hsve B_hsve2 B_katfz B_kath B_katrdy B_kd B_kl15 B_ko B_koe B_kuppl B_ldpein B_ll B_lr B_lr2 B_lsrdy B_nac B_nftev B_nsub B_pn B_sa B_sbbhk B_sbbhk2 B_sbbvk B_sbbvk2 B_slp B_slsrdy B_slv B_sta B_tehb B_tesrdy B_umaerf B_vl fkmsdka_w fkmsdk_w fr2_w fra2_w fra_w fr_w ilb ipteskf_w iptglmn_w iptref_w kmstnmax kmstpbr_w llsstat lutsfi1 lutsfi2 lutsfi3 lutsfi4 lutsfi5 lutsfi6 lutsfi7 lutsfi8 L_fgr miist_w mshfm_w msndko_w nmax_w nmot_w nsol nwsdstat nwsdstat2 nwsstat nwsstat2 phlsnh phlsnh2 phlsnv phlsnv2 rkat2_w rkat_w rkrn_w slsstat stpdmtl stpdmtla stptr S_bls S_brs S_ldpr taml tans tanwr tateist tesstat thvaist thvaist2 ti_w tka tmot tnwsfi tnwsfi2 tnwssi tnwssi2 tplrvk2_w tplrvk_w ub upwg_w usvk2_w usvk_w vfzg wdkba wnwi_w wnwsp_w zwout /end IN_MEASUREMENT
 /begin OUT_MEASUREMENT /end OUT_MEASUREMENT
 /begin LOC_MEASUREMENT /end LOC_MEASUREMENT
 /begin SUB_FUNCTION /end SUB_FUNCTION
/end FUNCTION
/begin FUNCTION KHMD "Berechnung Reservemoment für Katheizen"
 /begin DEF_CHARACTERISTIC CWKHMD FMDKHFH FMDKHFH2 FMDKHTM FMDKHTM2 KFKWTMP KFMDDSLA KFMDKH KFMDKH2 /end DEF_CHARACTERISTIC
 /begin REF_CHARACTERISTIC /end REF_CHARACTERISTIC
 /begin IN_MEASUREMENT B_fasla B_kh B_kw B_nokatfz dmllri_w fho_w fmdkh mifa_w nmot_w tmot /end IN_MEASUREMENT
 /begin OUT_MEASUREMENT dmrdsls_w dmrkh dmrkh_w /end OUT_MEASUREMENT
 /begin LOC_MEASUREMENT dmrkhz_w drkwtmp_w fmkhfho_w fmkhtm mifakh_w /end LOC_MEASUREMENT
 /begin SUB_FUNCTION /end SUB_FUNCTION
/end FUNCTION
/begin FUNCTION KIOC111 "" /begin DEF_CHARACTERISTIC /end DEF_CHARACTERISTIC
 /begin REF_CHARACTERISTIC NFSACVMN NFSACVMX NFSMVMN NFSMVMX NLLMVMN NLLMVMX NSACMVMN NSACMVMX NSLBVMN NSLBVMX TMNV TMNVFS /end REF_CHARACTERISTIC
 /begin IN_MEASUREMENT anznmax anzpbr_w B_acc B_ascpkw B_autget B_bt B_btanskl B_btdmmv B_btdmpm B_btebl B_btekp B_btev1 B_btev2 B_btev3 B_btev4 B_btev5 B_btev6 B_btev7 B_btev8 B_bthdm B_bthsh B_bthsh2 B_bthsv B_bthsv2 B_btkos B_btldp B_btslp B_btslv B_btsta B_bttev B_cotrim B_dmmvet B_dmpmet B_eblet B_ekpet B_etret B_faetr B_famls B_hsh2et B_hshet B_hsv2et B_hsvet B_koset B_nokatfz B_nsabg B_pn B_slpet B_slvet B_staet B_tevet co_pot dnfsacmv dnfsmv dnllmv dnsacmv dnslbv hsh2tim hshtim hsv2tim hsvtim kmstnmax kmstpbr_w nmax_w nmot tamldia tevtim tmot t_bthsh t_bthsh2 t_bthsv t_bthsv2 t_bttev t_bttim /end IN_MEASUREMENT
 /begin OUT_MEASUREMENT /end OUT_MEASUREMENT
 /begin LOC_MEASUREMENT /end LOC_MEASUREMENT
 /begin SUB_FUNCTION /end SUB_FUNCTION
/end FUNCTION
/begin FUNCTION KOS107 ""
 /begin DEF_CHARACTERISTIC LIMTKOA MDKOAN MDKOEN SNM08KOUB TKOAMNN TKOAMXN TKOEMNN TMKOAO TMKOAU TNSTKO TVKOE VKOAO /end DEF_CHARACTERISTIC
 /begin REF_CHARACTERISTIC /end REF_CHARACTERISTIC
 /begin IN_MEASUREMENT B_ac B_ko B_kosta B_stend B_vl mdko mifal_w nmot tmot vfzg /end IN_MEASUREMENT
 /begin OUT_MEASUREMENT B_acres B_koa B_koe B_nac /end OUT_MEASUREMENT
 /begin LOC_MEASUREMENT B_koena B_komnoff B_komnon B_komxoff B_kooff B_kosta esst_snm08koub /end LOC_MEASUREMENT
 /begin SUB_FUNCTION /end SUB_FUNCTION
/end FUNCTION
/begin FUNCTION kract111 "" /begin DEF_CHARACTERISTIC /end DEF_CHARACTERISTIC /begin REF_CHARACTERISTIC /end REF_CHARACTERISTIC
 /begin IN_MEASUREMENT B_auswrt B_fa B_fadldp B_fadmtle B_fadmtls B_faevz B_falls B_falr B_falra B_fanws B_fanwsd B_fasls B_fates B_inistw B_pwf B_resstw B_timerr devoff nsolfa pm_akt pm_fre pm_mod pm_ta pm_td tmot top_w ttimout wnwstst /end IN_MEASUREMENT
 /begin OUT_MEASUREMENT /end OUT_MEASUREMENT
 /begin LOC_MEASUREMENT /end LOC_MEASUREMENT
 /begin SUB_FUNCTION /end SUB_FUNCTION
/end FUNCTION
/begin COMPU_METHOD aimv_ul_b5p76e11 "" RAT_FUNC "%12.0" "-" COEFFS 0 0 5.76e+013 0 800 0 /end COMPU_METHOD
/begin COMPU_METHOD bfzg_sb_q0p217 "" RAT_FUNC "%6.3" "m/s^2" COEFFS 0 1 0 0 0 0.217 /end COMPU_METHOD
/begin COMPU_METHOD B_TRUE "boolsche Zustände, positive Logik" TAB_VERB "%6.3" "" COMPU_TAB_REF B_TRUE /end COMPU_METHOD
/begin COMPU_VTAB B_TRUE "boolsche Zustände, positive Logik" TAB_VERB 2 0 "----" 1 "TRUE" /end COMPU_VTAB
/begin COMPU_METHOD dez "1 : 1 Umrechnug (dez/hex)" RAT_FUNC "%6.2" "" COEFFS 0 1 0 0 0 1 /end COMPU_METHOD
/begin COMPU_METHOD DEZL "Dezimalzahl in 16-Bit-Hexzahl" RAT_FUNC "%6.2" "" COEFFS 0 1 0 0 0 1 /end COMPU_METHOD
/begin COMPU_METHOD dezsub1 "" RAT_FUNC "%6.2" "-" COEFFS 0 1 -1 0 0 1 /end COMPU_METHOD
/begin COMPU_METHOD fak_q0p0039 "" RAT_FUNC "%6.4" "-" COEFFS 0 256 0 0 0 1 /end COMPU_METHOD
/begin COMPU_METHOD fak_sb_b0p25 "" RAT_FUNC "%6.4" "-" COEFFS 0 256 0 0 0 0.5 /end COMPU_METHOD
/begin COMPU_METHOD fak_ub_b1 "" RAT_FUNC "%6.4" "-" COEFFS 0 256 0 0 0 1 /end COMPU_METHOD
/begin COMPU_METHOD fak_ub_b16 "" RAT_FUNC "%6.4" "-" COEFFS 0 256 0 0 0 16 /end COMPU_METHOD
/begin COMPU_METHOD fak_ub_b2 "" RAT_FUNC "%6.4" "-" COEFFS 0 256 0 0 0 2 /end COMPU_METHOD
/begin COMPU_METHOD fak_ub_b4 "" RAT_FUNC "%6.4" "-" COEFFS 0 256 0 0 0 4 /end COMPU_METHOD
/begin COMPU_METHOD fak_ub_b8 "" RAT_FUNC "%6.4" "-" COEFFS 0 256 0 0 0 8 /end COMPU_METHOD
/begin COMPU_METHOD fak_ub_q0p01 "" RAT_FUNC "%6.4" "" COEFFS 0 1 0 0 0 0.01 /end COMPU_METHOD
/begin COMPU_METHOD fak_uw_b1 "" RAT_FUNC "%7.6" "-" COEFFS 0 65536 0 0 0 1 /end COMPU_METHOD
/begin COMPU_METHOD fak_uw_b16 "" RAT_FUNC "%6.5" "-" COEFFS 0 65536 0 0 0 16 /end COMPU_METHOD
/begin COMPU_METHOD fak_uw_b2 "" RAT_FUNC "%7.6" "-" COEFFS 0 65536 0 0 0 2 /end COMPU_METHOD
/begin COMPU_METHOD fak_uw_b256 "" RAT_FUNC "%7.5" "" COEFFS 0 65536 0 0 0 256 /end COMPU_METHOD
/begin COMPU_METHOD fak_uw_b4 "" RAT_FUNC "%7.6" "-" COEFFS 0 65536 0 0 0 4 /end COMPU_METHOD
/begin COMPU_METHOD fak_uw_b64 "" RAT_FUNC "%6.5" "-" COEFFS 0 65536 0 0 0 64 /end COMPU_METHOD
/begin COMPU_METHOD fmfkr_dez "" RAT_FUNC "%5.2" "kHz" COEFFS 0 1 0 0 0 1 /end COMPU_METHOD
/begin COMPU_METHOD m_ub_b1020 "" RAT_FUNC "%6.2" "kg/h" COEFFS 0 1 0 0 0 4 /end COMPU_METHOD
/begin COMPU_METHOD m_ub_b23p3 "" RAT_FUNC "%6.3" "kg" COEFFS 0 2812.5 0 0 0 256 /end COMPU_METHOD
/begin COMPU_METHOD m_uw_b6553p5 "" RAT_FUNC "%6.3" "kg/h" COEFFS 0 1 0 0 0 0.1 /end COMPU_METHOD
/begin COMPU_METHOD nmot_ub_q40 "" RAT_FUNC "%6.1" "Upm" COEFFS 0 1 0 0 0 40 /end COMPU_METHOD
/begin COMPU_METHOD nmot_uw_q0p25 "" RAT_FUNC "%6.3" "U/min" COEFFS 0 1 0 0 0 0.25 /end COMPU_METHOD
/begin COMPU_METHOD p_uw_q0p039 "" RAT_FUNC "%6.4" "hPa" COEFFS 0 256 0 0 0 10 /end COMPU_METHOD
/begin COMPU_METHOD relDK_ub_b100 "" RAT_FUNC "%6.3" "% DK" COEFFS 0 255 0 0 0 100 /end COMPU_METHOD
/begin COMPU_METHOD relDK_uw_b100 "" RAT_FUNC "%6.4" "% DK" COEFFS 0 65535 0 0 0 100 /end COMPU_METHOD
/begin COMPU_METHOD relPED_ub_b100 "" RAT_FUNC "%6.3" "% PED" COEFFS 0 255 0 0 0 100 /end COMPU_METHOD
/begin COMPU_METHOD relPED_uw_b100 "" RAT_FUNC "%6.4" "% PED" COEFFS 0 65535 0 0 0 100 /end COMPU_METHOD
/begin COMPU_METHOD rel_q0p09726 "" RAT_FUNC "%6.3" "%" COEFFS 0 255 0 0 0 24.9 /end COMPU_METHOD
/begin COMPU_METHOD rel_sb_q0p39 "" RAT_FUNC "%6.3" "%" COEFFS 0 1 0 0 0 0.3906 /end COMPU_METHOD
/begin COMPU_METHOD rel_sw_b100 "" RAT_FUNC "%6.4" "%" COEFFS 0 32768 0 0 0 100 /end COMPU_METHOD
/begin COMPU_METHOD rel_sw_b1536 "" RAT_FUNC "%6.4" "%" COEFFS 0 65536 0 0 0 3072 /end COMPU_METHOD
/begin COMPU_METHOD rel_sw_b50 "" RAT_FUNC "%6.4" "%" COEFFS 0 65536 0 0 0 100 /end COMPU_METHOD
/begin COMPU_METHOD rel_sw_q0p0234 "" RAT_FUNC "%6.4" "%/seg" COEFFS 0 32 0 0 0 0.75 /end COMPU_METHOD
/begin COMPU_METHOD rel_ub_b100 "" RAT_FUNC "%6.3" "%" COEFFS 0 255 0 0 0 100 /end COMPU_METHOD
/begin COMPU_METHOD rel_ub_b127p5 "" RAT_FUNC "%6.3" "%" COEFFS 0 2 0 0 0 1 /end COMPU_METHOD
/begin COMPU_METHOD rel_ub_b99p6 "" RAT_FUNC "%6.3" "%" COEFFS 0 256 0 0 0 100 /end COMPU_METHOD
/begin COMPU_METHOD rel_ub_q0p3906 "" RAT_FUNC "%6.3" "%" COEFFS 0 256 0 0 0 100 /end COMPU_METHOD
/begin COMPU_METHOD rel_ub_q0p75 "" RAT_FUNC "%6.3" "%" COEFFS 0 1 0 0 0 0.75 /end COMPU_METHOD
/begin COMPU_METHOD rel_uw_b100 "" RAT_FUNC "%6.4" "%" COEFFS 0 65536 0 0 0 100 /end COMPU_METHOD
/begin COMPU_METHOD rel_uw_b200 "" RAT_FUNC "%6.4" "%" COEFFS 0 65536 0 0 0 200 /end COMPU_METHOD
/begin COMPU_METHOD rel_uw_b3072 "" RAT_FUNC "%6.4" "%" COEFFS 0 65536 0 0 0 3072 /end COMPU_METHOD
/begin COMPU_METHOD rel_uw_b40 "" RAT_FUNC "%6.5" "%" COEFFS 0 65536 0 0 0 40 /end COMPU_METHOD
/begin COMPU_METHOD rel_uw_q0p0234 "" RAT_FUNC "%6.4" "%" COEFFS 0 32 0 0 0 0.75 /end COMPU_METHOD
/begin COMPU_METHOD rkti_sy "" RAT_FUNC "%6.4" "ms/%" COEFFS 0 468.75 0 0 0 1 /end COMPU_METHOD
/begin COMPU_METHOD r_uw_q2 "" RAT_FUNC "%6.2" "Ohm" COEFFS 0 1 0 0 0 2 /end COMPU_METHOD
/begin COMPU_METHOD spgg_sw_b3052 "" RAT_FUNC "%6.3" "V/s" COEFFS 0 1 0 0 0 0.0931323 /end COMPU_METHOD
/begin COMPU_METHOD spg_q0p00039 "" RAT_FUNC "%6.5" "V" COEFFS 0 1 0 0 0 0.000390625 /end COMPU_METHOD
/begin COMPU_METHOD spg_q0p1 "" RAT_FUNC "%6.3" "V" COEFFS 0 1 0 0 0 0.1 /end COMPU_METHOD
/begin COMPU_METHOD spg_sw_q0p001222 "" RAT_FUNC "%6.4" "V" COEFFS 0 1 0 0 0 0.001222 /end COMPU_METHOD
/begin COMPU_METHOD spg_sw_q0p00488 "" RAT_FUNC "%6.4" "V" COEFFS 0 1024 0 0 0 5 /end COMPU_METHOD
/begin COMPU_METHOD spg_ubatt "" RAT_FUNC "%6.3" "V" COEFFS 0 1 0 0 0 0.0942 /end COMPU_METHOD
/begin COMPU_METHOD spg_ubatt_w "" RAT_FUNC "%6.4" "V" COEFFS 0 1 0 0 0 0.023535 /end COMPU_METHOD
/begin COMPU_METHOD spg_ub_b5 "" RAT_FUNC "%6.4" "V" COEFFS 0 256 0 0 0 5 /end COMPU_METHOD
/begin COMPU_METHOD spg_ub_q0p0052_o0p2 "" RAT_FUNC "%6.3" "V" COEFFS 0 255 51 0 0 1.33 /end COMPU_METHOD
/begin COMPU_METHOD spg_uw_b5 "" RAT_FUNC "%6.4" "V" COEFFS 0 1024 0 0 0 5 /end COMPU_METHOD
/begin COMPU_METHOD spg_uw_q0p001222 "" RAT_FUNC "%6.4" "V" COEFFS 0 1 0 0 0 0.001222 /end COMPU_METHOD
/begin COMPU_METHOD spg_uw_q0p00488 "" RAT_FUNC "%6.4" "V" COEFFS 0 1024 0 0 0 5 /end COMPU_METHOD
/begin COMPU_METHOD spg_uw_q0p00488_o1 "" RAT_FUNC "%6.3" "V" COEFFS 0 1024 1024 0 0 5 /end COMPU_METHOD
/begin COMPU_METHOD t100msxs_sb_q0p01 "" RAT_FUNC "%6.4" "s" COEFFS 0 1 0 0 0 0.01 /end COMPU_METHOD
/begin COMPU_METHOD t100msxs_ub_b255 "" RAT_FUNC "%6.2" "s" COEFFS 0 1 0 0 0 1 /end COMPU_METHOD
/begin COMPU_METHOD t100msxs_ub_b25p5 "" RAT_FUNC "%6.3" "s" COEFFS 0 1 0 0 0 0.1 /end COMPU_METHOD
/begin COMPU_METHOD t100msxs_uw_b6553p5 "" RAT_FUNC "%6.3" "s" COEFFS 0 1 0 0 0 0.1 /end COMPU_METHOD
/begin COMPU_METHOD t100msxs_uw_b6553p6 "" RAT_FUNC "%6.3" "s" COEFFS 0 10 0 0 0 1 /end COMPU_METHOD
/begin COMPU_METHOD t10msxs_q0p01_o0p05 "" RAT_FUNC "%6.4" "s" COEFFS 0 1 0.05 0 0 0.01 /end COMPU_METHOD
/begin COMPU_METHOD t10msxs_sb_q0p01 "" RAT_FUNC "%6.4" "s" COEFFS 0 1 0 0 0 0.01 /end COMPU_METHOD
/begin COMPU_METHOD t10msxs_ub_b2p55 "" RAT_FUNC "%6.4" "s" COEFFS 0 1 0 0 0 0.01 /end COMPU_METHOD
/begin COMPU_METHOD t10msxs_uw_b655p35 "" RAT_FUNC "%6.4" "s" COEFFS 0 1 0 0 0 0.01 /end COMPU_METHOD
/begin COMPU_METHOD t1msxms_q1 "" RAT_FUNC "%6.2" "ms" COEFFS 0 1 0 0 0 1 /end COMPU_METHOD
/begin COMPU_METHOD t1sxs_ub_b255 "" RAT_FUNC "%6.2" "s" COEFFS 0 1 0 0 0 1 /end COMPU_METHOD
/begin COMPU_METHOD t1sxs_uw_q1 "" RAT_FUNC "%6.2" "s" COEFFS 0 1 0 0 0 1 /end COMPU_METHOD
/begin COMPU_METHOD t200msxs_ub_b51 "" RAT_FUNC "%6.3" "s" COEFFS 0 1 0 0 0 0.2 /end COMPU_METHOD
/begin COMPU_METHOD t20msxs_ub_b5p1 "" RAT_FUNC "%6.4" "s" COEFFS 0 1 0 0 0 0.02 /end COMPU_METHOD
/begin COMPU_METHOD temp_sb_b0p093 "" RAT_FUNC "%6.5" "°C" COEFFS 0 512 0 0 0 0.375 /end COMPU_METHOD
/begin COMPU_METHOD temp_ub_b191p25 "" RAT_FUNC "%6.3" "Grad C" COEFFS 0 1 0 0 0 0.75 /end COMPU_METHOD
/begin COMPU_METHOD temp_ub_q0p75_o48 "" RAT_FUNC "%6.2" "Grad C" COEFFS 0 1 48 0 0 0.75 /end COMPU_METHOD
/begin COMPU_METHOD temp_ub_q5_o50 "" RAT_FUNC "%6.2" "Grad C" COEFFS 0 1 50 0 0 5 /end COMPU_METHOD
/begin COMPU_METHOD temp_uw_q0p75_o48 "" RAT_FUNC "%6.2" "Grad C" COEFFS 0 1 48 0 0 0.75 /end COMPU_METHOD
/begin COMPU_METHOD tinjection_sy "" RAT_FUNC "%6.4" "ms" COEFFS 0 312.5 0 0 0 1 /end COMPU_METHOD
/begin COMPU_METHOD tknockcon_sy "" RAT_FUNC "%8.7" "s" COEFFS 0 312500 0 0 0 1 /end COMPU_METHOD
/begin COMPU_METHOD TQ10 "Zeitquantisierung mit 10 [ms]" RAT_FUNC "%6.4" "sec" COEFFS 0 100 0 0 0 1 /end COMPU_METHOD
/begin COMPU_METHOD tsquant "Umrechnung Segmentzeit in DMD" RAT_FUNC "%6.2" "us" COEFFS 0 1.25 0 0 0 1 /end COMPU_METHOD
/begin COMPU_METHOD vfzg_ub_q1p25 "" RAT_FUNC "%6.2" "km/h" COEFFS 0 1 0 0 0 1.25 /end COMPU_METHOD
/begin COMPU_METHOD vfzg_uw_b512 "" RAT_FUNC "%6.4" "km/h" COEFFS 0 65536 0 0 0 512 /end COMPU_METHOD
/begin COMPU_METHOD vol_q0p1_l "" RAT_FUNC "%6.3" "L" COEFFS 0 1 0 0 0 0.1 /end COMPU_METHOD
/begin COMPU_METHOD vol_q1_l "" RAT_FUNC "%6.2" "L" COEFFS 0 1 0 0 0 1 /end COMPU_METHOD
/begin COMPU_METHOD vol_q4p8828Em3_l "" RAT_FUNC "%6.4" "L" COEFFS 0 65536 0 0 0 320 /end COMPU_METHOD
/begin COMPU_METHOD wkw_ub_q0p25 "" RAT_FUNC "%7.3" "Grad KW" COEFFS 0 4 0 0 0 1 /end COMPU_METHOD
/begin COMPU_METHOD wkw_ub_q0p5 "" RAT_FUNC "%7.3" "Grad KW" COEFFS 0 2 0 0 0 1 /end COMPU_METHOD
/begin COMPU_METHOD wkw_uw_b2048 "" RAT_FUNC "%7.4" "grad KW" COEFFS 0 32 0 0 0 1 /end COMPU_METHOD
/begin COMPU_METHOD WQ720 "Kurbelwellenwinkel - Quantisierung" RAT_FUNC "%6.2" "grad KW" COEFFS 0 1 0 0 0 2.813 /end COMPU_METHOD
/begin COMPU_METHOD zk100msxs_uw_b6553 "" RAT_FUNC "%6.1" "s" COEFFS 0 0 65536 0 10 0 /end COMPU_METHOD
/begin COMPU_METHOD zk10msxs_uw_b655 "" RAT_FUNC "%10.4" "s" COEFFS 0 0 65536 0 100 0 /end COMPU_METHOD
/begin COMPU_METHOD zw_sb_q0p75 "" RAT_FUNC "%6.3" "grad KW" COEFFS 0 255 0 0 0 191.25 /end COMPU_METHOD
/begin COMPU_METHOD zw_ub_q0p75 "" RAT_FUNC "%6.3" "Grad KW" COEFFS 0 255 0 0 0 191.25 /end COMPU_METHOD
/begin COMPU_METHOD zw_ub_q6 "" RAT_FUNC "%6.2" "Grad KW" COEFFS 0 255 0 0 0 1530 /end COMPU_METHOD
/begin COMPU_METHOD default "" RAT_FUNC "%6.2" "" COEFFS 0 1 0 0 0 1 /end COMPU_METHOD
/begin RECORD_LAYOUT FklWUw FNC_VALUES 1 UWORD COLUMN_DIR DIRECT /end RECORD_LAYOUT
/begin RECORD_LAYOUT GkfWUb FNC_VALUES 1 UBYTE COLUMN_DIR DIRECT /end RECORD_LAYOUT
/begin RECORD_LAYOUT GklWUb FNC_VALUES 1 UBYTE COLUMN_DIR DIRECT /end RECORD_LAYOUT
/begin RECORD_LAYOUT KfAxUbAyUbSstxUbSstyUbWSb NO_AXIS_PTS_X 1 UBYTE NO_AXIS_PTS_Y 2 UBYTE AXIS_PTS_X 3 UBYTE INDEX_INCR DIRECT AXIS_PTS_Y 4 UBYTE INDEX_INCR DIRECT FNC_VALUES 5 SBYTE COLUMN_DIR DIRECT /end RECORD_LAYOUT
/begin RECORD_LAYOUT KfAxUbAyUbSstxUbSstyUbWUb NO_AXIS_PTS_X 1 UBYTE NO_AXIS_PTS_Y 2 UBYTE AXIS_PTS_X 3 UBYTE INDEX_INCR DIRECT AXIS_PTS_Y 4 UBYTE INDEX_INCR DIRECT FNC_VALUES 5 UBYTE COLUMN_DIR DIRECT /end RECORD_LAYOUT
/begin RECORD_LAYOUT KfAxUwAyUwSstxUwSstyUwWUw NO_AXIS_PTS_X 1 UWORD NO_AXIS_PTS_Y 2 UWORD AXIS_PTS_X 3 UWORD INDEX_INCR DIRECT AXIS_PTS_Y 4 UWORD INDEX_INCR DIRECT FNC_VALUES 5 UWORD COLUMN_DIR DIRECT /end RECORD_LAYOUT
/begin RECORD_LAYOUT KlAUbSstUbWSb NO_AXIS_PTS_X 1 UBYTE AXIS_PTS_X 2 UBYTE INDEX_INCR DIRECT FNC_VALUES 3 SBYTE COLUMN_DIR DIRECT /end RECORD_LAYOUT
/begin RECORD_LAYOUT KlAUbSstUbWUb NO_AXIS_PTS_X 1 UBYTE AXIS_PTS_X 2 UBYTE INDEX_INCR DIRECT FNC_VALUES 3 UBYTE COLUMN_DIR DIRECT /end RECORD_LAYOUT
/begin RECORD_LAYOUT KlAUbSstUbWUw NO_AXIS_PTS_X 1 UBYTE AXIS_PTS_X 2 UBYTE INDEX_INCR DIRECT FNC_VALUES 3 UWORD COLUMN_DIR DIRECT /end RECORD_LAYOUT
/begin RECORD_LAYOUT KlAUwSstUwWUw NO_AXIS_PTS_X 1 UWORD AXIS_PTS_X 2 UWORD INDEX_INCR DIRECT FNC_VALUES 3 UWORD COLUMN_DIR DIRECT /end RECORD_LAYOUT
/begin RECORD_LAYOUT KwbUb FNC_VALUES 1 UBYTE COLUMN_DIR DIRECT /end RECORD_LAYOUT
/begin RECORD_LAYOUT KwSw FNC_VALUES 1 SWORD COLUMN_DIR DIRECT /end RECORD_LAYOUT
/begin RECORD_LAYOUT KwUb FNC_VALUES 1 UBYTE COLUMN_DIR DIRECT /end RECORD_LAYOUT
/begin RECORD_LAYOUT KwUl FNC_VALUES 1 ULONG COLUMN_DIR DIRECT /end RECORD_LAYOUT
/begin RECORD_LAYOUT KwUw FNC_VALUES 1 UWORD COLUMN_DIR DIRECT /end RECORD_LAYOUT
/begin RECORD_LAYOUT SstAUbSstUb NO_AXIS_PTS_X 1 UBYTE AXIS_PTS_X 2 UBYTE INDEX_INCR DIRECT /end RECORD_LAYOUT
/end MODULE
/end PROJECT
