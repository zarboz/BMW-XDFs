ASAP2_VERSION 1 3
/begin PROJECT BMW_ME72 "72111"
/begin HEADER "" VERSION "_721115A0" PROJECT_NO BMW_ME72 /end HEADER
/begin MODULE DIM ""
/begin MOD_COMMON "" BYTE_ORDER MSB_LAST ALIGNMENT_BYTE 1 ALIGNMENT_WORD 2 ALIGNMENT_LONG 2 /end MOD_COMMON
/begin CHARACTERISTIC AFNTOL "Toleranz zur Verkleinerung des Aussetzerfenster bzgl. Drehzahl" VALUE 0x811091 KwUb 10200. nmot_ub_q40 0.00 10200. FORMAT "%5.0" /end CHARACTERISTIC
/begin CHARACTERISTIC AHEAGW "Aussetzerhäufigkeit zum Erreichen der gesetzlichen Abgaslimits" VALUE 0x813E9E KwUw 65535.00 dez 0.00 65535.00 FORMAT "%8.2" /end CHARACTERISTIC
/begin CHARACTERISTIC AHEAGWS "Aussetzerhäufigkeit zum Erreichen der gesetzlichen Abgaslimits" VALUE 0x813EA0 KwUw 65535.00 dez 0.00 65535.00 FORMAT "%8.2" /end CHARACTERISTIC
/begin CHARACTERISTIC AHEARV "Aussetzerhäufigkeit zum Erreichen der Ausblendung weiterer Funktionen" VALUE 0x813EA2 KwUw 65535.00 dez 0.00 65535.00 FORMAT "%8.2" /end CHARACTERISTIC
/begin CHARACTERISTIC AHEKA "Aussetzerhäufigkeit zum Erreichen einer Kraftstoffabschaltung" VALUE 0x813EA4 KwUw 65535.00 dez 0.00 65535.00 FORMAT "%8.2" /end CHARACTERISTIC
/begin CHARACTERISTIC AHEKS "Aussetzerhäufigkeit zum Erreichen einer Katalysatorschädigung" VALUE 0x813EA6 KwUw 65535.00 dez 0.00 65535.00 FORMAT "%8.2" /end CHARACTERISTIC
/begin CHARACTERISTIC AHEKS1 "Aussetzerhäufigkeit zum Erreichen einer Katschädigung im 1. Intervall nach Start" VALUE 0x813EA8 KwUw 65535.00 dez 0.00 65535.00 FORMAT "%8.2" /end CHARACTERISTIC
/begin CHARACTERISTIC AIMDTED "Schwelle für Störerkennung Verlustmoment" VALUE 0x81744C KwUw 99.99847 rel_uw_b100 0.00 99.99847 FORMAT "%8.5" /end CHARACTERISTIC
/begin CHARACTERISTIC AINTKA "Anzahl Intervalle mit Katschädigung für Ti-Abschaltung" VALUE 0x813EAA KwUw 65535.00 dez 0.00 65535.00 FORMAT "%8.2" /end CHARACTERISTIC
/begin CHARACTERISTIC AIODTEX "Maximale Anzahl der i.O.-Prüfungen bei Tankentlüftungsdiagnose" VALUE 0x81A4EE KwUb 255.0 dez 0.00 255.0 FORMAT "%5.1" /end CHARACTERISTIC
/begin CHARACTERISTIC ANZTIBMX "Begrenzung ti-Einspritzzähler ""anztib_w""" VALUE 0x815A38 KwUw 50176.00 dez 0.00 50176.00 FORMAT "%8.2" /end CHARACTERISTIC
/begin CHARACTERISTIC ANZTIWS "Anzahl Einspritzungen für Wiederholstarterkennung" VALUE 0x811BA0 KwUb 255.0 dez 0.00 255.0 FORMAT "%5.1" /end CHARACTERISTIC
/begin CHARACTERISTIC ANZTPMX "Maximale Anzahl von hintereinander erlaubten Tips" VALUE 0x811AEE KwUb 255.0 dez 0.00 255.0 FORMAT "%5.1" /end CHARACTERISTIC
/begin CHARACTERISTIC APDTEX "max. Anzahl Prüfungen bei Tankentlüftungsdiagnose" VALUE 0x81A4EF KwUb 255.0 dez 0.00 255.0 FORMAT "%5.1" /end CHARACTERISTIC
/begin CHARACTERISTIC ASIDNWS "max. Anzahl Signalfehler" VALUE 0x8195B3 KwUb 255.0 DEZ 0.00 255.0 FORMAT "%5.1" /end CHARACTERISTIC
/begin CHARACTERISTIC ASIDNWSMX "Oberer Anschlag des Signalfehler-Zählers" VALUE 0x81009C KwUb 255.0 DEZ 0.00 255.0 FORMAT "%5.1" /end CHARACTERISTIC
/begin CHARACTERISTIC ATISLATM "Anzti-Schwelle zur Umschaltung von lamns_w auf lamwl_w" CURVE 0x815BD6 GklWUw 50176.00 dez 0.00 50176.00 FORMAT "%8.2"
 /begin AXIS_DESCR COM_AXIS tmst temp_ub_q0p75_o48 12 -48.00 143.3 AXIS_PTS_REF STS12ESUB /end AXIS_DESCR
/end CHARACTERISTIC
/begin CHARACTERISTIC AVRALU "Anzahl NW-Umdr./Verbrenng. f. Reaktivierung Aussetzererkennung nach Ausblendung" VALUE 0x81134C KwUb 254.0 dez 1.000 255.0 FORMAT "%5.1" /end CHARACTERISTIC
/begin CHARACTERISTIC AZYTIAB "Maximale Anzahl von Zylindern mit Ti-Abschaltung aufgrund von Aussetzern" VALUE 0x811092 KwUb 255.0 dez 0.00 255.0 FORMAT "%5.1" /end CHARACTERISTIC
/begin CHARACTERISTIC BRABEVI "Beschleunigung bei Rampe Beschleunigen" CURVE 0x8157B8 KlAUwSstUwWUw 7110.547 bfzg_uw_q0p1085 0.00 7110.547 FORMAT "%8.3"
 /begin AXIS_DESCR STD_AXIS vfzg_w vfzg_uw_b512 8 0.00 511.9922 FORMAT "%8.4" DEPOSIT ABSOLUTE /end AXIS_DESCR
/end CHARACTERISTIC
/begin CHARACTERISTIC BRATD "Beschleunigung (Betrag) bei Rampe Tip-Down" VALUE 0x811AEF KwUb 27.56 bfzg_ub_b27p67 0.00 27.56 FORMAT "%5.2" /end CHARACTERISTIC
/begin CHARACTERISTIC BRATU "Beschleunigung bei Rampe Tip-Up" VALUE 0x811AF0 KwUb 27.56 bfzg_ub_b27p67 0.00 27.56 FORMAT "%5.2" /end CHARACTERISTIC
/begin CHARACTERISTIC BRAWA1GA "Beschleunigung Rampe Wiederaufnahme im Lande-Mode Bereich 1" CURVE 0x81AD96 KlAUwSstUwWUw 7110.547 bfzg_uw_q0p1085 0.00 7110.547 FORMAT "%8.3"
 /begin AXIS_DESCR STD_AXIS vfzg_w vfzg_uw_b512 8 0.00 511.9922 FORMAT "%8.4" DEPOSIT ABSOLUTE /end AXIS_DESCR
/end CHARACTERISTIC
/begin CHARACTERISTIC BRAWA2GA "Beschleunigung Rampe Wiederaufnahme im Lande-Mode Bereich 2" CURVE 0x81ADB8 KlAUwSstUwWUw 7110.547 bfzg_uw_q0p1085 0.00 7110.547 FORMAT "%8.3"
 /begin AXIS_DESCR STD_AXIS vfzg_w vfzg_uw_b512 8 0.00 511.9922 FORMAT "%8.4" DEPOSIT ABSOLUTE /end AXIS_DESCR
/end CHARACTERISTIC
/begin CHARACTERISTIC BRAWA3GA "Beschleunigung Rampe Wiederaufnahme im Lande-Mode Bereich 3" CURVE 0x81ADDA KlAUwSstUwWUw 7110.547 bfzg_uw_q0p1085 0.00 7110.547 FORMAT "%8.3"
 /begin AXIS_DESCR STD_AXIS vfzg_w vfzg_uw_b512 8 0.00 511.9922 FORMAT "%8.4" DEPOSIT ABSOLUTE /end AXIS_DESCR
/end CHARACTERISTIC
/begin CHARACTERISTIC BRAWAVI "Beschleunigung Rampe Wiederaufnahme" CURVE 0x8157DA KlAUwSstUwWUw 7110.547 bfzg_uw_q0p1085 0.00 7110.547 FORMAT "%8.3"
 /begin AXIS_DESCR STD_AXIS vfzg_w vfzg_uw_b512 8 0.00 511.9922 FORMAT "%8.4" DEPOSIT ABSOLUTE /end AXIS_DESCR
/end CHARACTERISTIC
/begin CHARACTERISTIC CWDSLSY "Codewort in der Diagnose Sekundärluftsystem" VALUE 0x8195BE KwUb 255.0 dez 0.00 255.0 FORMAT "%5.1" /end CHARACTERISTIC
/begin CHARACTERISTIC CWDTHM "Codewort DTHM-Funktion" VALUE 0x81A093 KwUb 255.0 dez 0.00 255.0 FORMAT "%5.1" /end CHARACTERISTIC
/begin CHARACTERISTIC CWESSTT "Codewort zum setzen der Bits B_vbemg und B_wks" VALUE 0x811BA1 KwUb 255.0 dez 0.00 255.0 FORMAT "%5.1" /end CHARACTERISTIC
/begin CHARACTERISTIC CWFGRMD "Codewort für FGRMD" VALUE 0x811AF1 KwUb 255.0 dez 0.00 255.0 FORMAT "%5.1" /end CHARACTERISTIC
/begin CHARACTERISTIC CWGGEGAS "Codewort für GGEGAS" VALUE 0x819A78 KwUb 255.0 dez 0.00 255.0 FORMAT "%5.1" /end CHARACTERISTIC
/begin CHARACTERISTIC CWNOMIL "Codewort MIL-Ansteuerung nicht aktiv" VALUE 0x81968F KwUb 255.0 dez 0.00 255.0 FORMAT "%5.1" /end CHARACTERISTIC
/begin CHARACTERISTIC CWPREL "Retrigger NBM-Signal : Zeit / B_estart" VALUE 0x8127C4 KwUb 255.0 dez 0.00 255.0 FORMAT "%5.1" /end CHARACTERISTIC
/begin CHARACTERISTIC DASE_CMD "Codewort DMD-Ausblendbedingungen abschalten - nur für Testzwecke !!!" VALUE 0x81134D KwUb 7.000 dez 0.00 7.000 FORMAT "%5.3" /end CHARACTERISTIC
/begin CHARACTERISTIC DMITED "Delta Schwelle Füllungswunsch" VALUE 0x81744E KwUw 99.99847 rel_uw_b100 0.00 99.99847 FORMAT "%8.5" /end CHARACTERISTIC
/begin CHARACTERISTIC DMRFGRAL "Delta Relatives Moment bei langsamer FGR-Abschaltung" VALUE 0x8157B4 KwUw 199.9969 rel_uw_b200 0.00 199.9969 FORMAT "%8.4" /end CHARACTERISTIC
/begin CHARACTERISTIC DNSTED "Schwelle Delta Nsoll für Abbruch Diagnose Tankentlüftung" VALUE 0x8123EB KwUb 2550. nmot_ub_q10 0.00 2550. FORMAT "%5.0" /end CHARACTERISTIC
/begin CHARACTERISTIC DPDSVLU "Delta Druckwert für Signalvergleich Ladedruck mit Umgebungsdruck" VALUE 0x81B036 KwUw 2559.961 p_uw_q0p039 0.00 2559.961 FORMAT "%8.3" /end CHARACTERISTIC
/begin CHARACTERISTIC DPUPS "Druckdifferenz für Umschaltung Referenzdruck vor Drosselklappe" VALUE 0x810010 KwUb 2550. p_ub_q10 0.00 2550. FORMAT "%5.0" /end CHARACTERISTIC
/begin CHARACTERISTIC DPUPVDK "Differenzdruck pu-pvdk" CURVE 0x81B038 KlAUwSstUwWUw 2559.961 p_uw_q0p039 0.00 2559.961 FORMAT "%8.3"
 /begin AXIS_DESCR STD_AXIS ml_w m_uw_b6553p5 8 0.00 6553.500 FORMAT "%8.3" DEPOSIT ABSOLUTE /end AXIS_DESCR
/end CHARACTERISTIC
/begin CHARACTERISTIC DRLSOLA "Misfire Detection : Schwelle Lastdynamik für Ausblendung" CURVE 0x813EB8 GklWUw 767.9766 rel_sw_q0p0234 0.00 767.9766 FORMAT "%8.4"
 /begin AXIS_DESCR COM_AXIS rl rel_ub_q0p75 8 0.00 191.3 AXIS_PTS_REF SRL08DMUB /end AXIS_DESCR
/end CHARACTERISTIC
/begin CHARACTERISTIC DSUGRAD "Gradient für Drucksensor Umgebung" VALUE 0x81B05A KwUw 1023.984 dgrad_uw_q0p015 0.00 1023.984 FORMAT "%8.3" /end CHARACTERISTIC
/begin CHARACTERISTIC DSUOFS "Offset Drucksensor Umgebung" VALUE 0x81B05C KwSw 2559.961 p_sw_q0p039 -1280.000 1279.961 FORMAT "%8.3" /end CHARACTERISTIC
/begin CHARACTERISTIC DTANSETR "Hysterese Ansauglufttemperatur für elektr. Thermostatregelung" VALUE 0x819A7B KwUb 191.3 temp_ub_b191p25 0.00 191.3 FORMAT "%5.1" /end CHARACTERISTIC
/begin CHARACTERISTIC DTDTHM "Delta Entprellzeit Fehlerheilung Thermostat" VALUE 0x81A094 KwUb 25.50 t100msxs_ub_b25p5 0.00 25.50 FORMAT "%5.2" /end CHARACTERISTIC
/begin CHARACTERISTIC DTEBLEIN "Hystherese für Temperaturschwelle für E-Box Lüfter Ansteuerung" VALUE 0x81A46A KwUb 191.3 temp_ub_q0p75_o48 -48.00 143.3 FORMAT "%5.1" /end CHARACTERISTIC
/begin CHARACTERISTIC DTHMDTKA "Delta Motortemperatur zu Temp.-Kühleraustritt f. Thermostatdiagnose" VALUE 0x81A095 KwUb 191.3 temp_ub_b191p25 0.00 191.3 FORMAT "%5.1" /end CHARACTERISTIC
/begin CHARACTERISTIC DTMETR "Temperaturhysterese für elektrische Thermostatregelung" VALUE 0x819A7C KwUb 191.3 temp_ub_b191p25 0.00 191.3 FORMAT "%5.1" /end CHARACTERISTIC
/begin CHARACTERISTIC DTMWUC "Delta Motortemperaturschwelle für Erfüllung 'warm up cycle'" VALUE 0x8118FD KwUb 191.3 temp_ub_b191p25 0.00 191.3 FORMAT "%5.1" /end CHARACTERISTIC
/begin CHARACTERISTIC DTWNWS "Zeit für Nockenwellensollwinkel-Spätumschaltung" VALUE 0x814008 KwUw 655.3500 t10msxs_uw_b655p35 0.00 655.3500 FORMAT "%8.4" /end CHARACTERISTIC
/begin CHARACTERISTIC DUDKP1HY "Offset für Hysterese bei Umschaltung auf verstärktes Signal von DK-Poti 1" VALUE 0x81400E KwUw 80.08377 spg_uw_q0p001222 0.00 80.08377 FORMAT "%8.5" /end CHARACTERISTIC
/begin CHARACTERISTIC DUF_T "Zeit fürs Setzen der Zyklusflags der Funktionsüberwachungs-Diagnose" VALUE 0x8123BD KwUb 25.50 t100msxs_ub_b25p5 0.00 25.50 FORMAT "%5.2" /end CHARACTERISTIC
/begin CHARACTERISTIC DUKK "Schwelle für Kurzzeitanteil" VALUE 0x814262 KwSw 12287.81 rel_sw_q0p1875 -6144.000 6143.813 FORMAT "%8.3" /end CHARACTERISTIC
/begin CHARACTERISTIC DVFZETR "Hysterese Fahrzeuggeschwindigkeit für el. Thermostatregelung" VALUE 0x819A7D KwUb 318.8 vfzg_ub_q1p25 0.00 318.8 FORMAT "%5.1" /end CHARACTERISTIC
/begin CHARACTERISTIC DVIVZTMX "Maximales Delta zw. Ist- und Zielgeschw. für Tip-Erlaubnis" VALUE 0x8157FC KwUw 511.9922 vfzg_uw_b512 0.00 511.9922 FORMAT "%8.4" /end CHARACTERISTIC
/begin CHARACTERISTIC DVSAVO "Delta Geschwindigkeit für Rücksetzen Schubabschalteverbot vom FGR" VALUE 0x8157FE KwUw 511.9922 vfzg_uw_b512 0.00 511.9922 FORMAT "%8.4" /end CHARACTERISTIC
/begin CHARACTERISTIC DVSAVU "Delta Geschwindigkeit für Setzen Schubabschalteverbot vom FGR" VALUE 0x815800 KwUw 511.9922 vfzg_uw_b512 0.00 511.9922 FORMAT "%8.4" /end CHARACTERISTIC
/begin CHARACTERISTIC DVSKNBGA "Delta Geschwindigkeit für Setzwertkorrektur nach Beschleunigen" CURVE 0x81ADFC KlAUwSstUwWUw 511.9922 vfzg_uw_b512 0.00 511.9922 FORMAT "%8.4"
 /begin AXIS_DESCR STD_AXIS gangi dez 8 0.00 65535.00 FORMAT "%8.2" DEPOSIT ABSOLUTE /end AXIS_DESCR
/end CHARACTERISTIC
/begin CHARACTERISTIC DVSKNVGA "Delta Geschwindigkeit für Setzwertkorrektur nach Verzögern" CURVE 0x81AE1E KlAUwSstUwWUw 511.9922 vfzg_uw_b512 0.00 511.9922 FORMAT "%8.4"
 /begin AXIS_DESCR STD_AXIS gangi dez 8 0.00 65535.00 FORMAT "%8.2" DEPOSIT ABSOLUTE /end AXIS_DESCR
/end CHARACTERISTIC
/begin CHARACTERISTIC DVTIPUD "Änderung der Zielgeschwindigkeit bei Tip-Up oder Tip-Down" VALUE 0x815802 KwUw 511.9922 vfzg_uw_b512 0.00 511.9922 FORMAT "%8.4" /end CHARACTERISTIC
/begin CHARACTERISTIC DVZVITMX "Maximales Delta zw. Ziel- und Istgeschw. für Tip-Erlaubnis" VALUE 0x815804 KwUw 511.9922 vfzg_uw_b512 0.00 511.9922 FORMAT "%8.4" /end CHARACTERISTIC
/begin CHARACTERISTIC DVZVIWA "Delta zw. Ziel- und Istgeschw. für Übergang von Konstantfahrt in Wiederaufnahme" VALUE 0x815806 KwUw 511.9922 vfzg_uw_b512 0.00 511.9922 FORMAT "%8.4" /end CHARACTERISTIC
/begin CHARACTERISTIC DVZVRWA1 "Delta zw. Ziel- und Sollgeschw. für Übergang in WA-Lande-Mode Bereich 1" VALUE 0x815808 KwUw 511.9922 vfzg_uw_b512 0.00 511.9922 FORMAT "%8.4" /end CHARACTERISTIC
/begin CHARACTERISTIC DVZVRWA2 "Delta zw. Ziel- und Sollgeschw. für Übergang in WA-Lande-Mode Bereich 2" VALUE 0x81580A KwUw 511.9922 vfzg_uw_b512 0.00 511.9922 FORMAT "%8.4" /end CHARACTERISTIC
/begin CHARACTERISTIC DVZVRWA3 "Delta zw. Ziel- und Sollgeschw. für Übergang in WA-Lande-Mode Bereich 3" VALUE 0x81580C KwUw 511.9922 vfzg_uw_b512 0.00 511.9922 FORMAT "%8.4" /end CHARACTERISTIC
/begin CHARACTERISTIC DWDK12O "Maximal zulässige Abweichung zwischen den DK-Winkeln aus Poti 1 und 2" VALUE 0x810150 KwUb 100.0 relDK_ub_b100 0.00 100.0 FORMAT "%5.1" /end CHARACTERISTIC
/begin CHARACTERISTIC DWDK13O "Maximal zulässige Abweichung zwischen DK-Winkel aus Poti 1 und Ersatzwert" VALUE 0x810151 KwUb 100.0 relDK_ub_b100 0.00 100.0 FORMAT "%5.1" /end CHARACTERISTIC
/begin CHARACTERISTIC DWDK23O "Maximal zulässige Abweichung zwischen DK-Winkel aus Poti 2 und Ersatzwert" VALUE 0x810152 KwUb 100.0 relDK_ub_b100 0.00 100.0 FORMAT "%5.1" /end CHARACTERISTIC
/begin CHARACTERISTIC FABSALU "Abregelfaktor Beschleunigungssignal bei Schlechtwegstrecken-Erkennung" VALUE 0x8123DD KwUb 553.4 accgrd_ub_b555p55 0.00 553.4 FORMAT "%5.1" /end CHARACTERISTIC
/begin CHARACTERISTIC FASKIV1 "Faktor für Verlängerung 1. KAT-Intervall, Aussetzererkennung" VALUE 0x811093 KwUb 4.000 dez 1.000 5.000 FORMAT "%5.3" /end CHARACTERISTIC
/begin CHARACTERISTIC FHODSL "minimaler Höhenfaktor für DSLS" VALUE 0x81AA84 KwUw 3.999939 fak_uw_b4 0.00 3.999939 FORMAT "%8.6" /end CHARACTERISTIC
/begin CHARACTERISTIC FHOE "Ersatzwert für Höhe" VALUE 0x819B92 KwUb 3.984 fak_ub_b4 0.00 3.984 FORMAT "%5.3" /end CHARACTERISTIC
/begin CHARACTERISTIC FHSTT "Faktor Heißstart" CURVE 0x811BA2 KlAUbSstUbWUb 63.75 fak_ub_b64 0.00 63.75 FORMAT "%5.2"
 /begin AXIS_DESCR STD_AXIS tans temp_ub_q0p75_o48 6 -48.00 143.3 FORMAT "%5.1" DEPOSIT ABSOLUTE /end AXIS_DESCR
/end CHARACTERISTIC
/begin CHARACTERISTIC FIBSALU "Filterfaktor Beschleunigungssignal bei Schlechtwegstrecken-Erkennung" VALUE 0x8123DE KwUb 0.9961 rel_ub_b1p0 0.00 0.9961 /end CHARACTERISTIC
/begin CHARACTERISTIC FIMHU "Faktor Impuls hart" CURVE 0x810AC6 FklWUb 1.992 fak_ub_b2 0.00 1.992 FORMAT "%5.3"
 /begin AXIS_DESCR FIX_AXIS nwCtr dez 16 0.00 15.00 FORMAT "%5.2" FIX_AXIS_PAR 0 0 16 /end AXIS_DESCR
/end CHARACTERISTIC
/begin CHARACTERISTIC FIMWU "Faktor Impuls weich" CURVE 0x810AD6 FklWUb 1.992 fak_ub_b2 0.00 1.992 FORMAT "%5.3"
 /begin AXIS_DESCR FIX_AXIS nwCtr dez 16 0.00 15.00 FORMAT "%5.2" FIX_AXIS_PAR 0 0 16 /end AXIS_DESCR
/end CHARACTERISTIC
/begin CHARACTERISTIC FKKSN "Teillastklopfschutzeinspritzfaktor" CURVE 0x811AF7 KlAUbSstUbWUb 0.04150 fks_ub_b0p0415 0.00 0.04150 FORMAT "%7.5"
 /begin AXIS_DESCR STD_AXIS nmot nmot_ub_q40 8 0.00 10200. FORMAT "%5.0" DEPOSIT ABSOLUTE /end AXIS_DESCR
/end CHARACTERISTIC
/begin CHARACTERISTIC FKSTT "Faktor Kaltstart" CURVE 0x811BAF KlAUbSstUbWUb 63.75 fak_ub_b64 0.00 63.75 FORMAT "%5.2"
 /begin AXIS_DESCR STD_AXIS tmst temp_ub_q0p75_o48 12 -48.00 143.3 FORMAT "%5.1" DEPOSIT ABSOLUTE /end AXIS_DESCR
/end CHARACTERISTIC
/begin CHARACTERISTIC FMSLAMN "minimaler Adaptionsfaktor Sekundärluftmasse" VALUE 0x8195BF KwUb 1.992 fak_ub_b2 0.00 1.992 FORMAT "%5.3" /end CHARACTERISTIC
/begin CHARACTERISTIC FMSLAMX "maximaler Adaptionsfaktor Sekundärluftmasse" VALUE 0x8195C0 KwUb 1.992 fak_ub_b2 0.00 1.992 FORMAT "%5.3" /end CHARACTERISTIC
/begin CHARACTERISTIC FNSA "Nachstartanhebung" CURVE 0x819E03 GklWUb 1.992 fak_ub_b2 0.00 1.992 FORMAT "%5.3"
 /begin AXIS_DESCR COM_AXIS tans temp_ub_q0p75_o48 6 -48.00 143.3 AXIS_PTS_REF STA06ESUB /end AXIS_DESCR
/end CHARACTERISTIC
/begin CHARACTERISTIC FNSSM "Nachstartanhebung" CURVE 0x819E09 GklWUb 1.992 fak_ub_b2 0.00 1.992 FORMAT "%5.3"
 /begin AXIS_DESCR COM_AXIS tmst temp_ub_q0p75_o48 12 -48.00 143.3 AXIS_PTS_REF STS12ESUB /end AXIS_DESCR
/end CHARACTERISTIC
/begin CHARACTERISTIC FPWDKAPP "Drosselklappenkennlinie abh. von Fahrpedal nur f. Applik." CURVE 0x8130E4 KlAUwSstUwWUw 99.99847 rel_uw_b100 0.00 99.99847 FORMAT "%8.5"
 /begin AXIS_DESCR STD_AXIS wped_w relPED_uw_b100 16 0.00 100.0000 FORMAT "%8.4" DEPOSIT ABSOLUTE /end AXIS_DESCR
/end CHARACTERISTIC
/begin CHARACTERISTIC FRKAP "Faktor relative Kraftstoffmasse für Applikation" VALUE 0x819CE4 KwUb 1.992 fak_ub_b2 0.00 1.992 FORMAT "%5.3" /end CHARACTERISTIC
/begin CHARACTERISTIC FSWALUV "Erkennungsschwelle Schlechtwegstrecke abhängig von Fz.geschwindigkeit" CURVE 0x8123DF KlAUbSstUbWUb 55.34 acc_ub_b55p55 0.00 55.34 FORMAT "%5.2"
 /begin AXIS_DESCR STD_AXIS vfzg vfzg_ub_q1p25 4 0.00 318.8 FORMAT "%5.1" DEPOSIT ABSOLUTE /end AXIS_DESCR
/end CHARACTERISTIC
/begin CHARACTERISTIC FTETEDF "Beladungsschwelle Fettkorrektur für Prüfung i.O." VALUE 0x81B9CC KwSw 127.9980 fak_sw_b64 -64.00000 63.99805 FORMAT "%8.5" /end CHARACTERISTIC
/begin CHARACTERISTIC FTETEDM "Beladungsschwelle Magerkorrektur für Prüfung i.O." VALUE 0x81B9CE KwSw 127.9980 fak_sw_b64 -64.00000 63.99805 FORMAT "%8.5" /end CHARACTERISTIC
/begin CHARACTERISTIC FUKNSTM "Startwert Faktor ÜK im Nachstart" CURVE 0x81926A KlAUbSstUbWUb 3.984 fak_ub_b4 0.00 3.984 FORMAT "%5.3"
 /begin AXIS_DESCR STD_AXIS tmst temp_ub_q0p75_o48 9 -48.00 143.3 FORMAT "%5.1" DEPOSIT ABSOLUTE /end AXIS_DESCR
/end CHARACTERISTIC
/begin CHARACTERISTIC FVANST "Gewichtungsfaktor VA im Nachstart" VALUE 0x810002 KwUb 1.992 fak_ub_b2 0.00 1.992 FORMAT "%5.3" /end CHARACTERISTIC
/begin CHARACTERISTIC FVKKSN "Vollastklopfschutzeinspritzfaktor" CURVE 0x811B08 KlAUbSstUbWUb 0.04150 fks_ub_b0p0415 0.00 0.04150 FORMAT "%7.5"
 /begin AXIS_DESCR STD_AXIS nmot nmot_ub_q40 8 0.00 10200. FORMAT "%5.0" DEPOSIT ABSOLUTE /end AXIS_DESCR
/end CHARACTERISTIC
/begin CHARACTERISTIC FWFN "Faktor Wandfilm Drehzahleinfluss" VALUE 0x810064 KwUb 1.494 rel_ub_b1p4941 0.00 1.494 FORMAT "%5.3" /end CHARACTERISTIC
/begin CHARACTERISTIC FWSTAA1 "Wichtung Nachstart" CURVE 0x811B1A GklWUb 1.992 fak_ub_b2 0.00 1.992 FORMAT "%5.3"
 /begin AXIS_DESCR COM_AXIS kstaa fak_ub_b2 6 0.00 1.992 AXIS_PTS_REF SKS06ESUB /end AXIS_DESCR
/end CHARACTERISTIC
/begin CHARACTERISTIC FWSTAA2 "Wichtung Nachstart Umschaltschwelle" CURVE 0x811B20 GklWUb 1.992 fak_ub_b2 0.00 1.992 FORMAT "%5.3"
 /begin AXIS_DESCR COM_AXIS kstaa fak_ub_b2 6 0.00 1.992 AXIS_PTS_REF SKS06ESUB /end AXIS_DESCR
/end CHARACTERISTIC
/begin CHARACTERISTIC FWSTAA3 "Wichtung Nachstart Abregelung Bereich 1" CURVE 0x811B26 GklWUb 1.992 fak_ub_b2 0.00 1.992 FORMAT "%5.3"
 /begin AXIS_DESCR COM_AXIS kstaa fak_ub_b2 6 0.00 1.992 AXIS_PTS_REF SKS06ESUB /end AXIS_DESCR
/end CHARACTERISTIC
/begin CHARACTERISTIC FWSTAA4 "Wichtung Nachstart Abregelung Bereich 2" CURVE 0x811B2C GklWUb 1.992 fak_ub_b2 0.00 1.992 FORMAT "%5.3"
 /begin AXIS_DESCR COM_AXIS kstaa fak_ub_b2 6 0.00 1.992 AXIS_PTS_REF SKS06ESUB /end AXIS_DESCR
/end CHARACTERISTIC
/begin CHARACTERISTIC FZANSSA1 "Faktor für zündsynchrone Abregelung des Nachstartfaktors bei Heißstart Bereich 1" CURVE 0x819E15 GklWUb 0.2490 fak_ub_b0p25 0.00 0.2490 FORMAT "%6.4"
 /begin AXIS_DESCR COM_AXIS tans temp_ub_q0p75_o48 6 -48.00 143.3 AXIS_PTS_REF STA06ESUB /end AXIS_DESCR
/end CHARACTERISTIC
/begin CHARACTERISTIC FZANSSA2 "Faktor für zündsynchrone Abregelung des Nachstartfaktors bei Heißstart Bereich 2" CURVE 0x819E1B GklWUb 0.2490 fak_ub_b0p25 0.00 0.2490 FORMAT "%6.4"
 /begin AXIS_DESCR COM_AXIS tans temp_ub_q0p75_o48 6 -48.00 143.3 AXIS_PTS_REF STA06ESUB /end AXIS_DESCR
/end CHARACTERISTIC
/begin CHARACTERISTIC FZANSSM1 "Faktor für zündsynchrone Abregelung des Nachstartfaktors oberhalb Schwelle" CURVE 0x819E21 GklWUb 0.2490 fak_ub_b0p25 0.00 0.2490 FORMAT "%6.4"
 /begin AXIS_DESCR COM_AXIS tmst temp_ub_q0p75_o48 12 -48.00 143.3 AXIS_PTS_REF STS12ESUB /end AXIS_DESCR
/end CHARACTERISTIC
/begin CHARACTERISTIC FZANSSM2 "Faktor für zündsynchrone Abregelung des Nachstartfaktors unterhalb Schwelle" CURVE 0x819E2D GklWUb 0.2490 fak_ub_b0p25 0.00 0.2490 FORMAT "%6.4"
 /begin AXIS_DESCR COM_AXIS tmst temp_ub_q0p75_o48 12 -48.00 143.3 AXIS_PTS_REF STS12ESUB /end AXIS_DESCR
/end CHARACTERISTIC
/begin CHARACTERISTIC HTEDU "Untere Höhenschwelle für Durchführung Tankentlüftungsdiagnose" VALUE 0x81A4F0 KwUb 3.984 fak_ub_b4 0.00 3.984 FORMAT "%5.3" /end CHARACTERISTIC
/begin CHARACTERISTIC IDTHMU "untere Schwelle der integrierten Luftmasse für Freigabe Thermostatdiagnose" VALUE 0x81A096 KwUb 23.21 m_ub_b23p3 0.00 23.21 FORMAT "%5.2" /end CHARACTERISTIC
/begin CHARACTERISTIC IMLATDSL "min. Luftmassenfluß für Adaption/Zusatzdiagnose" VALUE 0x81AA86 KwUw 23.30133 m_uw_b23p3 0.00 23.30133 FORMAT "%8.5" /end CHARACTERISTIC
/begin CHARACTERISTIC IMLATDSLK "min. Luftmassenfluß für Kurztest" VALUE 0x81AA88 KwUw 23.30133 m_uw_b23p3 0.00 23.30133 FORMAT "%8.5" /end CHARACTERISTIC
/begin CHARACTERISTIC IMLDSL "minimale durchgeströmte Luftmasse" VALUE 0x8195C1 KwUb 0.9961 fak_ub_b1 0.00 0.9961 /end CHARACTERISTIC
/begin CHARACTERISTIC IMLHS "Luftmassenintegral Heißstart" VALUE 0x811BC8 KwUb 23.21 m_ub_b23p3 0.00 23.21 FORMAT "%5.2" /end CHARACTERISTIC
/begin CHARACTERISTIC IMSLADAP "Schwelle Luftmassenintegral für Wiederholung Adaption" VALUE 0x81AA8A KwUw 4660.267 m_uw_b4660 0.00 4660.267 FORMAT "%8.3" /end CHARACTERISTIC
/begin CHARACTERISTIC INTEDO "obere Schwelle Drehzahlintegral bei TEV-Diagnose" VALUE 0x817450 KwSw 16383.75 nmot_sw_q0p25 -8192.000 8191.750 FORMAT "%8.3" /end CHARACTERISTIC
/begin CHARACTERISTIC INTEDU "untere Schwelle Drehzahlintegral bei TEV-Diagnose" VALUE 0x817452 KwSw 16383.75 nmot_sw_q0p25 -8192.000 8191.750 FORMAT "%8.3" /end CHARACTERISTIC
/begin CHARACTERISTIC KAMFZ "Segment- bzw. Messfensterbeginn bei Segmentzeiterfassung Aussetzererkennung" VALUE 0x81A4F7 KwSb 1530. kw_q6 -768.0 762.0 FORMAT "%5.1" /end CHARACTERISTIC
/begin CHARACTERISTIC KFABAK "Aufteilungsfaktor Wandfilm bei BA" MAP 0x81927D GkfWUb 0.9961 fak_ub_b1 0.00 0.9961
 /begin AXIS_DESCR COM_AXIS tmot temp_ub_q0p75_o48 9 -48.00 143.3 AXIS_PTS_REF STM09ESUB /end AXIS_DESCR
 /begin AXIS_DESCR COM_AXIS nmot nmot_ub_q40 7 0.00 10200. AXIS_PTS_REF SNM07ESUB /end AXIS_DESCR
/end CHARACTERISTIC
/begin CHARACTERISTIC KFANS "Kennfeld für Lambdafaktor Ansaugluftkorrektur" MAP 0x819CE5 KfAxUbAyUbSstxUbSstyUbWUb 1.992 fak_ub_b2 0.00 1.992 FORMAT "%5.3"
 /begin AXIS_DESCR STD_AXIS ml m_ub_b1020 8 0.00 1020. FORMAT "%5.0" DEPOSIT ABSOLUTE /end AXIS_DESCR
 /begin AXIS_DESCR STD_AXIS tans temp_ub_q0p75_o48 6 -48.00 143.3 FORMAT "%5.1" DEPOSIT ABSOLUTE /end AXIS_DESCR
/end CHARACTERISTIC
/begin CHARACTERISTIC KFAVAK "Aufteilungsfaktor Wandfilm bei VA" MAP 0x8192BC GkfWUb 0.9961 fak_ub_b1 0.00 0.9961
 /begin AXIS_DESCR COM_AXIS tmot temp_ub_q0p75_o48 9 -48.00 143.3 AXIS_PTS_REF STM09ESUB /end AXIS_DESCR
 /begin AXIS_DESCR COM_AXIS nmot nmot_ub_q40 7 0.00 10200. AXIS_PTS_REF SNM07ESUB /end AXIS_DESCR
/end CHARACTERISTIC
/begin CHARACTERISTIC KFBAKL "Faktor Beschleunigungsanreicherung (K+L-Anteil)" MAP 0x8192FB GkfWUb 15.94 fak_ub_b16 0.00 15.94 FORMAT "%5.2"
 /begin AXIS_DESCR COM_AXIS tmot temp_ub_q0p75_o48 9 -48.00 143.3 AXIS_PTS_REF STM09ESUB /end AXIS_DESCR
 /begin AXIS_DESCR COM_AXIS nmot nmot_ub_q40 7 0.00 10200. AXIS_PTS_REF SNM07ESUB /end AXIS_DESCR
/end CHARACTERISTIC
/begin CHARACTERISTIC KFETRD "Sollwert für elektr. Thermostatregelung aus dk" MAP 0x819A7E KfAxUbAyUbSstxUbSstyUbWUb 191.3 temp_ub_q0p75_o48 -48.00 143.3 FORMAT "%5.1"
 /begin AXIS_DESCR STD_AXIS vfzg vfzg_ub_q1p25 6 0.00 318.8 FORMAT "%5.1" DEPOSIT ABSOLUTE /end AXIS_DESCR
 /begin AXIS_DESCR STD_AXIS wdkba relDK_ub_b100 6 0.00 100.0 FORMAT "%5.1" DEPOSIT ABSOLUTE /end AXIS_DESCR
/end CHARACTERISTIC
/begin CHARACTERISTIC KFETRT "Sollwert für elektr. Thermostatregelung aus tans" MAP 0x819AB0 KfAxUbAyUbSstxUbSstyUbWUb 191.3 temp_ub_q0p75_o48 -48.00 143.3 FORMAT "%5.1"
 /begin AXIS_DESCR STD_AXIS vfzg vfzg_ub_q1p25 8 0.00 318.8 FORMAT "%5.1" DEPOSIT ABSOLUTE /end AXIS_DESCR
 /begin AXIS_DESCR STD_AXIS tans temp_ub_q0p75_o48 8 -48.00 143.3 FORMAT "%5.1" DEPOSIT ABSOLUTE /end AXIS_DESCR
/end CHARACTERISTIC
/begin CHARACTERISTIC KFFWL "Kennfeld Warmlauffaktor" MAP 0x819E45 GkfWUb 1.992 fak_ub_b2 0.00 1.992 FORMAT "%5.3"
 /begin AXIS_DESCR COM_AXIS tmot temp_ub_q0p75_o48 12 -48.00 143.3 AXIS_PTS_REF STM12ESUB /end AXIS_DESCR
 /begin AXIS_DESCR COM_AXIS tmst temp_ub_q0p75_o48 12 -48.00 143.3 AXIS_PTS_REF STS12ESUB /end AXIS_DESCR
/end CHARACTERISTIC
/begin CHARACTERISTIC KFFWLW "Kennfeld Wichtung Warmlauffaktor" MAP 0x811C9D GkfWUb 0.9961 fak_ub_b1 0.00 0.9961
 /begin AXIS_DESCR COM_AXIS nmot nmot_ub_q40 12 0.00 10200. AXIS_PTS_REF SNM12ESUB /end AXIS_DESCR
 /begin AXIS_DESCR COM_AXIS rl rel_ub_q0p75 12 0.00 191.3 AXIS_PTS_REF SRL12ESUB /end AXIS_DESCR
/end CHARACTERISTIC
/begin CHARACTERISTIC KFFWNW "Korrekturfaktor bei Nockenwellensteuerung" MAP 0x811B74 KfAxUbAyUbSstxUbSstyUbWUb 1.992 fak_ub_b2 0.00 1.992 FORMAT "%5.3" /begin AXIS_DESCR STD_AXIS wnwue wkw_ub_q0p5 5 0.00 127.500 DEPOSIT ABSOLUTE /end AXIS_DESCR
 /begin AXIS_DESCR STD_AXIS tmot temp_ub_q0p75_o48 6 -48.00 143.3 FORMAT "%5.1" DEPOSIT ABSOLUTE /end AXIS_DESCR
/end CHARACTERISTIC
/begin CHARACTERISTIC KFFWST "Faktor Wiederholstart" MAP 0x815B5A KfAxUbAyUbSstxUwSstyUbWUb 0.9961 fak_ub_b1 0.00 0.9961
 /begin AXIS_DESCR STD_AXIS tmlauf_w t100msxs_uw_b6553p6 8 0.00 6553.500 FORMAT "%8.3" DEPOSIT ABSOLUTE /end AXIS_DESCR
 /begin AXIS_DESCR STD_AXIS tmotab temp_ub_q0p75_o48 8 -48.00 143.3 FORMAT "%5.1" DEPOSIT ABSOLUTE /end AXIS_DESCR
/end CHARACTERISTIC
/begin CHARACTERISTIC KFKSWF "Kennfeld für Kat.-Schutz-Wichtungsfaktoren" MAP 0x811094 KfAxUbAyUbSstxUbSstyUbWUb 255.0 dez 0.00 255.0 FORMAT "%5.1"
 /begin AXIS_DESCR STD_AXIS nmot nmot_ub_q40 6 0.00 10200. FORMAT "%5.0" DEPOSIT ABSOLUTE /end AXIS_DESCR
 /begin AXIS_DESCR STD_AXIS rl rel_ub_q0p75 6 0.00 191.3 FORMAT "%5.1" DEPOSIT ABSOLUTE /end AXIS_DESCR
/end CHARACTERISTIC
/begin CHARACTERISTIC KFLANS "Kennfeld Lambda-Motor-Beschreibung im Nachstart" MAP 0x815A3A GkfWUw 15.89990 fak_uw_b16 0.09985352 15.99976 FORMAT "%8.5"
 /begin AXIS_DESCR COM_AXIS tmst temp_ub_q0p75_o48 12 -48.00 143.3 AXIS_PTS_REF STS12ESUB /end AXIS_DESCR
 /begin AXIS_DESCR COM_AXIS anztib_w dez 12 0.00 65535.00 AXIS_PTS_REF SAN12ESUW /end AXIS_DESCR
/end CHARACTERISTIC
/begin CHARACTERISTIC KFLASWLR "Kennfeld Lambda-Motor-Soll im Warmlauf bei aktiver LR" MAP 0x819ED5 GkfWUb 1.992 fak_ub_b2 0.00 1.992 FORMAT "%5.3"
 /begin AXIS_DESCR COM_AXIS tmot temp_ub_q0p75_o48 12 -48.00 143.3 AXIS_PTS_REF STM12ESUB /end AXIS_DESCR
 /begin AXIS_DESCR COM_AXIS tmst temp_ub_q0p75_o48 12 -48.00 143.3 AXIS_PTS_REF STS12ESUB /end AXIS_DESCR
/end CHARACTERISTIC
/begin CHARACTERISTIC KFLF "Lambdakennfeld bei Teillast" MAP 0x819D25 KfAxUbAyUbSstxUbSstyUbWUb 1.992 fak_ub_b2 0.00 1.992 FORMAT "%5.3"
 /begin AXIS_DESCR STD_AXIS nmot nmot_ub_q40 12 0.00 10200. FORMAT "%5.0" DEPOSIT ABSOLUTE /end AXIS_DESCR
 /begin AXIS_DESCR STD_AXIS rl rel_ub_q0p75 16 0.00 191.3 FORMAT "%5.1" DEPOSIT ABSOLUTE /end AXIS_DESCR
/end CHARACTERISTIC
/begin CHARACTERISTIC KFNSWRL "Wichtung Nachstartanhebung" MAP 0x811B32 KfAxUbAyUbSstxUbSstyUbWUb 1.992 fak_ub_b2 0.00 1.992 FORMAT "%5.3"
 /begin AXIS_DESCR STD_AXIS tmst temp_ub_q0p75_o48 8 -48.00 143.3 FORMAT "%5.1" DEPOSIT ABSOLUTE /end AXIS_DESCR
 /begin AXIS_DESCR STD_AXIS rl rel_ub_q0p75 6 0.00 191.3 FORMAT "%5.1" DEPOSIT ABSOLUTE /end AXIS_DESCR
/end CHARACTERISTIC
/begin CHARACTERISTIC KFVAKL "Faktor Verzögerungsabmagerung (K+L-Anteil)" MAP 0x81933A GkfWUb 15.94 fak_ub_b16 0.00 15.94 FORMAT "%5.2"
 /begin AXIS_DESCR COM_AXIS tmot temp_ub_q0p75_o48 9 -48.00 143.3 AXIS_PTS_REF STM09ESUB /end AXIS_DESCR
 /begin AXIS_DESCR COM_AXIS nmot nmot_ub_q40 7 0.00 10200. AXIS_PTS_REF SNM07ESUB /end AXIS_DESCR
/end CHARACTERISTIC
/begin CHARACTERISTIC KFVOFFS "Geschwindigkeits-Offset für FGR-Regler" MAP 0x81580E KfAxUwAyUwSstxUwSstyUwWUw 511.9922 vfzg_uw_b512 0.00 511.9922 FORMAT "%8.4"
 /begin AXIS_DESCR STD_AXIS vziel_w vfzg_uw_b512 6 0.00 511.9922 FORMAT "%8.4" DEPOSIT ABSOLUTE /end AXIS_DESCR
 /begin AXIS_DESCR STD_AXIS gangi dez 8 0.00 65535.00 FORMAT "%8.2" DEPOSIT ABSOLUTE /end AXIS_DESCR
/end CHARACTERISTIC
/begin CHARACTERISTIC KFWDKMSN "Kennfeld für Drosselklappen-Sollwinkel" MAP 0x813126 KfAxUwAyUwSstxUwSstyUwWUw 99.99847 rel_uw_b100 0.00 99.99847 FORMAT "%8.5"
 /begin AXIS_DESCR STD_AXIS mlwdkns_w m_uw_b6553p5 16 0.00 6553.500 FORMAT "%8.3" DEPOSIT ABSOLUTE /end AXIS_DESCR
 /begin AXIS_DESCR STD_AXIS nmot_w nmot_uw_q0p25 6 0.00 16383.75 FORMAT "%8.2" DEPOSIT ABSOLUTE /end AXIS_DESCR
/end CHARACTERISTIC
/begin CHARACTERISTIC KFWDKPP "Ersatzwert für Drosselklappenwinkel aus Füllungssignal" MAP 0x810AFE KfAxUbAyUbSstxUbSstyUbWUb 100.0 relDK_ub_b100 0.00 100.0 FORMAT "%5.1"
 /begin AXIS_DESCR STD_AXIS nmot nmot_ub_q40 12 0.00 10200. FORMAT "%5.0" DEPOSIT ABSOLUTE /end AXIS_DESCR
 /begin AXIS_DESCR STD_AXIS rlvppl rel_ub_q0p75 12 0.00 191.3 FORMAT "%5.1" DEPOSIT ABSOLUTE /end AXIS_DESCR
/end CHARACTERISTIC
/begin CHARACTERISTIC KFWEE "Kennfeld Winkel Einspritzende" MAP 0x819BE6 KfAxUbAyUbSstxUbSstyUbWUb 1530. zw_ub_q6 0.00 1530. FORMAT "%5.0"
 /begin AXIS_DESCR STD_AXIS nmot nmot_ub_q40 8 0.00 10200. FORMAT "%5.0" DEPOSIT ABSOLUTE /end AXIS_DESCR
 /begin AXIS_DESCR STD_AXIS rl rel_ub_q0p75 8 0.00 191.3 FORMAT "%5.1" DEPOSIT ABSOLUTE /end AXIS_DESCR
/end CHARACTERISTIC
/begin CHARACTERISTIC KFWEEK "Kennfeld-Kalt Winkel Einspritzende" MAP 0x819C38 KfAxUbAyUbSstxUbSstyUbWUb 1530. zw_ub_q6 0.00 1530. FORMAT "%5.0"
 /begin AXIS_DESCR STD_AXIS nmot nmot_ub_q40 8 0.00 10200. FORMAT "%5.0" DEPOSIT ABSOLUTE /end AXIS_DESCR
 /begin AXIS_DESCR STD_AXIS rl rel_ub_q0p75 8 0.00 191.3 FORMAT "%5.1" DEPOSIT ABSOLUTE /end AXIS_DESCR
/end CHARACTERISTIC
/begin CHARACTERISTIC KFWHSTT "Wichtungskennfeld Heißstart" MAP 0x811BC9 KfAxUbAyUbSstxUbSstyUbWUb 1.992 fak_ub_b2 0.00 1.992 FORMAT "%5.3"
 /begin AXIS_DESCR STD_AXIS tans temp_ub_q0p75_o48 6 -48.00 143.3 FORMAT "%5.1" DEPOSIT ABSOLUTE /end AXIS_DESCR
 /begin AXIS_DESCR STD_AXIS anztist dez 6 0.00 255.0 FORMAT "%5.1" DEPOSIT ABSOLUTE /end AXIS_DESCR
/end CHARACTERISTIC
/begin CHARACTERISTIC KFWKSTN "Wichtungskennfeld Kaltstart" MAP 0x811BFB KfAxUbAyUbSstxUbSstyUbWUb 0.9961 fak_ub_b1 0.00 0.9961
 /begin AXIS_DESCR STD_AXIS tmst temp_ub_q0p75_o48 4 -48.00 143.3 FORMAT "%5.1" DEPOSIT ABSOLUTE /end AXIS_DESCR
 /begin AXIS_DESCR STD_AXIS nmot nmot_ub_q40 4 0.00 10200. FORMAT "%5.0" DEPOSIT ABSOLUTE /end AXIS_DESCR
/end CHARACTERISTIC
/begin CHARACTERISTIC KFWKSTT "Wichtungskennfeld Kaltstart" MAP 0x811C15 KfAxUbAyUbSstxUbSstyUbWUb 1.992 fak_ub_b2 0.00 1.992 FORMAT "%5.3"
 /begin AXIS_DESCR STD_AXIS tmst temp_ub_q0p75_o48 12 -48.00 143.3 FORMAT "%5.1" DEPOSIT ABSOLUTE /end AXIS_DESCR
 /begin AXIS_DESCR STD_AXIS anztist dez 6 0.00 255.0 FORMAT "%5.1" DEPOSIT ABSOLUTE /end AXIS_DESCR
/end CHARACTERISTIC
/begin CHARACTERISTIC KFWWNS "Wiederholstartzeitfaktor" MAP 0x81B11A KfAxUbAyUbSstxUwSstyUbWUb 1.992 fak_ub_b2 0.00 1.992 FORMAT "%5.3"
 /begin AXIS_DESCR STD_AXIS tabst_w t1sxs_uw_q1 8 0.00 65535.00 FORMAT "%8.2" DEPOSIT ABSOLUTE /end AXIS_DESCR
 /begin AXIS_DESCR STD_AXIS tmst temp_ub_q0p75_o48 8 -48.00 143.3 FORMAT "%5.1" DEPOSIT ABSOLUTE /end AXIS_DESCR
/end CHARACTERISTIC
/begin CHARACTERISTIC KFZWKS "Zündwinkelgrenzkennfeld für Klopfschutz-Einspritzung" MAP 0x815958 KfAxUbAyUbSstxUbSstyUbWSb 191.3 zw_sb_q0p75 -96.00 95.25 FORMAT "%5.2"
 /begin AXIS_DESCR STD_AXIS nmot nmot_ub_q40 16 0.00 10200. FORMAT "%5.0" DEPOSIT ABSOLUTE /end AXIS_DESCR
 /begin AXIS_DESCR STD_AXIS rl rel_ub_q0p75 10 0.00 191.3 FORMAT "%5.1" DEPOSIT ABSOLUTE /end AXIS_DESCR
/end CHARACTERISTIC
/begin CHARACTERISTIC KKFFGRGA "Verstärkungsfaktor bei Konstantfahrt für FGR-Regler" CURVE 0x81AE40 KlAUwSstUwWUw 3199.951 rel_uw_b3200 0.00 3199.951 FORMAT "%8.3"
 /begin AXIS_DESCR STD_AXIS gangi dez 8 0.00 65535.00 FORMAT "%8.2" DEPOSIT ABSOLUTE /end AXIS_DESCR
/end CHARACTERISTIC
/begin CHARACTERISTIC KLFWST "Faktor Wiederholstart" CURVE 0x815BB4 KlAUwSstUwWUw 0.9999847 fak_uw_b1 0.00 0.9999847 FORMAT "%9.7"
 /begin AXIS_DESCR STD_AXIS tabst_w t1sxs_uw_q1 8 0.00 65535.00 FORMAT "%8.2" DEPOSIT ABSOLUTE /end AXIS_DESCR
/end CHARACTERISTIC
/begin CHARACTERISTIC KLTATHMKA "Wartezeit für Freigabe Thermostatdiagnose abhängig von Temp.Kühleraustritt" CURVE 0x81B174 KlAUbSstUbWUw 6553.500 t100msxs_uw_b6553p5 0.00 6553.500 FORMAT "%8.3"
 /begin AXIS_DESCR STD_AXIS tka temp_ub_q0p75_o48 10 -48.00 143.3 FORMAT "%5.1" DEPOSIT ABSOLUTE /end AXIS_DESCR
/end CHARACTERISTIC
/begin CHARACTERISTIC KRAFGRGA "Verstärkungsfaktor bei Rampe für FGR-Regler" CURVE 0x81AE62 KlAUwSstUwWUw 3199.951 rel_uw_b3200 0.00 3199.951 FORMAT "%8.3"
 /begin AXIS_DESCR STD_AXIS gangi dez 8 0.00 65535.00 FORMAT "%8.2" DEPOSIT ABSOLUTE /end AXIS_DESCR
/end CHARACTERISTIC
/begin CHARACTERISTIC KTDWNWS "Entprellzeit DNWS Plaus-Fehler" MAP 0x81D148 KfAxUbAyUbSstxUbSstyUbWUb 65.28 t256msxs_ub_b65p535 0.00 65.28 FORMAT "%5.2"
 /begin AXIS_DESCR STD_AXIS tmot temp_ub_q0p75_o48 6 -48.00 143.3 FORMAT "%5.1" DEPOSIT ABSOLUTE /end AXIS_DESCR
 /begin AXIS_DESCR STD_AXIS tmst temp_ub_q0p75_o48 4 -48.00 143.3 FORMAT "%5.1" DEPOSIT ABSOLUTE /end AXIS_DESCR
/end CHARACTERISTIC
/begin CHARACTERISTIC LASWLTM "Offset Lambda-Motor-Soll bei inaktiver Lambdaregelung" CURVE 0x819F65 GklWSb 1.992 fak_sb_b1 -1.000 0.9922 FORMAT "%5.3"
 /begin AXIS_DESCR COM_AXIS tmot temp_ub_q0p75_o48 12 -48.00 143.3 AXIS_PTS_REF STM12ESUB /end AXIS_DESCR
/end CHARACTERISTIC
/begin CHARACTERISTIC MILANTI "MIL ist bei ti-Abschaltung an, auch im 1.dcy" VALUE 0x8110C6 KwUb 1.000 dez 0.00 1.000 FORMAT "%5.3" /end CHARACTERISTIC
/begin CHARACTERISTIC MLDSLAMN "min. Luftmasse für Bedingung Adaption/Zusatzdiagnose" VALUE 0x81AA8C KwUw 6553.500 m_uw_b6553p5 0.00 6553.500 FORMAT "%8.3" /end CHARACTERISTIC
/begin CHARACTERISTIC MLDSLAMX "max. Luftmasse für Bedingung Adaption/Zusatzdiagnose" VALUE 0x81AA8E KwUw 6553.500 m_uw_b6553p5 0.00 6553.500 FORMAT "%8.3" /end CHARACTERISTIC
/begin CHARACTERISTIC MLDSLKMN "min. Luftmasse für Bedingung Kurztest-Diagnose" VALUE 0x81AA90 KwUw 6553.500 m_uw_b6553p5 0.00 6553.500 FORMAT "%8.3" /end CHARACTERISTIC
/begin CHARACTERISTIC MLDSLKMX "max. Luftmasse für Bedingung Kurztest-Diagnose" VALUE 0x81AA92 KwUw 6553.500 m_uw_b6553p5 0.00 6553.500 FORMAT "%8.3" /end CHARACTERISTIC
/begin CHARACTERISTIC MLDSLMN "min. Luftmasse für Bedingung Diagnose" VALUE 0x81AA94 KwUw 6553.500 m_uw_b6553p5 0.00 6553.500 FORMAT "%8.3" /end CHARACTERISTIC
/begin CHARACTERISTIC MLDSLMX "max. Luftmasse für Bedingung Diagnose" VALUE 0x81AA96 KwUw 6553.500 m_uw_b6553p5 0.00 6553.500 FORMAT "%8.3" /end CHARACTERISTIC
/begin CHARACTERISTIC MRFGRMAX "Maximalwert für relatives Moment aus FGR" VALUE 0x8157B6 KwUw 199.9969 rel_uw_b200 0.00 199.9969 FORMAT "%8.4" /end CHARACTERISTIC
/begin CHARACTERISTIC MRFGRMR "FGR-Korrekturkennlinie" CURVE 0x81588E KlAUwSstUwWUw 199.9969 rel_uw_b200 0.00 199.9969 FORMAT "%8.4"
 /begin AXIS_DESCR STD_AXIS mrregl_w rel_uw_b200 8 0.00 199.9969 FORMAT "%8.4" DEPOSIT ABSOLUTE /end AXIS_DESCR
/end CHARACTERISTIC
/begin CHARACTERISTIC MRFGRSTA "Startwert für Relatives Moment bei Aktivierung FGR-Regler" VALUE 0x8158B0 KwUw 199.9969 rel_uw_b200 0.00 199.9969 FORMAT "%8.4" /end CHARACTERISTIC
/begin CHARACTERISTIC MRMRFGR "Inverse FGR-Korrekturkennlinie" CURVE 0x8158B2 KlAUwSstUwWUw 199.9969 rel_uw_b200 0.00 199.9969 FORMAT "%8.4"
 /begin AXIS_DESCR STD_AXIS mrfgri_w rel_uw_b200 8 0.00 199.9969 FORMAT "%8.4" DEPOSIT ABSOLUTE /end AXIS_DESCR
/end CHARACTERISTIC
/begin CHARACTERISTIC MSLBAS "Ini.- Sekundärluftmasse" VALUE 0x8195C2 KwUb 102.0 m_q0p4 0.00 102.0 FORMAT "%5.1" /end CHARACTERISTIC
/begin CHARACTERISTIC MSLOFMX "Diagnoseschwelle für Prüfung Offsetwert Sekundärluftmasse" VALUE 0x8195C3 KwUb 102.0 m_q0p4 0.00 102.0 FORMAT "%5.1" /end CHARACTERISTIC
/begin CHARACTERISTIC MSLVMX "Diagnoseschwelle für Ventildichtheitsprüfung" VALUE 0x8195C4 KwUb 102.0 m_q0p4 0.00 102.0 FORMAT "%5.1" /end CHARACTERISTIC
/begin CHARACTERISTIC NDKPPU "Minimaldrehzahl für Plausibilisierung DK-Poti 2 nach unten im Normalbetrieb" VALUE 0x810153 KwUb 10000. nmot_ub_q40 200.0 10200. FORMAT "%5.0" /end CHARACTERISTIC
/begin CHARACTERISTIC NDSTA "Drehzahlschwelle für Diagnose Startautomatik" VALUE 0x8123BF KwUb 10200. nmot_ub_q40 0.00 10200. FORMAT "%5.0" /end CHARACTERISTIC
/begin CHARACTERISTIC NDSTS "Drehzahlschwelle für Diagnose Startsignal" VALUE 0x815FC8 KwUw 16383.75 nmot_uw_q0p25 0.00 16383.75 FORMAT "%8.2" /end CHARACTERISTIC
/begin CHARACTERISTIC NDSVLO "obere Drehzahlschwelle für Signalvergleich Ladedruck mit Umgebungsdruck" VALUE 0x819B93 KwUb 10200. nmot_ub_q40 0.00 10200. FORMAT "%5.0" /end CHARACTERISTIC
/begin CHARACTERISTIC NDSVLU "Drehzahlschwelle für Signalvergleich Ladedruck mit Umgebungsdruck" VALUE 0x819B94 KwUb 10200. nmot_ub_q40 0.00 10200. FORMAT "%5.0" /end CHARACTERISTIC
/begin CHARACTERISTIC NDTHMO "obere Drehzahlschwelle für Freigabe Thermostatdiagnose" VALUE 0x81A097 KwUb 10200. nmot_ub_q40 0.00 10200. FORMAT "%5.0" /end CHARACTERISTIC
/begin CHARACTERISTIC NDTHMU "untere Drehzahlschwelle für Freigabe Thermostatdiagnose" VALUE 0x81A098 KwUb 10200. nmot_ub_q40 0.00 10200. FORMAT "%5.0" /end CHARACTERISTIC
/begin CHARACTERISTIC NDV "Fehlererkennung Tachosignal / Drehzahlschwelle minimal" VALUE 0x819A74 KwUb 10200. nmot_ub_q40 0.00 10200. FORMAT "%5.0" /end CHARACTERISTIC
/begin CHARACTERISTIC NDVO "Fehlererkennung Fz-Geschwindigkeitssignal, obere Drehzahlgrenze" VALUE 0x819A75 KwUb 10200. nmot_ub_q40 0.00 10200. FORMAT "%5.0" /end CHARACTERISTIC
/begin CHARACTERISTIC NGALU "Misfire Detection : Schwelle Drehzahländerung für Ausblendung" CURVE 0x813EC8 GklWUw 12799.77 nmotg_sw_q0p39 0.00 12799.77 FORMAT "%8.2"
 /begin AXIS_DESCR COM_AXIS nmot nmot_ub_q40 8 0.00 10200. AXIS_PTS_REF SNM08DMUB /end AXIS_DESCR
/end CHARACTERISTIC
/begin CHARACTERISTIC NMIALU "Min. Drehzahl für Ausblendung der Aussetzererkennung" VALUE 0x81134E KwUb 10200. nmot_ub_q40 0.00 10200. FORMAT "%5.0" /end CHARACTERISTIC
/begin CHARACTERISTIC NMN_DUF "Drehzahl-Schwelle fürs Setzen der Zyklusflags der Funktionsüberwachungs-Diagnose" VALUE 0x8123BE KwUb 10200. nmot_ub_q40 0.00 10200. FORMAT "%5.0" /end CHARACTERISTIC
/begin CHARACTERISTIC NMXALU "Max. Drehzahl für Ausblendung der Aussetzererkennung" VALUE 0x81134F KwUb 10200. nmot_ub_q40 0.00 10200. FORMAT "%5.0" /end CHARACTERISTIC
/begin CHARACTERISTIC NRLMN "Minimaldrehzahl zur Berechnung von umsrln" VALUE 0x814010 KwUw 16383.75 nmot_uw_q0p25 0.00 16383.75 FORMAT "%8.2" /end CHARACTERISTIC
/begin CHARACTERISTIC NSTEDMX "Maximale Solldrehzahl-Schwelle für Tankentlüftungsdiagnose" VALUE 0x8123EC KwUb 2550. nmot_ub_q10 0.00 2550. FORMAT "%5.0" /end CHARACTERISTIC
/begin CHARACTERISTIC PHNOKA "Anfangswert für Zähler Phasensignal nicht ok" VALUE 0x810033 KwUb 255.0 dez 0.00 255.0 FORMAT "%5.1" /end CHARACTERISTIC
/begin CHARACTERISTIC PUE "Ersatzwert für Umgebungsdruck" VALUE 0x81B05E KwUw 2559.961 p_uw_q0p039 0.00 2559.961 FORMAT "%8.3" /end CHARACTERISTIC
/begin CHARACTERISTIC PUMN "Umgebungsdruckbegrenzung minimal" VALUE 0x81B060 KwUw 2559.961 p_uw_q0p039 0.00 2559.961 FORMAT "%8.3" /end CHARACTERISTIC
/begin CHARACTERISTIC PUMX "Umgebungsdruckbegrenzung maximal" VALUE 0x81B062 KwUw 2559.961 p_uw_q0p039 0.00 2559.961 FORMAT "%8.3" /end CHARACTERISTIC
/begin CHARACTERISTIC PUSPSMX "max. Abweichung von Umgebungsdruck und Saugrohrdruck" VALUE 0x81B064 KwUw 2559.961 p_uw_q0p039 0.00 2559.961 FORMAT "%8.3" /end CHARACTERISTIC
/begin CHARACTERISTIC RKBAU "rk-Schwelle für BA-Anzeige" VALUE 0x814264 KwSw 3071.953 rel_sw_b1536 -1536.000 1535.953 FORMAT "%8.3" /end CHARACTERISTIC
/begin CHARACTERISTIC RKUKKLU "Schwelle Summe Kurz-/Langzeitanteil" VALUE 0x814266 KwSw 12287.81 rel_sw_q0p1875 -6144.000 6143.813 FORMAT "%8.3" /end CHARACTERISTIC
/begin CHARACTERISTIC RKVAU "rk-Schwelle für VA-Anzeige" VALUE 0x814268 KwSw 3071.953 rel_sw_b1536 -1536.000 1535.953 FORMAT "%8.3" /end CHARACTERISTIC
/begin CHARACTERISTIC RLSALUN "Lastschwelle zur Schuberkennung für Ausblendung der Aussetzererkennung" CURVE 0x811350 GklWUb 191.3 rel_ub_q0p75 0.00 191.3 FORMAT "%5.1"
 /begin AXIS_DESCR COM_AXIS nmot nmot_ub_q40 8 0.00 10200. AXIS_PTS_REF SNM08DMUB /end AXIS_DESCR
/end CHARACTERISTIC
/begin CHARACTERISTIC RLTEDMX "Maximale rl-Schwelle für Tankentlüftungsdiagnose" VALUE 0x8123ED KwUb 191.3 rel_ub_q0p75 0.00 191.3 FORMAT "%5.1" /end CHARACTERISTIC
/begin CHARACTERISTIC RLVPPMXN "Maximale Füllung für DK-Poti-Plausibilisierung" CURVE 0x810BA8 KlAUbSstUbWUb 191.3 rel_ub_q0p75 0.00 191.3 FORMAT "%5.1"
 /begin AXIS_DESCR STD_AXIS nmot nmot_ub_q40 12 0.00 10200. FORMAT "%5.0" DEPOSIT ABSOLUTE /end AXIS_DESCR
/end CHARACTERISTIC
/begin CHARACTERISTIC RMSLADA "Diagnoseschwelle für Adaption" VALUE 0x8195C5 KwUb 1.992 fak_ub_b2 0.00 1.992 FORMAT "%5.3" /end CHARACTERISTIC
/begin CHARACTERISTIC RMSLMN "Diagnoseschwelle: verringerte Sekundärluftmasse (Fehlerhaft)" VALUE 0x8195C6 KwUb 1.992 fak_ub_b2 0.00 1.992 FORMAT "%5.3" /end CHARACTERISTIC
/begin CHARACTERISTIC RMSLPMN "Diagnoseschwelle: Fehler Sekundärluftpumpe, nur Pulse Air" VALUE 0x8195C7 KwUb 1.992 fak_ub_b2 0.00 1.992 FORMAT "%5.3" /end CHARACTERISTIC
/begin CHARACTERISTIC RMSLSUMN "Diagnoseschwelle: verringerte Sekundärluftmasse; Summengrenzwert" VALUE 0x81AA98 KwUw 511.9922 fak_uw_b512 0.00 511.9922 FORMAT "%8.4" /end CHARACTERISTIC
/begin CHARACTERISTIC RMSLTMN "Schwelle: sehr geringe Sekundärluftmasse, ohne Offset" VALUE 0x8195C8 KwUb 1.992 fak_ub_b2 0.00 1.992 FORMAT "%5.3" /end CHARACTERISTIC
/begin CHARACTERISTIC RPTES "Widerstand Pumpenstrommessung DM-TL" VALUE 0x81744A KwUw 99.99847 r_q0p00153 0.00 99.99847 FORMAT "%8.5" /end CHARACTERISTIC
/begin AXIS_PTS SAN12ESUW "SST-Verteilung für den begrenzten Einspritzzähler anztib_w" 0x815638 anztib_w SstAUwSstUw 65535.00 dez 12 0.00 65535.00 FORMAT "%8.2" DEPOSIT ABSOLUTE /end AXIS_PTS
/begin AXIS_PTS SKS06ESUB "SST-Verteilung für den Startadaptionsfaktor kstaa" 0x81191A kstaa SstAUbSstUb 1.992 fak_ub_b2 6 0.00 1.992 FORMAT "%5.3" DEPOSIT ABSOLUTE /end AXIS_PTS
/begin AXIS_PTS SNM07ESUB "Stützstellenverteilung Drehzahl, 7 Sst." 0x8196D6 nmot SstAUbSstUb 10200. nmot_ub_q40 7 0.00 10200. FORMAT "%5.0" DEPOSIT ABSOLUTE /end AXIS_PTS
/begin AXIS_PTS SNM08DMUB "SST-Verteilung in DMD, 8 Drehzahl-SST" 0x811949 nmot SstAUbSstUb 10200. nmot_ub_q40 8 0.00 10200. FORMAT "%5.0" DEPOSIT ABSOLUTE /end AXIS_PTS
/begin AXIS_PTS SNM12ESUB "SST-Verteilung für die Motordrehzahl nmot" 0x811981 nmot SstAUbSstUb 10200. nmot_ub_q40 12 0.00 10200. FORMAT "%5.0" DEPOSIT ABSOLUTE /end AXIS_PTS
/begin AXIS_PTS SNM12FEUB "Stützstellen für WDKSMX, WDKUGDN" 0x81198E nmot SstAUbSstUb 10200. nmot_ub_q40 12 0.00 10200. FORMAT "%5.0" DEPOSIT ABSOLUTE /end AXIS_PTS
/begin AXIS_PTS SRL08DMUB "SST-Verteilung in DMD, 8 Last-SST" 0x8119F1 rl SstAUbSstUb 191.3 rel_ub_q0p75 8 0.00 191.3 FORMAT "%5.1" DEPOSIT ABSOLUTE /end AXIS_PTS
/begin AXIS_PTS SRL12ESUB "Sst-Verteilung für die relative Füllung rl" 0x8119FA rl SstAUbSstUb 191.3 rel_ub_q0p75 12 0.00 191.3 FORMAT "%5.1" DEPOSIT ABSOLUTE /end AXIS_PTS
/begin AXIS_PTS STA06ESUB "SST-Verteilung für die Ansauglufttemperatur" 0x81972E tans SstAUbSstUb 191.3 temp_ub_q0p75_o48 6 -48.00 143.3 FORMAT "%5.1" DEPOSIT ABSOLUTE /end AXIS_PTS
/begin AXIS_PTS STM09ESUB "Stützstellenverteilung Motortemperatur, 9 Sst." 0x819770 tmot SstAUbSstUb 191.3 temp_ub_q0p75_o48 9 -48.00 143.3 FORMAT "%5.1" DEPOSIT ABSOLUTE /end AXIS_PTS
/begin AXIS_PTS STM12ESUB "SST-Verteilung für die Motortemperatur tmot" 0x81977A tmot SstAUbSstUb 191.3 temp_ub_q0p75_o48 12 -48.00 143.3 FORMAT "%5.1" DEPOSIT ABSOLUTE /end AXIS_PTS
/begin AXIS_PTS STS12ESUB "SST-Verteilung für Motorstarttemperatur" 0x811A33 tmst SstAUbSstUb 191.3 temp_ub_q0p75_o48 12 -48.00 143.3 FORMAT "%5.1" DEPOSIT ABSOLUTE /end AXIS_PTS
/begin CHARACTERISTIC SZANSSM "Absteuerungsfaktorumschaltschwelle für Nachstartfaktor" CURVE 0x819E39 GklWUb 0.9961 fak_ub_b1 0.00 0.9961
 /begin AXIS_DESCR COM_AXIS tmst temp_ub_q0p75_o48 12 -48.00 143.3 AXIS_PTS_REF STS12ESUB /end AXIS_DESCR
/end CHARACTERISTIC
/begin CHARACTERISTIC TABGMSLAD "Abgas Temperaturschwelle für Auslösung Adaption" VALUE 0x8195C9 KwUb 1275. temp_ub_q5_o50 -50.00 1225. FORMAT "%5.0" /end CHARACTERISTIC
/begin CHARACTERISTIC TAETRMN "Ansauglufttemperaturschwelle zur Abschaltung der el. Thermostatregelung" VALUE 0x819B02 KwUb 191.3 temp_ub_q0p75_o48 -48.00 143.3 FORMAT "%5.1" /end CHARACTERISTIC
/begin CHARACTERISTIC TALUST "Zeitdauer Ausblendung der Aussetzererkennung nach Motorstart" VALUE 0x813ED8 KwUw 655.3500 t10msxs_uw_b655p35 0.00 655.3500 FORMAT "%8.4" /end CHARACTERISTIC
/begin CHARACTERISTIC TAMIALU "Minimale Ansauglufttemperatur für Ausblendung der Aussetzererkennung" VALUE 0x811358 KwUb 191.3 temp_ub_q0p75_o48 -48.00 143.3 FORMAT "%5.1" /end CHARACTERISTIC
/begin CHARACTERISTIC TANDSLMN "min. Ansauglufttemperatur für SL- Diagnose" VALUE 0x8195CA KwUb 191.3 temp_ub_q0p75_o48 -48.00 143.3 FORMAT "%5.1" /end CHARACTERISTIC
/begin CHARACTERISTIC TANDSLMX "max. Ansauglufttemperatur für SL- Diagnose" VALUE 0x8195CB KwUb 191.3 temp_ub_q0p75_o48 -48.00 143.3 FORMAT "%5.1" /end CHARACTERISTIC
/begin CHARACTERISTIC TANDT "Schwelle Temperaturdifferenz Ansaugluft für Heißstart" CURVE 0x811C71 KlAUbSstUbWUb 191.3 temp_ub_b191p25 0.00 191.3 FORMAT "%5.1"
 /begin AXIS_DESCR STD_AXIS tansab temp_ub_q0p75_o48 8 -48.00 143.3 FORMAT "%5.1" DEPOSIT ABSOLUTE /end AXIS_DESCR
/end CHARACTERISTIC
/begin CHARACTERISTIC TBTEVIO "Verzögerungszeit für Beladungprüfung TEV i.O. Erkennung" VALUE 0x81A4F1 KwUb 25.50 t100msxs_ub_b25p5 0.00 25.50 FORMAT "%5.2" /end CHARACTERISTIC
/begin CHARACTERISTIC TC6CSL "Mode 6: Component ID für Prüfung Sekundärluftsystem" VALUE 0x8195CC KwUb 127.0 dez 0.00 127.0 FORMAT "%5.1" /end CHARACTERISTIC
/begin CHARACTERISTIC TC6CSL2 "Mode 6: Component ID für Prüfung Sekundärluftsystem, Bank 2" VALUE 0x8195CD KwUb 127.0 dez 0.00 127.0 FORMAT "%5.1" /end CHARACTERISTIC
/begin CHARACTERISTIC TC6CSLN "Mode 6: Component ID für Prüfung minimale Sekundärluft in Phase 1" VALUE 0x8195CE KwUb 127.0 dez 0.00 127.0 FORMAT "%5.1" /end CHARACTERISTIC
/begin CHARACTERISTIC TC6CSLN2 "Mode 6: Component ID für Prüfung minimale Sekundärluft in Phase 1, Bank 2" VALUE 0x8195CF KwUb 127.0 dez 0.00 127.0 FORMAT "%5.1" /end CHARACTERISTIC
/begin CHARACTERISTIC TC6CSLV "Mode 6: Component ID für Prüfung Dichtheit SL-Ventil" VALUE 0x8195D0 KwUb 127.0 dez 0.00 127.0 FORMAT "%5.1" /end CHARACTERISTIC
/begin CHARACTERISTIC TC6CSLV2 "Mode 6: Component ID für Prüfung Dichtheit SL-Ventil, Bank 2" VALUE 0x8195D1 KwUb 127.0 dez 0.00 127.0 FORMAT "%5.1" /end CHARACTERISTIC
/begin CHARACTERISTIC TCEKP "Überwachung CAN time out für EKP-Abschaltung" VALUE 0x812B5F KwUb 2.550 t10msxs_ub_b2p55 0.00 2.550 FORMAT "%5.3" /end CHARACTERISTIC
/begin CHARACTERISTIC TDDFU "Entprellzeit für Fehlereintrag Druckksensor Umgebung" VALUE 0x819B95 KwUb 25.50 t100msxs_ub_b25p5 0.00 25.50 FORMAT "%5.2" /end CHARACTERISTIC
/begin CHARACTERISTIC TDDFUUGD "Entprellzeit für Fehlereintrag Druckksensor Umgebung" VALUE 0x819B96 KwUb 25.50 t100msxs_ub_b25p5 0.00 25.50 FORMAT "%5.2" /end CHARACTERISTIC
/begin CHARACTERISTIC TDMSLMN1 "Mindestmeßzeit Sekundärluftmasse, Phase 1" VALUE 0x8195D2 KwUb 25.50 t100msxs_ub_b25p5 0.00 25.50 FORMAT "%5.2" /end CHARACTERISTIC
/begin CHARACTERISTIC TDMSLMN4 "Mindestmeßzeit Sekundärluftmasse, Phase 4" VALUE 0x8195D3 KwUb 25.50 t100msxs_ub_b25p5 0.00 25.50 FORMAT "%5.2" /end CHARACTERISTIC
/begin CHARACTERISTIC TDMSLMNK "Mindestmeßzeit Sekundärluftmasse, Phase 1 bei Kurztest" VALUE 0x8195D4 KwUb 25.50 t100msxs_ub_b25p5 0.00 25.50 FORMAT "%5.2" /end CHARACTERISTIC
/begin CHARACTERISTIC TDMSLO "Mindest-Meßzeit für Einrechnung Sekundärluftmassen-Offset" VALUE 0x8195D5 KwUb 25.50 t100msxs_ub_b25p5 0.00 25.50 FORMAT "%5.2" /end CHARACTERISTIC
/begin CHARACTERISTIC TDMSLOF3 "Meßzeit Offset Sekundärluftmasse, Phase 3" VALUE 0x8195D6 KwUb 25.50 t100msxs_ub_b25p5 0.00 25.50 FORMAT "%5.2" /end CHARACTERISTIC
/begin CHARACTERISTIC TDMSLOF5 "Meßzeit Offset sekundärluftmasse, Phase 5" VALUE 0x8195D7 KwUb 25.50 t100msxs_ub_b25p5 0.00 25.50 FORMAT "%5.2" /end CHARACTERISTIC
/begin CHARACTERISTIC TDMSLOFK "Meßzeit Offset Sekundärluftmasse, Phase 3 bei Kurztest" VALUE 0x8195D8 KwUb 25.50 t100msxs_ub_b25p5 0.00 25.50 FORMAT "%5.2" /end CHARACTERISTIC
/begin CHARACTERISTIC TDMSLOK "Mindest-Meßzit für Einrechnung Sekundärluftmassen-Offset im Kurztest" VALUE 0x8195D9 KwUb 25.50 t100msxs_ub_b25p5 0.00 25.50 FORMAT "%5.2" /end CHARACTERISTIC
/begin CHARACTERISTIC TDMSLV "Messzeit für Ventildichtheitsprüfung" VALUE 0x8195DA KwUb 25.50 t100msxs_ub_b25p5 0.00 25.50 FORMAT "%5.2" /end CHARACTERISTIC
/begin CHARACTERISTIC TDMSLVK "Meßzeit für Ventildichtheitsprüfung bei Kurztest" VALUE 0x8195DB KwUb 25.50 t100msxs_ub_b25p5 0.00 25.50 FORMAT "%5.2" /end CHARACTERISTIC
/begin CHARACTERISTIC TDNWS "Entprellzeit Fehlerflag-Setzen" VALUE 0x8195B4 KwUb 25.50 t100msxs_ub_b25p5 0.00 25.50 FORMAT "%5.2" /end CHARACTERISTIC
/begin CHARACTERISTIC TDNWSNOSI "Entprellzeit vor Signal-Fehler-Zähler Initialisierung" VALUE 0x81AA7C KwUw 6553.500 t100msxs_uw_b6553p6 0.00 6553.500 FORMAT "%8.3" /end CHARACTERISTIC
/begin CHARACTERISTIC TDSLMVBA "Einschaltverzögerung BA-/VA-Sperre bei Bildung B_dslmes" VALUE 0x8195DC KwUb 25.50 t100msxs_ub_b25p5 0.00 25.50 FORMAT "%5.2" /end CHARACTERISTIC
/begin CHARACTERISTIC TDTHM "Entprellzeit Fehlererkennung Thermostat" VALUE 0x81A099 KwUb 25.50 t100msxs_ub_b25p5 0.00 25.50 FORMAT "%5.2" /end CHARACTERISTIC
/begin CHARACTERISTIC TDU5REF "Fehlererkennung 5 Volt Referenzspannung / Zeitdauer für Abfrage" VALUE 0x811AB2 KwUb 2.550 t10msxs_ub_b2p55 0.00 2.550 FORMAT "%5.3" /end CHARACTERISTIC
/begin CHARACTERISTIC TDV "Fehlererkennung Tachosignal / Zeitdauer für Abfrage" VALUE 0x819A76 KwUb 12.75 t50msxs_ub_b12p75 0.00 12.75 FORMAT "%5.2" /end CHARACTERISTIC
/begin CHARACTERISTIC TDWNW "Wartezeit Fehlerflag-Heilung bzw. Zyklusflag setzen" VALUE 0x8195B5 KwUb 25.50 t100msxs_ub_b25p5 0.00 25.50 FORMAT "%5.2" /end CHARACTERISTIC
/begin CHARACTERISTIC TEBLEIN "Temperaturschwelle für E-Box Lüfter Ansteuerung" VALUE 0x81A46B KwUb 191.3 temp_ub_q0p75_o48 -48.00 143.3 FORMAT "%5.1" /end CHARACTERISTIC
/begin CHARACTERISTIC TFGRARLG "Rampenlaufzeit bei langsamer FGR-Abschaltung" CURVE 0x819B05 KlAUbSstUbWUb 5.100 t20msxs_ub_b5p1 0.00 5.100 FORMAT "%5.3"
 /begin AXIS_DESCR STD_AXIS gangi dez 8 0.00 255.0 FORMAT "%5.1" DEPOSIT ABSOLUTE /end AXIS_DESCR
/end CHARACTERISTIC
/begin CHARACTERISTIC TFGRTP "Zeit für Tip-Erkennung bei FGR-Bedientasten" VALUE 0x811AF2 KwUb 5.080 t20msxs_ub_b5p1 0.02000 5.100 FORMAT "%5.3" /end CHARACTERISTIC
/begin CHARACTERISTIC TFIMSLI "Zeitkonstante für msli- und msln-Filter" VALUE 0x8195DD KwUb 12.6996 zk100msxs_ub_b25p5 0.100392 12.8000 FORMAT "%7.4" /end CHARACTERISTIC
/begin CHARACTERISTIC TFIMSLIK "Zeitkonstante für msli- und msln-Filter bei Kurztest" VALUE 0x8195DE KwUb 12.6996 zk100msxs_ub_b25p5 0.100392 12.8000 FORMAT "%7.4" /end CHARACTERISTIC
/begin CHARACTERISTIC TFIMSLO "Zeitkonstante für mslo- Filter" VALUE 0x8195DF KwUb 12.6996 zk100msxs_ub_b25p5 0.100392 12.8000 FORMAT "%7.4" /end CHARACTERISTIC
/begin CHARACTERISTIC TFIMSLOK "Zeitkonstante für mslo- Filter bei Kurztest" VALUE 0x8195E0 KwUb 12.6996 zk100msxs_ub_b25p5 0.100392 12.8000 FORMAT "%7.4" /end CHARACTERISTIC
/begin CHARACTERISTIC TFIMSLV "Zeitkonstante für mslv- Filter" VALUE 0x8195E1 KwUb 12.6996 zk100msxs_ub_b25p5 0.100392 12.8000 FORMAT "%7.4" /end CHARACTERISTIC
/begin CHARACTERISTIC TFIMSLVK "Zeitkonstante für mslv- Filter bei Kurztest" VALUE 0x8195E2 KwUb 12.6996 zk100msxs_ub_b25p5 0.100392 12.8000 FORMAT "%7.4" /end CHARACTERISTIC
/begin CHARACTERISTIC TFUPI "Filterzeitkonstante bei Umschaltung auf Ist-Druck als Referenzdruck vor DK" VALUE 0x814012 KwUw 655.350000 zk10msxs_uw_b655 0.0100001526 655.360000 FORMAT "%10.6" /end CHARACTERISTIC
/begin CHARACTERISTIC TFUPS "Filterzeitkonstante bei Umschaltung auf Soll-Ladedruck als Referenzdruck vor DK" VALUE 0x814014 KwUw 655.350000 zk10msxs_uw_b655 0.0100001526 655.360000 FORMAT "%10.6" /end CHARACTERISTIC
/begin CHARACTERISTIC TKATDSL "maximale Katalysatortemperatur für Freigabe SLS-Diagnose" VALUE 0x8195E3 KwUb 1275. temp_ub_q5_o50 -50.00 1225. FORMAT "%5.0" /end CHARACTERISTIC
/begin CHARACTERISTIC TLAED "Wartezeit bis Fehlerlampe aus nach Start" VALUE 0x819690 KwUb 51.00 t200msxs_ub_b51 0.00 51.00 FORMAT "%5.2" /end CHARACTERISTIC
/begin CHARACTERISTIC TMASKIV1 "Temperaturschwelle für Verlägerung 1. KAT-Intervall, Aussetzererkennung" VALUE 0x8110C7 KwUb 191.3 temp_ub_q0p75_o48 -48.00 143.3 FORMAT "%5.1" /end CHARACTERISTIC
/begin CHARACTERISTIC TMDSLAMN "min. Motortemperatur für Zusatzdiagnose" VALUE 0x8195E4 KwUb 191.3 temp_ub_q0p75_o48 -48.00 143.3 FORMAT "%5.1" /end CHARACTERISTIC
/begin CHARACTERISTIC TMDSLMN "min. Motortemperatur für DSLS" VALUE 0x8195E5 KwUb 191.3 temp_ub_q0p75_o48 -48.00 143.3 FORMAT "%5.1" /end CHARACTERISTIC
/begin CHARACTERISTIC TMDSLMX "max. Motortemperatur für DSLS" VALUE 0x8195E6 KwUb 191.3 temp_ub_q0p75_o48 -48.00 143.3 FORMAT "%5.1" /end CHARACTERISTIC
/begin CHARACTERISTIC TMDV "Motortemperaturschwelle für Freigabe Fz-Geschwindigkeits-Diagnose" VALUE 0x819A77 KwUb 191.3 temp_ub_q0p75_o48 -48.00 143.3 FORMAT "%5.1" /end CHARACTERISTIC
/begin CHARACTERISTIC TMH "Motortemperatur - Schwelle heiß" VALUE 0x811C82 KwUb 191.3 temp_ub_q0p75_o48 -48.00 143.3 FORMAT "%5.1" /end CHARACTERISTIC
/begin CHARACTERISTIC TMHSG "Motortemperatur Heißstartgrenze" VALUE 0x811C83 KwUb 191.3 temp_ub_q0p75_o48 -48.00 143.3 FORMAT "%5.1" /end CHARACTERISTIC
/begin CHARACTERISTIC TMKS "Motortemperaturschwelle für Klopfschutz-Einspritzung" VALUE 0x811B19 KwUb 191.3 temp_ub_q0p75_o48 -48.00 143.3 FORMAT "%5.1" /end CHARACTERISTIC
/begin CHARACTERISTIC TMSDTHMU "untere Motorstart-Temp.-Schwelle für Thermostatdiagnose" VALUE 0x81A09A KwUb 191.3 temp_ub_q0p75_o48 -48.00 143.3 FORMAT "%5.1" /end CHARACTERISTIC
/begin CHARACTERISTIC TMTED "Tmot-Schwelle für Tankentlüftungsdiagnose" VALUE 0x81A4F2 KwUb 191.3 temp_ub_q0p75_o48 -48.00 143.3 FORMAT "%5.1" /end CHARACTERISTIC
/begin CHARACTERISTIC TMWUC "Motortemperaturschwelle für Erfüllung 'warm up cycle'" VALUE 0x8118FE KwUb 191.3 temp_ub_q0p75_o48 -48.00 143.3 FORMAT "%5.1" /end CHARACTERISTIC
/begin CHARACTERISTIC TMWUCST "max. Motortemperatur im Start für Erfüllung 'warm up cycle'" VALUE 0x8118FF KwUb 191.3 temp_ub_q0p75_o48 -48.00 143.3 FORMAT "%5.1" /end CHARACTERISTIC
/begin CHARACTERISTIC TN2FGRGA "Doppelte Nennerzeitkonstante für FGR-Regler" CURVE 0x81AE84 KlAUwSstUwWUw 1310.700 t20msxs_uw_q0p02 0.00 1310.700 FORMAT "%8.3"
 /begin AXIS_DESCR STD_AXIS gangi dez 8 0.00 65535.00 FORMAT "%8.2" DEPOSIT ABSOLUTE /end AXIS_DESCR
/end CHARACTERISTIC
/begin CHARACTERISTIC TNODTEV "Zeit nach Motorstart für Verbot DTEV" VALUE 0x81B9D0 KwUw 6553.500 t100msxs_uw_b6553p5 0.00 6553.500 FORMAT "%8.3" /end CHARACTERISTIC
/begin CHARACTERISTIC TNODTEVT "Zeit für Verbot DTEV bei Testerbetrieb" VALUE 0x81B9D2 KwUw 6553.500 t100msxs_uw_b6553p5 0.00 6553.500 FORMAT "%8.3" /end CHARACTERISTIC
/begin CHARACTERISTIC TNOMF2 "zulässige Zeit außerhalb Meßfenster, Phase 2" VALUE 0x8195E7 KwUb 25.50 t100msxs_ub_b25p5 0.00 25.50 FORMAT "%5.2" /end CHARACTERISTIC
/begin CHARACTERISTIC TNOMF3 "zulässige Zeit außerhalb Meßfenster, Phase 3" VALUE 0x8195E8 KwUb 25.50 t100msxs_ub_b25p5 0.00 25.50 FORMAT "%5.2" /end CHARACTERISTIC
/begin CHARACTERISTIC TNOMF5 "zulässige Zeit außerhalb Meßfenster, Phase 5" VALUE 0x8195E9 KwUb 25.50 t100msxs_ub_b25p5 0.00 25.50 FORMAT "%5.2" /end CHARACTERISTIC
/begin CHARACTERISTIC TNSUUK "Zeit UK-Unterdrückung im Nachstart" VALUE 0x810003 KwUb 25.50 t100msxs_ub_b25p5 0.00 25.50 FORMAT "%5.2" /end CHARACTERISTIC
/begin CHARACTERISTIC TPDSTA "Entprellzeit für Diagnose Startautomatik" VALUE 0x815FC6 KwUw 655.3500 t10msxs_uw_b655p35 0.00 655.3500 FORMAT "%8.4" /end CHARACTERISTIC
/begin CHARACTERISTIC TPNSE "Prüfzeit nach Startende für DVE-Diagnose" VALUE 0x810BC1 KwUb 12.75 t50msxs_ub_b12p75 0.00 12.75 FORMAT "%5.2" /end CHARACTERISTIC
/begin CHARACTERISTIC TPRELNS "eitschwelle für NBM-Entprellung" VALUE 0x810181 KwUb 2.550 t_q0p01 0.00 2.550 FORMAT "%5.3" /end CHARACTERISTIC
/begin CHARACTERISTIC TPRELRENS "NBM-Signal Zeitschwelle für Retriggerung" VALUE 0x8127C5 KwUb 2.550 t_q0p01 0.00 2.550 FORMAT "%5.3" /end CHARACTERISTIC
/begin CHARACTERISTIC TSTAEBR "Zeit für Steckerabfall-Erkennung Bremse" VALUE 0x81AD90 KwUw 6553.500 t100msxs_uw_b6553p5 0.00 6553.500 FORMAT "%8.3" /end CHARACTERISTIC
/begin CHARACTERISTIC TSWKNBGA "Zeit bis Setzwertkorrektur nach Ende Beschleunigen" CURVE 0x81AEA6 KlAUwSstUwWUw 1310.700 t20msxs_uw_q0p02 0.00 1310.700 FORMAT "%8.3"
 /begin AXIS_DESCR STD_AXIS gangi dez 8 0.00 65535.00 FORMAT "%8.2" DEPOSIT ABSOLUTE /end AXIS_DESCR
/end CHARACTERISTIC
/begin CHARACTERISTIC TSWKNVGA "Zeit bis Setzwertkorrektur nach Ende Verzögern" CURVE 0x81AEC8 KlAUwSstUwWUw 1310.700 t20msxs_uw_q0p02 0.00 1310.700 FORMAT "%8.3"
 /begin AXIS_DESCR STD_AXIS gangi dez 8 0.00 65535.00 FORMAT "%8.2" DEPOSIT ABSOLUTE /end AXIS_DESCR
/end CHARACTERISTIC
/begin CHARACTERISTIC TTEBL "Zeitdauer der Ansteuerung des E-Box Lüfters nach Start" VALUE 0x81A46C KwUb 25.40 t100msxs_ub_b25p5 0.1000 25.50 FORMAT "%5.2" /end CHARACTERISTIC
/begin CHARACTERISTIC TTEDA "Zeitdauer der Aufsteuerung des TEV bei TEV-Diagnose" VALUE 0x817454 KwUw 1310.70 t20msxs_uw_b1310 0.00 1310.70 FORMAT "%7.2" /end CHARACTERISTIC
/begin CHARACTERISTIC TTEDBA "Zeitschwelle für Beginn der TEV-Aufsteuerung bei Tankentlüftungsdiagnose" VALUE 0x817456 KwUw 1310.70 t20msxs_uw_b1310 0.00 1310.70 FORMAT "%7.2" /end CHARACTERISTIC
/begin CHARACTERISTIC TTEDIV "Verzögerungszeit für Integratorstart Drehzahl-Auswertung" VALUE 0x817458 KwUw 1310.70 t20msxs_uw_b1310 0.00 1310.70 FORMAT "%7.2" /end CHARACTERISTIC
/begin CHARACTERISTIC TTEDN "Zeitdauer der Drehzahl-Auswertung bei TEV-Diagnose" VALUE 0x81745A KwUw 1310.70 t20msxs_uw_b1310 0.00 1310.70 FORMAT "%7.2" /end CHARACTERISTIC
/begin CHARACTERISTIC TTHMDMX "max. Motortemperatur f. Überwachung Thermostat-Diagnose" VALUE 0x81A09B KwUb 191.3 temp_ub_q0p75_o48 -48.00 143.3 FORMAT "%5.1" /end CHARACTERISTIC
/begin CHARACTERISTIC TVAWDKP1 "Verzögerungszeit für Auswahl DK-Poti 1 im Ersatzbetrieb" VALUE 0x810154 KwUb 2.540 t10msxs_ub_b2p55 0.01000 2.550 FORMAT "%5.3" /end CHARACTERISTIC
/begin CHARACTERISTIC TVAWDKP2 "Verzögerungszeit für Auswahl DK-Poti 2 im Ersatzbetrieb" VALUE 0x810155 KwUb 2.540 t10msxs_ub_b2p55 0.01000 2.550 FORMAT "%5.3" /end CHARACTERISTIC
/begin CHARACTERISTIC TVAWF12 "Fehlerzeit bei DK-Poti-Auswahl für Ersatzbetrieb" VALUE 0x810156 KwUb 2.540 t10msxs_ub_b2p55 0.01000 2.550 FORMAT "%5.3" /end CHARACTERISTIC
/begin CHARACTERISTIC TVERBR "Verzögerungszeit für Bremsschalter-Plausibilitätsprüfung" VALUE 0x819A79 KwUb 25.50 t100msxs_ub_b25p5 0.00 25.50 FORMAT "%5.2" /end CHARACTERISTIC
/begin CHARACTERISTIC TVETRA "Verzögerungzeit zum Löschen von B_etr" VALUE 0x81AD92 KwUw 6553.500 t100msxs_uw_b6553p6 0.00 6553.500 FORMAT "%8.3" /end CHARACTERISTIC
/begin CHARACTERISTIC TVETRE "Verzögerungzeit zum Setzen von B_etr" VALUE 0x81AD94 KwUw 6553.500 t100msxs_uw_b6553p6 0.00 6553.500 FORMAT "%8.3" /end CHARACTERISTIC
/begin CHARACTERISTIC TVKS "Verzugszeit für Einrechnung Klopfschutz-Einspritzung" VALUE 0x815A14 KwUw 1310.70 t20msxs_uw_b1310 0.00 1310.70 FORMAT "%7.2" /end CHARACTERISTIC
/begin CHARACTERISTIC TVKUP "Verzögerungszeit für B_kupplv" VALUE 0x810085 KwUb 5.100 t20msxs_ub_b5p1 0.00 5.100 FORMAT "%5.3" /end CHARACTERISTIC
/begin CHARACTERISTIC TVLADV "Zeitkonstante für Integrator bei vlast-Berechnung" CURVE 0x8158D4 KlAUwSstSwWUw 1309.98001 zk20msxs_uw_b1310 0.0199893187 1310.00000 FORMAT "%10.5"
 /begin AXIS_DESCR STD_AXIS dvzvi_w vfzg_sw_q0p00781 8 -256.0000 255.9922 FORMAT "%8.4" DEPOSIT ABSOLUTE /end AXIS_DESCR
/end CHARACTERISTIC
/begin CHARACTERISTIC TVPDKP1 "Fehlertoleranzzeit bei Bereichsprüfung DK-Poti 1" VALUE 0x810157 KwUb 2.540 t10msxs_ub_b2p55 0.01000 2.550 FORMAT "%5.3" /end CHARACTERISTIC
/begin CHARACTERISTIC TVPDKP2 "Fehlertoleranzzeit bei Bereichsprüfung DK-Poti 2" VALUE 0x810158 KwUb 2.540 t10msxs_ub_b2p55 0.01000 2.550 FORMAT "%5.3" /end CHARACTERISTIC
/begin CHARACTERISTIC TVPWDK12 "Fehlertoleranzzeit bei Gleichlaufprüfung der DK-Potis" VALUE 0x810159 KwUb 2.540 t10msxs_ub_b2p55 0.01000 2.550 FORMAT "%5.3" /end CHARACTERISTIC
/begin CHARACTERISTIC TVPWDK13 "Fehlertoleranzzeit bei Gleichlaufprüfung DK-Poti 1 und Ersatzwert aus Füllung" VALUE 0x81015A KwUb 2.540 t10msxs_ub_b2p55 0.01000 2.550 FORMAT "%5.3" /end CHARACTERISTIC
/begin CHARACTERISTIC TVPWDK23 "Fehlertoleranzzeit bei Gleichlaufprüfung DK-Poti 2 und Ersatzwert aus Füllung" VALUE 0x81015B KwUb 2.540 t10msxs_ub_b2p55 0.01000 2.550 FORMAT "%5.3" /end CHARACTERISTIC
/begin CHARACTERISTIC TVUB "Spannungskorrektur" CURVE 0x81591E KlAUbSstUbWUw 209.7120 tinjection_sy 0.00 209.7120 FORMAT "%8.4"
 /begin AXIS_DESCR STD_AXIS ub spg_ubatt 5 0.00 24.02 FORMAT "%5.2" DEPOSIT ABSOLUTE /end AXIS_DESCR
/end CHARACTERISTIC
/begin CHARACTERISTIC TVWDKS "Verzögerungszeit für Drosselklappen-Sollwinkel" VALUE 0x810011 KwUb 0.05000 t10msxs_ub_b2p55 0.00 0.05000 FORMAT "%7.5" /end CHARACTERISTIC
/begin CHARACTERISTIC TWDKSV "Zeitkonstante für Drosselklappensollwinkelfilterung" CURVE 0x813216 KlAUwSstUwWUw 655.350000 zk10msxs_uw_b655 0.0100001526 655.360000 FORMAT "%10.6"
 /begin AXIS_DESCR STD_AXIS pspvmin_w fak_uw_b2 6 0.00 1.999969 FORMAT "%8.6" DEPOSIT ABSOLUTE /end AXIS_DESCR
/end CHARACTERISTIC
/begin CHARACTERISTIC TWDSTA "Wartezeit für Diagnose Startautomatik" VALUE 0x8123C0 KwUb 2.550 t10msxs_ub_b2p55 0.00 2.550 FORMAT "%5.3" /end CHARACTERISTIC
/begin CHARACTERISTIC TWDSTS "Wartezeit für Diagnose Startsignal" VALUE 0x815FCA KwUw 655.3500 TQ10 0.00 655.3500 FORMAT "%8.4" /end CHARACTERISTIC
/begin CHARACTERISTIC TWETRS "Solltemperatur bei Anforderung Wärmetauscherschutz, ersetzt FWETRS" VALUE 0x819B03 KwUb 191.3 temp_ub_q0p75_o48 -48.00 143.3 FORMAT "%5.1" /end CHARACTERISTIC
/begin CHARACTERISTIC TWHLSLP "Wartezeit für Hochlauf Sekundärluftpumpe" VALUE 0x8195EA KwUb 25.50 t100msxs_ub_b25p5 0.00 25.50 FORMAT "%5.2" /end CHARACTERISTIC
/begin CHARACTERISTIC TWKODTE "Wartezeit nach Kompressor schalten für DTEVN" VALUE 0x81A4F3 KwUb 25.50 t100msxs_ub_b25p5 0.00 25.50 FORMAT "%5.2" /end CHARACTERISTIC
/begin CHARACTERISTIC TWMLFE "Mindestzeit für ml im Diagnosebereich" VALUE 0x8195EB KwUb 25.50 t100msxs_ub_b25p5 0.00 25.50 FORMAT "%5.2" /end CHARACTERISTIC
/begin CHARACTERISTIC TWMSLMIN "Entprellzeit für Fehlermeldung B_mslmin" VALUE 0x8195EC KwUb 25.50 t100msxs_ub_b25p5 0.00 25.50 FORMAT "%5.2" /end CHARACTERISTIC
/begin CHARACTERISTIC TWSTT "Schwelle Abstellzeit für Wiederholstart" CURVE 0x811C84 KlAUbSstUbWUb 255.0 t1sxs_ub_b255 0.00 255.0 FORMAT "%5.1"
 /begin AXIS_DESCR STD_AXIS tmotab temp_ub_q0p75_o48 12 -48.00 143.3 FORMAT "%5.1" DEPOSIT ABSOLUTE /end AXIS_DESCR
/end CHARACTERISTIC
/begin CHARACTERISTIC TZ2FGRGA "Doppelte Zählerzeitkonstante für FGR-Regler" CURVE 0x81AEEA KlAUwSstUwWUw 1310.700 t20msxs_uw_q0p02 0.00 1310.700 FORMAT "%8.3"
 /begin AXIS_DESCR STD_AXIS gangi dez 8 0.00 65535.00 FORMAT "%8.2" DEPOSIT ABSOLUTE /end AXIS_DESCR
/end CHARACTERISTIC
/begin CHARACTERISTIC U5REFMN "min. Schwelle für Diagnose 5 Volt Referenzspannung" VALUE 0x811AB3 KwUb 4.980 spg_ub_b5 0.00 4.980 FORMAT "%5.3" /end CHARACTERISTIC
/begin CHARACTERISTIC UADPUMN "min. Spannungswert für Diagnose Drucksensor" VALUE 0x819B97 KwUb 4.845 spg_ub_q0p019 0.00 4.845 FORMAT "%5.3" /end CHARACTERISTIC
/begin CHARACTERISTIC UADPUMX "max. Spannungswert für Diagnose Drucksensor" VALUE 0x819B98 KwUb 4.845 spg_ub_q0p019 0.00 4.845 FORMAT "%5.3" /end CHARACTERISTIC
/begin CHARACTERISTIC UBVDKPO "Batteriespannungsschwelle für Umschaltung auf verstärktes Signal von DK-Poti 1" VALUE 0x81015C KwUb 24.02 spg_ubatt 0.00 24.02 FORMAT "%5.2" /end CHARACTERISTIC
/begin CHARACTERISTIC UBVDKPU "Batteriespannungsschwelle für Umschaltung auf unverstärktes Signal von DK-Poti 1" VALUE 0x81015D KwUb 24.02 spg_ubatt 0.00 24.02 FORMAT "%5.2" /end CHARACTERISTIC
/begin CHARACTERISTIC UDKP1O "Maximale zulässige Spannung von DK-Poti 1" VALUE 0x81015E KwUb 4.980 spg_ub_b5 0.00 4.980 FORMAT "%5.3" /end CHARACTERISTIC
/begin CHARACTERISTIC UDKP1U "Minimale zulässige Spannung von DK-Poti 1" VALUE 0x81015F KwUb 4.980 spg_ub_b5 0.00 4.980 FORMAT "%5.3" /end CHARACTERISTIC
/begin CHARACTERISTIC UDKP2O "Maximale zulässige Spannung von DK-Poti 2" VALUE 0x810160 KwUb 4.980 spg_ub_b5 0.00 4.980 FORMAT "%5.3" /end CHARACTERISTIC
/begin CHARACTERISTIC UDKP2U "Minimale zulässige Spannung von DK-Poti 2" VALUE 0x810161 KwUb 4.980 spg_ub_b5 0.00 4.980 FORMAT "%5.3" /end CHARACTERISTIC
/begin CHARACTERISTIC VDMN "Geschwindigkeitsschwelle; Fehlererkennung Geschwindigkeitssignal" VALUE 0x81AD8A KwUw 511.9922 vfzg_uw_b512 0.00 511.9922 FORMAT "%8.4" /end CHARACTERISTIC
/begin CHARACTERISTIC VDTHMU "untere Geschwindigkeitsschwelle für Freigabe Thermostatdiagnose" VALUE 0x81A09C KwUb 318.8 vfzg_ub_q1p25 0.00 318.8 FORMAT "%5.1" /end CHARACTERISTIC
/begin CHARACTERISTIC VFZETR "Geschwindigkeitsschwelle für el. Thermostatregelung" VALUE 0x819B04 KwUb 318.8 vfzg_ub_q1p25 0.00 318.8 FORMAT "%5.1" /end CHARACTERISTIC
/begin CHARACTERISTIC VLMXVZ "Maximalwert für vlast_w" CURVE 0x8158F6 KlAUwSstUwWUw 511.9844 vfzg_uw_b512 0.007812500 511.9922 FORMAT "%8.4"
 /begin AXIS_DESCR STD_AXIS vziel_w vfzg_uw_b512 6 0.00 511.9922 FORMAT "%8.4" DEPOSIT ABSOLUTE /end AXIS_DESCR
/end CHARACTERISTIC
/begin CHARACTERISTIC WDKDSVLU "Drosselklappenschwelle für Drucksensorplausibilisierung" CURVE 0x819B99 KlAUbSstUbWUb 100.0 relDK_ub_b100 0.00 100.0 FORMAT "%5.1"
 /begin AXIS_DESCR STD_AXIS nmot nmot_ub_q40 6 0.00 10200. FORMAT "%5.0" DEPOSIT ABSOLUTE /end AXIS_DESCR
/end CHARACTERISTIC
/begin CHARACTERISTIC WDKSAPP "Drosselklappensollwert für Applikationszwecke" VALUE 0x814016 KwUw 99.99847 rel_uw_b100 0.00 99.99847 FORMAT "%8.5" /end CHARACTERISTIC
/begin CHARACTERISTIC WDKUGDN "KL Drosselklappenwinkel, ab der keine Drosselung mehr erfolgt" CURVE 0x81A742 GklWUw 99.99847 rel_uw_b100 0.00 99.99847 FORMAT "%8.5"
 /begin AXIS_DESCR COM_AXIS nmot nmot_ub_q40 12 0.00 10200. AXIS_PTS_REF SNM12FEUB /end AXIS_DESCR
/end CHARACTERISTIC
/begin CHARACTERISTIC WEAN "Winkel Einspritzabbruch" CURVE 0x819C8A KlAUbSstUbWUb 1530. zw_ub_q6 0.00 1530. FORMAT "%5.0"
 /begin AXIS_DESCR STD_AXIS nmot nmot_ub_q40 6 0.00 10200. FORMAT "%5.0" DEPOSIT ABSOLUTE /end AXIS_DESCR
/end CHARACTERISTIC
/begin CHARACTERISTIC WEEM "Vorlagerungswinkel - Korrektur" CURVE 0x819C97 KlAUbSstUbWUb 1530. zw_ub_q6 0.00 1530. FORMAT "%5.0"
 /begin AXIS_DESCR STD_AXIS tmot temp_ub_q0p75_o48 8 -48.00 143.3 FORMAT "%5.1" DEPOSIT ABSOLUTE /end AXIS_DESCR
/end CHARACTERISTIC
/begin CHARACTERISTIC WEESTM "Vorlagerunswinkel-Korrektur im Start" CURVE 0x819CA8 KlAUbSstUbWUb 1530. zw_ub_q6 0.00 1530. FORMAT "%5.0"
 /begin AXIS_DESCR STD_AXIS tmot temp_ub_q0p75_o48 8 -48.00 143.3 FORMAT "%5.1" DEPOSIT ABSOLUTE /end AXIS_DESCR
/end CHARACTERISTIC
/begin CHARACTERISTIC WEESTN "Winkel Einspritzende im Start" CURVE 0x819CB9 KlAUbSstUbWUb 1530. zw_ub_q6 0.00 1530. FORMAT "%5.0"
 /begin AXIS_DESCR STD_AXIS nmot nmot_ub_q40 4 0.00 10200. FORMAT "%5.0" DEPOSIT ABSOLUTE /end AXIS_DESCR
/end CHARACTERISTIC
/begin CHARACTERISTIC WEESTS "Winkelgrenze Einspritzende für sim. Startauslösungen" VALUE 0x814004 DI__Kwub__________ 717.3 WQ720 0.00 717.3 FORMAT "%5.1" /end CHARACTERISTIC
/begin CHARACTERISTIC WEEVLN "Winkel Einspritzende bei Vollast" CURVE 0x819CC2 KlAUbSstUbWUb 1530. zw_ub_q6 0.00 1530. FORMAT "%5.0"
 /begin AXIS_DESCR STD_AXIS nmot nmot_ub_q40 8 0.00 10200. FORMAT "%5.0" DEPOSIT ABSOLUTE /end AXIS_DESCR
/end CHARACTERISTIC
/begin CHARACTERISTIC WESBM "Winkel Einlaß-schließt vor SW-Bezugsmarke (tR)" VALUE 0x814003 DI__Kwub__________ 717.3 WQ720 0.00 717.3 FORMAT "%5.1" /end CHARACTERISTIC
/begin CHARACTERISTIC WFRL "Kraftstoffwandfilmkennlinie" CURVE 0x813CBE FklWUw 6143.906 rel_uw_b6144 0.00 6143.906 FORMAT "%8.3"
 /begin AXIS_DESCR FIX_AXIS rlp_w rel_uw_q0p0234 26 0.00 155.9766 FORMAT "%8.4" FIX_AXIS_PAR 0 8 26 /end AXIS_DESCR
/end CHARACTERISTIC
/begin CHARACTERISTIC WKSVN "Zündwinkelgrenzkennlinie für Klopfschutz-Einspritzung bei Vollast" CURVE 0x815A16 KlAUbSstUbWSb 191.3 zw_sb_q0p75 -96.00 95.25 FORMAT "%5.2"
 /begin AXIS_DESCR STD_AXIS nmot nmot_ub_q40 16 0.00 10200. FORMAT "%5.0" DEPOSIT ABSOLUTE /end AXIS_DESCR
/end CHARACTERISTIC
/begin CHARACTERISTIC WNWAIMN "Minimalwert der individuelle NW-Spätanschlagsadaption" VALUE 0x81AA7E KwSw 255.996 wkw_sw_b128 -128.000 127.996 FORMAT "%7.3" /end CHARACTERISTIC
/begin CHARACTERISTIC WNWAIMX "Maximalwert der individuellen NW-Spätanschlagsadaption" VALUE 0x81AA80 KwSw 255.996 wkw_sw_b128 -128.000 127.996 FORMAT "%7.3" /end CHARACTERISTIC
/begin CHARACTERISTIC ZBALM "Abregelfaktor L-Speicher (tmot) BA" CURVE 0x819379 KlAUbSstUbWUb 0.1245 fak_ub_b0p125 0.00 0.1245 FORMAT "%6.4"
 /begin AXIS_DESCR STD_AXIS tmot temp_ub_q0p75_o48 7 -48.00 143.3 FORMAT "%5.1" DEPOSIT ABSOLUTE /end AXIS_DESCR
/end CHARACTERISTIC
/begin CHARACTERISTIC ZDGZA1 "Zündungszahl Abregelung Bereich 1" VALUE 0x811B72 KwUb 255.0 dez 0.00 255.0 FORMAT "%5.1" /end CHARACTERISTIC
/begin CHARACTERISTIC ZDGZA2 "Zündungszahl Abregelung Bereich 2" VALUE 0x811B73 KwUb 255.0 dez 0.00 255.0 FORMAT "%5.1" /end CHARACTERISTIC
/begin CHARACTERISTIC ZDSU "Zeitkonstante für Filterung von pu und fho in GGDSU" VALUE 0x819BA6 KwUb 25.4996 zk100msxs_ub_b25p5 0.100392 25.6000 FORMAT "%7.4" /end CHARACTERISTIC
/begin CHARACTERISTIC ZERBR "Fehlerzähler für Bremsschalter-Unplausibilitäten" VALUE 0x819A7A KwUb 255.0 dez 0.00 255.0 FORMAT "%5.1" /end CHARACTERISTIC
/begin CHARACTERISTIC ZKLANSWL "Zeitkonstante Filterung lamnswl_w" VALUE 0x815BEE KwUw 655.350000 zk10msxs_uw_b655 0.0100001526 655.360000 FORMAT "%10.6" /end CHARACTERISTIC
/begin CHARACTERISTIC ZKWNW "Zeitkonstante Korrekturfaktor Nockenwellenumschaltung" VALUE 0x811B9F KwUb 5.08000 zk20msxs_ub_b5p1 0.0200000 5.10000 FORMAT "%7.5" /end CHARACTERISTIC
/begin CHARACTERISTIC ZMVDTE "Zeitkonstante Überwachung Verlustmoment" VALUE 0x81745C KwUw 3276.75000 zk50msxs_uw_b3276p8 0.0500007630 3276.80000 FORMAT "%10.5" /end CHARACTERISTIC
/begin CHARACTERISTIC ZNTED "Zeitkonstante Drehzahlfilterung bei TEV-Diagnose" VALUE 0x81745E KwUw 655.350000 zk10msxs_uw_b655 0.0100001526 655.360000 FORMAT "%10.6" /end CHARACTERISTIC
/begin CHARACTERISTIC ZPRELNS "NBM - Entprellung über Anzahl Zähne" VALUE 0x8175EE KwUw 255.0000 dez 0.00 255.0000 FORMAT "%8.4" /end CHARACTERISTIC
/begin CHARACTERISTIC ZTPREL "Anzahl Zähne während der Starterkennung" VALUE 0x811A68 KwUb 40.00 dez 0.00 40.00 FORMAT "%5.2" /end CHARACTERISTIC
/begin CHARACTERISTIC ZUKK "Abregelfaktor Kurzzeitanteil" VALUE 0x810065 KwUb 0.9961 fak_ub_b1 0.00 0.9961 /end CHARACTERISTIC
/begin CHARACTERISTIC ZUKNST "Abregelzeitkonstante ÜK-Faktor im Nachstart" VALUE 0x813CF2 KwUw 6553.4999985 zk100msxs_uw_b6553 0.10000152590 6553.6000000 FORMAT "%12.7" /end CHARACTERISTIC
/begin CHARACTERISTIC ZVALM "Abregelfaktor L-Speicher (tmot) VA" CURVE 0x819388 KlAUbSstUbWUb 0.1245 fak_ub_b0p125 0.00 0.1245 FORMAT "%6.4"
 /begin AXIS_DESCR STD_AXIS tmot temp_ub_q0p75_o48 7 -48.00 143.3 FORMAT "%5.1" DEPOSIT ABSOLUTE /end AXIS_DESCR
/end CHARACTERISTIC
/begin CHARACTERISTIC ZZWEETM "Umschaltschwelle Vorlagerungswinkel" CURVE 0x819CD3 KlAUbSstUbWUb 8160. nwu_ub_q32 0.00 8160. FORMAT "%5.0"
 /begin AXIS_DESCR STD_AXIS tmst temp_ub_q0p75_o48 8 -48.00 143.3 FORMAT "%5.1" DEPOSIT ABSOLUTE /end AXIS_DESCR
/end CHARACTERISTIC
/begin MEASUREMENT abak "Aufteilungsfaktor Wandfilm bei BA" UBYTE fak_ub_b1 1 100 0 0.996094 ECU_ADDRESS 0x380B33 /end MEASUREMENT
/begin MEASUREMENT afnmn "Bereichsfenster Aussetzer, minimale Drehzahl" UBYTE nmot_ub_q40 1 100 0 10200 FORMAT "%5.0" ECU_ADDRESS 0x382FE1 /end MEASUREMENT
/begin MEASUREMENT afnmx "Bereichsfenster Aussetzer, maximale Drehzahl" UBYTE nmot_ub_q40 1 100 0 10200 FORMAT "%5.0" ECU_ADDRESS 0x382FE2 /end MEASUREMENT
/begin MEASUREMENT afrlmn "Bereichsfenster Aussetzer, minimale Last" UBYTE rel_ub_q0p75 1 100 0 191.25 FORMAT "%5.1" ECU_ADDRESS 0x382FE3 /end MEASUREMENT
/begin MEASUREMENT afrlmx "Bereichsfenster Aussetzer, maximale Last" UBYTE rel_ub_q0p75 1 100 0 191.25 FORMAT "%5.1" ECU_ADDRESS 0x382FE4 /end MEASUREMENT
/begin MEASUREMENT aftnmn "Bereichsfenster Aussetzer, minimale Drehzahl, temporär" UBYTE nmot_ub_q40 1 100 0 10200 FORMAT "%5.0" ECU_ADDRESS 0x380B5E /end MEASUREMENT
/begin MEASUREMENT aftnmx "Bereichsfenster Aussetzer, maximale Drehzahl, temporär" UBYTE nmot_ub_q40 1 100 0 10200 FORMAT "%5.0" ECU_ADDRESS 0x380B5F /end MEASUREMENT
/begin MEASUREMENT aftrlmn "Bereichsfenster Aussetzer, minimale Last, temporär" UBYTE rel_ub_q0p75 1 100 0 191.25 FORMAT "%5.1" ECU_ADDRESS 0x380B60 /end MEASUREMENT
/begin MEASUREMENT aftrlmx "Bereichsfenster Aussetzer, maximale Last, temporär" UBYTE rel_ub_q0p75 1 100 0 191.25 FORMAT "%5.1" ECU_ADDRESS 0x380B61 /end MEASUREMENT
/begin MEASUREMENT aint "" UBYTE dez 1 100 0 255 FORMAT "%5.1" ARRAY_SIZE 8 ECU_ADDRESS 0x380B62 /end MEASUREMENT
/begin MEASUREMENT anztib_w "ti-Einspritzzähler mit Begrenzung" UWORD dez 1 100 0 65535 FORMAT "%8.2" ECU_ADDRESS 0x382228 /end MEASUREMENT
/begin MEASUREMENT anztis "Anzahl vom CIFI initialisierter ti's (Synchro-Abtastung)" UBYTE dez 1 100 0 255 FORMAT "%5.1" ECU_ADDRESS 0x380B34 /end MEASUREMENT
/begin MEASUREMENT anztist "ti-Einspritzzähler im Start" UBYTE dez 1 100 0 255 FORMAT "%5.1" ECU_ADDRESS 0x380CB5 /end MEASUREMENT
/begin MEASUREMENT anztpdn "Anzahl der hintereinander erfolgten Tip-Downs" UBYTE dez 1 100 0 255 FORMAT "%5.1" ECU_ADDRESS 0x380C8E /end MEASUREMENT
/begin MEASUREMENT anztpup "Anzahl der hintereinander erfolgten Tip-Ups" UBYTE dez 1 100 0 255 FORMAT "%5.1" ECU_ADDRESS 0x380C8F /end MEASUREMENT
/begin MEASUREMENT avak "Aufteilungsfaktor Wandfilm bei VA" UBYTE fak_ub_b1 1 100 0 0.996094 ECU_ADDRESS 0x380B35 /end MEASUREMENT
/begin MEASUREMENT azycnt "Anzahl der wg. katschädigender Aussetzer abgeschalteten Zylinder" UBYTE dez 1 100 0 255 FORMAT "%5.1" ECU_ADDRESS 0x380B6A /end MEASUREMENT
/begin MEASUREMENT bbdmdmil "" UBYTE dez 1 100 0 255 FORMAT "%5.1" ECU_ADDRESS 0x382FE5 /end MEASUREMENT
/begin MEASUREMENT bbsp1 "Byte für Bedingung B_sp1 als Triggerevent in DCLA" UBYTE dez 1 100 0 255 FORMAT "%5.1" ECU_ADDRESS 0x380B6B /end MEASUREMENT
/begin MEASUREMENT bbsp2 "Byte für Bedingung B_sp2 als Triggerevent in DCLA" UBYTE dez 1 100 0 255 FORMAT "%5.1" ECU_ADDRESS 0x380B6C /end MEASUREMENT
/begin MEASUREMENT bbwuc "Byte für Bedingung B_wuc als Triggerevent in DCLA" UBYTE dez 1 100 0 255 FORMAT "%5.1" ECU_ADDRESS 0x380BEB /end MEASUREMENT
/begin MEASUREMENT bfnmn "Bereichsfenster Motorbetrieb, minimale Drehzahl" UBYTE nmot_ub_q40 1 100 0 10200 FORMAT "%5.0" ECU_ADDRESS 0x380B6D /end MEASUREMENT
/begin MEASUREMENT bfnmx "Bereichsfenster Motorbetrieb, maximale Drehzahl" UBYTE nmot_ub_q40 1 100 0 10200 FORMAT "%5.0" ECU_ADDRESS 0x380B6E /end MEASUREMENT
/begin MEASUREMENT bfrlmn "Bereichsfenster Motorbetrieb, minimale Last" UBYTE rel_ub_q0p75 1 100 0 191.25 FORMAT "%5.1" ECU_ADDRESS 0x380B6F /end MEASUREMENT
/begin MEASUREMENT bfrlmx "Bereichsfenster Motorbetrieb, maximale Last" UBYTE rel_ub_q0p75 1 100 0 191.25 FORMAT "%5.1" ECU_ADDRESS 0x380B70 /end MEASUREMENT
/begin MEASUREMENT bssp "Speicherwert Signal Beschleunigungssensor" UWORD acc_uw_b55p55 1 100 0 55.5547 FORMAT "%8.5" ECU_ADDRESS 0x382602 /end MEASUREMENT
/begin MEASUREMENT B_afklt "Bereichsfenster Aussetzer, Bedingung kalt, TMOT<TMWUC" UBYTE B_TRUE 1 100 0 1 BIT_MASK 0x2 FORMAT "%13.11" ECU_ADDRESS 0x382FE5 /end MEASUREMENT
/begin MEASUREMENT B_aftklt "Bereichsfenster Aussetzer, temporär, Bedingung kalt, TMOT<TMWUC" UBYTE B_TRUE 1 100 0 1 BIT_MASK 0x8 FORMAT "%13.11" ECU_ADDRESS 0x382FE5 /end MEASUREMENT
/begin MEASUREMENT B_aftwrm "Bereichsfenster Aussetzer, temporär, Bedingung warm, TMOT>TMWUC" UBYTE B_TRUE 1 100 0 1 BIT_MASK 0x4 FORMAT "%13.11" ECU_ADDRESS 0x382FE5 /end MEASUREMENT
/begin MEASUREMENT B_afwrm "Bereichsfenster Aussetzer, Bedingung warm, TMOT>TMWUC" UBYTE B_TRUE 1 100 0 1 BIT_MASK 0x1 FORMAT "%13.11" ECU_ADDRESS 0x382FE5 /end MEASUREMENT
/begin MEASUREMENT B_airbag "Bedingung Airbag ausgelöst" UWORD B_TRUE 1 100 0 1 BIT_MASK 0x80 FORMAT "%13.11" ECU_ADDRESS 0xFDDA /end MEASUREMENT
/begin MEASUREMENT B_asla "Anforderung Sekundärluftadaption Bank 1" UWORD B_TRUE 1 100 0 1 BIT_MASK 0x8 FORMAT "%13.11" ECU_ADDRESS 0x380E72 /end MEASUREMENT
/begin MEASUREMENT B_asla2 "Anforderung Sekundärluftadaption Bank 2" UWORD B_TRUE 1 100 0 1 BIT_MASK 0x4000 FORMAT "%13.11" ECU_ADDRESS 0x380E70 /end MEASUREMENT
/begin MEASUREMENT B_atev "Bedingung Endstufendiagnose TEV auf" UWORD B_TRUE 1 100 0 1 BIT_MASK 0x400 FORMAT "%13.11" ECU_ADDRESS 0xFD8A /end MEASUREMENT
/begin MEASUREMENT B_ba "Bedingung Beschleunigungsanreicherung (Anzeige)" UWORD B_TRUE 1 100 0 1 BIT_MASK 0x4000 FORMAT "%13.11" ECU_ADDRESS 0xFD2A /end MEASUREMENT
/begin MEASUREMENT B_bag "Bedingung starke Beschleunigungsanreicherung" UWORD B_TRUE 1 100 0 1 BIT_MASK 0x8000 FORMAT "%13.11" ECU_ADDRESS 0xFD2A /end MEASUREMENT
/begin MEASUREMENT B_bbdthm "Bedingung Betriebsbereich Diagn. Thermostat erfüllt" UBYTE B_TRUE 1 100 0 1 BIT_MASK 0x1 FORMAT "%13.11" ECU_ADDRESS 0x380CB7 /end MEASUREMENT
/begin MEASUREMENT B_besch "Bedingung FGR im Zustand Beschleunigen" UWORD B_TRUE 1 100 0 1 BIT_MASK 0x1 FORMAT "%13.11" ECU_ADDRESS 0x382102 /end MEASUREMENT
/begin MEASUREMENT B_bfklt "Bereichsfenster Motorbetrieb, Bedingung kalt, TMOT<TMWUC" UBYTE B_TRUE 1 100 0 1 BIT_MASK 0x20 FORMAT "%13.11" ECU_ADDRESS 0x382FE5 /end MEASUREMENT
/begin MEASUREMENT B_bfwrm "Bereichsfenster Motorbetrieb, Bedingung warm, TMOT>TMWUC" UBYTE B_TRUE 1 100 0 1 BIT_MASK 0x10 FORMAT "%13.11" ECU_ADDRESS 0x382FE5 /end MEASUREMENT
/begin MEASUREMENT B_bl "Bedingung Bremslichtschalter betätigt" UWORD B_TRUE 1 100 0 1 BIT_MASK 0x400 FORMAT "%13.11" ECU_ADDRESS 0xFD88 /end MEASUREMENT
/begin MEASUREMENT B_blkeb "MIL-Ansteuerung blinkend eigenbestimmt" UBYTE B_TRUE 1 100 0 1 BIT_MASK 0x4 FORMAT "%13.11" ECU_ADDRESS 0x380AFE /end MEASUREMENT
/begin MEASUREMENT B_blkmd "MIL-Ansteuerung blinkend durch Aussetzererkennung" UWORD B_TRUE 1 100 0 1 BIT_MASK 0x20 FORMAT "%13.11" ECU_ADDRESS 0xFD72 /end MEASUREMENT
/begin MEASUREMENT B_br "Bedingung Bremstestschalter betätigt" UWORD B_TRUE 1 100 0 1 BIT_MASK 0x800 FORMAT "%13.11" ECU_ADDRESS 0xFD88 /end MEASUREMENT
/begin MEASUREMENT B_br2k "Bedingung Bremse betätigt 2-kanalig erkannt" UWORD B_TRUE 1 100 0 1 BIT_MASK 0x1000 FORMAT "%13.11" ECU_ADDRESS 0xFD88 /end MEASUREMENT
/begin MEASUREMENT B_brems "Bedingung Bremse betätigt" UWORD B_TRUE 1 100 0 1 BIT_MASK 0x4000 FORMAT "%13.11" ECU_ADDRESS 0xFD46 /end MEASUREMENT
/begin MEASUREMENT B_crdmtl "DMTL-Sperr-Bedingung aus CRash-Signal" UWORD B_TRUE 1 100 0 1 BIT_MASK 0x2000 FORMAT "%13.11" ECU_ADDRESS 0xFDC2 /end MEASUREMENT
/begin MEASUREMENT B_cwdslt "Bedingung: Freigabe Ventildichtheitsprüfung" UWORD B_TRUE 1 100 0 1 BIT_MASK 0x1 FORMAT "%13.11" ECU_ADDRESS 0x380E6E /end MEASUREMENT
/begin MEASUREMENT B_cwdthm "Bedingung: Diagnose Thermostat Motor-Kühlmittel eingeschaltet" UBYTE B_TRUE 1 100 0 1 BIT_MASK 0x10 FORMAT "%13.11" ECU_ADDRESS 0x380CB7 /end MEASUREMENT
/begin MEASUREMENT B_cwsla "Bedingung: Freigabe der Adaptionsphase/Zusatzdiagnose" UWORD B_TRUE 1 100 0 1 BIT_MASK 0x8000 FORMAT "%13.11" ECU_ADDRESS 0x380E70 /end MEASUREMENT
/begin MEASUREMENT B_dknot "Bedingung DK-Poti-Notfahren aktiv" UWORD B_TRUE 1 100 0 1 BIT_MASK 0x4 FORMAT "%13.11" ECU_ADDRESS 0xFD4E /end MEASUREMENT
/begin MEASUREMENT B_dkp1e "Bedingung Fehler DK-Poti 1" UWORD B_TRUE 1 100 0 1 BIT_MASK 0x8 FORMAT "%13.11" ECU_ADDRESS 0xFD4E /end MEASUREMENT
/begin MEASUREMENT B_dkp1mn "Bedingung Bereichsverletzung DK-Poti 1 nach unten" UWORD B_TRUE 1 100 0 1 BIT_MASK 0x10 FORMAT "%13.11" ECU_ADDRESS 0xFD4E /end MEASUREMENT
/begin MEASUREMENT B_dkp1mx "Bedingung Bereichsverletzung DK-Poti 1 nach oben" UWORD B_TRUE 1 100 0 1 BIT_MASK 0x20 FORMAT "%13.11" ECU_ADDRESS 0xFD4E /end MEASUREMENT
/begin MEASUREMENT B_dkp1np "Bedingung DK-Poti 1 unplausibel zu Ersatzwert aus Füllung" UWORD B_TRUE 1 100 0 1 BIT_MASK 0x40 FORMAT "%13.11" ECU_ADDRESS 0xFD4E /end MEASUREMENT
/begin MEASUREMENT B_dkp2e "Bedingung Fehler DK-Poti 2" UWORD B_TRUE 1 100 0 1 BIT_MASK 0x80 FORMAT "%13.11" ECU_ADDRESS 0xFD4E /end MEASUREMENT
/begin MEASUREMENT B_dkp2mn "Bedingung Bereichsverletzung DK-Poti 2 nach unten" UWORD B_TRUE 1 100 0 1 BIT_MASK 0x100 FORMAT "%13.11" ECU_ADDRESS 0xFD4E /end MEASUREMENT
/begin MEASUREMENT B_dkp2mx "Bedingung Bereichsverletzung DK-Poti 2 nach oben" UWORD B_TRUE 1 100 0 1 BIT_MASK 0x200 FORMAT "%13.11" ECU_ADDRESS 0xFD4E /end MEASUREMENT
/begin MEASUREMENT B_dkp2np "Bedingung DK-Poti 2 unplausibel zu Ersatzwert aus Füllung" UWORD B_TRUE 1 100 0 1 BIT_MASK 0x400 FORMAT "%13.11" ECU_ADDRESS 0xFD4E /end MEASUREMENT
/begin MEASUREMENT B_dkpaw "Bedingung DK-Poti-Auswahl für DK-Sensor-Ersatzbetrieb" UWORD B_TRUE 1 100 0 1 BIT_MASK 0x800 FORMAT "%13.11" ECU_ADDRESS 0xFD4E /end MEASUREMENT
/begin MEASUREMENT B_dkunb "Bedingung: Drosselklappenposition unbekannt" UWORD B_TRUE 1 100 0 1 BIT_MASK 0x1000 FORMAT "%13.11" ECU_ADDRESS 0xFD4E /end MEASUREMENT
/begin MEASUREMENT B_dsl "Bedingung Diagnoseanforderung" UWORD B_TRUE 1 100 0 1 BIT_MASK 0x8000 FORMAT "%13.11" ECU_ADDRESS 0x380E6E /end MEASUREMENT
/begin MEASUREMENT B_dsl1 "Diagnose Phase 1: Bestimmung Sekundärluftmasse" UWORD B_TRUE 1 100 0 1 BIT_MASK 0x20 FORMAT "%13.11" ECU_ADDRESS 0x380E70 /end MEASUREMENT
/begin MEASUREMENT B_dsl1ab "Diagnose Phase 1: Abbruch Phase 1" UWORD B_TRUE 1 100 0 1 BIT_MASK 0x40 FORMAT "%13.11" ECU_ADDRESS 0x380E70 /end MEASUREMENT
/begin MEASUREMENT B_dsl1e "Diagnose Phase 1, Meßfreigabe Sekundärluftmasse" UWORD B_TRUE 1 100 0 1 BIT_MASK 0x80 FORMAT "%13.11" ECU_ADDRESS 0x380E70 /end MEASUREMENT
/begin MEASUREMENT B_dsl2 "Diagnose Phase 2: Ventildichtheit" UWORD B_TRUE 1 100 0 1 BIT_MASK 0x100 FORMAT "%13.11" ECU_ADDRESS 0x380E70 /end MEASUREMENT
/begin MEASUREMENT B_dsl2ab "Diagnose Phase 2: Abbruch Phase 2" UWORD B_TRUE 1 100 0 1 BIT_MASK 0x200 FORMAT "%13.11" ECU_ADDRESS 0x380E70 /end MEASUREMENT
/begin MEASUREMENT B_dsl2e "Diagnose Phase 2: Freigabe Messung" UWORD B_TRUE 1 100 0 1 BIT_MASK 0x400 FORMAT "%13.11" ECU_ADDRESS 0x380E70 /end MEASUREMENT
/begin MEASUREMENT B_dsl3 "Diagnose Phase3: Offset Sekundärluftmasse" UWORD B_TRUE 1 100 0 1 BIT_MASK 0x800 FORMAT "%13.11" ECU_ADDRESS 0x380E70 /end MEASUREMENT
/begin MEASUREMENT B_dsl3ab "Diagnose Phase 3: Abbruch" UWORD B_TRUE 1 100 0 1 BIT_MASK 0x1000 FORMAT "%13.11" ECU_ADDRESS 0x380E70 /end MEASUREMENT
/begin MEASUREMENT B_dsl3e "Diagnose Phase 3: Freigabe Messung" UWORD B_TRUE 1 100 0 1 BIT_MASK 0x2000 FORMAT "%13.11" ECU_ADDRESS 0x380E70 /end MEASUREMENT
/begin MEASUREMENT B_dsl4 "Bedingung Phase 4: Sekundärluftmasse aus Adaption/Zusatzdiagnose" UWORD B_TRUE 1 100 0 1 BIT_MASK 0x1 FORMAT "%13.11" ECU_ADDRESS 0x380E72 /end MEASUREMENT
/begin MEASUREMENT B_dsl4ab "Bedingung: Abbruch Phase 4" UWORD B_TRUE 1 100 0 1 BIT_MASK 0x2 FORMAT "%13.11" ECU_ADDRESS 0x380E72 /end MEASUREMENT
/begin MEASUREMENT B_dsl4e "Bedingung: Phase 4 Freigabe Messung" UWORD B_TRUE 1 100 0 1 BIT_MASK 0x4 FORMAT "%13.11" ECU_ADDRESS 0x380E72 /end MEASUREMENT
/begin MEASUREMENT B_dsl5 "Diagnose Phase 5: Offset Sekundärluftmasse" UWORD B_TRUE 1 100 0 1 BIT_MASK 0x10 FORMAT "%13.11" ECU_ADDRESS 0x380E72 /end MEASUREMENT
/begin MEASUREMENT B_dsl5ab "Diagnose Phase 5: Abbruch" UWORD B_TRUE 1 100 0 1 BIT_MASK 0x20 FORMAT "%13.11" ECU_ADDRESS 0x380E72 /end MEASUREMENT
/begin MEASUREMENT B_dsl5e "Diagnose Phase 5: Freigabe Messung" UWORD B_TRUE 1 100 0 1 BIT_MASK 0x40 FORMAT "%13.11" ECU_ADDRESS 0x380E72 /end MEASUREMENT
/begin MEASUREMENT B_dsla "Adaptionsphase: Bestimmung Sekundärluftmasse" UWORD B_TRUE 1 100 0 1 BIT_MASK 0x40 FORMAT "%13.11" ECU_ADDRESS 0xFD64 /end MEASUREMENT
/begin MEASUREMENT B_dslerr "Zusammenfassung Abbruchmerkmale Sekundärluftdiagnose" UWORD B_TRUE 1 100 0 1 BIT_MASK 0x8 FORMAT "%13.11" ECU_ADDRESS 0x380E6E /end MEASUREMENT
/begin MEASUREMENT B_dslfa "Bedingung: Anforderung SL-System für Kurztest" UWORD B_TRUE 1 100 0 1 BIT_MASK 0x80 FORMAT "%13.11" ECU_ADDRESS 0xFD64 /end MEASUREMENT
/begin MEASUREMENT B_dslm "Diagnose Sekundärluftmasse" UWORD B_TRUE 1 100 0 1 BIT_MASK 0x10 FORMAT "%13.11" ECU_ADDRESS 0x380E6E /end MEASUREMENT
/begin MEASUREMENT B_dslmab "Diagnose Sekundärluftmasse, Meßabbruch" UWORD B_TRUE 1 100 0 1 BIT_MASK 0x20 FORMAT "%13.11" ECU_ADDRESS 0x380E6E /end MEASUREMENT
/begin MEASUREMENT B_dslme "Diagnose Sekundärluftmasse, Meßfreigabe" UWORD B_TRUE 1 100 0 1 BIT_MASK 0x40 FORMAT "%13.11" ECU_ADDRESS 0x380E6E /end MEASUREMENT
/begin MEASUREMENT B_dslmes "Bedingung: Freigabe Meßfenster" UWORD B_TRUE 1 100 0 1 BIT_MASK 0x80 FORMAT "%13.11" ECU_ADDRESS 0x380E6E /end MEASUREMENT
/begin MEASUREMENT B_dslo "Diagnose Sekundärluftmassenoffset" UWORD B_TRUE 1 100 0 1 BIT_MASK 0x100 FORMAT "%13.11" ECU_ADDRESS 0x380E6E /end MEASUREMENT
/begin MEASUREMENT B_dsloab "Diagnose Sekundärluftoffset, Meßabbruch" UWORD B_TRUE 1 100 0 1 BIT_MASK 0x200 FORMAT "%13.11" ECU_ADDRESS 0x380E6E /end MEASUREMENT
/begin MEASUREMENT B_dsloe "Diagnose Sekundärluftoffset, Meßfreigabe" UWORD B_TRUE 1 100 0 1 BIT_MASK 0x400 FORMAT "%13.11" ECU_ADDRESS 0x380E6E /end MEASUREMENT
/begin MEASUREMENT B_dsls "Aktive Diagnose: Sekundärluft-System" UWORD B_TRUE 1 100 0 1 BIT_MASK 0x20 FORMAT "%13.11" ECU_ADDRESS 0xFD42 /end MEASUREMENT
/begin MEASUREMENT B_dslsp4 "Bedingung: Anforderung SL-System für Sekundärluftadaption/Zusatzdiagnose" UWORD B_TRUE 1 100 0 1 BIT_MASK 0x100 FORMAT "%13.11" ECU_ADDRESS 0xFD64 /end MEASUREMENT
/begin MEASUREMENT B_dslt "Diagnose Dichtheit Sekundärluftventi" UWORD B_TRUE 1 100 0 1 BIT_MASK 0x800 FORMAT "%13.11" ECU_ADDRESS 0x380E6E /end MEASUREMENT
/begin MEASUREMENT B_dsltab "Diagnose Ventilichtheit, Meßabbruch" UWORD B_TRUE 1 100 0 1 BIT_MASK 0x1 FORMAT "%13.11" ECU_ADDRESS 0x380E70 /end MEASUREMENT
/begin MEASUREMENT B_dslte "Diagnose Ventildichtheit, Meßfreigabe" UWORD B_TRUE 1 100 0 1 BIT_MASK 0x2 FORMAT "%13.11" ECU_ADDRESS 0x380E70 /end MEASUREMENT
/begin MEASUREMENT B_dspe "Bedingung Diagnose Sekundärluft ein" UWORD B_TRUE 1 100 0 1 BIT_MASK 0x200 FORMAT "%13.11" ECU_ADDRESS 0xFD64 /end MEASUREMENT
/begin MEASUREMENT B_dsper "Bedingung Rücksetzen ESP ein" UWORD B_TRUE 1 100 0 1 BIT_MASK 0x4 FORMAT "%13.11" ECU_ADDRESS 0x380E70 /end MEASUREMENT
/begin MEASUREMENT B_dspes "Bedingung Setzen ESP ein" UWORD B_TRUE 1 100 0 1 BIT_MASK 0x8 FORMAT "%13.11" ECU_ADDRESS 0x380E70 /end MEASUREMENT
/begin MEASUREMENT B_dteaa "Bedingung Aufsteuerprüfung für TEV Diagnose aktiv" UWORD B_TRUE 1 100 0 1 BIT_MASK 0x8000 FORMAT "%13.11" ECU_ADDRESS 0xFD4C /end MEASUREMENT
/begin MEASUREMENT B_dteabr "Abbruch der TE-Diagnose durch Störeinflüsse (Beschreibungsvariable)" UBYTE B_TRUE 1 100 0 1 BIT_MASK 0x1 FORMAT "%13.11" ECU_ADDRESS 0x380D60 /end MEASUREMENT
/begin MEASUREMENT B_dtean "Abbruch TE-Diagnose wegen Änderung der Solldrehzahl" UBYTE B_TRUE 1 100 0 1 BIT_MASK 0x2 FORMAT "%13.11" ECU_ADDRESS 0x380D60 /end MEASUREMENT
/begin MEASUREMENT B_dteaq "Abbruch TE-Diagnose wegen Änderung der Vorsteuerluft" UBYTE B_TRUE 1 100 0 1 BIT_MASK 0x4 FORMAT "%13.11" ECU_ADDRESS 0x380D60 /end MEASUREMENT
/begin MEASUREMENT B_dtebel "Eingangsbedingungen der Beladungsprüfung erfüllt" UBYTE B_TRUE 1 100 0 1 BIT_MASK 0x8 FORMAT "%13.11" ECU_ADDRESS 0x380D60 /end MEASUREMENT
/begin MEASUREMENT B_dtebn "Beginn der Drehzahlprüfung" UWORD B_TRUE 1 100 0 1 BIT_MASK 0x8000 FORMAT "%13.11" ECU_ADDRESS 0xFDC8 /end MEASUREMENT
/begin MEASUREMENT B_dtei "Steuerbit für Integrator bei Tankentlüftungsdiagnose" UWORD B_TRUE 1 100 0 1 BIT_MASK 0x1 FORMAT "%13.11" ECU_ADDRESS 0xFDCA /end MEASUREMENT
/begin MEASUREMENT B_dtes "Aktive Diagnose: Tankentlüftungssystem" UWORD B_TRUE 1 100 0 1 BIT_MASK 0x1 FORMAT "%13.11" ECU_ADDRESS 0xFD4E /end MEASUREMENT
/begin MEASUREMENT B_dtesq "Abbruch der TE-Diagnose wegen Störungen der Solluft" UBYTE B_TRUE 1 100 0 1 BIT_MASK 0x10 FORMAT "%13.11" ECU_ADDRESS 0x380D60 /end MEASUREMENT
/begin MEASUREMENT B_dtest "Start für TEV-Ansteuerung" UWORD B_TRUE 1 100 0 1 BIT_MASK 0x2 FORMAT "%13.11" ECU_ADDRESS 0xFD4E /end MEASUREMENT
/begin MEASUREMENT B_dtevio "Bedingung TEV i.O. (Beschreibungsvariable)" UBYTE B_TRUE 1 100 0 1 BIT_MASK 0x20 FORMAT "%13.11" ECU_ADDRESS 0x380D60 /end MEASUREMENT
/begin MEASUREMENT B_ebl "Bedingung Ansteuerung E-Box Lüfter" UWORD B_TRUE 1 100 0 1 BIT_MASK 0x8000 FORMAT "%13.11" ECU_ADDRESS 0xFD9C /end MEASUREMENT
/begin MEASUREMENT B_edsl "Bedingung Error Ladedrucksensor" UWORD B_TRUE 1 100 0 1 BIT_MASK 0x400 FORMAT "%13.11" ECU_ADDRESS 0xFD90 /end MEASUREMENT
/begin MEASUREMENT B_edsuu "Bedingung Error Umgebungsdrucksensor nicht zeitentprellt" UBYTE B_TRUE 1 100 0 1 BIT_MASK 0x1 FORMAT "%13.11" ECU_ADDRESS 0x38310E /end MEASUREMENT
/begin MEASUREMENT B_eepdif "Plausibilitätsprüfung EEPROM und FLASH-Daten" UWORD B_TRUE 1 100 0 1 BIT_MASK 0x40 FORMAT "%13.11" ECU_ADDRESS 0xFDC2 /end MEASUREMENT
/begin MEASUREMENT B_enable1 "" UWORD B_TRUE 1 100 0 1 BIT_MASK 0x80 FORMAT "%13.11" ECU_ADDRESS 0xFDC2 /end MEASUREMENT
/begin MEASUREMENT B_enws "Bedingung Fehler Nockenwellenansteuerung liegt vor" UWORD B_TRUE 1 100 0 1 BIT_MASK 0x2000 FORMAT "%13.11" ECU_ADDRESS 0xFD22 /end MEASUREMENT
/begin MEASUREMENT B_erbr "Bedingung Bremsschaltersignale unplausibel" UWORD B_TRUE 1 100 0 1 BIT_MASK 0x2000 FORMAT "%13.11" ECU_ADDRESS 0xFD88 /end MEASUREMENT
/begin MEASUREMENT B_errofs "Bedingung: zulässige Sekundärluftmassen-Offset überschritten" UWORD B_TRUE 1 100 0 1 BIT_MASK 0x10 FORMAT "%13.11" ECU_ADDRESS 0x380E70 /end MEASUREMENT
/begin MEASUREMENT B_errofs2 "Bedingung: max. zulässiger Offsetwert überschritten, Bank 2" UWORD B_TRUE 1 100 0 1 BIT_MASK 0x1000 FORMAT "%13.11" ECU_ADDRESS 0x380E6E /end MEASUREMENT
/begin MEASUREMENT B_esls "Bedingung Falschluft durch Fehler im Sekundärluftsystem" UWORD B_TRUE 1 100 0 1 BIT_MASK 0x40 FORMAT "%13.11" ECU_ADDRESS 0xFD42 /end MEASUREMENT
/begin MEASUREMENT B_esnws "Bedingung Gemischfaktor bei Nockenwellenverstellung" UWORD B_TRUE 1 100 0 1 BIT_MASK 0x200 FORMAT "%13.11" ECU_ADDRESS 0xFD96 /end MEASUREMENT
/begin MEASUREMENT B_ethmr "Bedingung Thermostatfehler im RS-Flip-Flop gespeichert" UBYTE B_TRUE 1 100 0 1 BIT_MASK 0x4 FORMAT "%13.11" ECU_ADDRESS 0x380CB7 /end MEASUREMENT
/begin MEASUREMENT B_ethms "Bedingung Thermostatfehler erkannt und Auslösen des Zyklusflags" UBYTE B_TRUE 1 100 0 1 BIT_MASK 0x2 FORMAT "%13.11" ECU_ADDRESS 0x380CB7 /end MEASUREMENT
/begin MEASUREMENT B_etr "Bedingung elektrische Thermostatregelung" UWORD B_TRUE 1 100 0 1 BIT_MASK 0x2 FORMAT "%13.11" ECU_ADDRESS 0xFD8E /end MEASUREMENT
/begin MEASUREMENT B_etrtam "Umschaltung elektr. Thermostatregelung auf Festwert bei niedrigem tans" UWORD B_TRUE 1 100 0 1 BIT_MASK 0x4 FORMAT "%13.11" ECU_ADDRESS 0xFD8E /end MEASUREMENT
/begin MEASUREMENT B_etrvfzg "Bedingung elektr. Thermostatregelung bzgl. VFZG" UWORD B_TRUE 1 100 0 1 BIT_MASK 0x8 FORMAT "%13.11" ECU_ADDRESS 0xFD8E /end MEASUREMENT
/begin MEASUREMENT B_ez "Verbot des gesamten Motorlaufs (MOTRONIC bleibt in Zahnentprellphase" UBYTE B_TRUE 1 100 0 1 BIT_MASK 0x1 FORMAT "%13.11" ECU_ADDRESS 0x383130 /end MEASUREMENT
/begin MEASUREMENT B_fgrakt "Bedingung FGR-Regler aktiv" UWORD B_TRUE 1 100 0 1 BIT_MASK 0x4 FORMAT "%13.11" ECU_ADDRESS 0x382102 /end MEASUREMENT
/begin MEASUREMENT B_fgrari "Bedingung FGR-Abschaltrampe Initialisierung" UWORD B_TRUE 1 100 0 1 BIT_MASK 0x1000 FORMAT "%13.11" ECU_ADDRESS 0xFD8A /end MEASUREMENT
/begin MEASUREMENT B_fgrdvi "Bedingung FGR-Regler Initialisierung der gespeicherten Regelabweichung" UWORD B_TRUE 1 100 0 1 BIT_MASK 0x8 FORMAT "%13.11" ECU_ADDRESS 0x382102 /end MEASUREMENT
/begin MEASUREMENT B_fgren "Bedingung Fahrgeschwindigkeitsregelung aktiv (Enable)" UWORD B_TRUE 1 100 0 1 BIT_MASK 0x2 FORMAT "%13.11" ECU_ADDRESS 0xFD42 /end MEASUREMENT
/begin MEASUREMENT B_fgrene "Bedingung FGR-Regelung aktiv (Enable) erweitert" UWORD B_TRUE 1 100 0 1 BIT_MASK 0x4 FORMAT "%13.11" ECU_ADDRESS 0xFD90 /end MEASUREMENT
/begin MEASUREMENT B_fgrkf "Bedingung: FGR im Zustand Konstantfahrt" UWORD B_TRUE 1 100 0 1 BIT_MASK 0x40 FORMAT "%13.11" ECU_ADDRESS 0xFD90 /end MEASUREMENT
/begin MEASUREMENT B_fgrkfm "Bedingung: FGR im Zustand Konstantfahrt (aus ME)" UWORD B_TRUE 1 100 0 1 BIT_MASK 0x8 FORMAT "%13.11" ECU_ADDRESS 0xFD90 /end MEASUREMENT
/begin MEASUREMENT B_fgrra "Bedingung FGR-Rampe" UWORD B_TRUE 1 100 0 1 BIT_MASK 0x10 FORMAT "%13.11" ECU_ADDRESS 0x382102 /end MEASUREMENT
/begin MEASUREMENT B_fgrvem "Bedingung: FGR im Zustand Verzögern (aus ME)" UWORD B_TRUE 1 100 0 1 BIT_MASK 0x10 FORMAT "%13.11" ECU_ADDRESS 0xFD90 /end MEASUREMENT
/begin MEASUREMENT B_fgrver "Bedingung: FGR im Zustand Verzögern" UWORD B_TRUE 1 100 0 1 BIT_MASK 0x80 FORMAT "%13.11" ECU_ADDRESS 0xFD90 /end MEASUREMENT
/begin MEASUREMENT B_fofstp "Bedingung fuel-off Adaption gestoppt" UWORD B_TRUE 1 100 0 1 BIT_MASK 0x40 FORMAT "%13.11" ECU_ADDRESS 0xFDDE /end MEASUREMENT
/begin MEASUREMENT B_fonstp "Bedingung fuel-on Adaption gestoppt" UWORD B_TRUE 1 100 0 1 BIT_MASK 0x80 FORMAT "%13.11" ECU_ADDRESS 0xFDDE /end MEASUREMENT
/begin MEASUREMENT B_ftv2_er "" UWORD B_TRUE 1 100 0 1 BIT_MASK 0x80 FORMAT "%13.11" ECU_ADDRESS 0xFD40 /end MEASUREMENT
/begin MEASUREMENT B_ftv_er "" UWORD B_TRUE 1 100 0 1 BIT_MASK 0x100 FORMAT "%13.11" ECU_ADDRESS 0xFD40 /end MEASUREMENT
/begin MEASUREMENT B_hag "Bedingung Höhenadaption gültig" UWORD B_TRUE 1 100 0 1 BIT_MASK 0x800 FORMAT "%13.11" ECU_ADDRESS 0xFD90 /end MEASUREMENT
/begin MEASUREMENT B_hst "Bedingung Heißstart" UBYTE B_TRUE 1 100 0 1 BIT_MASK 0x1 FORMAT "%13.11" ECU_ADDRESS 0x38311F /end MEASUREMENT
/begin MEASUREMENT B_kfnb "Bedingung Konstantfahrt nach Beschleunigen" UWORD B_TRUE 1 100 0 1 BIT_MASK 0x20 FORMAT "%13.11" ECU_ADDRESS 0x382102 /end MEASUREMENT
/begin MEASUREMENT B_kfnv "Bedingung Konstantfahrt nach Verzögern" UWORD B_TRUE 1 100 0 1 BIT_MASK 0x40 FORMAT "%13.11" ECU_ADDRESS 0x382102 /end MEASUREMENT
/begin MEASUREMENT B_kmmil "MIL-Ansteuerung mit Relevanz zu Kilometererfassung" UWORD B_TRUE 1 100 0 1 BIT_MASK 0x4000 FORMAT "%13.11" ECU_ADDRESS 0xFD72 /end MEASUREMENT
/begin MEASUREMENT B_kse "Bedingung Anfettung bei Klopfschutz" UWORD B_TRUE 1 100 0 1 BIT_MASK 0x80 FORMAT "%13.11" ECU_ADDRESS 0xFD96 /end MEASUREMENT
/begin MEASUREMENT B_kuppl "Bedingung Kupplungspedal betätigt" UWORD B_TRUE 1 100 0 1 BIT_MASK 0x8000 FORMAT "%13.11" ECU_ADDRESS 0xFD46 /end MEASUREMENT
/begin MEASUREMENT B_kupplv "Bedingung Kupplung betätigt verzögert" UWORD B_TRUE 1 100 0 1 BIT_MASK 0x4000 FORMAT "%13.11" ECU_ADDRESS 0xFD88 /end MEASUREMENT
/begin MEASUREMENT B_lamnse "Bedingung Ende lamns_w-Berechnung" UWORD B_TRUE 1 100 0 1 BIT_MASK 0x100 FORMAT "%13.11" ECU_ADDRESS 0xFD96 /end MEASUREMENT
/begin MEASUREMENT B_ldrugd "Bedingung ungedrosselt, Freigabe durch LDR" UWORD B_TRUE 1 100 0 1 BIT_MASK 0x2 FORMAT "%13.11" ECU_ADDRESS 0xFD24 /end MEASUREMENT
/begin MEASUREMENT B_luena "Bedingung LU-Berechnung erlaubt (ohne Verzugszeit)" UWORD B_TRUE 1 100 0 1 BIT_MASK 0x2 FORMAT "%13.11" ECU_ADDRESS 0xFDDC /end MEASUREMENT
/begin MEASUREMENT B_lustop "Laufunruhe-Berechnung gesperrt" UWORD B_TRUE 1 100 0 1 BIT_MASK 0x2000 FORMAT "%13.11" ECU_ADDRESS 0xFDDE /end MEASUREMENT
/begin MEASUREMENT B_lustopu "Laufunruhe-Berechnung gesperrt, unverzögert" UWORD B_TRUE 1 100 0 1 BIT_MASK 0x4 FORMAT "%13.11" ECU_ADDRESS 0xFDDC /end MEASUREMENT
/begin MEASUREMENT B_mdarv "kritische Aussetzerrate vorhanden" UWORD B_TRUE 1 100 0 1 BIT_MASK 0x40 FORMAT "%13.11" ECU_ADDRESS 0xFD72 /end MEASUREMENT
/begin MEASUREMENT B_mddrla "Bedingung Misfire Detection Lastgradient für Aussetzererkennung" UWORD B_TRUE 1 100 0 1 BIT_MASK 0x20 FORMAT "%13.11" ECU_ADDRESS 0xFDE0 /end MEASUREMENT
/begin MEASUREMENT B_mdkat "Katschädigende Aussetzerrate überschritten (zur Ausblendung anderer Funktionen)" UWORD B_TRUE 1 100 0 1 BIT_MASK 0x80 FORMAT "%13.11" ECU_ADDRESS 0xFD72 /end MEASUREMENT
/begin MEASUREMENT B_mdng "Bedingung Misfire Detection Drehzahlgradient für Aussetzererkennung" UWORD B_TRUE 1 100 0 1 BIT_MASK 0x2 FORMAT "%13.11" ECU_ADDRESS 0xFDE0 /end MEASUREMENT
/begin MEASUREMENT B_mdnmot "Bedingung Misfire Detection obere und untere Drehzahlgrenze" UWORD B_TRUE 1 100 0 1 BIT_MASK 0x4 FORMAT "%13.11" ECU_ADDRESS 0xFDE0 /end MEASUREMENT
/begin MEASUREMENT B_mdrl "Bedingung Misfire Detection untere Lastgrenze" UWORD B_TRUE 1 100 0 1 BIT_MASK 0x8 FORMAT "%13.11" ECU_ADDRESS 0xFDE0 /end MEASUREMENT
/begin MEASUREMENT B_mdstop_m "Monitor, Misfire Detection gesperrt" UBYTE B_TRUE 1 100 0 1 BIT_MASK 0x80 FORMAT "%13.11" ECU_ADDRESS 0xE3E6 /end MEASUREMENT
/begin MEASUREMENT B_mdtnst "Bedingung Misfire Detection Zeit nach Startende" UWORD B_TRUE 1 100 0 1 BIT_MASK 0x10 FORMAT "%13.11" ECU_ADDRESS 0xFDE0 /end MEASUREMENT
/begin MEASUREMENT B_mil "MIL-Ansteuerung" UWORD B_TRUE 1 100 0 1 BIT_MASK 0x8000 FORMAT "%13.11" ECU_ADDRESS 0xFD72 /end MEASUREMENT
/begin MEASUREMENT B_milblk "MIL-Ansteuerung blinkend" UBYTE B_TRUE 1 100 0 1 BIT_MASK 0x8 FORMAT "%13.11" ECU_ADDRESS 0x380AFE /end MEASUREMENT
/begin MEASUREMENT B_mileb "MIL-Ansteuerung eigenbestimmt" UBYTE B_TRUE 1 100 0 1 BIT_MASK 0x2 FORMAT "%13.11" ECU_ADDRESS 0x380AFE /end MEASUREMENT
/begin MEASUREMENT B_milmd "MIL-Ansteuerung an durch Aussetzererkennung, bei ti-Abschaltung" UWORD B_TRUE 1 100 0 1 BIT_MASK 0x100 FORMAT "%13.11" ECU_ADDRESS 0xFD72 /end MEASUREMENT
/begin MEASUREMENT B_milst "MIL-Ansteuerung Prueffunktion bei Start" UBYTE B_TRUE 1 100 0 1 BIT_MASK 0x1 FORMAT "%13.11" ECU_ADDRESS 0x380AFE /end MEASUREMENT
/begin MEASUREMENT B_mslmin "Bedingung sehr geringe Sekundärluftmasse aus Meßphase" UWORD B_TRUE 1 100 0 1 BIT_MASK 0x2 FORMAT "%13.11" ECU_ADDRESS 0x380E6E /end MEASUREMENT
/begin MEASUREMENT B_mslmin2 "Bedingung sehr geringe Sekundärluftmasse aus Meßphase (Bank 2)" UWORD B_TRUE 1 100 0 1 BIT_MASK 0x4 FORMAT "%13.11" ECU_ADDRESS 0x380E6E /end MEASUREMENT
/begin MEASUREMENT B_mslmn "Bedingung zu wenig Sekundärluftmasse" UWORD B_TRUE 1 100 0 1 BIT_MASK 0x400 FORMAT "%13.11" ECU_ADDRESS 0xFD64 /end MEASUREMENT
/begin MEASUREMENT B_mslofs "Bedingung Einrechnung Sekundärluftmassenoffset" UWORD B_TRUE 1 100 0 1 BIT_MASK 0x800 FORMAT "%13.11" ECU_ADDRESS 0x380E72 /end MEASUREMENT
/begin MEASUREMENT B_mslofs2 "Bedingung Einrechnung Sekundärluftmassenoffset, Bank 2" UWORD B_TRUE 1 100 0 1 BIT_MASK 0x1000 FORMAT "%13.11" ECU_ADDRESS 0x380E72 /end MEASUREMENT
/begin MEASUREMENT B_mslpmn "Fehlerbedingung: keine Sekundärluftpumpe, nur Pulse Air" UWORD B_TRUE 1 100 0 1 BIT_MASK 0x800 FORMAT "%13.11" ECU_ADDRESS 0xFD64 /end MEASUREMENT
/begin MEASUREMENT B_mslpmn2 "Fehlerbedingung: keine Sekundärluftpumpe, nur Pulse Air, Bank 2" UWORD B_TRUE 1 100 0 1 BIT_MASK 0x1000 FORMAT "%13.11" ECU_ADDRESS 0xFD64 /end MEASUREMENT
/begin MEASUREMENT B_NWS "Bedingung Nockenwellensteuerung" UWORD B_TRUE 1 100 0 1 BIT_MASK 0x4000 FORMAT "%13.11" ECU_ADDRESS 0xFD00 /end MEASUREMENT
/begin MEASUREMENT B_phas2 "Bedingung Phase 2 low/high" UWORD B_TRUE 1 100 0 1 BIT_MASK 0x80 FORMAT "%13.11" ECU_ADDRESS 0xFD20 /end MEASUREMENT
/begin MEASUREMENT B_phase "Bedingung Phase low/high" UWORD B_TRUE 1 100 0 1 BIT_MASK 0x100 FORMAT "%13.11" ECU_ADDRESS 0xFD20 /end MEASUREMENT
/begin MEASUREMENT B_phsok "Bedingung Phasensignal ok" UWORD B_TRUE 1 100 0 1 BIT_MASK 0x800 FORMAT "%13.11" ECU_ADDRESS 0xFD74 /end MEASUREMENT
/begin MEASUREMENT B_phsok2 "Bedingung Phasensignal 2 ok" UWORD B_TRUE 1 100 0 1 BIT_MASK 0x1000 FORMAT "%13.11" ECU_ADDRESS 0xFD74 /end MEASUREMENT
/begin MEASUREMENT B_redkl "Freigabe Reduzierung ÜK-K- und -L-Anteil" UWORD B_TRUE 1 100 0 1 BIT_MASK 0x1 FORMAT "%13.11" ECU_ADDRESS 0xFD2C /end MEASUREMENT
/begin MEASUREMENT B_resta "NBM-Retrigger mit B_estart" UBYTE B_TRUE 1 100 0 1 BIT_MASK 0x1 FORMAT "%13.11" ECU_ADDRESS 0x380D78 /end MEASUREMENT
/begin MEASUREMENT B_retime "Retrigger NBM-Signal über Zeit-Delta zwischen 2NBM-Flanken" UBYTE B_TRUE 1 100 0 1 BIT_MASK 0x2 FORMAT "%13.11" ECU_ADDRESS 0x380D78 /end MEASUREMENT
/begin MEASUREMENT B_rlvugd "Bedingung: Füllung nicht im für DK-Poti-Plausibilisierung geeigneten Bereich" UWORD B_TRUE 1 100 0 1 BIT_MASK 0x2000 FORMAT "%13.11" ECU_ADDRESS 0xFD4E /end MEASUREMENT
/begin MEASUREMENT B_savfgr "Bedingung: Schubabschalteverbot durch FGR" UWORD B_TRUE 1 100 0 1 BIT_MASK 0x4 FORMAT "%13.11" ECU_ADDRESS 0xFD42 /end MEASUREMENT
/begin MEASUREMENT B_savm "Bedingung: Schubabschalteverbot durch FGR (aus ME)" UWORD B_TRUE 1 100 0 1 BIT_MASK 0x20 FORMAT "%13.11" ECU_ADDRESS 0xFD90 /end MEASUREMENT
/begin MEASUREMENT B_sla "Anforderung Sekundärluftadaptionsphase" UWORD B_TRUE 1 100 0 1 BIT_MASK 0x2000 FORMAT "%13.11" ECU_ADDRESS 0xFD64 /end MEASUREMENT
/begin MEASUREMENT B_slar "Anforderung Sekundärluftadaptionsphase zurücksetzen" UWORD B_TRUE 1 100 0 1 BIT_MASK 0x100 FORMAT "%13.11" ECU_ADDRESS 0x380E72 /end MEASUREMENT
/begin MEASUREMENT B_slas "Anforderung Sekundärluftadaptionsphase setzen" UWORD B_TRUE 1 100 0 1 BIT_MASK 0x80 FORMAT "%13.11" ECU_ADDRESS 0x380E72 /end MEASUREMENT
/begin MEASUREMENT B_sp1 "FLC-Trigger der Aussetzererkennung" UBYTE B_TRUE 1 100 0 1 BIT_MASK 0x1 FORMAT "%13.11" ECU_ADDRESS 0x380B6B /end MEASUREMENT
/begin MEASUREMENT B_sp2 "HLC-Trigger der Aussetzererkennung" UBYTE B_TRUE 1 100 0 1 BIT_MASK 0x1 FORMAT "%13.11" ECU_ADDRESS 0x380B6C /end MEASUREMENT
/begin MEASUREMENT B_staebr "Bedingung Steckerabfall-Erkennung Bremse" UWORD B_TRUE 1 100 0 1 BIT_MASK 0x8000 FORMAT "%13.11" ECU_ADDRESS 0xFD88 /end MEASUREMENT
/begin MEASUREMENT B_stv2_er "" UWORD B_TRUE 1 100 0 1 BIT_MASK 0x200 FORMAT "%13.11" ECU_ADDRESS 0xFD40 /end MEASUREMENT
/begin MEASUREMENT B_stv_er "" UWORD B_TRUE 1 100 0 1 BIT_MASK 0x400 FORMAT "%13.11" ECU_ADDRESS 0xFD40 /end MEASUREMENT
/begin MEASUREMENT B_swe "Bedingung Schlechtwegstrecke erkannt" UWORD B_TRUE 1 100 0 1 BIT_MASK 0x100 FORMAT "%13.11" ECU_ADDRESS 0xFDC8 /end MEASUREMENT
/begin MEASUREMENT B_swev "Bedingung Schlechtwegstrecke im Verdacht" UWORD B_TRUE 1 100 0 1 BIT_MASK 0x200 FORMAT "%13.11" ECU_ADDRESS 0xFDC8 /end MEASUREMENT
/begin MEASUREMENT B_swknb "Bedingung Setzwertkorrektur nach Beschleunigen" UWORD B_TRUE 1 100 0 1 BIT_MASK 0x80 FORMAT "%13.11" ECU_ADDRESS 0x382102 /end MEASUREMENT
/begin MEASUREMENT B_swknv "Bedingung Setzwertkorrektur nach Verzögern" UWORD B_TRUE 1 100 0 1 BIT_MASK 0x100 FORMAT "%13.11" ECU_ADDRESS 0x382102 /end MEASUREMENT
/begin MEASUREMENT B_szsls "Bedingung Diagnose Sekundärluftsystem durchgeführt, Summe" UWORD B_TRUE 1 100 0 1 BIT_MASK 0x2000 FORMAT "%13.11" ECU_ADDRESS 0x380E6E /end MEASUREMENT
/begin MEASUREMENT B_tankd "Ansteuerung Lampe Check-Filler-Cap" UWORD B_TRUE 1 100 0 1 BIT_MASK 0x4000 FORMAT "%13.11" ECU_ADDRESS 0xFDC2 /end MEASUREMENT
/begin MEASUREMENT B_tbenh "Bedingung Taste Beschleunigen negative Flanke nach Halten" UWORD B_TRUE 1 100 0 1 BIT_MASK 0x200 FORMAT "%13.11" ECU_ADDRESS 0x382102 /end MEASUREMENT
/begin MEASUREMENT B_tbent "Bedingung Taste Beschleunigen negative Flanke nach Tip" UWORD B_TRUE 1 100 0 1 BIT_MASK 0x400 FORMAT "%13.11" ECU_ADDRESS 0x382102 /end MEASUREMENT
/begin MEASUREMENT B_tbep "Bedingung Taste Beschleunigen positive Flanke" UWORD B_TRUE 1 100 0 1 BIT_MASK 0x800 FORMAT "%13.11" ECU_ADDRESS 0x382102 /end MEASUREMENT
/begin MEASUREMENT B_tbeph "Bedingung Taste Beschleunigen positive Flanke Halten" UWORD B_TRUE 1 100 0 1 BIT_MASK 0x1000 FORMAT "%13.11" ECU_ADDRESS 0x382102 /end MEASUREMENT
/begin MEASUREMENT B_tiab1 "ti-Abschaltung bei kat.schädigenden Aussetzerraten, Zyl/Zündung 1" UBYTE B_TRUE 1 100 0 1 BIT_MASK 0x1 FORMAT "%13.11" ECU_ADDRESS 0x380A4A /end MEASUREMENT
/begin MEASUREMENT B_tiab2 "ti-Abschaltung bei kat.schädigenden Aussetzerraten, Zyl/Zündung 2" UBYTE B_TRUE 1 100 0 1 BIT_MASK 0x2 FORMAT "%13.11" ECU_ADDRESS 0x380A4A /end MEASUREMENT
/begin MEASUREMENT B_tiab3 "ti-Abschaltung bei kat.schädigenden Aussetzerraten, Zyl/Zündung 3" UBYTE B_TRUE 1 100 0 1 BIT_MASK 0x4 FORMAT "%13.11" ECU_ADDRESS 0x380A4A /end MEASUREMENT
/begin MEASUREMENT B_tiab4 "ti-Abschaltung bei kat.schädigenden Aussetzerraten, Zyl/Zündung 4" UBYTE B_TRUE 1 100 0 1 BIT_MASK 0x8 FORMAT "%13.11" ECU_ADDRESS 0x380A4A /end MEASUREMENT
/begin MEASUREMENT B_tiab5 "ti-Abschaltung bei kat.schädigenden Aussetzerraten, Zyl/Zündung 5" UBYTE B_TRUE 1 100 0 1 BIT_MASK 0x10 FORMAT "%13.11" ECU_ADDRESS 0x380A4A /end MEASUREMENT
/begin MEASUREMENT B_tiab6 "ti-Abschaltung bei kat.schädigenden Aussetzerraten, Zyl/Zündung6" UBYTE B_TRUE 1 100 0 1 BIT_MASK 0x20 FORMAT "%13.11" ECU_ADDRESS 0x380A4A /end MEASUREMENT
/begin MEASUREMENT B_tiab7 "ti-Abschaltung bei kat.schädigenden Aussetzerraten, Zyl/Zündung 7" UBYTE B_TRUE 1 100 0 1 BIT_MASK 0x40 FORMAT "%13.11" ECU_ADDRESS 0x380A4A /end MEASUREMENT
/begin MEASUREMENT B_tiab8 "ti-Abschaltung bei kat.schädigenden Aussetzerraten, Zyl/Zündung 8" UBYTE B_TRUE 1 100 0 1 BIT_MASK 0x80 FORMAT "%13.11" ECU_ADDRESS 0x380A4A /end MEASUREMENT
/begin MEASUREMENT B_tpderl "Bedingung Tip-Down erlaubt" UWORD B_TRUE 1 100 0 1 BIT_MASK 0x2000 FORMAT "%13.11" ECU_ADDRESS 0x382102 /end MEASUREMENT
/begin MEASUREMENT B_tpdn "Bedingung FGR im Zustand Tip-Down" UWORD B_TRUE 1 100 0 1 BIT_MASK 0x4000 FORMAT "%13.11" ECU_ADDRESS 0x382102 /end MEASUREMENT
/begin MEASUREMENT B_tpuerl "Bedingung Tip-Up erlaubt" UWORD B_TRUE 1 100 0 1 BIT_MASK 0x8000 FORMAT "%13.11" ECU_ADDRESS 0x382102 /end MEASUREMENT
/begin MEASUREMENT B_tpup "Bedingung FGR im Zustand Tip-Up" UWORD B_TRUE 1 100 0 1 BIT_MASK 0x1 FORMAT "%13.11" ECU_ADDRESS 0x382104 /end MEASUREMENT
/begin MEASUREMENT B_tsenh "Bedingung Taste Setzen negative Flanke nach Halten" UWORD B_TRUE 1 100 0 1 BIT_MASK 0x2 FORMAT "%13.11" ECU_ADDRESS 0x382104 /end MEASUREMENT
/begin MEASUREMENT B_tsent "Bedingung Taste setzen negative Flanke nach Tip" UWORD B_TRUE 1 100 0 1 BIT_MASK 0x4 FORMAT "%13.11" ECU_ADDRESS 0x382104 /end MEASUREMENT
/begin MEASUREMENT B_tsroov "Bedingung Segmentzeit-Wordoverflow" UWORD B_TRUE 1 100 0 1 BIT_MASK 0x8 FORMAT "%13.11" ECU_ADDRESS 0xFDD4 /end MEASUREMENT
/begin MEASUREMENT B_tvenh "Bedingung Taste Verzögern negative Flanke nach Halten" UWORD B_TRUE 1 100 0 1 BIT_MASK 0x8 FORMAT "%13.11" ECU_ADDRESS 0x382104 /end MEASUREMENT
/begin MEASUREMENT B_tvent "Bedingung Taste Verzögern negative Flanke nach Tip" UWORD B_TRUE 1 100 0 1 BIT_MASK 0x10 FORMAT "%13.11" ECU_ADDRESS 0x382104 /end MEASUREMENT
/begin MEASUREMENT B_tvep "Bedingung Taste Verzögern positive Flanke" UWORD B_TRUE 1 100 0 1 BIT_MASK 0x20 FORMAT "%13.11" ECU_ADDRESS 0x382104 /end MEASUREMENT
/begin MEASUREMENT B_tveph "Bedingung Taste Verzögern positive Flanke Halten" UWORD B_TRUE 1 100 0 1 BIT_MASK 0x40 FORMAT "%13.11" ECU_ADDRESS 0x382104 /end MEASUREMENT
/begin MEASUREMENT B_twap "Bedingung Taste Wiederaufnahme positive Fanke" UWORD B_TRUE 1 100 0 1 BIT_MASK 0x80 FORMAT "%13.11" ECU_ADDRESS 0x382104 /end MEASUREMENT
/begin MEASUREMENT B_uebetu "Bedingung Übergang Beschleunigen nach Tip-Up erfolgt" UWORD B_TRUE 1 100 0 1 BIT_MASK 0x100 FORMAT "%13.11" ECU_ADDRESS 0x382104 /end MEASUREMENT
/begin MEASUREMENT B_uebrkf "Bedingung Übergang von begrenzter Rampe nach Konstantfahrt erfolgt" UWORD B_TRUE 1 100 0 1 BIT_MASK 0x200 FORMAT "%13.11" ECU_ADDRESS 0x382104 /end MEASUREMENT
/begin MEASUREMENT B_uebvau "Bedingung Übergang von Beschleunigen oder Verzögern nach Aus erfolgt" UWORD B_TRUE 1 100 0 1 BIT_MASK 0x400 FORMAT "%13.11" ECU_ADDRESS 0x382104 /end MEASUREMENT
/begin MEASUREMENT B_uevztd "Bedingung Übergang von Verzögern nach Tip-Down erfolgt" UWORD B_TRUE 1 100 0 1 BIT_MASK 0x800 FORMAT "%13.11" ECU_ADDRESS 0x382104 /end MEASUREMENT
/begin MEASUREMENT B_ugd "Bedingung: DK-Winkel größer als für 95% der max. rel. Füllung erforderlich" UWORD B_TRUE 1 100 0 1 BIT_MASK 0x4 FORMAT "%13.11" ECU_ADDRESS 0xFD24 /end MEASUREMENT
/begin MEASUREMENT B_ugdb "Bedingung Bereitschaft ungedrosselt" UWORD B_TRUE 1 100 0 1 BIT_MASK 0x8 FORMAT "%13.11" ECU_ADDRESS 0xFD24 /end MEASUREMENT
/begin MEASUREMENT B_ugds "DK-Sollwinkel im ungedrosselten Bereich" UWORD B_TRUE 1 100 0 1 BIT_MASK 0x10 FORMAT "%13.11" ECU_ADDRESS 0xFD24 /end MEASUREMENT
/begin MEASUREMENT B_ugdset "Freigabe DK-Sollwinkel im ungedrosselten Bereich Turbo" UWORD B_TRUE 1 100 0 1 BIT_MASK 0x20 FORMAT "%13.11" ECU_ADDRESS 0xFD24 /end MEASUREMENT
/begin MEASUREMENT B_uk1 "Einschaltbedingung Übergangskompensation" UWORD B_TRUE 1 100 0 1 BIT_MASK 0x2 FORMAT "%13.11" ECU_ADDRESS 0xFD2C /end MEASUREMENT
/begin MEASUREMENT B_ukg "Bedingung Ük wirkt stark" UWORD B_TRUE 1 100 0 1 BIT_MASK 0x4 FORMAT "%13.11" ECU_ADDRESS 0xFD2C /end MEASUREMENT
/begin MEASUREMENT B_ukk "Einschaltbedingung ÜK Kurzzeit-Anteil" UWORD B_TRUE 1 100 0 1 BIT_MASK 0x8 FORMAT "%13.11" ECU_ADDRESS 0xFD2C /end MEASUREMENT
/begin MEASUREMENT B_ukns "Einschaltbedingung ÜK nach Start" UWORD B_TRUE 1 100 0 1 BIT_MASK 0x10 FORMAT "%13.11" ECU_ADDRESS 0xFD2C /end MEASUREMENT
/begin MEASUREMENT B_va "Bedingung Verzögerungsabmagerung (Anzeige)" UWORD B_TRUE 1 100 0 1 BIT_MASK 0x20 FORMAT "%13.11" ECU_ADDRESS 0xFD2C /end MEASUREMENT
/begin MEASUREMENT B_vaau "Bedingung Verzögerungsabmagerung Aufteilung" UWORD B_TRUE 1 100 0 1 BIT_MASK 0x40 FORMAT "%13.11" ECU_ADDRESS 0xFD2C /end MEASUREMENT
/begin MEASUREMENT B_vag "Bedingung starke Verzögerungsabmagerung" UWORD B_TRUE 1 100 0 1 BIT_MASK 0x80 FORMAT "%13.11" ECU_ADDRESS 0xFD2C /end MEASUREMENT
/begin MEASUREMENT B_vakl "Bedingung Verzögerungsabmagerung L- und K-Anteil" UWORD B_TRUE 1 100 0 1 BIT_MASK 0x100 FORMAT "%13.11" ECU_ADDRESS 0xFD2C /end MEASUREMENT
/begin MEASUREMENT B_val "Bedingung Verzögerungsabmagerung L-Anteil" UWORD B_TRUE 1 100 0 1 BIT_MASK 0x200 FORMAT "%13.11" ECU_ADDRESS 0xFD2C /end MEASUREMENT
/begin MEASUREMENT B_vbemg "Bedingung Verbrennungserkennung möglich" UWORD B_TRUE 1 100 0 1 BIT_MASK 0x400 FORMAT "%13.11" ECU_ADDRESS 0xFD96 /end MEASUREMENT
/begin MEASUREMENT B_vbmg "Bedingung Verbrennung möglich" UWORD B_TRUE 1 100 0 1 BIT_MASK 0x800 FORMAT "%13.11" ECU_ADDRESS 0xFD96 /end MEASUREMENT
/begin MEASUREMENT B_wavo "Bedingung Wiederaufnahme von oben" UWORD B_TRUE 1 100 0 1 BIT_MASK 0x2 FORMAT "%13.11" ECU_ADDRESS 0x382102 /end MEASUREMENT
/begin MEASUREMENT B_wdk1v "Bedingung Berechnung des DK-Winkels aus verstärktem Signal von Poti 1" UWORD B_TRUE 1 100 0 1 BIT_MASK 0x4000 FORMAT "%13.11" ECU_ADDRESS 0xFD4E /end MEASUREMENT
/begin MEASUREMENT B_wdk2sel "Bedingung DK-Winkel-Berechnung für Lageregler aus Poti 2" UWORD B_TRUE 1 100 0 1 BIT_MASK 0x8000 FORMAT "%13.11" ECU_ADDRESS 0xFD4E /end MEASUREMENT
/begin MEASUREMENT B_wf "Bedingung Wandfilmberechnung" UWORD B_TRUE 1 100 0 1 BIT_MASK 0x400 FORMAT "%13.11" ECU_ADDRESS 0xFD2C /end MEASUREMENT
/begin MEASUREMENT B_wiauf "Bedingung FGR im Zustand Wiederaufnahme" UWORD B_TRUE 1 100 0 1 BIT_MASK 0x1000 FORMAT "%13.11" ECU_ADDRESS 0x382104 /end MEASUREMENT
/begin MEASUREMENT B_wks "Bedingung Wiederholkaltstart" UWORD B_TRUE 1 100 0 1 BIT_MASK 0x1000 FORMAT "%13.11" ECU_ADDRESS 0xFD96 /end MEASUREMENT
/begin MEASUREMENT B_wst "Bedingung Wiederholstart" UWORD B_TRUE 1 100 0 1 BIT_MASK 0x2000 FORMAT "%13.11" ECU_ADDRESS 0xFD96 /end MEASUREMENT
/begin MEASUREMENT B_wuc "Bedingung 'warm up cycle' erkannt" UBYTE B_TRUE 1 100 0 1 BIT_MASK 0x1 FORMAT "%13.11" ECU_ADDRESS 0x380BEB /end MEASUREMENT
/begin MEASUREMENT B_zahn "NBM-Entprellung über Anzahl Zähne" UBYTE B_TRUE 1 100 0 1 BIT_MASK 0x4 FORMAT "%13.11" ECU_ADDRESS 0x380D78 /end MEASUREMENT
/begin MEASUREMENT B_zeit "NBM-Entprellung über Zeit" UBYTE B_TRUE 1 100 0 1 BIT_MASK 0x8 FORMAT "%13.11" ECU_ADDRESS 0x380D78 /end MEASUREMENT
/begin MEASUREMENT B_zsls "Bedingung Diagnose Sekundärluftsystem durchgeführt" UWORD B_TRUE 1 100 0 1 BIT_MASK 0x4000 FORMAT "%13.11" ECU_ADDRESS 0x380E6E /end MEASUREMENT
/begin MEASUREMENT B_ztev "Bedingung Endstufendiagnose TEV zu" UWORD B_TRUE 1 100 0 1 BIT_MASK 0x800 FORMAT "%13.11" ECU_ADDRESS 0xFD8A /end MEASUREMENT
/begin MEASUREMENT B_zthms "Bedingung Modellendtemperatur erreicht und Betriebsbereich war freigegeben" UBYTE B_TRUE 1 100 0 1 BIT_MASK 0x8 FORMAT "%13.11" ECU_ADDRESS 0x380CB7 /end MEASUREMENT
/begin MEASUREMENT ctrerbr "Fehlerzähler für Bremsschalter-Plausibilisierung" UBYTE dez 1 100 0 255 FORMAT "%5.1" ECU_ADDRESS 0x380C7F /end MEASUREMENT
/begin MEASUREMENT dmidte "Füllungsänderung bezogen auf Referenzwert" UWORD rel_uw_b100 1 100 0 99.9985 FORMAT "%8.5" ECU_ADDRESS 0x382680 /end MEASUREMENT
/begin MEASUREMENT dmrar_w "Delta Relatives Moment bei Abschaltrampe FGR" UWORD rel_uw_b200 1 100 0 199.997 FORMAT "%8.4" ECU_ADDRESS 0x3820F2 /end MEASUREMENT
/begin MEASUREMENT dndte "Delta n bei Tankentlüftungsdiagnose" SWORD nmot_sw_q0p25 1 100 -8192 8191.75 FORMAT "%8.3" ECU_ADDRESS 0x382682 /end MEASUREMENT
/begin MEASUREMENT dnsdte "Änderung der Solldrehzahl bezogen auf Referenzwert" UBYTE nmot_ub_q10 1 100 0 2550 FORMAT "%5.0" ECU_ADDRESS 0x380D65 /end MEASUREMENT
/begin MEASUREMENT dpvdkspu_w "delta zwischen Druck vor Drosselklappe und Umgebungsdruck" UWORD p_uw_q0p039 1 100 0 2559.96 FORMAT "%8.3" ECU_ADDRESS 0x382182 /end MEASUREMENT
/begin MEASUREMENT DSLSLRlokBits1 "" UWORD dez 1 100 0 65535 FORMAT "%8.2" ECU_ADDRESS 0x380E6E /end MEASUREMENT
/begin MEASUREMENT DSLSLRlokBits2 "" UWORD dez 1 100 0 65535 FORMAT "%8.2" ECU_ADDRESS 0x380E70 /end MEASUREMENT
/begin MEASUREMENT DSLSLRlokBits3 "" UWORD dez 1 100 0 65535 FORMAT "%8.2" ECU_ADDRESS 0x380E72 /end MEASUREMENT
/begin MEASUREMENT DstaNvBits "" UBYTE dez 1 100 0 255 FORMAT "%5.1" ECU_ADDRESS 0x383130 /end MEASUREMENT
/begin MEASUREMENT DTEVNbits "" UBYTE dez 1 100 0 255 FORMAT "%5.1" ECU_ADDRESS 0x380D60 /end MEASUREMENT
/begin MEASUREMENT dtevphc_w "" UWORD t100msxs_uw_b6553p5 1 100 0 6553.5 FORMAT "%8.3" ECU_ADDRESS 0x38267C /end MEASUREMENT
/begin MEASUREMENT DTHMlokBits "" UBYTE dez 1 100 0 255 FORMAT "%5.1" ECU_ADDRESS 0x380CB7 /end MEASUREMENT
/begin MEASUREMENT dvrabe_w "Delta Geschwindigkeit bei Beschleunigungsrampe" UWORD vfzg_uw_b512 1 100 0 511.992 FORMAT "%8.4" ECU_ADDRESS 0x3820FC /end MEASUREMENT
/begin MEASUREMENT dvrave_w "Delta Geschwindigkeit bei Verzögerungsrampe" UWORD vfzg_uw_b512 1 100 0 511.992 FORMAT "%8.4" ECU_ADDRESS 0x3820FE /end MEASUREMENT
/begin MEASUREMENT dvzvi_w "Differenz zwischen Ziel- und Istgeschwindigkeit" SWORD vfzg_sw_q0p00781 1 100 -256 255.992 FORMAT "%8.4" ECU_ADDRESS 0x382100 /end MEASUREMENT
/begin MEASUREMENT dwdkba_w "Gradient DK-Winkel" SWORD relDK_q0p02441 1 100 -800 799.976 FORMAT "%8.4" ECU_ADDRESS 0x3813CE /end MEASUREMENT
/begin MEASUREMENT dwdks_w "Änderung des Drosselklappen-Sollwinkels" SWORD rel_sw_b50 1 100 -50 49.9985 FORMAT "%8.5" ECU_ADDRESS 0xFA1E /end MEASUREMENT
/begin MEASUREMENT dwfk_w "Wandfilmmengendifferenz Kurzzeitanteil" SWORD rel_sw_q0p1875 1 100 -6144 6143.81 FORMAT "%8.3" ECU_ADDRESS 0x3811D4 /end MEASUREMENT
/begin MEASUREMENT dwfl_w "Wandfilmmengendifferenz Langzeitanteil" SWORD rel_sw_q0p1875 1 100 -6144 6143.81 FORMAT "%8.3" ECU_ADDRESS 0x3811D6 /end MEASUREMENT
/begin MEASUREMENT dwf_w "Wandfilmmengendifferenz" SWORD rel_sw_q0p1875 1 100 -6144 6143.81 FORMAT "%8.3" ECU_ADDRESS 0x3811D8 /end MEASUREMENT
/begin MEASUREMENT egaspfad "EGAS-Pfad als Umweltbedingung für Funktionsüberwachungs-Diagnoseeintrag" UBYTE dez 1 100 0 255 FORMAT "%5.1" ECU_ADDRESS 0x380D3F /end MEASUREMENT
/begin MEASUREMENT ESSTTbits "Bits zur Funktion Start" UBYTE dez 1 100 0 255 FORMAT "%5.1" ECU_ADDRESS 0x38311F /end MEASUREMENT
/begin MEASUREMENT evsup0 "" UBYTE dez 1 100 0 255 FORMAT "%5.1" ECU_ADDRESS 0x380D44 /end MEASUREMENT
/begin MEASUREMENT fbakl_w "Faktor K- und L-Anteil der ÜK bei BA" SWORD fak_sw_b256 1 100 -256 255.992 FORMAT "%8.4" ECU_ADDRESS 0x3811DA /end MEASUREMENT
/begin MEASUREMENT fbans "Nachstartfaktor der ÜK bei BA" UBYTE fak_ub_b8 1 100 0 7.96875 FORMAT "%5.3" ECU_ADDRESS 0x380962 /end MEASUREMENT
/begin MEASUREMENT fbans_w "Nachstartfaktor der ÜK bei BA" UWORD fak_uw_b8 1 100 0 7.99988 FORMAT "%8.6" ECU_ADDRESS 0x380DE8 /end MEASUREMENT
/begin MEASUREMENT ffzdfp "Fehlerpfadidentifikationsnummer (dfp) zum Freeze-Frame Zero" UBYTE dez 1 100 0 255 FORMAT "%5.1" ECU_ADDRESS 0x380AFF /end MEASUREMENT
/begin MEASUREMENT FGRMDlokBits1 "" UWORD dez 1 100 0 65535 FORMAT "%8.2" ECU_ADDRESS 0x382102 /end MEASUREMENT
/begin MEASUREMENT FGRMDlokBits2 "" UWORD dez 1 100 0 65535 FORMAT "%8.2" ECU_ADDRESS 0x382104 /end MEASUREMENT
/begin MEASUREMENT fgru "Faktor Grundvorsteuerung" UBYTE fak_ub_b2 1 100 0 1.99219 FORMAT "%5.3" ECU_ADDRESS 0x380A49 /end MEASUREMENT
/begin MEASUREMENT fho "Korrekturfaktor Höhe" UBYTE fak_ub_b4 1 100 0 3.98438 FORMAT "%5.3" ECU_ADDRESS 0x380C95 /end MEASUREMENT
/begin MEASUREMENT fho_w "Korrekturfaktor Höhe (word)" UWORD fak_uw_b4 1 100 0 3.99994 FORMAT "%8.6" ECU_ADDRESS 0x38148E /end MEASUREMENT
/begin MEASUREMENT fivzabg "Intervallzähler abgasrelevante Aussetzer" UBYTE dez 1 100 0 255 FORMAT "%5.1" ECU_ADDRESS 0x380B71 /end MEASUREMENT
/begin MEASUREMENT fks "Faktor Klopfschutz" UWORD fak_uw_b256 1 100 0 255.996 FORMAT "%7.3" ECU_ADDRESS 0x3811B6 /end MEASUREMENT
/begin MEASUREMENT fktns "Nachstartanhebung" UBYTE fak_ub_b4 1 100 0 3.98438 FORMAT "%5.3" ECU_ADDRESS 0x380CAF /end MEASUREMENT
/begin MEASUREMENT flgkat "Statusflag kat.schädigende Aussetzerraten oder ti-Abschaltung" UBYTE dez 1 100 0 255 FORMAT "%5.1" ECU_ADDRESS 0x380B72 /end MEASUREMENT
/begin MEASUREMENT flgtiab "Statusflag ti-Abschaltung bei kat.schädigenden Aussetzerraten" UBYTE dez 1 100 0 255 FORMAT "%5.1" ECU_ADDRESS 0x380A4A /end MEASUREMENT
/begin MEASUREMENT fmsla "Korrekturfaktor Sekundärluftmasse adaptiv" UBYTE fak_ub_b2 1 100 0 1.99219 FORMAT "%5.3" ECU_ADDRESS 0x380A85 /end MEASUREMENT
/begin MEASUREMENT fmsla2 "Korrekturfaktor Sekundärluftmasse adaptiv Bank 2" UBYTE fak_ub_b2 1 100 0 1.99219 FORMAT "%5.3" ECU_ADDRESS 0x380A86 /end MEASUREMENT
/begin MEASUREMENT fmslav "Adaptionsfaktor Sekundärluftmasse" UBYTE fak_ub_b2 1 100 0 1.99219 FORMAT "%5.3" ECU_ADDRESS 0x382F25 /end MEASUREMENT
/begin MEASUREMENT fmslav2 "Adaptionsfaktor Sekundärluftmasse, Bank 2" UBYTE fak_ub_b2 1 100 0 1.99219 FORMAT "%5.3" ECU_ADDRESS 0x382F26 /end MEASUREMENT
/begin MEASUREMENT fns "Faktor Nachstart" UBYTE fak_ub_b4 1 100 0 3.98438 FORMAT "%5.3" ECU_ADDRESS 0x380B03 /end MEASUREMENT
/begin MEASUREMENT fpvdkds "Faktor Druck vor Drosselklappe von Drucksensor" UBYTE fak_ub_b4 1 100 0 3.98438 FORMAT "%5.3" ECU_ADDRESS 0x380A3A /end MEASUREMENT
/begin MEASUREMENT fpvdkdsl_w "Faktor Druck vor Drosselklappe von Ladedrucksensor (word)" UWORD fak_uw_b4 1 100 0 3.99994 FORMAT "%8.6" ECU_ADDRESS 0x38218C /end MEASUREMENT
/begin MEASUREMENT fpvdkdsu_w "Faktor Druck vor Drosselklappe von Umgebungsdrucksensor (word)" UWORD fak_uw_b4 1 100 0 3.99994 FORMAT "%8.6" ECU_ADDRESS 0x382184 /end MEASUREMENT
/begin MEASUREMENT fpvdkds_w "Faktor Druck vor Drosselklappe von Drucksensor (word)" UWORD fak_uw_b4 1 100 0 3.99994 FORMAT "%8.6" ECU_ADDRESS 0x381490 /end MEASUREMENT
/begin MEASUREMENT frhodkr_w "Faktor Luftdichtekorrektur für DK-Durchfluß korrigiert (word)" UWORD fak_uw_b2 1 100 0 1.99997 FORMAT "%8.6" ECU_ADDRESS 0x3813E2 /end MEASUREMENT
/begin MEASUREMENT frhol_w "Faktor Luftdichte f(Ansauglufttemp., Höhe) 16-Bit" UWORD fak_uw_b2 1 100 0 1.99997 FORMAT "%8.6" ECU_ADDRESS 0x382186 /end MEASUREMENT
/begin MEASUREMENT fst0_w "Vorgesteuerter Startfaktor 16 Bit" UWORD fak_uw_b64 1 100 0 63.999 FORMAT "%8.5" ECU_ADDRESS 0x382248 /end MEASUREMENT
/begin MEASUREMENT fst_w "Faktor Starteinspritzung" UWORD fak_uw_b64 1 100 0 63.999 FORMAT "%8.5" ECU_ADDRESS 0x381246 /end MEASUREMENT
/begin MEASUREMENT fvakl_w "Faktor K- und L-Anteil der ÜK bei VA" SWORD fak_sw_b256 1 100 -256 255.992 FORMAT "%8.4" ECU_ADDRESS 0x3811DC /end MEASUREMENT
/begin MEASUREMENT fvans "Nachstartfaktor der ÜK bei VA" UBYTE fak_ub_b8 1 100 0 7.96875 FORMAT "%5.3" ECU_ADDRESS 0x380963 /end MEASUREMENT
/begin MEASUREMENT fwe "Faktor Wiedereinsetzen" UBYTE fak_ub_b2 1 100 0 1.99219 FORMAT "%5.3" ECU_ADDRESS 0x380A16 /end MEASUREMENT
/begin MEASUREMENT fwl "Faktor Warmlauf" UBYTE fak_ub_b2 1 100 0 1.99219 FORMAT "%5.3" ECU_ADDRESS 0x380B04 /end MEASUREMENT
/begin MEASUREMENT fwnw "Gemischfaktor Nockenwellenstellung" UBYTE fak_ub_b2 1 100 0 1.99219 FORMAT "%5.3" ECU_ADDRESS 0x380A0A /end MEASUREMENT
/begin MEASUREMENT fzabgs_w "Fehlerzähler Summe, zählt abgasrelevante Aussetzer über alle Zylinder" UWORD dez 1 100 0 65535 FORMAT "%8.2" ECU_ADDRESS 0x380FBC /end MEASUREMENT
/begin MEASUREMENT fzabg_w "Aussetzerzähler" UWORD dez 1 100 0 65535 FORMAT "%8.2" ARRAY_SIZE 8 ECU_ADDRESS 0x380FBE /end MEASUREMENT
/begin MEASUREMENT fzans1 "Faktor Abregelung Nachstart ohne Berücksichtigung des Startmengenadaptionswerts" UBYTE fak_ub_b0p25 1 100 0 0.249023 FORMAT "%6.4" ECU_ADDRESS 0x380CB0 /end MEASUREMENT
/begin MEASUREMENT fzans2 "Faktor Abregelung Nachstart mit Berücksichtigung des Startmengenadaptionswerts" UBYTE fak_ub_b0p25 1 100 0 0.249023 FORMAT "%6.4" ECU_ADDRESS 0x380CB1 /end MEASUREMENT
/begin MEASUREMENT fzarv_w "Fehlerzähler, zählt Aussetzer über alle Zylinder" UWORD dez 1 100 0 65535 FORMAT "%8.2" ECU_ADDRESS 0x380FCE /end MEASUREMENT
/begin MEASUREMENT fzkats1_w "Fehlerzähler Summe Bank 1, zählt katschädigende Aussetzer über alle Zyl. Bank 1" UWORD dez 1 100 0 65535 FORMAT "%8.2" ECU_ADDRESS 0x380FD0 /end MEASUREMENT
/begin MEASUREMENT fzkats2_w "Fehlerzähler Summe Bank 2, zählt katschädigende Aussetzer über alle Zyl. Bank 2" UWORD dez 1 100 0 65535 FORMAT "%8.2" ECU_ADDRESS 0x380FD2 /end MEASUREMENT
/begin MEASUREMENT fzkats_w "Fehlerzähler Summe, zählt katschädigende Aussetzer über alle Zylinder" UWORD dez 1 100 0 65535 FORMAT "%8.2" ECU_ADDRESS 0x380FD4 /end MEASUREMENT
/begin MEASUREMENT fzkat_w "Fehlerzähler Zdg.  x, zählt kat.schädigende (gewichtete) Aussetzer an Zündung" UWORD dez 1 100 0 65535 FORMAT "%8.2" ARRAY_SIZE 8 ECU_ADDRESS 0x380FD6 /end MEASUREMENT
/begin MEASUREMENT GgdsasNvBits "" UBYTE dez 1 100 0 255 FORMAT "%5.1" ECU_ADDRESS 0x38310E /end MEASUREMENT
/begin MEASUREMENT indte "Integrierte Drehzahländerung" SWORD nmot_sw_q0p25 1 100 -8192 8191.75 FORMAT "%8.3" ECU_ADDRESS 0x382684 /end MEASUREMENT
/begin MEASUREMENT iptes_w "Pumpenstrom Tankdiagnose" UWORD i_uA_q6p1035 1 100 0 399.994 FORMAT "%8.4" ECU_ADDRESS 0x382678 /end MEASUREMENT
/begin MEASUREMENT ivzabg_w "Intervallzähler für abgasrelevante Aussetzer (0-1000 KW-Umdr. bzw. 0-500 NW-Um.)" UWORD dez 1 100 0 65535 FORMAT "%8.2" ECU_ADDRESS 0x380FE6 /end MEASUREMENT
/begin MEASUREMENT ivzarv_w "Intervallzähler für Aussetzer (0-60 KW-Umdr.), zur Ausblendung weiterer Funktion" UWORD dez 1 100 0 65535 FORMAT "%8.2" ECU_ADDRESS 0x380FE8 /end MEASUREMENT
/begin MEASUREMENT ivzkat_w "Intervallzähler für katschädigende Aussetzer (0-200 Kw-Umdr. bzw. 0-100 NW-Um.)" UWORD dez 1 100 0 65535 FORMAT "%8.2" ECU_ADDRESS 0x380FEA /end MEASUREMENT
/begin MEASUREMENT kfgr_w "Verstärkungsfaktor FGR-Regler" UWORD rel_uw_b3200 1 100 0 3199.95 FORMAT "%8.3" ECU_ADDRESS 0x382106 /end MEASUREMENT
/begin MEASUREMENT kswf "Kat.-Schutz-Wichtungsfaktoren, aus KFKSWF" UBYTE dez 1 100 0 255 FORMAT "%5.1" ECU_ADDRESS 0x380B73 /end MEASUREMENT
/begin MEASUREMENT lamnswl_w "Lambda-Motor-Soll für Nachstart und Warmlauf" UWORD fak_uw_b16 1 100 0 15.9998 FORMAT "%8.5" ECU_ADDRESS 0x3811D2 /end MEASUREMENT
/begin MEASUREMENT lamns_w "Lambda-Motor-Soll für Nachstart" UWORD fak_uw_b16 1 100 0 15.9998 FORMAT "%8.5" ECU_ADDRESS 0x38222A /end MEASUREMENT
/begin MEASUREMENT lamwl_w "Lambda-Motor-Soll für Warmlauf" UWORD fak_uw_b16 1 100 0 15.9998 FORMAT "%8.5" ECU_ADDRESS 0x382250 /end MEASUREMENT
/begin MEASUREMENT ldfki_w "Ladedruck Filterzeitkonstante aus Kennfeld" UWORD zk10msxs_uw_b655 1 100 0.0100002 655.36 FORMAT "%10.6" ECU_ADDRESS 0x38218E /end MEASUREMENT
/begin MEASUREMENT m6amsl "Mode 6 - Speicher: Anzahl Werteblöcke bei Prüfung Sekundärluftmasse" UBYTE dez 1 100 0 255 FORMAT "%5.1" ECU_ADDRESS 0x382F27 /end MEASUREMENT
/begin MEASUREMENT m6cmsl "Mode 6 - Speicher: Component ID für Prüfung Sekundärluftsystem" UBYTE dez 1 100 0 255 FORMAT "%5.1" ECU_ADDRESS 0x382F28 /end MEASUREMENT
/begin MEASUREMENT m6cmsl2 "Mode 6 - Speicher: Component ID für Prüfung Sekundärluftsystem (Bank 2)" UBYTE dez 1 100 0 255 FORMAT "%5.1" ECU_ADDRESS 0x382F29 /end MEASUREMENT
/begin MEASUREMENT m6cmslv "Mode 6 - Speicher: Component ID für Prüfung Dichtheit Sekundärluftsystem" UBYTE dez 1 100 0 255 FORMAT "%5.1" ECU_ADDRESS 0x382F2A /end MEASUREMENT
/begin MEASUREMENT m6cmslv2 "Mode 6 - Speicher: Component ID für Prüfung Dichtheit Sekundärluftsystem" UBYTE dez 1 100 0 255 FORMAT "%5.1" ECU_ADDRESS 0x382F2B /end MEASUREMENT
/begin MEASUREMENT m6smsl2_w "Mode 6 - Speicher: Schwellwert bei Prüfung Sekundärluftmasse, Bank 2" UWORD dez 1 100 0 65535 FORMAT "%8.2" ECU_ADDRESS 0x383180 /end MEASUREMENT
/begin MEASUREMENT m6smslv2_w "Mode 6 - Speicher: Schwellwert bei Ventildichtheitsprüfung, Bank 2" UWORD dez 1 100 0 65535 FORMAT "%8.2" ECU_ADDRESS 0x383182 /end MEASUREMENT
/begin MEASUREMENT m6smslv_w "Mode 6 - Speicher: Schwellwert bei Ventildichtheitsprüfung" UWORD dez 1 100 0 65535 FORMAT "%8.2" ECU_ADDRESS 0x383184 /end MEASUREMENT
/begin MEASUREMENT m6smsl_w "Mode 6 - Speicher: Schwellwert bei Prüfung Sekundärluftmasse" UWORD dez 1 100 0 65535 FORMAT "%8.2" ECU_ADDRESS 0x383186 /end MEASUREMENT
/begin MEASUREMENT m6wmsl2_w "Mode 6 - Speicher: Messwert Sekundärluftmasse bei SL-Einblasung, Bank 2" UWORD dez 1 100 0 65535 FORMAT "%8.2" ECU_ADDRESS 0x383188 /end MEASUREMENT
/begin MEASUREMENT m6wmslv2_w "Mode 6 - Speicher: Messwert Ventildichtheit, Bank 2" UWORD dez 1 100 0 65535 FORMAT "%8.2" ECU_ADDRESS 0x38318A /end MEASUREMENT
/begin MEASUREMENT m6wmslv_w "Mode 6 - Speicher: Messwert Ventildichtheit" UWORD dez 1 100 0 65535 FORMAT "%8.2" ECU_ADDRESS 0x38318C /end MEASUREMENT
/begin MEASUREMENT m6wmsl_w "Mode 6 - Speicher: Messwert Sekundärluftmasse bei SL-Einblasung" UWORD dez 1 100 0 65535 FORMAT "%8.2" ECU_ADDRESS 0x38318E /end MEASUREMENT
/begin MEASUREMENT midter "" UWORD rel_uw_b100 1 100 0 99.9985 FORMAT "%8.5" ECU_ADDRESS 0x382686 /end MEASUREMENT
/begin MEASUREMENT milstat "" UBYTE dez 1 100 0 255 FORMAT "%5.1" ECU_ADDRESS 0x380AFE /end MEASUREMENT
/begin MEASUREMENT mi_duf "Istmoment beim Ansprechen des Momentenvergleichs in der Funktionsüberwachung" UBYTE rel_ub_b99p6 1 100 0 99.6094 FORMAT "%5.2" ECU_ADDRESS 0x380D40 /end MEASUREMENT
/begin MEASUREMENT mldkns_w "Normierter Soll-Luftmassenstrom durch Drosselvorrichtung" UWORD m_uw_b6553p5 1 100 0 6553.5 FORMAT "%8.3" ECU_ADDRESS 0x3813E4 /end MEASUREMENT
/begin MEASUREMENT mldks_w "Soll-Luftmassenstrom durch Drosselvorrichtung" UWORD m_uw_b6553p5 1 100 0 6553.5 FORMAT "%8.3" ECU_ADDRESS 0x3813E6 /end MEASUREMENT
/begin MEASUREMENT mlsol_w "Soll-Luftmassenstrom" UWORD m_uw_b6553p5 1 100 0 6553.5 FORMAT "%8.3" ECU_ADDRESS 0x3813E8 /end MEASUREMENT
/begin MEASUREMENT mlwdkns_w "Normierter Luftmassenstrom für Sollwinkelbestimmung Drosselklappe" UWORD m_uw_b6553p5 1 100 0 6553.5 FORMAT "%8.3" ECU_ADDRESS 0x3813EA /end MEASUREMENT
/begin MEASUREMENT mpfad "Momenten-Pfad in Funktion und Funktionsüberwachung als Umweltbedingung für Diag." UBYTE dez 1 100 0 255 FORMAT "%5.1" ECU_ADDRESS 0x380D41 /end MEASUREMENT
/begin MEASUREMENT mrfgri_w "Relatives Moment Initialisierungswert für FGR-Regler" UWORD rel_uw_b200 1 100 0 199.997 FORMAT "%8.4" ECU_ADDRESS 0x382108 /end MEASUREMENT
/begin MEASUREMENT mrfgrm_w "Relativer Momentenwunsch von FGR (aus ME)" UWORD rel_uw_b200 1 100 0 199.997 FORMAT "%8.4" ECU_ADDRESS 0x38210A /end MEASUREMENT
/begin MEASUREMENT mrfgru_w "Untere Grenze für relatives Moment aus FGR" UWORD rel_uw_b200 1 100 0 199.997 FORMAT "%8.4" ECU_ADDRESS 0x3820F4 /end MEASUREMENT
/begin MEASUREMENT mrfgrv_w "Relativer Momentenwunsch aus FGR vor Begrenzung" UWORD rel_uw_b200 1 100 0 199.997 FORMAT "%8.4" ECU_ADDRESS 0x38214C /end MEASUREMENT
/begin MEASUREMENT mrfgr_w "Relative Momentenanforderung von FGR" UWORD rel_uw_b200 1 100 0 199.997 FORMAT "%8.4" ECU_ADDRESS 0x3820F6 /end MEASUREMENT
/begin MEASUREMENT mrregl_w "Relatives Moment Reglerausgang FGR" UWORD rel_uw_b200 1 100 0 199.997 FORMAT "%8.4" ECU_ADDRESS 0x38210C /end MEASUREMENT
/begin MEASUREMENT mrrgli_w "Initialisierungswert Relatives Moment für FGR-Regler" UWORD rel_uw_b200 1 100 0 199.997 FORMAT "%8.4" ECU_ADDRESS 0x38210E /end MEASUREMENT
/begin MEASUREMENT mslif "Istwert Sekundärluftmasse, gefiltert" UBYTE m_q0p4 1 100 0 102 FORMAT "%5.1" ECU_ADDRESS 0x380A87 /end MEASUREMENT
/begin MEASUREMENT mslif2 "Istwert Sekundärluftmasse, gefiltert (Bank 2)" UBYTE m_q0p4 1 100 0 102 FORMAT "%5.1" ECU_ADDRESS 0x380A88 /end MEASUREMENT
/begin MEASUREMENT mslift "Istwert Sekundärluftmasse, gefiltert, temporär" UBYTE m_q0p4 1 100 0 102 FORMAT "%5.1" ECU_ADDRESS 0x380A89 /end MEASUREMENT
/begin MEASUREMENT mslift2 "Istwert Sekundärluftmasse, gefiltert, temporär (Bank 2)" UBYTE m_q0p4 1 100 0 102 FORMAT "%5.1" ECU_ADDRESS 0x380A8A /end MEASUREMENT
/begin MEASUREMENT mslnenn "Nennwert Sekundärluftmasse" UBYTE m_q0p4 1 100 0 102 FORMAT "%5.1" ECU_ADDRESS 0x382F2C /end MEASUREMENT
/begin MEASUREMENT mslnenn2 "Nennwert Sekundärluftmasse, Bank 2" UBYTE m_q0p4 1 100 0 102 FORMAT "%5.1" ECU_ADDRESS 0x382F2D /end MEASUREMENT
/begin MEASUREMENT mslnf "Nenn-Sekundärluftmasse, gefiltert" UBYTE m_q0p4 1 100 0 102 FORMAT "%5.1" ECU_ADDRESS 0x380A8B /end MEASUREMENT
/begin MEASUREMENT mslnf2 "Nenn-Sekundärluftmasse, gefiltert, Bank 2" UBYTE m_q0p4 1 100 0 102 FORMAT "%5.1" ECU_ADDRESS 0x380A8C /end MEASUREMENT
/begin MEASUREMENT mslnt "Nenn-Sekundärluftmasse, temporär" UBYTE m_q0p4 1 100 0 102 FORMAT "%5.1" ECU_ADDRESS 0x380A8D /end MEASUREMENT
/begin MEASUREMENT mslnt2 "Nenn-Sekundärluftmasse,temporär, Bank 2" UBYTE m_q0p4 1 100 0 102 FORMAT "%5.1" ECU_ADDRESS 0x380A8E /end MEASUREMENT
/begin MEASUREMENT mslofs "Offsetwert Sekundärluftmasse" SBYTE m_q0p4 1 100 -51.2 50.8 FORMAT "%5.2" ECU_ADDRESS 0x380A8F /end MEASUREMENT
/begin MEASUREMENT mslofs2 "Offsetwert Sekundärluftmasse, Bank 2" SBYTE m_q0p4 1 100 -51.2 50.8 FORMAT "%5.2" ECU_ADDRESS 0x380A90 /end MEASUREMENT
/begin MEASUREMENT mslt2_w "temporäre Sekundärluftmasse, Bank 2" UWORD m_uw_b6553p5 1 100 0 6553.5 FORMAT "%8.3" ECU_ADDRESS 0x380E74 /end MEASUREMENT
/begin MEASUREMENT mslt_w "temporäre Sekundärluftmasse" UWORD m_uw_b6553p5 1 100 0 6553.5 FORMAT "%8.3" ECU_ADDRESS 0x380E76 /end MEASUREMENT
/begin MEASUREMENT mslv "Sekundärluftmasse für Ventildichtheitsprüfung" UBYTE m_q0p4 1 100 0 102 FORMAT "%5.1" ECU_ADDRESS 0x380A91 /end MEASUREMENT
/begin MEASUREMENT mslv2 "Sekundärluftmasse für Ventildichtheitsprüfung, Bank 2" UBYTE m_q0p4 1 100 0 102 FORMAT "%5.1" ECU_ADDRESS 0x380A92 /end MEASUREMENT
/begin MEASUREMENT mslvf "Sekundärluftventilundichtheitmasse, gefiltert" SBYTE m_q0p4 1 100 -51.2 50.8 FORMAT "%5.2" ECU_ADDRESS 0x380A93 /end MEASUREMENT
/begin MEASUREMENT mslvf2 "temporäre Sekundärluftmasse Ventil, gefiltert, Bank 2" SBYTE m_q0p4 1 100 -51.2 50.8 FORMAT "%5.2" ECU_ADDRESS 0x380A94 /end MEASUREMENT
/begin MEASUREMENT mslvft "Sekundärluftventilundichtheit, gefiltert, temporär" SBYTE m_q0p4 1 100 -51.2 50.8 FORMAT "%5.2" ECU_ADDRESS 0x380A95 /end MEASUREMENT
/begin MEASUREMENT mslvft2 "Sekundärluftventilundichtheit, gefiltert, temporär (Bank 2)" SBYTE m_q0p4 1 100 -51.2 50.8 FORMAT "%5.2" ECU_ADDRESS 0x380A96 /end MEASUREMENT
/begin MEASUREMENT mslvt2_w "temporäre Ventilleckage, Bank 2" SWORD m_sw_q0p1 1 100 -3276.8 3276.7 FORMAT "%8.3" ECU_ADDRESS 0x380E78 /end MEASUREMENT
/begin MEASUREMENT mslvt_w "temporäre Ventilleckage" SWORD m_sw_q0p1 1 100 -3276.8 3276.7 FORMAT "%8.3" ECU_ADDRESS 0x380E7A /end MEASUREMENT
/begin MEASUREMENT mvdtehp "Hochpaßgefiltertes Verlustmoment" UWORD rel_uw_b100 1 100 0 99.9985 FORMAT "%8.5" ECU_ADDRESS 0x382688 /end MEASUREMENT
/begin MEASUREMENT NIST "Motor-Istdrehzahl" UBYTE NQ25 1 100 0 6375 FORMAT "%5.0" ECU_ADDRESS 0xF904 /end MEASUREMENT
/begin MEASUREMENT nsactr "Nachstartcounter" UBYTE fak_ub_b2 1 100 0 1.99219 FORMAT "%5.3" ECU_ADDRESS 0x380CB2 /end MEASUREMENT
/begin MEASUREMENT nsactr1 "Nachstartcounter ohne Berücksichtigung des Startmengenadaptionswerts" UBYTE fak_ub_b2 1 100 0 1.99219 FORMAT "%5.3" ECU_ADDRESS 0x380CB3 /end MEASUREMENT
/begin MEASUREMENT nsactr2 "Nachstartcounter mit Berücksichtigung des Startmengenadaptionswerts" UBYTE fak_ub_b2 1 100 0 1.99219 FORMAT "%5.3" ECU_ADDRESS 0x380CB4 /end MEASUREMENT
/begin MEASUREMENT nsdter "Solldrehzahl Referenz" UBYTE nmot_ub_q10 1 100 0 2550 FORMAT "%5.0" ECU_ADDRESS 0x380D66 /end MEASUREMENT
/begin MEASUREMENT ntpdte "Tiefpaßgefilterte Drehzahl" UWORD nmot_uw_q0p25 1 100 0 16383.8 FORMAT "%8.2" ECU_ADDRESS 0x38268A /end MEASUREMENT
/begin MEASUREMENT ntpdter "Tiefpaßgefilterte Drehzahl, Referenzwert" UWORD nmot_uw_q0p25 1 100 0 16383.8 FORMAT "%8.2" ECU_ADDRESS 0x38268C /end MEASUREMENT
/begin MEASUREMENT nwCtr "" UBYTE dez 1 100 0 255 FORMAT "%5.1" ECU_ADDRESS 0x380A17 /end MEASUREMENT
/begin MEASUREMENT phpw "Phasensignal Pegelwechsel (8 Bit Schieberegister)" UBYTE dez 1 100 0 255 FORMAT "%5.1" ECU_ADDRESS 0x380BF9 /end MEASUREMENT
/begin MEASUREMENT phpw2 "Phasensignal 2 Pegelwechsel (8 Bit Schieberegister)" UBYTE dez 1 100 0 255 FORMAT "%5.1" ECU_ADDRESS 0x380BFA /end MEASUREMENT
/begin MEASUREMENT plsol "Soll-Ladedruck" UBYTE p_ub_q10 1 100 0 2550 FORMAT "%5.0" ECU_ADDRESS 0xFA2C /end MEASUREMENT
/begin MEASUREMENT plsol_w "Soll-Ladedruck" UWORD p_uw_q0p039 1 100 0 2559.96 FORMAT "%8.3" ECU_ADDRESS 0x3813EC /end MEASUREMENT
/begin MEASUREMENT pspvmin_w "Minimalauswahl aus pspvdk und psspvdk" UWORD fak_uw_b2 1 100 0 1.99997 FORMAT "%8.6" ECU_ADDRESS 0x3813EE /end MEASUREMENT
/begin MEASUREMENT pssol_w "Sollsaugrohrdruck" UWORD p_uw_q0p039 1 100 0 2559.96 FORMAT "%8.3" ECU_ADDRESS 0x3813F0 /end MEASUREMENT
/begin MEASUREMENT psspvdkd_w "Verhältnis Sollsaugrohrdruck/Druck vor Drosselklappe von Drucksensor (word)" UWORD fak_uw_b4 1 100 0 3.99994 FORMAT "%8.6" ECU_ADDRESS 0x382190 /end MEASUREMENT
/begin MEASUREMENT psspvdk_w "Verhältnis Soll-Saugrohrdruck zu Druck vor Drosselklappe" UWORD fak_uw_b2 1 100 0 1.99997 FORMAT "%8.6" ECU_ADDRESS 0x3813F2 /end MEASUREMENT
/begin MEASUREMENT pu "Umgebungsdruck" UBYTE p_ub_q5 1 100 0 1275 FORMAT "%5.0" ECU_ADDRESS 0x380C96 /end MEASUREMENT
/begin MEASUREMENT pus_w "Umgebungsdruck ohne Umschaltung auf Ersatzwert bei Sensorfehler" UWORD p_uw_q0p039 1 100 0 2559.96 FORMAT "%8.3" ECU_ADDRESS 0x382188 /end MEASUREMENT
/begin MEASUREMENT pu_w "Umgebungsdruck" UWORD p_uw_q0p039 1 100 0 2559.96 FORMAT "%8.3" ECU_ADDRESS 0x381492 /end MEASUREMENT
/begin MEASUREMENT pvdkds "Druck vor Drosselklappe von Drucksensor" UBYTE p_ub_q10 1 100 0 2550 FORMAT "%5.0" ECU_ADDRESS 0x380C98 /end MEASUREMENT
/begin MEASUREMENT pvdkdsl_w "Druck vor Drosselklappe von Ladedrucksensor (word)" UWORD p_uw_q0p039 1 100 0 2559.96 FORMAT "%8.3" ECU_ADDRESS 0x382192 /end MEASUREMENT
/begin MEASUREMENT pvdkdsu_w "Druck vor Drosselklappe von Umgebungsdrucksensor (word)" UWORD p_uw_q0p039 1 100 0 2559.96 FORMAT "%8.3" ECU_ADDRESS 0x38218A /end MEASUREMENT
/begin MEASUREMENT pvdkds_w "Druck vor Drosselklappe von Drucksensor (word)" UWORD p_uw_q0p039 1 100 0 2559.96 FORMAT "%8.3" ECU_ADDRESS 0x381494 /end MEASUREMENT
/begin MEASUREMENT pvdkmx_w "Maximaler Druck vor Drosselklappe Ausgangswert aus Kennlinie PVDKMX" UWORD p_uw_q0p039 1 100 0 2559.96 FORMAT "%8.3" ECU_ADDRESS 0x382194 /end MEASUREMENT
/begin MEASUREMENT pvdkr_w "Referenzdruck vor Drosselklappe" UWORD p_uw_q0p039 1 100 0 2559.96 FORMAT "%8.3" ECU_ADDRESS 0x3813F4 /end MEASUREMENT
/begin MEASUREMENT pvdkspud "Differenz zwischen Umgebungsdruck und Druck vor Drosselklappe" UBYTE p_ub_q10 1 100 0 2550 FORMAT "%5.0" ECU_ADDRESS 0x380C97 /end MEASUREMENT
/begin MEASUREMENT pvdks_w "Druck vor Drosselklappe ohne Umschaltung auf Ersatzwert bei Sensorfehler" UWORD p_uw_q0p039 1 100 0 2559.96 FORMAT "%8.3" ECU_ADDRESS 0x382196 /end MEASUREMENT
/begin MEASUREMENT rkukg_w "rel. Kraftstoffmasse Übergangskompensation" SWORD rel_sw_b1536 1 100 -1536 1535.95 FORMAT "%8.3" ECU_ADDRESS 0xFA2E /end MEASUREMENT
/begin MEASUREMENT rkukkl_w "Kurz- und Langzeitanteil der UK" SWORD rel_sw_q0p1875 1 100 -6144 6143.81 FORMAT "%8.3" ECU_ADDRESS 0x3811DE /end MEASUREMENT
/begin MEASUREMENT rkukk_w "rk-Kurzzeitanteil der UK" SWORD rel_sw_q0p1875 1 100 -6144 6143.81 FORMAT "%8.3" ECU_ADDRESS 0x3811E0 /end MEASUREMENT
/begin MEASUREMENT rkukl_w "rk-Langzeitanteil der UK" SWORD rel_sw_q0p1875 1 100 -6144 6143.81 FORMAT "%8.3" ECU_ADDRESS 0x3811E2 /end MEASUREMENT
/begin MEASUREMENT rlsolk_w "Korrigierte relative Sollfüllung" UWORD rel_uw_q0p0234 1 100 0 1535.98 FORMAT "%8.3" ECU_ADDRESS 0x3813F6 /end MEASUREMENT
/begin MEASUREMENT rlvppl "Relative Luftfüllung (dichtekorrigiert) für Berechnung DK-Winkel-Ersatzwert" UBYTE rel_ub_q0p75 1 100 0 191.25 FORMAT "%5.1" ECU_ADDRESS 0x380A5D /end MEASUREMENT
/begin MEASUREMENT rlvppmx "Maximale Füllung für DK-Poti-Plausibilisierung" UBYTE rel_ub_q0p75 1 100 0 191.25 FORMAT "%5.1" ECU_ADDRESS 0x380A5E /end MEASUREMENT
/begin MEASUREMENT rmsl "relative Sekundärluftmasse" UBYTE fak_ub_b2 1 100 0 1.99219 FORMAT "%5.3" ECU_ADDRESS 0x380A97 /end MEASUREMENT
/begin MEASUREMENT rmsl2 "relative Sekundärluftmasse, Bank 2" UBYTE fak_ub_b2 1 100 0 1.99219 FORMAT "%5.3" ECU_ADDRESS 0x380A98 /end MEASUREMENT
/begin MEASUREMENT rmslt "relative Sekundärluftmasse ohne Offset- Korrektur" UBYTE fak_ub_b2 1 100 0 1.99219 FORMAT "%5.3" ECU_ADDRESS 0x380A99 /end MEASUREMENT
/begin MEASUREMENT rmslt2 "relative Sekundärluftmasse ohne Offset- Korrektur, Bank 2" UBYTE fak_ub_b2 1 100 0 1.99219 FORMAT "%5.3" ECU_ADDRESS 0x380A9A /end MEASUREMENT
/begin MEASUREMENT rstMon_um "" UWORD dez 1 100 0 65535 FORMAT "%8.2" ECU_ADDRESS 0x382EB4 /end MEASUREMENT
/begin MEASUREMENT rstpfad "Reset-Pfad als Umweltbedingung für Rechnerüberwachungs-Diagnoseeintrag" UBYTE dez 1 100 0 255 FORMAT "%5.1" ECU_ADDRESS 0x380D43 /end MEASUREMENT
/begin MEASUREMENT sdwfk_w "Speicherinhalt der Wandfilmdifferenz für Kurzzeitanteil" SWORD rel_sw_q0p1875 1 100 -6144 6143.81 FORMAT "%8.3" ECU_ADDRESS 0x3811E4 /end MEASUREMENT
/begin MEASUREMENT sdwfl_w "Speicherinhalt der Wandfilmdifferenz für Langzeitanteil" SWORD rel_sw_q0p1875 1 100 -6144 6143.81 FORMAT "%8.3" ECU_ADDRESS 0x3811E6 /end MEASUREMENT
/begin MEASUREMENT skapfad "SKA-Pfad als Umweltbedingung für Funktionsüberwachungs-Diagnoseeintrag" UBYTE dez 1 100 0 255 FORMAT "%5.1" ECU_ADDRESS 0x380D42 /end MEASUREMENT
/begin MEASUREMENT slp_an "" UBYTE dez 1 100 0 255 FORMAT "%5.1" ECU_ADDRESS 0x380D45 /end MEASUREMENT
/begin MEASUREMENT slsstat "SLS-Status über CAN" UBYTE dez 1 100 0 255 FORMAT "%5.1" ECU_ADDRESS 0x380A9B /end MEASUREMENT
/begin MEASUREMENT tadtea "rel. TEV-Öffnung aus Tankentlüftungsdiagnose" UBYTE rel_ub_b100 1 100 0 100 FORMAT "%5.1" ECU_ADDRESS 0x380B3A /end MEASUREMENT
/begin MEASUREMENT tbtevio_c "" UBYTE t100msxs_ub_b25p5 1 100 0 25.5 FORMAT "%5.2" ECU_ADDRESS 0x380D61 /end MEASUREMENT
/begin MEASUREMENT tc6tesc "Ausgabe-Code SCAN-Tool Mode 6 aus TES-Diagnose" UBYTE dez 1 100 0 255 FORMAT "%5.1" ECU_ADDRESS 0x38314D /end MEASUREMENT
/begin MEASUREMENT tc6tess "Ausgabe Schwellwert SCAN-Tool Mode 6 aus TES-Diagnose" UWORD dez 1 100 0 65535 FORMAT "%8.2" ECU_ADDRESS 0x383EF4 /end MEASUREMENT
/begin MEASUREMENT tc6tesw "Ausgabe Prüfwert SCAN-Tool Mode 6 aus TES-Diagnose" UWORD dez 1 100 0 65535 FORMAT "%8.2" ECU_ADDRESS 0x383EF6 /end MEASUREMENT
/begin MEASUREMENT tdten_w "Berechnungszeit für Drehzahlcheck" UWORD t20msxs_uw_b1310 1 100 0 1310.7 FORMAT "%7.2" ECU_ADDRESS 0x38267E /end MEASUREMENT
/begin MEASUREMENT tdwnws "" UWORD t2msxs_uw_b131p07 1 100 0 131.07 FORMAT "%8.4" ECU_ADDRESS 0xE42A /end MEASUREMENT
/begin MEASUREMENT tesstat "Funktionsstatus DTES bei Anforderung Systemcheck" UBYTE dez 1 100 0 255 FORMAT "%5.1" ECU_ADDRESS 0x380D62 /end MEASUREMENT
/begin MEASUREMENT tfwdks_w "Zeitkonstante für wdks Filterung" UWORD zk10msxs_uw_b655 1 100 0.0100002 655.36 FORMAT "%10.6" ECU_ADDRESS 0x3813F8 /end MEASUREMENT
/begin MEASUREMENT tmlauf_w "Motorlaufzeit vor dem Abstellen" UWORD t100msxs_uw_b6553p6 1 100 0 6553.5 FORMAT "%8.3" ECU_ADDRESS 0x383A02 /end MEASUREMENT
/begin MEASUREMENT tmstem "Motortemperatur bei Startende in Memory" UBYTE temp_ub_q0p75_o48 1 100 -48 143.25 FORMAT "%5.1" ECU_ADDRESS 0x380BEA /end MEASUREMENT
/begin MEASUREMENT tn2fgr_w "Doppelte Nennerzeitkonstante FGR-Regler" UWORD t20msxs_uw_q0p02 1 100 0 1310.7 FORMAT "%8.3" ECU_ADDRESS 0x382110 /end MEASUREMENT
/begin MEASUREMENT top_w "Operating time seit powerfail" UWORD t6minxmin_q6 1 100 0 393210 FORMAT "%8.1" ECU_ADDRESS 0x3839CA /end MEASUREMENT
/begin MEASUREMENT tsroh_w "Segmentzeit unkorrigiert" UWORD tsquant 1 100 0 52428 FORMAT "%8.2" ECU_ADDRESS 0x382704 /end MEASUREMENT
/begin MEASUREMENT tstlauf_w "Zeit seit B_st auf 1" UWORD t100msxs_uw_b6553p6 1 100 0 6553.5 FORMAT "%8.3" ECU_ADDRESS 0x38224A /end MEASUREMENT
/begin MEASUREMENT twkodte_c "" UBYTE t100msxs_ub_b25p5 1 100 0 25.5 FORMAT "%5.2" ECU_ADDRESS 0x380D63 /end MEASUREMENT
/begin MEASUREMENT tz2fgr_w "Doppelte Zählerzeitkonstante FGR-Regler" UWORD t20msxs_uw_q0p02 1 100 0 1310.7 FORMAT "%8.3" ECU_ADDRESS 0x382112 /end MEASUREMENT
/begin MEASUREMENT u5ref1 "ADC-Wert 5 Volt-Referenzspannung 1 (Byte)" UBYTE spg_ub_b5 1 100 0 4.98047 FORMAT "%5.3" ECU_ADDRESS 0x380C6C /end MEASUREMENT
/begin MEASUREMENT u5ref1_w "ADC-Wert 5 Volt-Referenzspannung 1" UWORD spg_uw_b1280 1 100 0 1279.96 FORMAT "%7.2" ECU_ADDRESS 0x382024 /end MEASUREMENT
/begin MEASUREMENT u5ref2 "ADC-Wert 5 Volt-Referenzspannung 2 (Byte)" UBYTE spg_ub_b5 1 100 0 4.98047 FORMAT "%5.3" ECU_ADDRESS 0x380C6D /end MEASUREMENT
/begin MEASUREMENT u5ref2_w "ADC-Wert 5 Volt-Referenzspannung 2" UWORD spg_uw_b1280 1 100 0 1279.96 FORMAT "%7.2" ECU_ADDRESS 0x382026 /end MEASUREMENT
/begin MEASUREMENT uptes_w "Spannung Pumpenstrom Tankdiagnose" UWORD spg_q0p00488 1 100 0 319.995 FORMAT "%8.4" ECU_ADDRESS 0x38267A /end MEASUREMENT
/begin MEASUREMENT vlast_w "Zusätzliche Offset-Geschwindigkeit für FGR-Regler bei höherer Last" UWORD vfzg_uw_b512 1 100 0 511.992 FORMAT "%8.4" ECU_ADDRESS 0x382114 /end MEASUREMENT
/begin MEASUREMENT voffs_w "Offsetgeschwindigkeit für FGR-Regler" UWORD vfzg_uw_b512 1 100 0 511.992 FORMAT "%8.4" ECU_ADDRESS 0x382116 /end MEASUREMENT
/begin MEASUREMENT vrbemx_w "Maximalwert für vregl_w bei Beschleunigung" UWORD vfzg_uw_b512 1 100 0 511.992 FORMAT "%8.4" ECU_ADDRESS 0x382118 /end MEASUREMENT
/begin MEASUREMENT vregl_w "Sollgeschwindigkeit für FGR-Regler" UWORD vfzg_uw_b512 1 100 0 511.992 FORMAT "%8.4" ECU_ADDRESS 0x38211A /end MEASUREMENT
/begin MEASUREMENT vrvemn_w "Minimalwert für vregl_w bei Verzögern" UWORD vfzg_uw_b512 1 100 0 511.992 FORMAT "%8.4" ECU_ADDRESS 0x38211C /end MEASUREMENT
/begin MEASUREMENT vstvvr "Erhöhung des Sollwerts der VMAX-Regelung über Werkstatt-Tester" UBYTE dez 1 100 0 255 FORMAT "%5.1" ECU_ADDRESS 0x380D46 /end MEASUREMENT
/begin MEASUREMENT vziel_w "Zielgeschwindigkeit FGR" UWORD vfzg_uw_b512 1 100 0 511.992 FORMAT "%8.4" ECU_ADDRESS 0x38211E /end MEASUREMENT
/begin MEASUREMENT wdk1_w "DK-Winkel aus Poti 1" SWORD relDK_q0p02441 1 100 -800 799.976 FORMAT "%8.4" ECU_ADDRESS 0xF8C4 /end MEASUREMENT
/begin MEASUREMENT wdk2_w "DK-Winkel aus Poti 2" SWORD relDK_q0p02441 1 100 -800 799.976 FORMAT "%8.4" ECU_ADDRESS 0xF8C6 /end MEASUREMENT
/begin MEASUREMENT wdk3 "DK-Winkel-Ersatzwert aus Füllungssignal" UBYTE relDK_ub_b100 1 100 0 100 FORMAT "%5.1" ECU_ADDRESS 0x380A5F /end MEASUREMENT
/begin MEASUREMENT wdkba "Drosselklappenwinkel bezogen auf unteren Anschlag" UBYTE relDK_ub_b100 1 100 0 100 FORMAT "%5.1" ECU_ADDRESS 0x380A60 /end MEASUREMENT
/begin MEASUREMENT wdkba_w "Drosselklappenwinkel bezogen auf unteren Anschlag" SWORD relDK_q0p02441 1 100 -800 799.976 FORMAT "%8.4" ECU_ADDRESS 0xF8C8 /end MEASUREMENT
/begin MEASUREMENT wdks "Sollwert DK-Winkel, bezogen auf unteren Anschlag" UBYTE rel_ub_b99p6 1 100 0 99.6094 FORMAT "%5.2" ECU_ADDRESS 0x380923 /end MEASUREMENT
/begin MEASUREMENT wdksgv_w "Drosselklappen-Sollwinkel vor Applikationsschnittstelle (gefiltert)" UWORD rel_uw_b100 1 100 0 99.9985 FORMAT "%8.5" ECU_ADDRESS 0x3813FA /end MEASUREMENT
/begin MEASUREMENT wdksp_w "Prädizierter Drosselklappen-Sollwinkel" UWORD rel_uw_b100 1 100 0 99.9985 FORMAT "%8.5" ECU_ADDRESS 0x3813FC /end MEASUREMENT
/begin MEASUREMENT wdksv_w "Drosselklappen-Sollwinkel vor Applikationsschnittstelle (ungefiltert)" UWORD rel_uw_b100 1 100 0 99.9985 FORMAT "%8.5" ECU_ADDRESS 0x3813FE /end MEASUREMENT
/begin MEASUREMENT wdks_w "Sollwert Drosselklappenwinkel, bezogen auf (unteren) Anschlag" UWORD rel_uw_b100 1 100 0 99.9985 FORMAT "%8.5" ECU_ADDRESS 0xFA20 /end MEASUREMENT
/begin MEASUREMENT wdkugd_w "Drosselklappenwinkel, bei dem 95% Füllung erreicht wird" UWORD rel_uw_b100 1 100 0 99.9985 FORMAT "%8.5" ECU_ADDRESS 0xFA22 /end MEASUREMENT
/begin MEASUREMENT wea "Winkelmarke Einspritzabbruch" UBYTE zw_ub_q6 1 100 0 1530 FORMAT "%5.0" ECU_ADDRESS 0x380AFB /end MEASUREMENT
/begin MEASUREMENT wee "Winkel Einspritzende im Normalbetrieb" UBYTE zw_ub_q6 1 100 0 1530 FORMAT "%5.0" ECU_ADDRESS 0x380AFC /end MEASUREMENT
/begin MEASUREMENT weenwcnt_w "" UWORD DEZL 1 100 0 65535 FORMAT "%8.2" ECU_ADDRESS 0x38221C /end MEASUREMENT
/begin MEASUREMENT weer "Winkel Einspritzende resultierend" UBYTE WQ720 1 100 0 717.315 FORMAT "%5.1" ECU_ADDRESS 0x380AFD /end MEASUREMENT
/begin MEASUREMENT wf_w "Wandfilmmenge" SWORD rel_sw_q0p1875 1 100 -6144 6143.81 FORMAT "%8.3" ECU_ADDRESS 0x3811E8 /end MEASUREMENT
/begin MEASUREMENT zbale "Abregelfaktor Langzeitanteil bei BA" UBYTE fak_ub_b0p125 1 100 0 0.124512 FORMAT "%6.4" ECU_ADDRESS 0x380B36 /end MEASUREMENT
/begin MEASUREMENT zdteio "I.O.-Zähler für Tankentlüftungsdiagnose" UBYTE dez 1 100 0 255 FORMAT "%5.1" ECU_ADDRESS 0x380D67 /end MEASUREMENT
/begin MEASUREMENT zdtev "Prüfungszähler für TEV-Diagnose" UBYTE dez 1 100 0 255 FORMAT "%5.1" ECU_ADDRESS 0x380D64 /end MEASUREMENT
/begin MEASUREMENT zphnok "Zähler Fehler auf Phasensignal" UBYTE dez 1 100 0 255 FORMAT "%5.1" ECU_ADDRESS 0x380BFB /end MEASUREMENT
/begin MEASUREMENT zphnok2 "Zähler Fehler auf Phasensignal 2" UBYTE dez 1 100 0 255 FORMAT "%5.1" ECU_ADDRESS 0x380BFC /end MEASUREMENT
/begin MEASUREMENT zvale "Abregelfaktor Langzeitanteil bei VA" UBYTE fak_ub_b0p125 1 100 0 0.124512 FORMAT "%6.4" ECU_ADDRESS 0x380B37 /end MEASUREMENT
/begin FUNCTION DMDMIL "Fehlerbehandlung der Aussetzererkennung, Ansteuerung der MIL und Heilung"
 /begin DEF_CHARACTERISTIC AFNTOL AHEAGW AHEAGWS AHEARV AHEKA AHEKS AHEKS1 AINTKA AZYTIAB FASKIV1 KFKSWF MILANTI TMASKIV1 /end DEF_CHARACTERISTIC
 /begin REF_CHARACTERISTIC TMWUC /end REF_CHARACTERISTIC
 /begin IN_MEASUREMENT bbdcy B_cdmd B_pwf B_synph cd_bits1_w nmot rl tmot /end IN_MEASUREMENT
 /begin OUT_MEASUREMENT afnmn afnmx afrlmn afrlmx aftnmn aftnmx aftrlmn aftrlmx aint azycnt bbdmdmil bbsp1 bbsp2 bfnmn bfnmx bfrlmn bfrlmx B_afklt B_aftklt B_aftwrm B_afwrm B_bfklt B_bfwrm B_blkmd B_mdarv B_mdkat B_milmd B_sp1 B_sp2 B_tiab1 B_tiab2 B_tiab3 B_tiab4 B_tiab5 B_tiab6 B_tiab7 B_tiab8 flgtiab fzabgs_w fzabg_w fzarv_w fzkats1_w fzkats2_w fzkats_w fzkat_w ivzabg_w ivzarv_w ivzkat_w kswf /end OUT_MEASUREMENT
 /begin LOC_MEASUREMENT fivzabg flgkat /end LOC_MEASUREMENT
 /begin SUB_FUNCTION /end SUB_FUNCTION
/end FUNCTION
/begin FUNCTION DMDSTP "Diagnose Misfire Detection; Stopbedingungen"
 /begin DEF_CHARACTERISTIC AVRALU DASE_CMD DRLSOLA NGALU NMIALU NMXALU RLSALUN TALUST TAMIALU /end DEF_CHARACTERISTIC
 /begin REF_CHARACTERISTIC SNM08DMUB SRL08DMUB /end REF_CHARACTERISTIC
 /begin IN_MEASUREMENT B_eev esst_snm08dmub esst_srl08dmub nmot rl /end IN_MEASUREMENT
 /begin OUT_MEASUREMENT /end OUT_MEASUREMENT
 /begin LOC_MEASUREMENT B_fofstp B_fonstp B_luena B_lustop B_lustopu B_mddrla B_mdng B_mdnmot B_mdrl B_mdstop_m B_mdtnst /end LOC_MEASUREMENT
 /begin SUB_FUNCTION /end SUB_FUNCTION
/end FUNCTION
/begin FUNCTION DMDTSB "Diagnosis Misfire Detection Segmentzeitbildung" /begin DEF_CHARACTERISTIC KAMFZ /end DEF_CHARACTERISTIC /begin REF_CHARACTERISTIC /end REF_CHARACTERISTIC /begin IN_MEASUREMENT B_trev_inc trevovCtr tseghi tseg_w zzyl /end IN_MEASUREMENT /begin OUT_MEASUREMENT B_tsroov tsroh_w /end OUT_MEASUREMENT /begin LOC_MEASUREMENT /end LOC_MEASUREMENT /begin SUB_FUNCTION /end SUB_FUNCTION /end FUNCTION
/begin FUNCTION DMDUE "Diagnose Misfire Detection Overview (Übersicht)" /begin DEF_CHARACTERISTIC /end DEF_CHARACTERISTIC /begin REF_CHARACTERISTIC /end REF_CHARACTERISTIC /begin IN_MEASUREMENT nmot /end IN_MEASUREMENT /begin OUT_MEASUREMENT /end OUT_MEASUREMENT /begin LOC_MEASUREMENT /end LOC_MEASUREMENT /begin SUB_FUNCTION /end SUB_FUNCTION /end FUNCTION
/begin FUNCTION DMIL "OBDII; MIL-Ansteuerung" /begin DEF_CHARACTERISTIC CWNOMIL TLAED /end DEF_CHARACTERISTIC /begin REF_CHARACTERISTIC /end REF_CHARACTERISTIC
 /begin IN_MEASUREMENT B_blkfb B_blkmd B_milfb B_milmd B_nmot B_nokatfz dfpmMilState /end IN_MEASUREMENT
 /begin OUT_MEASUREMENT B_kmmil B_mil /end OUT_MEASUREMENT
 /begin LOC_MEASUREMENT B_blkeb B_milblk B_mileb B_milst milstat /end LOC_MEASUREMENT
 /begin SUB_FUNCTION /end SUB_FUNCTION
/end FUNCTION
/begin FUNCTION DMILE "OBDII; MIL-Endstufe" /begin DEF_CHARACTERISTIC /end DEF_CHARACTERISTIC /begin REF_CHARACTERISTIC /end REF_CHARACTERISTIC /begin IN_MEASUREMENT B_desee B_mil /end IN_MEASUREMENT /begin OUT_MEASUREMENT /end OUT_MEASUREMENT /begin LOC_MEASUREMENT /end LOC_MEASUREMENT /begin SUB_FUNCTION /end SUB_FUNCTION /end FUNCTION
/begin FUNCTION DMLSE "Diagnose; Endstufenprüfung elektrischer Motorlüfter" /begin DEF_CHARACTERISTIC /end DEF_CHARACTERISTIC /begin REF_CHARACTERISTIC /end REF_CHARACTERISTIC /begin IN_MEASUREMENT B_desee taml /end IN_MEASUREMENT /begin OUT_MEASUREMENT /end OUT_MEASUREMENT /begin LOC_MEASUREMENT /end LOC_MEASUREMENT /begin SUB_FUNCTION /end SUB_FUNCTION /end FUNCTION
/begin FUNCTION DNWS "Diagnose Nockenwellensteuerung"
 /begin DEF_CHARACTERISTIC ASIDNWS ASIDNWSMX KTDWNWS TDNWS TDNWSNOSI TDWNW WNWAIMN WNWAIMX /end DEF_CHARACTERISTIC
 /begin REF_CHARACTERISTIC ANWFLMX /end REF_CHARACTERISTIC
 /begin IN_MEASUREMENT B_cdnws B_cdnws2 B_ftv B_phad B_pwf B_stend B_stv cd_bits2_w jnwfl nwbits tmot tmst wnws wnwsp_w zzyl /end IN_MEASUREMENT
 /begin OUT_MEASUREMENT B_enws /end OUT_MEASUREMENT
 /begin LOC_MEASUREMENT B_ftv2_er B_ftv_er B_stv2_er B_stv_er tdwnws /end LOC_MEASUREMENT
 /begin SUB_FUNCTION /end SUB_FUNCTION
/end FUNCTION
/begin FUNCTION DNWSE "Diagnose; Nockenwellensteuerung Endstufe" /begin DEF_CHARACTERISTIC /end DEF_CHARACTERISTIC /begin REF_CHARACTERISTIC /end REF_CHARACTERISTIC /begin IN_MEASUREMENT B_desee tanwr /end IN_MEASUREMENT /begin OUT_MEASUREMENT /end OUT_MEASUREMENT /begin LOC_MEASUREMENT /end LOC_MEASUREMENT /begin SUB_FUNCTION /end SUB_FUNCTION /end FUNCTION
/begin FUNCTION DPH "Diagnose; Plausibilitätsprüfung Phasensensor" /begin DEF_CHARACTERISTIC PHNOKA /end DEF_CHARACTERISTIC /begin REF_CHARACTERISTIC /end REF_CHARACTERISTIC /begin IN_MEASUREMENT B_st /end IN_MEASUREMENT /begin OUT_MEASUREMENT B_phas2 B_phase B_phsok B_phsok2 phpw phpw2 zphnok zphnok2 /end OUT_MEASUREMENT /begin LOC_MEASUREMENT /end LOC_MEASUREMENT /begin SUB_FUNCTION /end SUB_FUNCTION /end FUNCTION
/begin FUNCTION DSLPE "Diagnose; Sekundärluftpumpe Endstufe" /begin DEF_CHARACTERISTIC /end DEF_CHARACTERISTIC /begin REF_CHARACTERISTIC /end REF_CHARACTERISTIC /begin IN_MEASUREMENT B_desee B_slp /end IN_MEASUREMENT /begin OUT_MEASUREMENT /end OUT_MEASUREMENT /begin LOC_MEASUREMENT /end LOC_MEASUREMENT /begin SUB_FUNCTION /end SUB_FUNCTION /end FUNCTION
/begin FUNCTION DSLSLR "Diagnose Sekundärluftsystem mit Zweipunkt-Lambdaregelung"
 /begin DEF_CHARACTERISTIC CWDSLSY FHODSL FMSLAMN FMSLAMX IMLATDSL IMLATDSLK IMLDSL IMSLADAP MLDSLAMN MLDSLAMX MLDSLKMN MLDSLKMX MLDSLMN MLDSLMX MSLBAS MSLOFMX MSLVMX RMSLADA RMSLMN RMSLPMN RMSLSUMN RMSLTMN TABGMSLAD TANDSLMN TANDSLMX TC6CSL TC6CSL2 TC6CSLN TC6CSLN2 TC6CSLV TC6CSLV2 TDMSLMN1 TDMSLMN4 TDMSLMNK TDMSLO TDMSLOF3 TDMSLOF5 TDMSLOFK TDMSLOK TDMSLV TDMSLVK TDSLMVBA TFIMSLI TFIMSLIK TFIMSLO TFIMSLOK TFIMSLV TFIMSLVK TKATDSL TMDSLAMN TMDSLMN TMDSLMX TNOMF2 TNOMF3 TNOMF5 TWHLSLP TWMLFE TWMSLMIN /end DEF_CHARACTERISTIC
 /begin REF_CHARACTERISTIC /end REF_CHARACTERISTIC
 /begin IN_MEASUREMENT B_bag B_cdsls B_edkvs B_edkvs2 B_enws B_evloc B_fasla B_faslarq B_fasls B_hag B_kha B_lowra B_lrnda B_lrnda2 B_mdarv B_nmot B_pwf B_slp B_slpoff B_sls B_slsadap B_slsfz B_slsoff B_te B_vag fho_w frm2_w frm_w imlatm_w imlpr lamsons2_w lamsons_w mlbb2_w mlbb_w ml_w msabg2_w msabg_w msl msl2 tabgm tans tkatm tmot /end IN_MEASUREMENT
 /begin OUT_MEASUREMENT B_dsla B_dslfa B_dsls B_dslsp4 B_dspe B_esls B_mslmn B_mslpmn B_mslpmn2 B_sla fmsla fmsla2 m6amsl m6cmsl m6cmsl2 m6cmslv m6cmslv2 m6smsl2_w m6smslv2_w m6smslv_w m6smsl_w m6wmsl2_w m6wmslv2_w m6wmslv_w m6wmsl_w slsstat /end OUT_MEASUREMENT
 /begin LOC_MEASUREMENT B_asla B_asla2 B_cwdslt B_cwsla B_dsl B_dsl1 B_dsl1ab B_dsl1e B_dsl2 B_dsl2ab B_dsl2e B_dsl3 B_dsl3ab B_dsl3e B_dsl4 B_dsl4ab B_dsl4e B_dsl5 B_dsl5ab B_dsl5e B_dslerr B_dslm B_dslmab B_dslme B_dslmes B_dslo B_dsloab B_dsloe B_dslt B_dsltab B_dslte B_dsper B_dspes B_errofs B_errofs2 B_mslmin B_mslmin2 B_mslofs B_mslofs2 B_slar B_slas B_szsls B_zsls DSLSLRlokBits1 DSLSLRlokBits2 DSLSLRlokBits3 fmslav fmslav2 mslif mslif2 mslift mslift2 mslnenn mslnenn2 mslnf mslnf2 mslnt mslnt2 mslofs mslofs2 mslt2_w mslt_w mslv mslv2 mslvf mslvf2 mslvft mslvft2 mslvt2_w mslvt_w rmsl rmsl2 rmslt rmslt2 /end LOC_MEASUREMENT
 /begin SUB_FUNCTION /end SUB_FUNCTION
/end FUNCTION
/begin FUNCTION DSLVE "Diagnose; Plausibilitätsprüfung Sekundärluftventil-Endstufe" /begin DEF_CHARACTERISTIC /end DEF_CHARACTERISTIC /begin REF_CHARACTERISTIC /end REF_CHARACTERISTIC /begin IN_MEASUREMENT B_desee B_slv /end IN_MEASUREMENT /begin OUT_MEASUREMENT /end OUT_MEASUREMENT /begin LOC_MEASUREMENT /end LOC_MEASUREMENT /begin SUB_FUNCTION /end SUB_FUNCTION /end FUNCTION
/begin FUNCTION DSTA "Diagnose; Startautomatik Ansteuerung" /begin DEF_CHARACTERISTIC NDSTA TPDSTA TWDSTA /end DEF_CHARACTERISTIC /begin REF_CHARACTERISTIC CWSTA /end REF_CHARACTERISTIC /begin IN_MEASUREMENT B_estart B_kl15 B_pwf nmot /end IN_MEASUREMENT /begin OUT_MEASUREMENT B_enable1 B_ez DstaNvBits /end OUT_MEASUREMENT /begin LOC_MEASUREMENT /end LOC_MEASUREMENT /begin SUB_FUNCTION /end SUB_FUNCTION /end FUNCTION
/begin FUNCTION DSTAE "Endstufendiagnose für Startautomatik" /begin DEF_CHARACTERISTIC /end DEF_CHARACTERISTIC /begin REF_CHARACTERISTIC /end REF_CHARACTERISTIC /begin IN_MEASUREMENT B_desee B_sta /end IN_MEASUREMENT /begin OUT_MEASUREMENT /end OUT_MEASUREMENT /begin LOC_MEASUREMENT /end LOC_MEASUREMENT /begin SUB_FUNCTION /end SUB_FUNCTION /end FUNCTION
/begin FUNCTION DSTS "Diagnose; Startautomatik Signaleingang" /begin DEF_CHARACTERISTIC NDSTS TWDSTS /end DEF_CHARACTERISTIC /begin REF_CHARACTERISTIC CWSTA /end REF_CHARACTERISTIC /begin IN_MEASUREMENT B_estart nmot_w tnst_w /end IN_MEASUREMENT /begin OUT_MEASUREMENT /end OUT_MEASUREMENT /begin LOC_MEASUREMENT /end LOC_MEASUREMENT /begin SUB_FUNCTION /end SUB_FUNCTION /end FUNCTION
/begin FUNCTION DSWEC "Schlechtwegerk. aus Rad-Beschl.,-> mittels CAN von ABS SG zu Motronic" /begin DEF_CHARACTERISTIC FABSALU FIBSALU FSWALUV /end DEF_CHARACTERISTIC /begin REF_CHARACTERISTIC /end REF_CHARACTERISTIC /begin IN_MEASUREMENT bsc B_cdswe vfzg /end IN_MEASUREMENT /begin OUT_MEASUREMENT B_swe /end OUT_MEASUREMENT /begin LOC_MEASUREMENT bssp B_swev /end LOC_MEASUREMENT /begin SUB_FUNCTION /end SUB_FUNCTION /end FUNCTION
/begin FUNCTION DTEVE "Diagnose; Tankentlüftungsventil - Endstufe" /begin DEF_CHARACTERISTIC /end DEF_CHARACTERISTIC /begin REF_CHARACTERISTIC /end REF_CHARACTERISTIC /begin IN_MEASUREMENT B_desee tateout /end IN_MEASUREMENT /begin OUT_MEASUREMENT B_atev B_ztev /end OUT_MEASUREMENT /begin LOC_MEASUREMENT /end LOC_MEASUREMENT /begin SUB_FUNCTION /end SUB_FUNCTION /end FUNCTION
/begin FUNCTION DTEVN "Diagnose Tankentlüftungsventil (OBDII)"
 /begin DEF_CHARACTERISTIC AIMDTED AIODTEX APDTEX DMITED DNSTED FTETEDF FTETEDM HTEDU INTEDO INTEDU NSTEDMX RLTEDMX TBTEVIO TMTED TNODTEV TNODTEVT TTEDA TTEDBA TTEDIV TTEDN TWKODTE ZMVDTE ZNTED /end DEF_CHARACTERISTIC
 /begin REF_CHARACTERISTIC TTEGAI TTEINI /end REF_CHARACTERISTIC
 /begin IN_MEASUREMENT B_cdtes B_dmtltz B_druck B_dsls B_edkvs B_edkvs2 B_enws B_fa B_fates B_frao B_frau B_kh B_ko B_kw B_ll B_lowra B_lr B_lr2 B_mdarv B_pwf B_rkat B_rkaz B_stend B_tei cd_bits1_w fho ftead_w mdverl_w milsol_w mstesoll_w nmot_w nsol rl tmot vfzg /end IN_MEASUREMENT
 /begin OUT_MEASUREMENT B_dteaa B_dtebn B_dtes B_dtest tadtea tbtevio_c tc6tesc tc6tess tc6tesw tesstat twkodte_c zdteio zdtev /end OUT_MEASUREMENT
 /begin LOC_MEASUREMENT B_dteabr B_dtean B_dteaq B_dtebel B_dtei B_dtesq B_dtevio dmidte dndte dnsdte DTEVNbits dtevphc_w indte midter mvdtehp nsdter ntpdte ntpdter tdten_w /end LOC_MEASUREMENT
 /begin SUB_FUNCTION /end SUB_FUNCTION
/end FUNCTION
/begin FUNCTION DTHM "Diagnose Thermostat Motor-Kühlmittel"
 /begin DEF_CHARACTERISTIC CWDTHM DTDTHM DTHMDTKA IDTHMU KLTATHMKA NDTHMO NDTHMU TDTHM TMSDTHMU TTHMDMX VDTHMU /end DEF_CHARACTERISTIC
 /begin REF_CHARACTERISTIC /end REF_CHARACTERISTIC
 /begin IN_MEASUREMENT B_ll B_lowra B_mxmntm B_nmot B_sa B_stend B_tmdmme imlatm nmot tans tka tmotlin tmst vfzg /end IN_MEASUREMENT
 /begin OUT_MEASUREMENT /end OUT_MEASUREMENT
 /begin LOC_MEASUREMENT B_bbdthm B_cwdthm B_ethmr B_ethms B_zthms DTHMlokBits /end LOC_MEASUREMENT
 /begin SUB_FUNCTION /end SUB_FUNCTION
/end FUNCTION
/begin FUNCTION DTIP "OBDII; Tester-Interface Package" /begin DEF_CHARACTERISTIC /end DEF_CHARACTERISTIC /begin REF_CHARACTERISTIC /end REF_CHARACTERISTIC /begin IN_MEASUREMENT cw_erfil fcmEnd FCMTab /end IN_MEASUREMENT /begin OUT_MEASUREMENT ffzdfp /end OUT_MEASUREMENT /begin LOC_MEASUREMENT /end LOC_MEASUREMENT /begin SUB_FUNCTION /end SUB_FUNCTION /end FUNCTION
/begin FUNCTION DTOP "Diagnose; Betriebszeit" /begin DEF_CHARACTERISTIC /end DEF_CHARACTERISTIC /begin REF_CHARACTERISTIC /end REF_CHARACTERISTIC /begin IN_MEASUREMENT B_nmot B_pwf /end IN_MEASUREMENT /begin OUT_MEASUREMENT top_w /end OUT_MEASUREMENT /begin LOC_MEASUREMENT /end LOC_MEASUREMENT /begin SUB_FUNCTION /end SUB_FUNCTION /end FUNCTION
/begin FUNCTION DTRIG "OBDII; Auswählbare Trigger für Fehlerpfad-Management" /begin DEF_CHARACTERISTIC /end DEF_CHARACTERISTIC /begin REF_CHARACTERISTIC /end REF_CHARACTERISTIC /begin IN_MEASUREMENT bbdcy bbno bbsp1 bbsp2 bbsp3 bbtim bbwuc /end IN_MEASUREMENT /begin OUT_MEASUREMENT /end OUT_MEASUREMENT /begin LOC_MEASUREMENT /end LOC_MEASUREMENT /begin SUB_FUNCTION /end SUB_FUNCTION /end FUNCTION
/begin FUNCTION DU5REF "Diagnose: Überwachung interne 5 V Spannungsversorung" /begin DEF_CHARACTERISTIC TDU5REF U5REFMN /end DEF_CHARACTERISTIC /begin REF_CHARACTERISTIC /end REF_CHARACTERISTIC /begin IN_MEASUREMENT iUrefsp1_w /end IN_MEASUREMENT /begin OUT_MEASUREMENT u5ref1 u5ref2 /end OUT_MEASUREMENT /begin LOC_MEASUREMENT u5ref1_w u5ref2_w /end LOC_MEASUREMENT /begin SUB_FUNCTION /end SUB_FUNCTION /end FUNCTION
/begin FUNCTION DUF "Diagnose aus der Funktionsüberwachung" /begin DEF_CHARACTERISTIC DUF_T NMN_DUF /end DEF_CHARACTERISTIC /begin REF_CHARACTERISTIC /end REF_CHARACTERISTIC
 /begin IN_MEASUREMENT B_fgr B_fgr_um B_hfm B_i_ska_um B_mibeg B_msr B_noacc_um B_nomsr_um B_notlu_fr B_pwgnotfr B_sp1s B_sp2s B_spsmin B_ub_ok B_wdk2sel ei_adcc_um ei_ipa_um ei_mver_um ei_nc_um ei_reac_um ei_rlc_um ei_rlip_um ei_spsc_um ei_zwc_um mi_um nmot_um /end IN_MEASUREMENT
 /begin OUT_MEASUREMENT egaspfad mi_duf mpfad skapfad /end OUT_MEASUREMENT
 /begin LOC_MEASUREMENT /end LOC_MEASUREMENT
 /begin SUB_FUNCTION /end SUB_FUNCTION
/end FUNCTION
/begin FUNCTION DUMMY_D "" /begin DEF_CHARACTERISTIC /end DEF_CHARACTERISTIC /begin REF_CHARACTERISTIC /end REF_CHARACTERISTIC /begin IN_MEASUREMENT B_synph /end IN_MEASUREMENT /begin OUT_MEASUREMENT B_crdmtl B_tankd evsup0 slp_an vstvvr /end OUT_MEASUREMENT /begin LOC_MEASUREMENT /end LOC_MEASUREMENT /begin SUB_FUNCTION /end SUB_FUNCTION /end FUNCTION
/begin FUNCTION DUMWEX "Diagose; Erweiterte Umweltbedingumgen" /begin DEF_CHARACTERISTIC /end DEF_CHARACTERISTIC /begin REF_CHARACTERISTIC /end REF_CHARACTERISTIC /begin IN_MEASUREMENT kmstand /end IN_MEASUREMENT /begin OUT_MEASUREMENT /end OUT_MEASUREMENT /begin LOC_MEASUREMENT /end LOC_MEASUREMENT /begin SUB_FUNCTION /end SUB_FUNCTION /end FUNCTION
/begin FUNCTION DUR "Diagnose aus der Rechnerüberwachung" /begin DEF_CHARACTERISTIC /end DEF_CHARACTERISTIC /begin REF_CHARACTERISTIC /end REF_CHARACTERISTIC /begin IN_MEASUREMENT /end IN_MEASUREMENT /begin OUT_MEASUREMENT rstpfad /end OUT_MEASUREMENT /begin LOC_MEASUREMENT rstMon_um /end LOC_MEASUREMENT /begin SUB_FUNCTION /end SUB_FUNCTION /end FUNCTION
/begin FUNCTION DVFZ "Diagnose: Plausibilitätsprüfung Fahrzeuggeschwindigkeit" /begin DEF_CHARACTERISTIC NDV NDVO TDV TMDV VDMN /end DEF_CHARACTERISTIC /begin REF_CHARACTERISTIC /end REF_CHARACTERISTIC /begin IN_MEASUREMENT B_lowra B_sa nmot tmot vfzroh_w /end IN_MEASUREMENT /begin OUT_MEASUREMENT /end OUT_MEASUREMENT /begin LOC_MEASUREMENT /end LOC_MEASUREMENT /begin SUB_FUNCTION /end SUB_FUNCTION /end FUNCTION
/begin FUNCTION DWUC "OBDII; Erfüllung Bedingung 'warm up cycle'" /begin DEF_CHARACTERISTIC DTMWUC TMWUC TMWUCST /end DEF_CHARACTERISTIC /begin REF_CHARACTERISTIC /end REF_CHARACTERISTIC /begin IN_MEASUREMENT B_stend tmot /end IN_MEASUREMENT /begin OUT_MEASUREMENT bbwuc B_wuc /end OUT_MEASUREMENT /begin LOC_MEASUREMENT tmstem /end LOC_MEASUREMENT /begin SUB_FUNCTION /end SUB_FUNCTION /end FUNCTION
/begin FUNCTION EA "Einspritzart" /begin DEF_CHARACTERISTIC KFWEE KFWEEK WEAN WEEM WEESTM WEESTN WEEVLN ZZWEETM /end DEF_CHARACTERISTIC /begin REF_CHARACTERISTIC /end REF_CHARACTERISTIC /begin IN_MEASUREMENT B_stend B_vl nmot rl tmot tmst vsvw wnwem zzyl /end IN_MEASUREMENT /begin OUT_MEASUREMENT wea wee weer /end OUT_MEASUREMENT /begin LOC_MEASUREMENT weenwcnt_w /end LOC_MEASUREMENT /begin SUB_FUNCTION /end SUB_FUNCTION /end FUNCTION
/begin FUNCTION EASTT "Einspritzart Start" /begin DEF_CHARACTERISTIC WEESTM WEESTN WEESTS WESBM ZTPREL /end DEF_CHARACTERISTIC /begin REF_CHARACTERISTIC /end REF_CHARACTERISTIC /begin IN_MEASUREMENT /end IN_MEASUREMENT /begin OUT_MEASUREMENT /end OUT_MEASUREMENT /begin LOC_MEASUREMENT /end LOC_MEASUREMENT /begin SUB_FUNCTION /end SUB_FUNCTION /end FUNCTION
/begin FUNCTION EEDAT "Daten im EEPROM" /begin DEF_CHARACTERISTIC /end DEF_CHARACTERISTIC /begin REF_CHARACTERISTIC /end REF_CHARACTERISTIC
 /begin IN_MEASUREMENT B_ndsav B_pwf frao2_w frao_w frau2_w frau_w rkat2_w rkat_w rkaz2_w rkaz_w /end IN_MEASUREMENT
 /begin OUT_MEASUREMENT B_eepdif /end OUT_MEASUREMENT
 /begin LOC_MEASUREMENT /end LOC_MEASUREMENT
 /begin SUB_FUNCTION /end SUB_FUNCTION
/end FUNCTION
/begin FUNCTION _EEPROM "EEPROM-Behandlung" /begin DEF_CHARACTERISTIC /end DEF_CHARACTERISTIC /begin REF_CHARACTERISTIC /end REF_CHARACTERISTIC /begin IN_MEASUREMENT /end IN_MEASUREMENT /begin OUT_MEASUREMENT /end OUT_MEASUREMENT /begin LOC_MEASUREMENT /end LOC_MEASUREMENT /begin SUB_FUNCTION /end SUB_FUNCTION /end FUNCTION
/begin FUNCTION ELS "E-Box Lüfter Steuerung" /begin DEF_CHARACTERISTIC DTEBLEIN TEBLEIN TTEBL /end DEF_CHARACTERISTIC /begin REF_CHARACTERISTIC /end REF_CHARACTERISTIC /begin IN_MEASUREMENT B_nmot tsg /end IN_MEASUREMENT /begin OUT_MEASUREMENT /end OUT_MEASUREMENT /begin LOC_MEASUREMENT B_ebl /end LOC_MEASUREMENT /begin SUB_FUNCTION /end SUB_FUNCTION /end FUNCTION
/begin FUNCTION EPRL "Entprellung Drehzahlgebersignal" /begin DEF_CHARACTERISTIC CWPREL TPRELNS TPRELRENS ZPRELNS /end DEF_CHARACTERISTIC /begin REF_CHARACTERISTIC /end REF_CHARACTERISTIC /begin IN_MEASUREMENT B_autget B_estart ttooth10msCtr /end IN_MEASUREMENT /begin OUT_MEASUREMENT B_resta B_retime B_zahn B_zeit /end OUT_MEASUREMENT /begin LOC_MEASUREMENT /end LOC_MEASUREMENT /begin SUB_FUNCTION /end SUB_FUNCTION /end FUNCTION
/begin FUNCTION ESGRU "Grundeinspritzungen" /begin DEF_CHARACTERISTIC FRKAP KFANS KFLF /end DEF_CHARACTERISTIC /begin REF_CHARACTERISTIC /end REF_CHARACTERISTIC /begin IN_MEASUREMENT ml nmot rl tans vsfrk /end IN_MEASUREMENT /begin OUT_MEASUREMENT fgru /end OUT_MEASUREMENT /begin LOC_MEASUREMENT /end LOC_MEASUREMENT /begin SUB_FUNCTION /end SUB_FUNCTION /end FUNCTION
/begin FUNCTION ESKS "Klopfschutz Einspritzung (Katalysatorschutz)" /begin DEF_CHARACTERISTIC FKKSN FVKKSN KFZWKS TMKS TVKS WKSVN /end DEF_CHARACTERISTIC /begin REF_CHARACTERISTIC /end REF_CHARACTERISTIC /begin IN_MEASUREMENT B_vl nmot rl tmot zwout zzyl /end IN_MEASUREMENT /begin OUT_MEASUREMENT B_kse fks /end OUT_MEASUREMENT /begin LOC_MEASUREMENT /end LOC_MEASUREMENT /begin SUB_FUNCTION /end SUB_FUNCTION /end FUNCTION
/begin FUNCTION ESNST "Einspritzung Nachstart"
 /begin DEF_CHARACTERISTIC ANZTIBMX FNSA FNSSM FWSTAA1 FWSTAA2 FWSTAA3 FWSTAA4 FZANSSA1 FZANSSA2 FZANSSM1 FZANSSM2 KFLANS KFNSWRL KFWWNS SZANSSM ZDGZA1 ZDGZA2 /end DEF_CHARACTERISTIC
 /begin REF_CHARACTERISTIC SAN12ESUW SKS06ESUB STA06ESUB STS12ESUB /end REF_CHARACTERISTIC
 /begin IN_MEASUREMENT anzti_w B_hst B_st B_staa B_stend B_wks ESSTTbits esst_san12esuw esst_sks06esub esst_sta06esub esst_sts12esub kstaa rl tabst_w tans tmst /end IN_MEASUREMENT
 /begin OUT_MEASUREMENT anztib_w B_lamnse fns lamns_w /end OUT_MEASUREMENT
 /begin LOC_MEASUREMENT fktns fzans1 fzans2 nsactr nsactr1 nsactr2 /end LOC_MEASUREMENT
 /begin SUB_FUNCTION /end SUB_FUNCTION
/end FUNCTION
/begin FUNCTION ESNWS "Nockenwellensteuerung Gemischkorrektur" /begin DEF_CHARACTERISTIC DTWNWS KFFWNW ZKWNW /end DEF_CHARACTERISTIC /begin REF_CHARACTERISTIC TWNWS /end REF_CHARACTERISTIC /begin IN_MEASUREMENT B_ll B_wnws tmot tnst_w wnwue /end IN_MEASUREMENT /begin OUT_MEASUREMENT fwnw /end OUT_MEASUREMENT /begin LOC_MEASUREMENT B_esnws /end LOC_MEASUREMENT /begin SUB_FUNCTION /end SUB_FUNCTION /end FUNCTION
/begin FUNCTION ESSTT "Einspritzzeit Start"
 /begin DEF_CHARACTERISTIC ANZTIWS CWESSTT FHSTT FKSTT IMLHS KFFWST KFWHSTT KFWKSTN KFWKSTT KLFWST TANDT TMH TMHSG TWSTT /end DEF_CHARACTERISTIC
 /begin REF_CHARACTERISTIC /end REF_CHARACTERISTIC
 /begin IN_MEASUREMENT anzti_w B_pwf B_st B_stend imlatm kstaa nmot tabst_w tans tansab tistzyl tmotab tmst tnse_w zzyl /end IN_MEASUREMENT
 /begin OUT_MEASUREMENT B_hst B_vbemg B_wks B_wst ESSTTbits fst_w tmlauf_w /end OUT_MEASUREMENT
 /begin LOC_MEASUREMENT anztist B_vbmg fst0_w tstlauf_w /end LOC_MEASUREMENT
 /begin SUB_FUNCTION /end SUB_FUNCTION
/end FUNCTION
/begin FUNCTION ESTI "Einspritzung ti-Bildung" /begin DEF_CHARACTERISTIC TVUB /end DEF_CHARACTERISTIC /begin REF_CHARACTERISTIC /end REF_CHARACTERISTIC /begin IN_MEASUREMENT /end IN_MEASUREMENT /begin OUT_MEASUREMENT /end OUT_MEASUREMENT /begin LOC_MEASUREMENT B_NWS /end LOC_MEASUREMENT /begin SUB_FUNCTION /end SUB_FUNCTION /end FUNCTION
/begin FUNCTION ESUK "Einspritzung Übergangskompensation"
 /begin DEF_CHARACTERISTIC DUKK FUKNSTM FVANST FWFN KFABAK KFAVAK KFBAKL KFVAKL RKBAU RKUKKLU RKVAU TNSUUK WFRL ZBALM ZUKK ZUKNST ZVALM /end DEF_CHARACTERISTIC
 /begin REF_CHARACTERISTIC SNM07ESUB STM09ESUB /end REF_CHARACTERISTIC
 /begin IN_MEASUREMENT anzti B_ll B_nswo3 B_sa B_st B_stend drlp_w esst_snm07esub esst_stm09esub fuka nmot nmot_w rlp_w tmot tmst vstfba vstfva /end IN_MEASUREMENT
 /begin OUT_MEASUREMENT B_ba B_bag B_ukg B_va B_vag rkukg_w /end OUT_MEASUREMENT
 /begin LOC_MEASUREMENT abak anztis avak B_redkl B_uk1 B_ukk B_ukns B_vaau B_vakl B_val B_wf dwfk_w dwfl_w dwf_w fbakl_w fbans fbans_w fvakl_w fvans rkukkl_w rkukk_w rkukl_w sdwfk_w sdwfl_w wf_w zbale zvale /end LOC_MEASUREMENT
 /begin SUB_FUNCTION /end SUB_FUNCTION
/end FUNCTION
/begin FUNCTION ESWE "Einspritzung Schubabschalten Wiedereinsetzen" /begin DEF_CHARACTERISTIC FIMHU FIMWU /end DEF_CHARACTERISTIC /begin REF_CHARACTERISTIC /end REF_CHARACTERISTIC /begin IN_MEASUREMENT B_ll B_sa zzyl /end IN_MEASUREMENT /begin OUT_MEASUREMENT fwe nwCtr /end OUT_MEASUREMENT /begin LOC_MEASUREMENT /end LOC_MEASUREMENT /begin SUB_FUNCTION /end SUB_FUNCTION /end FUNCTION
/begin FUNCTION ESWL "Einspritzung Warmlauf" /begin DEF_CHARACTERISTIC ATISLATM KFFWL KFFWLW KFLASWLR LASWLTM ZKLANSWL /end DEF_CHARACTERISTIC /begin REF_CHARACTERISTIC SNM12ESUB SRL12ESUB STM12ESUB STS12ESUB /end REF_CHARACTERISTIC
 /begin IN_MEASUREMENT anztib_w B_lrnda B_lrnda2 B_stend esst_snm12esub esst_srl12esub esst_stm12esub esst_sts12esub lamns_w nmot rl tmot tmst /end IN_MEASUREMENT
 /begin OUT_MEASUREMENT fwl lamnswl_w /end OUT_MEASUREMENT
 /begin LOC_MEASUREMENT lamwl_w /end LOC_MEASUREMENT
 /begin SUB_FUNCTION /end SUB_FUNCTION
/end FUNCTION
/begin FUNCTION ETR "Elektrische Thermostatregelung"
 /begin DEF_CHARACTERISTIC DTANSETR DTMETR DVFZETR KFETRD KFETRT TAETRMN TVETRA TVETRE TWETRS VFZETR /end DEF_CHARACTERISTIC
 /begin REF_CHARACTERISTIC /end REF_CHARACTERISTIC
 /begin IN_MEASUREMENT B_etret B_faetr B_got B_ntkw B_vl tans tmot vfzg wdkba /end IN_MEASUREMENT
 /begin OUT_MEASUREMENT B_etr /end OUT_MEASUREMENT
 /begin LOC_MEASUREMENT B_etrtam B_etrvfzg /end LOC_MEASUREMENT
 /begin SUB_FUNCTION /end SUB_FUNCTION
/end FUNCTION
/begin FUNCTION FGRAUS "Abschaltung Fahrgeschwindigkeitsregler" /begin DEF_CHARACTERISTIC DMRFGRAL MRFGRMAX TFGRARLG /end DEF_CHARACTERISTIC /begin REF_CHARACTERISTIC /end REF_CHARACTERISTIC /begin IN_MEASUREMENT B_fgr B_fgras B_fgren B_fgrver gangi mrfgrv_w /end IN_MEASUREMENT /begin OUT_MEASUREMENT mrfgr_w /end OUT_MEASUREMENT /begin LOC_MEASUREMENT B_fgrari dmrar_w mrfgru_w /end LOC_MEASUREMENT /begin SUB_FUNCTION /end SUB_FUNCTION /end FUNCTION
/begin FUNCTION FGRMD "Funktionslogik und Regelalgorithmus Fahrgeschwindigkeitsregler"
 /begin DEF_CHARACTERISTIC ANZTPMX BRABEVI BRATD BRATU BRAWA1GA BRAWA2GA BRAWA3GA BRAWAVI CWFGRMD DVIVZTMX DVSAVO DVSAVU DVSKNBGA DVSKNVGA DVTIPUD DVZVITMX DVZVIWA DVZVRWA1 DVZVRWA2 DVZVRWA3 KFVOFFS KKFFGRGA KRAFGRGA MRFGRMR MRFGRSTA MRMRFGR TFGRTP TN2FGRGA TSWKNBGA TSWKNVGA TVLADV TZ2FGRGA VLMXVZ /end DEF_CHARACTERISTIC
 /begin REF_CHARACTERISTIC MRFGRMAX VFGRMAX VFGRMIN VREGLMAX VREGLMIN /end REF_CHARACTERISTIC
 /begin IN_MEASUREMENT B_acc B_fgr B_fgrenv B_fgresv B_fgrhsa B_fgrtbe B_fgrtse B_fgrtve B_fgrtwa gangi mrfgr_w mrped_w vfgr_w vfzg_w /end IN_MEASUREMENT
 /begin OUT_MEASUREMENT B_fgrene B_fgrkfm B_fgrvem B_savm mrfgrm_w mrregl_w mrrgli_w vziel_w /end OUT_MEASUREMENT
 /begin LOC_MEASUREMENT anztpdn anztpup B_besch B_fgrakt B_fgrdvi B_fgrra B_kfnb B_kfnv B_swknb B_swknv B_tbenh B_tbent B_tbep B_tbeph B_tpderl B_tpdn B_tpuerl B_tpup B_tsenh B_tsent B_tvenh B_tvent B_tvep B_tveph B_twap B_uebetu B_uebrkf B_uebvau B_uevztd B_wavo B_wiauf dvrabe_w dvrave_w dvzvi_w FGRMDlokBits1 FGRMDlokBits2 kfgr_w mrfgri_w tn2fgr_w tz2fgr_w vlast_w voffs_w vrbemx_w vregl_w vrvemn_w /end LOC_MEASUREMENT
 /begin SUB_FUNCTION /end SUB_FUNCTION
/end FUNCTION
/begin FUNCTION FGRUE "Übersicht Fahrgeschwindigkeitsregler" /begin DEF_CHARACTERISTIC /end DEF_CHARACTERISTIC /begin REF_CHARACTERISTIC /end REF_CHARACTERISTIC
 /begin IN_MEASUREMENT B_acc B_fgrene B_fgrenv B_fgrkfm B_fgrvem B_savacc B_savm mracc_w mrfgrm_w /end IN_MEASUREMENT
 /begin OUT_MEASUREMENT B_fgren B_fgrkf B_fgrver B_savfgr mrfgrv_w /end OUT_MEASUREMENT
 /begin LOC_MEASUREMENT /end LOC_MEASUREMENT
 /begin SUB_FUNCTION /end SUB_FUNCTION
/end FUNCTION
/begin FUNCTION FUEDK "Füllungssteuerung (Berechnung DK-Sollwinkel)"
 /begin DEF_CHARACTERISTIC DPUPS FPWDKAPP KFWDKMSN NRLMN TFUPI TFUPS TVWDKS TWDKSV WDKSAPP WDKUGDN /end DEF_CHARACTERISTIC
 /begin REF_CHARACTERISTIC KLAF KUMSRL SNM12FEUB _TURBO /end REF_CHARACTERISTIC
 /begin IN_MEASUREMENT B_fpwdkap B_pwf B_wdksap drlfue_w esst_snm12feub frhodk_w fupsrl_w klaf_kge milsol_w mrfuemx_w mrfue_w msndko_w mste_w nmot nmot_w pirg_w pspvdk_w pu_w pvdk_w rfagr_w rlsol_w umsrln_w wped_w /end IN_MEASUREMENT
 /begin OUT_MEASUREMENT B_ugd dwdks_w plsol plsol_w pssol_w pvdkr_w wdks wdksp_w wdksv_w wdks_w wdkugd_w /end OUT_MEASUREMENT
 /begin LOC_MEASUREMENT B_ldrugd B_ugdb B_ugds B_ugdset frhodkr_w mldkns_w mldks_w mlsol_w mlwdkns_w pspvmin_w psspvdk_w rlsolk_w tfwdks_w wdksgv_w /end LOC_MEASUREMENT
 /begin SUB_FUNCTION /end SUB_FUNCTION
/end FUNCTION
/begin FUNCTION ggairb "Gebergröße Airbag" /begin DEF_CHARACTERISTIC TCEKP /end DEF_CHARACTERISTIC /begin REF_CHARACTERISTIC /end REF_CHARACTERISTIC /begin IN_MEASUREMENT B_ins3cok B_nmot ekpausc /end IN_MEASUREMENT /begin OUT_MEASUREMENT B_airbag /end OUT_MEASUREMENT /begin LOC_MEASUREMENT /end LOC_MEASUREMENT /begin SUB_FUNCTION /end SUB_FUNCTION /end FUNCTION
/begin FUNCTION GGDG "Gebergrößen: Drehzahlgeber und Bezugsmarkengeber" /begin DEF_CHARACTERISTIC /end DEF_CHARACTERISTIC /begin REF_CHARACTERISTIC /end REF_CHARACTERISTIC /begin IN_MEASUREMENT /end IN_MEASUREMENT /begin OUT_MEASUREMENT /end OUT_MEASUREMENT /begin LOC_MEASUREMENT NIST /end LOC_MEASUREMENT /begin SUB_FUNCTION /end SUB_FUNCTION /end FUNCTION
/begin FUNCTION GGDMTL "Gebergroesse DM-TL" /begin DEF_CHARACTERISTIC RPTES /end DEF_CHARACTERISTIC /begin REF_CHARACTERISTIC /end REF_CHARACTERISTIC /begin IN_MEASUREMENT B_cddmtl uuptes_w /end IN_MEASUREMENT /begin OUT_MEASUREMENT iptes_w uptes_w /end OUT_MEASUREMENT /begin LOC_MEASUREMENT /end LOC_MEASUREMENT /begin SUB_FUNCTION /end SUB_FUNCTION /end FUNCTION
/begin FUNCTION GGDSAS "Gebergröße Drucksensoren außerhalb Saugrohr"
 /begin DEF_CHARACTERISTIC DPDSVLU DPUPVDK DSUGRAD DSUOFS FHOE NDSVLO NDSVLU PUE PUMN PUMX PUSPSMX TDDFU TDDFUUGD UADPUMN UADPUMX WDKDSVLU ZDSU /end DEF_CHARACTERISTIC
 /begin REF_CHARACTERISTIC /end REF_CHARACTERISTIC
 /begin IN_MEASUREMENT B_nmot ftu ml_w nmot plsol_w pspvdk_w pssol_w ps_w udsl_w udsu_w wdkba /end IN_MEASUREMENT
 /begin OUT_MEASUREMENT B_edsl B_edsuu B_hag fho fho_w fpvdkds fpvdkds_w frhol_w GgdsasNvBits pu pus_w pu_w pvdkds pvdkds_w pvdkmx_w pvdkspud pvdks_w /end OUT_MEASUREMENT
 /begin LOC_MEASUREMENT dpvdkspu_w fpvdkdsl_w fpvdkdsu_w ldfki_w psspvdkd_w pvdkdsl_w pvdkdsu_w /end LOC_MEASUREMENT
 /begin SUB_FUNCTION /end SUB_FUNCTION
/end FUNCTION
/begin FUNCTION GGDVE "Gebergrößen Drosselklappensteller"
 /begin DEF_CHARACTERISTIC DUDKP1HY DWDK12O DWDK13O DWDK23O KFWDKPP NDKPPU RLVPPMXN TPNSE TVAWDKP1 TVAWDKP2 TVAWF12 TVPDKP1 TVPDKP2 TVPWDK12 TVPWDK13 TVPWDK23 UBVDKPO UBVDKPU UDKP1O UDKP1U UDKP2O UDKP2U /end DEF_CHARACTERISTIC
 /begin REF_CHARACTERISTIC /end REF_CHARACTERISTIC
 /begin IN_MEASUREMENT B_dkpu B_st B_stend B_ubpvg dkpstg_w E_lm fpvdkds ftvdk nmot rl ub udkp1a_w udkp1sv udkp1vo_w udkp1vv_w udkp1v_w udkp1_w udkp2a_w udkp2_w /end IN_MEASUREMENT
 /begin OUT_MEASUREMENT B_dknot B_dkpaw B_dkunb B_wdk1v B_wdk2sel dwdkba_w wdkba wdkba_w /end OUT_MEASUREMENT
 /begin LOC_MEASUREMENT B_dkp1e B_dkp1mn B_dkp1mx B_dkp1np B_dkp2e B_dkp2mn B_dkp2mx B_dkp2np B_rlvugd rlvppl rlvppmx wdk1_w wdk2_w wdk3 /end LOC_MEASUREMENT
 /begin SUB_FUNCTION /end SUB_FUNCTION
/end FUNCTION
/begin FUNCTION GGEGAS "Gebergröße Brems- und Kupplungsschalter" /begin DEF_CHARACTERISTIC CWGGEGAS TSTAEBR TVERBR TVKUP ZERBR /end DEF_CHARACTERISTIC /begin REF_CHARACTERISTIC /end REF_CHARACTERISTIC /begin IN_MEASUREMENT B_autget B_pwf S_bls S_brs S_kupp /end IN_MEASUREMENT /begin OUT_MEASUREMENT B_br2k B_brems B_kuppl B_kupplv ctrerbr /end OUT_MEASUREMENT /begin LOC_MEASUREMENT B_bl B_br B_erbr B_staebr /end LOC_MEASUREMENT /begin SUB_FUNCTION /end SUB_FUNCTION /end FUNCTION
/begin COMPU_METHOD accgrd_ub_b555p55 "" RAT_FUNC "%6.2" "m/(s^3)" COEFFS 0 1 0 0 0 2.17 /end COMPU_METHOD
/begin COMPU_METHOD acc_ub_b55p55 "" RAT_FUNC "%6.3" "m/(s^2)" COEFFS 0 1 0 0 0 0.217 /end COMPU_METHOD
/begin COMPU_METHOD acc_uw_b55p55 "" RAT_FUNC "%6.5" "m/(s^2)" COEFFS 0 147456 0 0 0 125 /end COMPU_METHOD
/begin COMPU_METHOD bfzg_ub_b27p67 "" RAT_FUNC "%6.3" "m/s^2" COEFFS 0 256 0 0 0 27.67 /end COMPU_METHOD
/begin COMPU_METHOD bfzg_uw_q0p1085 "" RAT_FUNC "%6.3" "m/s^2" COEFFS 0 1 0 0 0 0.1085 /end COMPU_METHOD
/begin COMPU_METHOD B_TRUE "boolsche Zustände, positive Logik" TAB_VERB "%6.3" "" COMPU_TAB_REF B_TRUE /end COMPU_METHOD
/begin COMPU_VTAB B_TRUE "boolsche Zustände, positive Logik" TAB_VERB 2 0 "----" 1 "TRUE" /end COMPU_VTAB
/begin COMPU_METHOD DEZ "1 : 1 Umrechnug (dez/hex)" RAT_FUNC "%6.2" "" COEFFS 0 1 0 0 0 1 /end COMPU_METHOD
/begin COMPU_METHOD dez "1 : 1 Umrechnug (dez/hex)" RAT_FUNC "%6.2" "" COEFFS 0 1 0 0 0 1 /end COMPU_METHOD
/begin COMPU_METHOD DEZL "Dezimalzahl in 16-Bit-Hexzahl" RAT_FUNC "%6.2" "" COEFFS 0 1 0 0 0 1 /end COMPU_METHOD
/begin COMPU_METHOD dgrad_uw_q0p015 "" RAT_FUNC "%6.4" "hPa/V" COEFFS 0 65536 0 0 0 1024 /end COMPU_METHOD
/begin COMPU_METHOD fak_sb_b1 "" RAT_FUNC "%6.4" "-" COEFFS 0 256 0 0 0 2 /end COMPU_METHOD
/begin COMPU_METHOD fak_sw_b256 "" RAT_FUNC "%6.4" "-" COEFFS 0 65536 0 0 0 512 /end COMPU_METHOD
/begin COMPU_METHOD fak_sw_b64 "" RAT_FUNC "%6.4" "-" COEFFS 0 65536 0 0 0 128 /end COMPU_METHOD
/begin COMPU_METHOD fak_ub_b0p125 "" RAT_FUNC "%6.5" "-" COEFFS 0 256 0 0 0 0.125 /end COMPU_METHOD
/begin COMPU_METHOD fak_ub_b0p25 "" RAT_FUNC "%6.5" "-" COEFFS 0 256 0 0 0 0.25 /end COMPU_METHOD
/begin COMPU_METHOD fak_ub_b1 "" RAT_FUNC "%6.4" "-" COEFFS 0 256 0 0 0 1 /end COMPU_METHOD
/begin COMPU_METHOD fak_ub_b16 "" RAT_FUNC "%6.4" "-" COEFFS 0 256 0 0 0 16 /end COMPU_METHOD
/begin COMPU_METHOD fak_ub_b2 "" RAT_FUNC "%6.4" "-" COEFFS 0 256 0 0 0 2 /end COMPU_METHOD
/begin COMPU_METHOD fak_ub_b4 "" RAT_FUNC "%6.4" "-" COEFFS 0 256 0 0 0 4 /end COMPU_METHOD
/begin COMPU_METHOD fak_ub_b64 "" RAT_FUNC "%6.3" "-" COEFFS 0 256 0 0 0 64 /end COMPU_METHOD
/begin COMPU_METHOD fak_ub_b8 "" RAT_FUNC "%6.4" "-" COEFFS 0 256 0 0 0 8 /end COMPU_METHOD
/begin COMPU_METHOD fak_uw_b1 "" RAT_FUNC "%7.6" "-" COEFFS 0 65536 0 0 0 1 /end COMPU_METHOD
/begin COMPU_METHOD fak_uw_b16 "" RAT_FUNC "%6.5" "-" COEFFS 0 65536 0 0 0 16 /end COMPU_METHOD
/begin COMPU_METHOD fak_uw_b2 "" RAT_FUNC "%7.6" "-" COEFFS 0 65536 0 0 0 2 /end COMPU_METHOD
/begin COMPU_METHOD fak_uw_b256 "" RAT_FUNC "%7.5" "" COEFFS 0 65536 0 0 0 256 /end COMPU_METHOD
/begin COMPU_METHOD fak_uw_b4 "" RAT_FUNC "%7.6" "-" COEFFS 0 65536 0 0 0 4 /end COMPU_METHOD
/begin COMPU_METHOD fak_uw_b512 "" RAT_FUNC "%6.4" "" COEFFS 0 65536 0 0 0 512 /end COMPU_METHOD
/begin COMPU_METHOD fak_uw_b64 "" RAT_FUNC "%6.5" "-" COEFFS 0 65536 0 0 0 64 /end COMPU_METHOD
/begin COMPU_METHOD fak_uw_b8 "" RAT_FUNC "%6.5" "-" COEFFS 0 65536 0 0 0 8 /end COMPU_METHOD
/begin COMPU_METHOD fks_ub_b0p0415 "" RAT_FUNC "%6.5" "1/Grad KW" COEFFS 0 6144 0 0 0 1 /end COMPU_METHOD
/begin COMPU_METHOD i_uA_q6p1035 "" RAT_FUNC "%6.4" "mA" COEFFS 0 65536 0 0 0 400 /end COMPU_METHOD
/begin COMPU_METHOD kw_q6 "" RAT_FUNC "%6.2" "°KW" COEFFS 0 1 0 0 0 6 /end COMPU_METHOD
/begin COMPU_METHOD m_q0p4 "" RAT_FUNC "%6.3" "kg/h" COEFFS 0 1 0 0 0 0.4 /end COMPU_METHOD
/begin COMPU_METHOD m_sw_q0p1 "" RAT_FUNC "%6.3" "kg/h" COEFFS 0 1 0 0 0 0.1 /end COMPU_METHOD
/begin COMPU_METHOD m_ub_b1020 "" RAT_FUNC "%6.2" "kg/h" COEFFS 0 1 0 0 0 4 /end COMPU_METHOD
/begin COMPU_METHOD m_ub_b23p3 "" RAT_FUNC "%6.3" "kg" COEFFS 0 2812.5 0 0 0 256 /end COMPU_METHOD
/begin COMPU_METHOD m_uw_b23p3 "" RAT_FUNC "%6.5" "kg" COEFFS 0 2812.5 0 0 0 1 /end COMPU_METHOD
/begin COMPU_METHOD m_uw_b4660 "" RAT_FUNC "%6.4" "g" COEFFS 0 3600 0 0 0 256 /end COMPU_METHOD
/begin COMPU_METHOD m_uw_b6553p5 "" RAT_FUNC "%6.3" "kg/h" COEFFS 0 1 0 0 0 0.1 /end COMPU_METHOD
/begin COMPU_METHOD nmotg_sw_q0p39 "" RAT_FUNC "%6.3" "U/min/s" COEFFS 0 1 0 0 0 0.39063 /end COMPU_METHOD
/begin COMPU_METHOD nmot_sw_q0p25 "" RAT_FUNC "%6.3" "U/min" COEFFS 0 1 0 0 0 0.25 /end COMPU_METHOD
/begin COMPU_METHOD nmot_ub_q10 "" RAT_FUNC "%6.1" "U/min" COEFFS 0 1 0 0 0 10 /end COMPU_METHOD
/begin COMPU_METHOD nmot_ub_q40 "" RAT_FUNC "%6.1" "Upm" COEFFS 0 1 0 0 0 40 /end COMPU_METHOD
/begin COMPU_METHOD nmot_uw_q0p25 "" RAT_FUNC "%6.3" "U/min" COEFFS 0 1 0 0 0 0.25 /end COMPU_METHOD
/begin COMPU_METHOD NQ25 "Drehzahlquantisierung 25.0 [Upm]" RAT_FUNC "%6.1" "Upm" COEFFS 0 1 0 0 0 25 /end COMPU_METHOD
/begin COMPU_METHOD nwu_ub_q32 "" RAT_FUNC "%6.1" "" COEFFS 0 1 0 0 0 32 /end COMPU_METHOD
/begin COMPU_METHOD p_sw_q0p039 "" RAT_FUNC "%6.4" "hPa" COEFFS 0 256 0 0 0 10 /end COMPU_METHOD
/begin COMPU_METHOD p_ub_q10 "" RAT_FUNC "%6.1" "hPa" COEFFS 0 1 0 0 0 10 /end COMPU_METHOD
/begin COMPU_METHOD p_ub_q5 "" RAT_FUNC "%6.2" "hPa" COEFFS 0 1 0 0 0 5 /end COMPU_METHOD
/begin COMPU_METHOD p_uw_q0p039 "" RAT_FUNC "%6.4" "hPa" COEFFS 0 256 0 0 0 10 /end COMPU_METHOD
/begin COMPU_METHOD relDK_q0p02441 "" RAT_FUNC "%6.4" "% DK" COEFFS 0 65536 0 0 0 1600 /end COMPU_METHOD
/begin COMPU_METHOD relDK_ub_b100 "" RAT_FUNC "%6.3" "% DK" COEFFS 0 255 0 0 0 100 /end COMPU_METHOD
/begin COMPU_METHOD relPED_uw_b100 "" RAT_FUNC "%6.4" "% PED" COEFFS 0 65535 0 0 0 100 /end COMPU_METHOD
/begin COMPU_METHOD rel_sw_b1536 "" RAT_FUNC "%6.4" "%" COEFFS 0 65536 0 0 0 3072 /end COMPU_METHOD
/begin COMPU_METHOD rel_sw_b50 "" RAT_FUNC "%6.4" "%" COEFFS 0 65536 0 0 0 100 /end COMPU_METHOD
/begin COMPU_METHOD rel_sw_q0p0234 "" RAT_FUNC "%6.4" "%/seg" COEFFS 0 32 0 0 0 0.75 /end COMPU_METHOD
/begin COMPU_METHOD rel_sw_q0p1875 "" RAT_FUNC "%6.3" "%" COEFFS 0 65536 0 0 0 12288 /end COMPU_METHOD
/begin COMPU_METHOD rel_ub_b100 "" RAT_FUNC "%6.3" "%" COEFFS 0 255 0 0 0 100 /end COMPU_METHOD
/begin COMPU_METHOD rel_ub_b1p0 "" RAT_FUNC "%6.4" "%" COEFFS 0 256 0 0 0 1 /end COMPU_METHOD
/begin COMPU_METHOD rel_ub_b1p4941 "" RAT_FUNC "%6.4" "%" COEFFS 0 256 0 0 0 1.5 /end COMPU_METHOD
/begin COMPU_METHOD rel_ub_b99p6 "" RAT_FUNC "%6.3" "%" COEFFS 0 256 0 0 0 100 /end COMPU_METHOD
/begin COMPU_METHOD rel_ub_q0p75 "" RAT_FUNC "%6.3" "%" COEFFS 0 1 0 0 0 0.75 /end COMPU_METHOD
/begin COMPU_METHOD rel_uw_b100 "" RAT_FUNC "%6.4" "%" COEFFS 0 65536 0 0 0 100 /end COMPU_METHOD
/begin COMPU_METHOD rel_uw_b200 "" RAT_FUNC "%6.4" "%" COEFFS 0 65536 0 0 0 200 /end COMPU_METHOD
/begin COMPU_METHOD rel_uw_b3200 "" RAT_FUNC "%6.4" "%/(km/h)" COEFFS 0 65536 0 0 0 3200 /end COMPU_METHOD
/begin COMPU_METHOD rel_uw_b6144 "" RAT_FUNC "%6.3" "%" COEFFS 0 65536 0 0 0 6144 /end COMPU_METHOD
/begin COMPU_METHOD rel_uw_q0p0234 "" RAT_FUNC "%6.4" "%" COEFFS 0 32 0 0 0 0.75 /end COMPU_METHOD
/begin COMPU_METHOD r_q0p00153 "" RAT_FUNC "%6.4" "Ohm" COEFFS 0 65536 0 0 0 100 /end COMPU_METHOD
/begin COMPU_METHOD spg_q0p00488 "" RAT_FUNC "%6.4" "V" COEFFS 0 1024 0 0 0 5 /end COMPU_METHOD
/begin COMPU_METHOD spg_ubatt "" RAT_FUNC "%6.3" "V" COEFFS 0 1 0 0 0 0.0942 /end COMPU_METHOD
/begin COMPU_METHOD spg_ub_b5 "" RAT_FUNC "%6.4" "V" COEFFS 0 256 0 0 0 5 /end COMPU_METHOD
/begin COMPU_METHOD spg_ub_q0p019 "" RAT_FUNC "%6.4" "V" COEFFS 0 1 0 0 0 0.019 /end COMPU_METHOD
/begin COMPU_METHOD spg_uw_b1280 "" RAT_FUNC "%7.4" "V" COEFFS 0 1000 0 0 0 19.531 /end COMPU_METHOD
/begin COMPU_METHOD spg_uw_q0p001222 "" RAT_FUNC "%6.4" "V" COEFFS 0 1 0 0 0 0.001222 /end COMPU_METHOD
/begin COMPU_METHOD t100msxs_ub_b25p5 "" RAT_FUNC "%6.3" "s" COEFFS 0 1 0 0 0 0.1 /end COMPU_METHOD
/begin COMPU_METHOD t100msxs_uw_b6553p5 "" RAT_FUNC "%6.3" "s" COEFFS 0 1 0 0 0 0.1 /end COMPU_METHOD
/begin COMPU_METHOD t100msxs_uw_b6553p6 "" RAT_FUNC "%6.3" "s" COEFFS 0 10 0 0 0 1 /end COMPU_METHOD
/begin COMPU_METHOD t10msxs_ub_b2p55 "" RAT_FUNC "%6.4" "s" COEFFS 0 1 0 0 0 0.01 /end COMPU_METHOD
/begin COMPU_METHOD t10msxs_uw_b655p35 "" RAT_FUNC "%6.4" "s" COEFFS 0 1 0 0 0 0.01 /end COMPU_METHOD
/begin COMPU_METHOD t1sxs_ub_b255 "" RAT_FUNC "%6.2" "s" COEFFS 0 1 0 0 0 1 /end COMPU_METHOD
/begin COMPU_METHOD t1sxs_uw_q1 "" RAT_FUNC "%6.2" "s" COEFFS 0 1 0 0 0 1 /end COMPU_METHOD
/begin COMPU_METHOD t200msxs_ub_b51 "" RAT_FUNC "%6.3" "s" COEFFS 0 1 0 0 0 0.2 /end COMPU_METHOD
/begin COMPU_METHOD t20msxs_ub_b5p1 "" RAT_FUNC "%6.4" "s" COEFFS 0 1 0 0 0 0.02 /end COMPU_METHOD
/begin COMPU_METHOD t20msxs_uw_b1310 "" RAT_FUNC "%7.4" "Sek." COEFFS 0 1 0 0 0 0.02 /end COMPU_METHOD
/begin COMPU_METHOD t20msxs_uw_q0p02 "" RAT_FUNC "%6.4" "s" COEFFS 0 1 0 0 0 0.02 /end COMPU_METHOD
/begin COMPU_METHOD t256msxs_ub_b65p535 "" RAT_FUNC "%6.3" "s" COEFFS 0 1000 0 0 0 256 /end COMPU_METHOD
/begin COMPU_METHOD t2msxs_uw_b131p07 "" RAT_FUNC "%6.4" "s" COEFFS 0 1 0 0 0 0.002 /end COMPU_METHOD
/begin COMPU_METHOD t50msxs_ub_b12p75 "" RAT_FUNC "%6.4" "s" COEFFS 0 1 0 0 0 0.05 /end COMPU_METHOD
/begin COMPU_METHOD t6minxmin_q6 "" RAT_FUNC "%6.2" "min" COEFFS 0 1 0 0 0 6 /end COMPU_METHOD
/begin COMPU_METHOD temp_ub_b191p25 "" RAT_FUNC "%6.3" "Grad C" COEFFS 0 1 0 0 0 0.75 /end COMPU_METHOD
/begin COMPU_METHOD temp_ub_q0p75_o48 "" RAT_FUNC "%6.2" "Grad C" COEFFS 0 1 48 0 0 0.75 /end COMPU_METHOD
/begin COMPU_METHOD temp_ub_q5_o50 "" RAT_FUNC "%6.2" "Grad C" COEFFS 0 1 50 0 0 5 /end COMPU_METHOD
/begin COMPU_METHOD tinjection_sy "" RAT_FUNC "%6.4" "ms" COEFFS 0 312.5 0 0 0 1 /end COMPU_METHOD
/begin COMPU_METHOD TQ10 "Zeitquantisierung mit 10 [ms]" RAT_FUNC "%6.4" "sec" COEFFS 0 100 0 0 0 1 /end COMPU_METHOD
/begin COMPU_METHOD tsquant "Umrechnung Segmentzeit in DMD" RAT_FUNC "%6.2" "us" COEFFS 0 1.25 0 0 0 1 /end COMPU_METHOD
/begin COMPU_METHOD t_q0p01 "" RAT_FUNC "%6.4" "s" COEFFS 0 100 0 0 0 1 /end COMPU_METHOD
/begin COMPU_METHOD vfzg_sw_q0p00781 "" RAT_FUNC "%6.4" "km/h" COEFFS 0 1 0 0 0 0.0078125 /end COMPU_METHOD
/begin COMPU_METHOD vfzg_ub_q1p25 "" RAT_FUNC "%6.2" "km/h" COEFFS 0 1 0 0 0 1.25 /end COMPU_METHOD
/begin COMPU_METHOD vfzg_uw_b512 "" RAT_FUNC "%6.4" "km/h" COEFFS 0 65536 0 0 0 512 /end COMPU_METHOD
/begin COMPU_METHOD wkw_sw_b128 "" RAT_FUNC "%7.5" "Grad KW" COEFFS 0 256 0 0 0 1 /end COMPU_METHOD
/begin COMPU_METHOD wkw_ub_q0p5 "" RAT_FUNC "%7.3" "Grad KW" COEFFS 0 2 0 0 0 1 /end COMPU_METHOD
/begin COMPU_METHOD WQ720 "Kurbelwellenwinkel - Quantisierung" RAT_FUNC "%6.2" "grad KW" COEFFS 0 1 0 0 0 2.813 /end COMPU_METHOD
/begin COMPU_METHOD zk100msxs_ub_b25p5 "" RAT_FUNC "%6.3" "s" COEFFS 0 0 256 0 10 0 /end COMPU_METHOD
/begin COMPU_METHOD zk100msxs_uw_b6553 "" RAT_FUNC "%6.1" "s" COEFFS 0 0 65536 0 10 0 /end COMPU_METHOD
/begin COMPU_METHOD zk10msxs_uw_b655 "" RAT_FUNC "%10.4" "s" COEFFS 0 0 65536 0 100 0 /end COMPU_METHOD
/begin COMPU_METHOD zk20msxs_ub_b5p1 "" RAT_FUNC "%6.4" "s" COEFFS 0 0 5.1 0 1 0 /end COMPU_METHOD
/begin COMPU_METHOD zk20msxs_uw_b1310 "" RAT_FUNC "%10.3" "s" COEFFS 0 0 1310 0 1 0 /end COMPU_METHOD
/begin COMPU_METHOD zk50msxs_uw_b3276p8 "" RAT_FUNC "%10.3" "s" COEFFS 0 0 65536 0 20 0 /end COMPU_METHOD
/begin COMPU_METHOD zw_sb_q0p75 "" RAT_FUNC "%6.3" "grad KW" COEFFS 0 255 0 0 0 191.25 /end COMPU_METHOD
/begin COMPU_METHOD zw_ub_q6 "" RAT_FUNC "%6.2" "Grad KW" COEFFS 0 255 0 0 0 1530 /end COMPU_METHOD
/begin RECORD_LAYOUT DI__Kwub__________ FNC_VALUES 1 UBYTE COLUMN_DIR DIRECT /end RECORD_LAYOUT
/begin RECORD_LAYOUT FklWUb FNC_VALUES 1 UBYTE COLUMN_DIR DIRECT /end RECORD_LAYOUT
/begin RECORD_LAYOUT FklWUw FNC_VALUES 1 UWORD COLUMN_DIR DIRECT /end RECORD_LAYOUT
/begin RECORD_LAYOUT GkfWUb FNC_VALUES 1 UBYTE COLUMN_DIR DIRECT /end RECORD_LAYOUT
/begin RECORD_LAYOUT GkfWUw FNC_VALUES 1 UWORD COLUMN_DIR DIRECT /end RECORD_LAYOUT
/begin RECORD_LAYOUT GklWSb FNC_VALUES 1 SBYTE COLUMN_DIR DIRECT /end RECORD_LAYOUT
/begin RECORD_LAYOUT GklWUb FNC_VALUES 1 UBYTE COLUMN_DIR DIRECT /end RECORD_LAYOUT
/begin RECORD_LAYOUT GklWUw FNC_VALUES 1 UWORD COLUMN_DIR DIRECT /end RECORD_LAYOUT
/begin RECORD_LAYOUT KfAxUbAyUbSstxUbSstyUbWSb NO_AXIS_PTS_X 1 UBYTE NO_AXIS_PTS_Y 2 UBYTE AXIS_PTS_X 3 UBYTE INDEX_INCR DIRECT AXIS_PTS_Y 4 UBYTE INDEX_INCR DIRECT FNC_VALUES 5 SBYTE COLUMN_DIR DIRECT /end RECORD_LAYOUT
/begin RECORD_LAYOUT KfAxUbAyUbSstxUbSstyUbWUb NO_AXIS_PTS_X 1 UBYTE NO_AXIS_PTS_Y 2 UBYTE AXIS_PTS_X 3 UBYTE INDEX_INCR DIRECT AXIS_PTS_Y 4 UBYTE INDEX_INCR DIRECT FNC_VALUES 5 UBYTE COLUMN_DIR DIRECT /end RECORD_LAYOUT
/begin RECORD_LAYOUT KfAxUbAyUbSstxUwSstyUbWUb NO_AXIS_PTS_X 1 UBYTE NO_AXIS_PTS_Y 2 UBYTE AXIS_PTS_X 3 UWORD INDEX_INCR DIRECT AXIS_PTS_Y 4 UBYTE INDEX_INCR DIRECT FNC_VALUES 5 UBYTE COLUMN_DIR DIRECT /end RECORD_LAYOUT
/begin RECORD_LAYOUT KfAxUwAyUwSstxUwSstyUwWUw NO_AXIS_PTS_X 1 UWORD NO_AXIS_PTS_Y 2 UWORD AXIS_PTS_X 3 UWORD INDEX_INCR DIRECT AXIS_PTS_Y 4 UWORD INDEX_INCR DIRECT FNC_VALUES 5 UWORD COLUMN_DIR DIRECT /end RECORD_LAYOUT
/begin RECORD_LAYOUT KlAUbSstUbWSb NO_AXIS_PTS_X 1 UBYTE AXIS_PTS_X 2 UBYTE INDEX_INCR DIRECT FNC_VALUES 3 SBYTE COLUMN_DIR DIRECT /end RECORD_LAYOUT
/begin RECORD_LAYOUT KlAUbSstUbWUb NO_AXIS_PTS_X 1 UBYTE AXIS_PTS_X 2 UBYTE INDEX_INCR DIRECT FNC_VALUES 3 UBYTE COLUMN_DIR DIRECT /end RECORD_LAYOUT
/begin RECORD_LAYOUT KlAUbSstUbWUw NO_AXIS_PTS_X 1 UBYTE AXIS_PTS_X 2 UBYTE INDEX_INCR DIRECT FNC_VALUES 3 UWORD COLUMN_DIR DIRECT /end RECORD_LAYOUT
/begin RECORD_LAYOUT KlAUwSstSwWUw NO_AXIS_PTS_X 1 UWORD AXIS_PTS_X 2 SWORD INDEX_INCR DIRECT FNC_VALUES 3 UWORD COLUMN_DIR DIRECT /end RECORD_LAYOUT
/begin RECORD_LAYOUT KlAUwSstUwWUw NO_AXIS_PTS_X 1 UWORD AXIS_PTS_X 2 UWORD INDEX_INCR DIRECT FNC_VALUES 3 UWORD COLUMN_DIR DIRECT /end RECORD_LAYOUT
/begin RECORD_LAYOUT KwSb FNC_VALUES 1 SBYTE COLUMN_DIR DIRECT /end RECORD_LAYOUT
/begin RECORD_LAYOUT KwSw FNC_VALUES 1 SWORD COLUMN_DIR DIRECT /end RECORD_LAYOUT
/begin RECORD_LAYOUT KwUb FNC_VALUES 1 UBYTE COLUMN_DIR DIRECT /end RECORD_LAYOUT
/begin RECORD_LAYOUT KwUw FNC_VALUES 1 UWORD COLUMN_DIR DIRECT /end RECORD_LAYOUT
/begin RECORD_LAYOUT SstAUbSstUb NO_AXIS_PTS_X 1 UBYTE AXIS_PTS_X 2 UBYTE INDEX_INCR DIRECT /end RECORD_LAYOUT
/begin RECORD_LAYOUT SstAUwSstUw NO_AXIS_PTS_X 1 UWORD AXIS_PTS_X 2 UWORD INDEX_INCR DIRECT /end RECORD_LAYOUT
/end MODULE
/end PROJECT
