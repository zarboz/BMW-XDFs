ASAP2_VERSION 1 3
/begin PROJECT BMW_ME72 "72111"
/begin HEADER "" VERSION "_721115A0" PROJECT_NO BMW_ME72 /end HEADER
/begin MODULE DIM ""
/begin MOD_COMMON "" BYTE_ORDER MSB_LAST ALIGNMENT_BYTE 1 ALIGNMENT_WORD 2 ALIGNMENT_LONG 2 /end MOD_COMMON
/begin CHARACTERISTIC ABGMSIGV "Abgastemperaturschwelle für Signalunterbrechung mit Ri-Diagnose vor KAT" VALUE 0x811AA9 KwUb 1275. temp_ub_q5_o50 -50.00 1225. FORMAT "%5.0" /end CHARACTERISTIC
/begin CHARACTERISTIC ALFO "Anfangswert für Lernfilter bei fuel-on/fuel-off Adaption" VALUE 0x813EAC KwUw 179.9973 dtsegn_b720divZyl 0.00 179.9973 FORMAT "%8.4" /end CHARACTERISTIC
/begin CHARACTERISTIC ANALUN "Anzahl Verbrennungen für Ausblendungen nach erkanntem Auss., drehzahlabhängig" CURVE 0x811359 GklWUb 255.0 dez 0.00 255.0 FORMAT "%5.1"
 /begin AXIS_DESCR COM_AXIS nmot nmot_ub_q40 8 0.00 10200. AXIS_PTS_REF SNM08DMUB /end AXIS_DESCR
/end CHARACTERISTIC
/begin CHARACTERISTIC ANWFOHE "Anzahl NW-Umdr. für Heilung" VALUE 0x8110C8 KwUb 255.0 dez 0.00 255.0 FORMAT "%5.1" /end CHARACTERISTIC
/begin CHARACTERISTIC ANWFOST "Anzahl NW-Umdr. für Reaktivierung fuel-on/-off Adaption nach Ausblendung" VALUE 0x8110C9 KwUb 255.0 dez 0.00 255.0 FORMAT "%5.1" /end CHARACTERISTIC
/begin CHARACTERISTIC ANZGEM "Anzahl der Gemischfehler" VALUE 0x811AAA KwUb 255.0 dez 0.00 255.0 FORMAT "%5.1" /end CHARACTERISTIC
/begin CHARACTERISTIC CDFO "Codewort zum Ausschalten und Rücksetzen der Adaption" VALUE 0x8110CA KwUb 255.0 dez 0.00 255.0 FORMAT "%5.1" /end CHARACTERISTIC
/begin CHARACTERISTIC CDLSVV "Codewort Diagnose vertauschte Sonden vor Kat im OBDII-Mode (invers: Europa-Mode)" VALUE 0x810187 KwUb 255.0 dez 0.00 255.0 FORMAT "%5.1" /end CHARACTERISTIC
/begin CHARACTERISTIC CWDLSV "Codeword zur Diagnoseauswahl der DLSV" VALUE 0x819A60 KwUb 255.0 dez 0.00 255.0 FORMAT "%5.1" /end CHARACTERISTIC
/begin CHARACTERISTIC DFSEFO2N "drehzahlabh. max. plausible Abweichungen der FSE-Werte" CURVE 0x8110CB GklWSb 2.802 dtsegn_b11p25divZyl -1.406 1.395 FORMAT "%5.3"
 /begin AXIS_DESCR COM_AXIS nmot nmot_ub_q40 8 0.00 10200. AXIS_PTS_REF SDZ08DMUB2 /end AXIS_DESCR
/end CHARACTERISTIC
/begin CHARACTERISTIC DFSEFON "drehzahlabh. max. plausible Abweichungen der FSE-Werte" CURVE 0x8110D3 GklWSb 2.802 dtsegn_b11p25divZyl -1.406 1.395 FORMAT "%5.3"
 /begin AXIS_DESCR COM_AXIS nmot nmot_ub_q40 8 0.00 10200. AXIS_PTS_REF SDZ08DMUB /end AXIS_DESCR
/end CHARACTERISTIC
/begin CHARACTERISTIC DFSERES "Differenz der Adaptionswerte zum Auslösen eines Reset der fuel-on/-off adaption" VALUE 0x8110DB KwUb 2.802 dtsegn_b11p25divZyl 0.00 2.802 FORMAT "%5.3" /end CHARACTERISTIC
/begin CHARACTERISTIC DLURMIN "Drehzahlabh. Laufunruhe-Referenz-Minimalwert 1" CURVE 0x811242 GklWSb 181.2 luquant -90.95 90.24 FORMAT "%5.2"
 /begin AXIS_DESCR COM_AXIS nmot nmot_ub_q40 8 0.00 10200. AXIS_PTS_REF SNM08DMUB /end AXIS_DESCR
/end CHARACTERISTIC
/begin CHARACTERISTIC DMXRDL "Begrenzung bei max. Laufunruhe-Referenzwert-Änderung von dlurs" VALUE 0x81124A KwSb 90.24 luquant 0.00 90.24 FORMAT "%5.2" /end CHARACTERISTIC
/begin CHARACTERISTIC DMXRFL "Begrenzung bei max. Filter-Laufunruhe-Referenzwert-Änderung" VALUE 0x811139 KwSb 90.24 luquant 0.00 90.24 FORMAT "%5.2" /end CHARACTERISTIC
/begin CHARACTERISTIC DMXRLU "Begrenzung bei max. Laufunruhe-Referenzwert-Änderung" VALUE 0x811361 KwSb 90.24 luquant 0.00 90.24 FORMAT "%5.2" /end CHARACTERISTIC
/begin CHARACTERISTIC DRISIGV "Diagnoseschwelle Ri-Sonde für Signalunterbrechung vor KAT" VALUE 0x81AD22 KwUw 131070.0 r_uw_q2 0.00 131070.0 FORMAT "%8.1" /end CHARACTERISTIC
/begin CHARACTERISTIC FIAMALU "Anhebungsfaktor für Filter Mehrfachaussetzererkennung" VALUE 0x811362 KwUb 3.984 fak_ub_b4 0.00 3.984 FORMAT "%5.3" /end CHARACTERISTIC
/begin CHARACTERISTIC FIMALU "Filterfaktor Mehrfachaussetzererkennung" VALUE 0x811363 KwUb 0.9961 fak_ub_b1 0.00 0.9961 /end CHARACTERISTIC
/begin CHARACTERISTIC FLFO "Filterfaktor Lernfilter der fuel-on/-off Adaption" VALUE 0x813EAE KwSw 1.999969 fak_uw_b2 -1.000000 0.9999695 FORMAT "%8.6" /end CHARACTERISTIC
/begin CHARACTERISTIC FLUTN "Filterfaktor Laufunruhe-Filter" CURVE 0x81113A GklWUb 0.9961 fak_ub_b1 0.00 0.9961
 /begin AXIS_DESCR COM_AXIS nmot nmot_ub_q40 8 0.00 10200. AXIS_PTS_REF SNM08DMUB /end AXIS_DESCR
/end CHARACTERISTIC
/begin CHARACTERISTIC FLUV1 "Schalter der Modifikation 1 der Laufunruhe-Berechnung" VALUE 0x811364 KwUb 255.0 dez 0.00 255.0 FORMAT "%5.1" /end CHARACTERISTIC
/begin CHARACTERISTIC FLUV2 "Schalter der Modifikation 2 der Laufunruhe-Berechnung" VALUE 0x811365 KwUb 255.0 dez 0.00 255.0 FORMAT "%5.1" /end CHARACTERISTIC
/begin CHARACTERISTIC FRDO "obere Diagnoseschwelle für Lambdaregler" VALUE 0x81B9F8 KwUw 1.999969 fak_uw_b2 0.00 1.999969 FORMAT "%8.6" /end CHARACTERISTIC
/begin CHARACTERISTIC FRDU "untere Diagnoseschwelle für Lambdaregler" VALUE 0x81B9FA KwUw 1.999969 fak_uw_b2 0.00 1.999969 FORMAT "%8.6" /end CHARACTERISTIC
/begin CHARACTERISTIC FS1FO "Filterfaktor Segmentzeit-Filter 1 der fuel-on/-off Adaption" VALUE 0x813EB0 KwUw 0.9999695 fak_uw_b2 0.00 0.9999695 FORMAT "%9.7" /end CHARACTERISTIC
/begin CHARACTERISTIC FS2FO "Filterfaktor Segmentzeit-Filter 2 der fuel-on/-off Adaption" VALUE 0x813EB2 KwUw 0.9999695 fak_uw_b2 0.00 0.9999695 FORMAT "%9.7" /end CHARACTERISTIC
/begin CHARACTERISTIC KFAMAL "Kennfeld Absenkungsfaktor für Lur-Wert bei erkannten Mehrfachaussetzern" MAP 0x811366 GkfWUb 0.9961 fak_ub_b1 0.00 0.9961
 /begin AXIS_DESCR COM_AXIS rl rel_ub_q0p75 8 0.00 191.3 AXIS_PTS_REF SRL08DMUB /end AXIS_DESCR
 /begin AXIS_DESCR COM_AXIS nmot nmot_ub_q40 8 0.00 10200. AXIS_PTS_REF SNM08DMUB /end AXIS_DESCR
/end CHARACTERISTIC
/begin CHARACTERISTIC KFAMAL1 "Kennfeld Absenkungsfaktor für Lur-Wert bei erkannten Mehrfachaussetzern" MAP 0x8113A6 GkfWUb 0.9961 fak_ub_b1 0.00 0.9961
 /begin AXIS_DESCR COM_AXIS rl rel_ub_q0p75 8 0.00 191.3 AXIS_PTS_REF SRL08DMUB /end AXIS_DESCR
 /begin AXIS_DESCR COM_AXIS nmot nmot_ub_q40 8 0.00 10200. AXIS_PTS_REF SNM08DMUB /end AXIS_DESCR
/end CHARACTERISTIC
/begin CHARACTERISTIC KFCFO "Kennfeld zur Definition der Bereichseigenschaften (dominant..)" MAP 0x8110DC GkfWUb 255.0 dez 0.00 255.0 FORMAT "%5.1"
 /begin AXIS_DESCR COM_AXIS rl rel_ub_q0p75 3 0.00 191.3 AXIS_PTS_REF SDZ03DMUB /end AXIS_DESCR
 /begin AXIS_DESCR COM_AXIS nmot nmot_ub_q40 8 0.00 10200. AXIS_PTS_REF SDZ08DMUB /end AXIS_DESCR
/end CHARACTERISTIC
/begin CHARACTERISTIC KFCFO2 "Kennfeld zur Definition der Bereichseigenschaften (dominant..)" MAP 0x8110F4 GkfWUb 255.0 dez 0.00 255.0 FORMAT "%5.1"
 /begin AXIS_DESCR COM_AXIS rl rel_ub_q0p75 3 0.00 191.3 AXIS_PTS_REF SDZ03DMUB2 /end AXIS_DESCR
 /begin AXIS_DESCR COM_AXIS nmot nmot_ub_q40 8 0.00 10200. AXIS_PTS_REF SDZ08DMUB2 /end AXIS_DESCR
/end CHARACTERISTIC
/begin CHARACTERISTIC KFDLUR "Kennfeld für Laufunruhedifferenz dluts Referenzwert" MAP 0x81124B GkfWSb 181.2 luquant -90.95 90.24 FORMAT "%5.2"
 /begin AXIS_DESCR COM_AXIS rl rel_ub_q0p75 8 0.00 191.3 AXIS_PTS_REF SRL08DMUB /end AXIS_DESCR
 /begin AXIS_DESCR COM_AXIS nmot nmot_ub_q40 8 0.00 10200. AXIS_PTS_REF SNM08DMUB /end AXIS_DESCR
/end CHARACTERISTIC
/begin CHARACTERISTIC KFDLUR1 "Kennfeld für Laufunruhedifferenz dluts Referenzwert" MAP 0x81128B GkfWSb 181.2 luquant -90.95 90.24 FORMAT "%5.2"
 /begin AXIS_DESCR COM_AXIS rl rel_ub_q0p75 8 0.00 191.3 AXIS_PTS_REF SRL08DMUB /end AXIS_DESCR
 /begin AXIS_DESCR COM_AXIS nmot nmot_ub_q40 8 0.00 10200. AXIS_PTS_REF SNM08DMUB /end AXIS_DESCR
/end CHARACTERISTIC
/begin CHARACTERISTIC KFDLUR2 "Kennfeld für Laufunruhedifferenz dluts Referenzwert" MAP 0x8112CB GkfWSb 181.2 luquant -90.95 90.24 FORMAT "%5.2"
 /begin AXIS_DESCR COM_AXIS rl rel_ub_q0p75 8 0.00 191.3 AXIS_PTS_REF SRL08DMUB /end AXIS_DESCR
 /begin AXIS_DESCR COM_AXIS nmot nmot_ub_q40 8 0.00 10200. AXIS_PTS_REF SNM08DMUB /end AXIS_DESCR
/end CHARACTERISTIC
/begin CHARACTERISTIC KFDLURZ "Kennfeld für Laufunruhedifferenz dluts Referenzwert bei ZAS" MAP 0x81130B GkfWSb 181.2 luquant -90.95 90.24 FORMAT "%5.2"
 /begin AXIS_DESCR COM_AXIS rl rel_ub_q0p75 8 0.00 191.3 AXIS_PTS_REF SRL08DMUB /end AXIS_DESCR
 /begin AXIS_DESCR COM_AXIS nmot nmot_ub_q40 8 0.00 10200. AXIS_PTS_REF SNM08DMUB /end AXIS_DESCR
/end CHARACTERISTIC
/begin CHARACTERISTIC KFLUAR "Kennfeld für Laufunruhe-Abstandsmass-Referenzwert" MAP 0x811142 GkfWUb 181.2 luquant 0.00 181.2 FORMAT "%5.1"
 /begin AXIS_DESCR COM_AXIS rl rel_ub_q0p75 8 0.00 191.3 AXIS_PTS_REF SRL08DMUB /end AXIS_DESCR
 /begin AXIS_DESCR COM_AXIS nmot nmot_ub_q40 8 0.00 10200. AXIS_PTS_REF SNM08DMUB /end AXIS_DESCR
/end CHARACTERISTIC
/begin CHARACTERISTIC KFLUAR1 "Kennfeld für Laufunruhe-Abstandsmass-Referenzwert" MAP 0x811182 GkfWUb 181.2 luquant 0.00 181.2 FORMAT "%5.1"
 /begin AXIS_DESCR COM_AXIS rl rel_ub_q0p75 8 0.00 191.3 AXIS_PTS_REF SRL08DMUB /end AXIS_DESCR
 /begin AXIS_DESCR COM_AXIS nmot nmot_ub_q40 8 0.00 10200. AXIS_PTS_REF SNM08DMUB /end AXIS_DESCR
/end CHARACTERISTIC
/begin CHARACTERISTIC KFLUAR2 "Kennfeld für Laufunruhe-Abstandsmass-Referenzwert" MAP 0x8111C2 GkfWUb 181.2 luquant 0.00 181.2 FORMAT "%5.1"
 /begin AXIS_DESCR COM_AXIS rl rel_ub_q0p75 8 0.00 191.3 AXIS_PTS_REF SRL08DMUB /end AXIS_DESCR
 /begin AXIS_DESCR COM_AXIS nmot nmot_ub_q40 8 0.00 10200. AXIS_PTS_REF SNM08DMUB /end AXIS_DESCR
/end CHARACTERISTIC
/begin CHARACTERISTIC KFLUARZ "Kennfeld für Laufunruhe-Abstandsmass-Referenzwert bei ZAS" MAP 0x811202 GkfWUb 181.2 luquant 0.00 181.2 FORMAT "%5.1"
 /begin AXIS_DESCR COM_AXIS rl rel_ub_q0p75 8 0.00 191.3 AXIS_PTS_REF SRL08DMUB /end AXIS_DESCR
 /begin AXIS_DESCR COM_AXIS nmot nmot_ub_q40 8 0.00 10200. AXIS_PTS_REF SNM08DMUB /end AXIS_DESCR
/end CHARACTERISTIC
/begin CHARACTERISTIC KFLURB "Kennfeld für Laufunruhe-Referenz-Basiswert" MAP 0x8113E6 GkfWSb 181.2 luquant -90.95 90.24 FORMAT "%5.2"
 /begin AXIS_DESCR COM_AXIS rl rel_ub_q0p75 8 0.00 191.3 AXIS_PTS_REF SRL08DMUB /end AXIS_DESCR
 /begin AXIS_DESCR COM_AXIS nmot nmot_ub_q40 8 0.00 10200. AXIS_PTS_REF SNM08DMUB /end AXIS_DESCR
/end CHARACTERISTIC
/begin CHARACTERISTIC KFLURB1 "Kennfeld für Laufunruhe-Referenz-Basiswert" MAP 0x811426 GkfWSb 181.2 luquant -90.95 90.24 FORMAT "%5.2"
 /begin AXIS_DESCR COM_AXIS rl rel_ub_q0p75 8 0.00 191.3 AXIS_PTS_REF SRL08DMUB /end AXIS_DESCR
 /begin AXIS_DESCR COM_AXIS nmot nmot_ub_q40 8 0.00 10200. AXIS_PTS_REF SNM08DMUB /end AXIS_DESCR
/end CHARACTERISTIC
/begin CHARACTERISTIC KFLURB2 "Kennfeld für Laufunruhe-Referenz-Basiswert" MAP 0x811466 GkfWSb 181.2 luquant -90.95 90.24 FORMAT "%5.2"
 /begin AXIS_DESCR COM_AXIS rl rel_ub_q0p75 8 0.00 191.3 AXIS_PTS_REF SRL08DMUB /end AXIS_DESCR
 /begin AXIS_DESCR COM_AXIS nmot nmot_ub_q40 8 0.00 10200. AXIS_PTS_REF SNM08DMUB /end AXIS_DESCR
/end CHARACTERISTIC
/begin CHARACTERISTIC KFLURBZ "Kennfeld für Laufunruhe-Referenz-Basiswert bei ZAS" MAP 0x8114A6 GkfWSb 181.2 luquant -90.95 90.24 FORMAT "%5.2"
 /begin AXIS_DESCR COM_AXIS rl rel_ub_q0p75 8 0.00 191.3 AXIS_PTS_REF SRL08DMUB /end AXIS_DESCR
 /begin AXIS_DESCR COM_AXIS nmot nmot_ub_q40 8 0.00 10200. AXIS_PTS_REF SNM08DMUB /end AXIS_DESCR
/end CHARACTERISTIC
/begin CHARACTERISTIC KFLURM "Kennfeld für Laufunruhe-Referenzwert zur Mehrfachaussetzererkennung ->Lum-Vergl." MAP 0x8114E6 GkfWSb 181.2 luquant -90.95 90.24 FORMAT "%5.2"
 /begin AXIS_DESCR COM_AXIS rl rel_ub_q0p75 8 0.00 191.3 AXIS_PTS_REF SRL08DMUB /end AXIS_DESCR
 /begin AXIS_DESCR COM_AXIS nmot nmot_ub_q40 8 0.00 10200. AXIS_PTS_REF SNM08DMUB /end AXIS_DESCR
/end CHARACTERISTIC
/begin CHARACTERISTIC KFLURM1 "Kennfeld für Laufunruhe-Referenzwert zur Mehrfachaussetzererkennung ->Lum-Vergl." MAP 0x811526 GkfWSb 181.2 luquant -90.95 90.24 FORMAT "%5.2"
 /begin AXIS_DESCR COM_AXIS rl rel_ub_q0p75 8 0.00 191.3 AXIS_PTS_REF SRL08DMUB /end AXIS_DESCR
 /begin AXIS_DESCR COM_AXIS nmot nmot_ub_q40 8 0.00 10200. AXIS_PTS_REF SNM08DMUB /end AXIS_DESCR
/end CHARACTERISTIC
/begin CHARACTERISTIC LACSDOFF "Lambda Offset bei Reset der Kraftstoffkorrektur bei CSD-Verdacht  in %DLSV" VALUE 0x81AD24 KwSw 1.999969 fak_sw_b1 -1.000000 0.9999695 FORMAT "%8.6" /end CHARACTERISTIC
/begin CHARACTERISTIC LURBRL "Laufunruhe-Referenzwert bei Fahrzeug steht" CURVE 0x811566 GklWSb 181.2 luquant -90.95 90.24 FORMAT "%5.2"
 /begin AXIS_DESCR COM_AXIS rl rel_ub_q0p75 8 0.00 191.3 AXIS_PTS_REF SRL08DMUB /end AXIS_DESCR
/end CHARACTERISTIC
/begin CHARACTERISTIC LURFOST "Laufruhe-Referenzwert für stop fuel-on/-off Adaption, Vergleich mit lunw" VALUE 0x81110C KwUb 181.2 luquant 0.00 181.2 FORMAT "%5.1" /end CHARACTERISTIC
/begin CHARACTERISTIC LURKH "dmrkh-abh. Laufunruhe-Referenzkorrekturwert, bei Katheizen" CURVE 0x819686 KlAUbSstUbWUb 0.9961 fak_ub_b1 0.00 0.9961
 /begin AXIS_DESCR STD_AXIS dmrkh rel_ub_b99p6 4 0.00 99.61 FORMAT "%5.2" DEPOSIT ABSOLUTE /end AXIS_DESCR
/end CHARACTERISTIC
/begin CHARACTERISTIC LURKTM "Tmot-abhängiger Laufunruhe-Referenz-Korrekturwert" CURVE 0x81156E GklWSb 181.2 luquant -90.95 90.24 FORMAT "%5.2"
 /begin AXIS_DESCR COM_AXIS tmot temp_ub_q0p75_o48 8 -48.00 143.3 AXIS_PTS_REF STM08DMUB /end AXIS_DESCR
/end CHARACTERISTIC
/begin CHARACTERISTIC LURMIN1 "Drehzahlabh. Laufunruhe-Referenz-Minimalwert 1" CURVE 0x811576 GklWSb 181.2 luquant -90.95 90.24 FORMAT "%5.2"
 /begin AXIS_DESCR COM_AXIS nmot nmot_ub_q40 8 0.00 10200. AXIS_PTS_REF SNM08DMUB /end AXIS_DESCR
/end CHARACTERISTIC
/begin CHARACTERISTIC LURMIN2 "Drehzahlabh. Laufunruhe-Referenz-Minimalwert 2" CURVE 0x81157E GklWSb 181.2 luquant -90.95 90.24 FORMAT "%5.2"
 /begin AXIS_DESCR COM_AXIS nmot nmot_ub_q40 8 0.00 10200. AXIS_PTS_REF SNM08DMUB /end AXIS_DESCR
/end CHARACTERISTIC
/begin CHARACTERISTIC LURMIN3 "Drehzahlabh. Laufunruhe-Referenz-Minimalwert 3" CURVE 0x811586 GklWSb 181.2 luquant -90.95 90.24 FORMAT "%5.2"
 /begin AXIS_DESCR COM_AXIS nmot nmot_ub_q40 8 0.00 10200. AXIS_PTS_REF SNM08DMUB /end AXIS_DESCR
/end CHARACTERISTIC
/begin CHARACTERISTIC MDERKFON "Anzahl Aussetzer für Adaptionsstop (Heilung)" VALUE 0x813EB4 KwUw 65535.00 dez 0.00 65535.00 FORMAT "%8.2" /end CHARACTERISTIC
/begin CHARACTERISTIC NFLUV "Drehzahlschwelle der Modifikation der Laufunruhe-Berechnung" VALUE 0x81158E KwUb 10200. nmot_ub_q40 0.00 10200. FORMAT "%5.0" /end CHARACTERISTIC
/begin CHARACTERISTIC NMIDLU "Min. Drehzahl für Ausblendung der Aussetzererkennung DMDDLU" VALUE 0x81134B KwUb 10200. nmot_ub_q40 0.00 10200. FORMAT "%5.0" /end CHARACTERISTIC
/begin CHARACTERISTIC P_ZYL "Abstand zur Bestimmung des arithmet Mittelwertes - DMDLU" VALUE 0x81158F KwUb 7.000 dez 0.00 7.000 FORMAT "%5.3" /end CHARACTERISTIC
/begin CHARACTERISTIC RISIGRESV "Schwelle für Reset Signalunterbrechung mit Ri-Diagnose vor KAT" VALUE 0x81AD26 KwUw 131070.0 r_uw_q2 0.00 131070.0 FORMAT "%8.1" /end CHARACTERISTIC
/begin AXIS_PTS SDZ03DMUB "SST-Verteilung in DMD, 3 Drehzahl-SST" 0x81111F rl SstAUbSstUb 191.3 rel_ub_q0p75 3 0.00 191.3 FORMAT "%5.1" DEPOSIT ABSOLUTE /end AXIS_PTS
/begin AXIS_PTS SDZ03DMUB2 "SST-Verteilung in DMD, 3 Drehzahl-SST" 0x811123 rl SstAUbSstUb 191.3 rel_ub_q0p75 3 0.00 191.3 FORMAT "%5.1" DEPOSIT ABSOLUTE /end AXIS_PTS
/begin AXIS_PTS SDZ08DMUB "SST-Verteilung in DMD, 8 Drehzahl-SST" 0x811127 nmot SstAUbSstUb 10200. nmot_ub_q40 8 0.00 10200. FORMAT "%5.0" DEPOSIT ABSOLUTE /end AXIS_PTS
/begin AXIS_PTS SDZ08DMUB2 "SST-Verteilung in DMD, 8 Drehzahl-SST" 0x811130 nmot SstAUbSstUb 10200. nmot_ub_q40 8 0.00 10200. FORMAT "%5.0" DEPOSIT ABSOLUTE /end AXIS_PTS
/begin CHARACTERISTIC SFONTM "Schwellwert tmot für fuel-on Adaption aktiv" VALUE 0x81110D KwUb 191.3 temp_ub_q0p75_o48 -48.00 143.3 FORMAT "%5.1" /end CHARACTERISTIC
/begin CHARACTERISTIC SLFOO2N "Obere Schwelle (Schwellwert-KL) für Lernfilterwert bei fuel-on/-off Adaption" CURVE 0x81110E GklWUb 0.7004 dtsegn_b720divZyl 0.00 0.7004
 /begin AXIS_DESCR COM_AXIS nmot nmot_ub_q40 8 0.00 10200. AXIS_PTS_REF SDZ08DMUB2 /end AXIS_DESCR
/end CHARACTERISTIC
/begin CHARACTERISTIC SLFOON "Obere Schwelle (Schwellwert-KL) für Lernfilterwert bei fuel-on/-off Adaption" CURVE 0x811116 GklWUb 0.7004 dtsegn_b720divZyl 0.00 0.7004
 /begin AXIS_DESCR COM_AXIS nmot nmot_ub_q40 8 0.00 10200. AXIS_PTS_REF SDZ08DMUB /end AXIS_DESCR
/end CHARACTERISTIC
/begin CHARACTERISTIC SLFOU "Untere Schwelle für Lernfilterwert bei fuel-on/-off Adaption" VALUE 0x813EB6 KwSw 89.99725 dtsegn_b720divZyl 0.00 89.99725 FORMAT "%8.5" /end CHARACTERISTIC
/begin AXIS_PTS SNM08DMUB "SST-Verteilung in DMD, 8 Drehzahl-SST" 0x811949 nmot SstAUbSstUb 10200. nmot_ub_q40 8 0.00 10200. FORMAT "%5.0" DEPOSIT ABSOLUTE /end AXIS_PTS
/begin AXIS_PTS SRL08DMUB "SST-Verteilung in DMD, 8 Last-SST" 0x8119F1 rl SstAUbSstUb 191.3 rel_ub_q0p75 8 0.00 191.3 FORMAT "%5.1" DEPOSIT ABSOLUTE /end AXIS_PTS
/begin AXIS_PTS STM08DMUB "8 Motortemperaturstützstellen für DMD" 0x819755 tmot SstAUbSstUb 191.3 temp_ub_q0p75_o48 8 -48.00 143.3 FORMAT "%5.1" DEPOSIT ABSOLUTE /end AXIS_PTS
/begin CHARACTERISTIC TDLSVV "Entprellzeit für Erkennung vertauschte Lambdasonden" VALUE 0x81B9FC KwUw 6553.500 t100msxs_uw_b6553p5 0.00 6553.500 FORMAT "%8.3" /end CHARACTERISTIC
/begin CHARACTERISTIC TDWLSVV "Wartezeit für Zyklusbit setzen Diagnose vertauschte Lambdasonden" VALUE 0x81B9FE KwUw 6553.500 t100msxs_uw_b6553p5 0.00 6553.500 FORMAT "%8.3" /end CHARACTERISTIC
/begin CHARACTERISTIC TMNEB "Motortemperaturschwelle für Messung Nebenschluß Sonde vor KAT" VALUE 0x819A61 KwUb 191.3 temp_ub_q0p75_o48 -48.00 143.3 FORMAT "%5.1" /end CHARACTERISTIC
/begin CHARACTERISTIC TMSV "Motortemperaturschwelle für Erkennung Kaltstart für Messung Sonde vor KAT" VALUE 0x819A62 KwUb 191.3 temp_ub_q0p75_o48 -48.00 143.3 FORMAT "%5.1" /end CHARACTERISTIC
/begin CHARACTERISTIC TMSVA "Motorabstelltemperaturschwelle für Messung Abkühlung Sonde vor KAT" VALUE 0x819A63 KwUb 191.3 temp_ub_q0p75_o48 -48.00 143.3 FORMAT "%5.1" /end CHARACTERISTIC
/begin CHARACTERISTIC TNALU "Testphasenlänge nach erkanntem Aussetzer" VALUE 0x811590 KwUb 255.0 dez 0.00 255.0 FORMAT "%5.1" /end CHARACTERISTIC
/begin CHARACTERISTIC TNSTDN "Zeit nach Start für Diagnose Fehler Nebenschluß (Monoflop)" VALUE 0x811AAB KwUb 5.100 t20msxs_ub_b5p1 0.00 5.100 FORMAT "%5.3" /end CHARACTERISTIC
/begin CHARACTERISTIC TRSA "Überwachungszeit Regelung (vor KAT)-> Sonde Aus" VALUE 0x819A64 KwUb 25.50 t100msxs_ub_b25p5 0.00 25.50 FORMAT "%5.2" /end CHARACTERISTIC
/begin CHARACTERISTIC TSTOI "Entprellzeit für Bedingung stöchiometrisch in %DLSV" VALUE 0x819A65 KwUb 5.100 t20msxs_ub_b5p1 0.00 5.100 FORMAT "%5.3" /end CHARACTERISTIC
/begin CHARACTERISTIC TUSDU "Verzög.zeit für Erkennung Adernschluß und Sonde mit begr. Spannungshub v.K." VALUE 0x81AD28 KwUw 6553.500 t100msxs_uw_q100 0.00 6553.500 FORMAT "%8.3" /end CHARACTERISTIC
/begin CHARACTERISTIC TUSDUC "Verzögerungszeit Code für Erkennung Adernschluß Sonde vor KAT" VALUE 0x81AD2A KwUw 6553.500 t100msxs_uw_q100 0.00 6553.500 FORMAT "%8.3" /end CHARACTERISTIC
/begin CHARACTERISTIC TUSEINV "Verzögerungzeit für Einschalten der Sondenbetriebsbereitschaft vor KAT" VALUE 0x819A66 KwUb 255.0 t1sxs_ub_b255 0.00 255.0 FORMAT "%5.1" /end CHARACTERISTIC
/begin CHARACTERISTIC TUSFETT "Verzög.zeit für Erkennung niederohmiger Nebenschluß nach Ubatt vor KAT" VALUE 0x81AD2C KwUw 6553.500 t100msxs_uw_q100 0.00 6553.500 FORMAT "%8.3" /end CHARACTERISTIC
/begin CHARACTERISTIC TVCSD "Entprellzeit für CSD Fehler in %DLSV" VALUE 0x81AD2E KwUw 1310.70 t20msxs_uw_b1310 0.00 1310.70 FORMAT "%7.2" /end CHARACTERISTIC
/begin CHARACTERISTIC TVSIG "Entprellzeit für Bedingung Signalfehler in %DLSV" VALUE 0x81AD30 KwUw 1310.70 t20msxs_uw_b1310 0.00 1310.70 FORMAT "%7.2" /end CHARACTERISTIC
/begin CHARACTERISTIC TVSIGMX "Entprellzeit für Regelung am Anschlag in %DLSV" VALUE 0x819A67 KwUb 5.100 t20msxs_ub_b5p1 0.00 5.100 FORMAT "%5.3" /end CHARACTERISTIC
/begin CHARACTERISTIC TVTCSD "Maxinmale Dauer Halbperiode bei CSD  in %DLSV" VALUE 0x81AD32 KwUw 1310.70 t20msxs_uw_b1310 0.00 1310.70 FORMAT "%7.2" /end CHARACTERISTIC
/begin CHARACTERISTIC USDBO "obere Schwelle f. Erk. Adernschluß und defekte Sonde mit begrenztem Spannungshub" VALUE 0x8156D8 KwUw 319.9951 spg_uw_q0p00488_o1 -1.000000 318.9951 FORMAT "%8.4" /end CHARACTERISTIC
/begin CHARACTERISTIC USDBU "untere Schwelle f. Erk. Adernschluß u. defekte Sonde mit begrenztem Spannungshub" VALUE 0x8156DA KwUw 319.9951 spg_uw_q0p00488_o1 -1.000000 318.9951 FORMAT "%8.4" /end CHARACTERISTIC
/begin CHARACTERISTIC USFHK "Sondenspannungsschwelle für Erkennung fett hinter Kat" VALUE 0x8156DC KwUw 319.9951 spg_uw_q0p00488_o1 -1.000000 318.9951 FORMAT "%8.4" /end CHARACTERISTIC
/begin CHARACTERISTIC USMHK "Sondenspannungsschwelle für Erkennung mager hinter Kat" VALUE 0x8156DE KwUw 319.9951 spg_uw_q0p00488_o1 -1.000000 318.9951 FORMAT "%8.4" /end CHARACTERISTIC
/begin CHARACTERISTIC USR "Regelschwelle für Regelung vor Kat" VALUE 0x819A68 KwUb 1.330 spg_ub_q0p0052_o0p2 -0.2000 1.130 FORMAT "%5.3" /end CHARACTERISTIC
/begin CHARACTERISTIC USRCSD "Regelschwelle für Regelung vor Kat bei CSD" VALUE 0x819A69 KwUb 1.330 spg_ub_q0p0052_o0p2 -0.2000 1.130 FORMAT "%5.3" /end CHARACTERISTIC
/begin CHARACTERISTIC USREF "Schwelle für Sondenbetriebsbereitschaft bei fettem Gemisch (vor KAT)" VALUE 0x8156E0 KwUw 319.9951 spg_uw_q0p00488_o1 -1.000000 318.9951 FORMAT "%8.4" /end CHARACTERISTIC
/begin CHARACTERISTIC USREFCSD "Heilungschwelle für CSD" VALUE 0x81AD34 KwUw 319.9951 spg_uw_q0p00488_o1 -1.000000 318.9951 FORMAT "%8.4" /end CHARACTERISTIC
/begin CHARACTERISTIC USREFV "obere Heilungschwelle für Signalfehlerverdacht" VALUE 0x81AD36 KwUw 319.9951 spg_uw_q0p00488_o1 -1.000000 318.9951 FORMAT "%8.4" /end CHARACTERISTIC
/begin CHARACTERISTIC USREM "Schwelle für Sondenbetriebsbereitschaft bei magerem Gemisch (vor KAT)" VALUE 0x8156E2 KwUw 319.9951 spg_uw_q0p00488_o1 -1.000000 318.9951 FORMAT "%8.4" /end CHARACTERISTIC
/begin CHARACTERISTIC USREMV "untere Heilungschwelle für Signalfehlerverdacht" VALUE 0x81AD38 KwUw 319.9951 spg_uw_q0p00488_o1 -1.000000 318.9951 FORMAT "%8.4" /end CHARACTERISTIC
/begin CHARACTERISTIC ZASMASK "Zylinderabschaltmaske für CIFI aus ZAS" VALUE 0x81111E KwUb 255.0 dez 0.00 255.0 FORMAT "%5.1" /end CHARACTERISTIC
/begin CHARACTERISTIC ZLUTSFI "Zeitkonstante für Filterung Laufunruhe-Testgröße" VALUE 0x810021 KwUb 2.550 t10msxs_ub_b2p55 0.00 2.550 FORMAT "%5.3" /end CHARACTERISTIC
/begin MEASUREMENT anwfoh "zählt Anzahl der NW-Umdr. für Heilung der fuel-on/-off Adaption" UBYTE dez 1 100 0 255 FORMAT "%5.1" ECU_ADDRESS 0x380BB1 /end MEASUREMENT
/begin MEASUREMENT anwfos "zählt Anzahl der NW-Umdr. von Bedingungen für Adaption erfüllt bis Lernbeginn" UBYTE dez 1 100 0 255 FORMAT "%5.1" ECU_ADDRESS 0x380BB0 /end MEASUREMENT
/begin MEASUREMENT B_adcsd "Bedingung für Prüfung Adernschluß und CSD" UBYTE B_TRUE 1 100 0 1 BIT_MASK 0x4 FORMAT "%13.11" ECU_ADDRESS 0x380C38 /end MEASUREMENT
/begin MEASUREMENT B_adcsd2 "Bedingung für Prüfung Adernschluß und CSD Bank2" UBYTE B_TRUE 1 100 0 1 BIT_MASK 0x4 FORMAT "%13.11" ECU_ADDRESS 0x380C39 /end MEASUREMENT
/begin MEASUREMENT B_adde "Bedingung Adernschluß oder defekte Sonde mit begrenztem Spannungshub" UBYTE B_TRUE 1 100 0 1 BIT_MASK 0x10 FORMAT "%13.11" ECU_ADDRESS 0x380C38 /end MEASUREMENT
/begin MEASUREMENT B_adde2 "Bedingung Adernschluß oder defekte Sonde mit begrenztem Spannungshub Bank2" UBYTE B_TRUE 1 100 0 1 BIT_MASK 0x10 FORMAT "%13.11" ECU_ADDRESS 0x380C39 /end MEASUREMENT
/begin MEASUREMENT B_adsvb "Verbot Betriebsbereitschaft wegen Adernschluß" UBYTE B_TRUE 1 100 0 1 BIT_MASK 0x1 FORMAT "%13.11" ECU_ADDRESS 0x383108 /end MEASUREMENT
/begin MEASUREMENT B_adsvb2 "Verbot Betriebsbereitschaft wegen Adernschluß Bank2" UBYTE B_TRUE 1 100 0 1 BIT_MASK 0x1 FORMAT "%13.11" ECU_ADDRESS 0x383109 /end MEASUREMENT
/begin MEASUREMENT B_analu_m "Monitor, Ausblendung nach dem ersten erkannten Aussetzer" UBYTE B_TRUE 1 100 0 1 BIT_MASK 0x4 FORMAT "%13.11" ECU_ADDRESS 0xE518 /end MEASUREMENT
/begin MEASUREMENT B_dluerk_m "Monitor, Aussetzer erkannt in DMDDLU" UBYTE B_TRUE 1 100 0 1 BIT_MASK 0x1 FORMAT "%13.11" ECU_ADDRESS 0xE518 /end MEASUREMENT
/begin MEASUREMENT B_dmd_reset "" UWORD B_TRUE 1 100 0 1 BIT_MASK 0x10 FORMAT "%13.11" ECU_ADDRESS 0xFDE2 /end MEASUREMENT
/begin MEASUREMENT B_dsven "Bedingung Freigabe Sondendiagnose vor KAT" UWORD B_TRUE 1 100 0 1 BIT_MASK 0x4 FORMAT "%13.11" ECU_ADDRESS 0xFD84 /end MEASUREMENT
/begin MEASUREMENT B_dsven2 "Bedingung Freigabe Sondendiagnose vor KAT Bank2" UWORD B_TRUE 1 100 0 1 BIT_MASK 0x8 FORMAT "%13.11" ECU_ADDRESS 0xFD84 /end MEASUREMENT
/begin MEASUREMENT B_fodo "Bedingung fuel-on/-off adaption in dominantem Bereich aktiv" UBYTE B_TRUE 1 100 0 1 BIT_MASK 0x2 FORMAT "%13.11" ECU_ADDRESS 0x383034 /end MEASUREMENT
/begin MEASUREMENT B_fodon "Bedingung fuel-on Adaption in drehzahldominantem Bereich aktiv" UBYTE B_TRUE 1 100 0 1 BIT_MASK 0x8 FORMAT "%13.11" ECU_ADDRESS 0x383034 /end MEASUREMENT
/begin MEASUREMENT B_fof_m "Monitor, Bedingung fuel-off Adaption aktiv" UBYTE B_TRUE 1 100 0 1 BIT_MASK 0x40 FORMAT "%13.11" ECU_ADDRESS 0xE3E6 /end MEASUREMENT
/begin MEASUREMENT B_fohe "aktueller Bereich ist ein Heilbereich" UBYTE B_TRUE 1 100 0 1 BIT_MASK 0x80 FORMAT "%13.11" ECU_ADDRESS 0x383034 /end MEASUREMENT
/begin MEASUREMENT B_fohold "fuel-on Adaption angehalten" UBYTE B_TRUE 1 100 0 1 BIT_MASK 0x4 FORMAT "%13.11" ECU_ADDRESS 0x383035 /end MEASUREMENT
/begin MEASUREMENT B_fontm "Motortemperatur genügend hoch für fuel-on-Adaption" UWORD B_TRUE 1 100 0 1 BIT_MASK 0x20 FORMAT "%13.11" ECU_ADDRESS 0xFDDE /end MEASUREMENT
/begin MEASUREMENT B_fon_m "Monitor, Bedingung fuel-on Adaption aktiv" UBYTE B_TRUE 1 100 0 1 BIT_MASK 0x1 FORMAT "%13.11" ECU_ADDRESS 0xE3E6 /end MEASUREMENT
/begin MEASUREMENT B_for11 "KF-Bereich 11 fertig gelernt (ready)" UBYTE B_TRUE 1 100 0 1 BIT_MASK 0x1 FORMAT "%13.11" ECU_ADDRESS 0x383038 /end MEASUREMENT
/begin MEASUREMENT B_for12 "KF-Bereich 12 fertig gelernt (ready)" UBYTE B_TRUE 1 100 0 1 BIT_MASK 0x1 FORMAT "%13.11" ECU_ADDRESS 0x383039 /end MEASUREMENT
/begin MEASUREMENT B_for13 "KF-Bereich 13 fertig gelernt (ready)" UBYTE B_TRUE 1 100 0 1 BIT_MASK 0x1 FORMAT "%13.11" ECU_ADDRESS 0x38303A /end MEASUREMENT
/begin MEASUREMENT B_for21 "KF-Bereich 21 fertig gelernt (ready)" UBYTE B_TRUE 1 100 0 1 BIT_MASK 0x2 FORMAT "%13.11" ECU_ADDRESS 0x383038 /end MEASUREMENT
/begin MEASUREMENT B_for22 "KF-Bereich 22 fertig gelernt (ready)" UBYTE B_TRUE 1 100 0 1 BIT_MASK 0x2 FORMAT "%13.11" ECU_ADDRESS 0x383039 /end MEASUREMENT
/begin MEASUREMENT B_for23 "KF-Bereich 23 fertig gelernt (ready)" UBYTE B_TRUE 1 100 0 1 BIT_MASK 0x2 FORMAT "%13.11" ECU_ADDRESS 0x38303A /end MEASUREMENT
/begin MEASUREMENT B_for31 "KF-Bereich 31 fertig gelernt" UBYTE B_TRUE 1 100 0 1 BIT_MASK 0x4 FORMAT "%13.11" ECU_ADDRESS 0x383038 /end MEASUREMENT
/begin MEASUREMENT B_for32 "KF-Bereich 32 fertig gelernt" UBYTE B_TRUE 1 100 0 1 BIT_MASK 0x4 FORMAT "%13.11" ECU_ADDRESS 0x383039 /end MEASUREMENT
/begin MEASUREMENT B_for33 "KF-Bereich 33 fertig gelernt" UBYTE B_TRUE 1 100 0 1 BIT_MASK 0x4 FORMAT "%13.11" ECU_ADDRESS 0x38303A /end MEASUREMENT
/begin MEASUREMENT B_for41 "KF-Bereich 41 fertig gelernt" UBYTE B_TRUE 1 100 0 1 BIT_MASK 0x8 FORMAT "%13.11" ECU_ADDRESS 0x383038 /end MEASUREMENT
/begin MEASUREMENT B_for42 "KF-Bereich 42 fertig gelernt" UBYTE B_TRUE 1 100 0 1 BIT_MASK 0x8 FORMAT "%13.11" ECU_ADDRESS 0x383039 /end MEASUREMENT
/begin MEASUREMENT B_for43 "KF-Bereich 43 fertig gelernt" UBYTE B_TRUE 1 100 0 1 BIT_MASK 0x8 FORMAT "%13.11" ECU_ADDRESS 0x38303A /end MEASUREMENT
/begin MEASUREMENT B_for51 "KF-Bereich 51 fertig gelernt" UBYTE B_TRUE 1 100 0 1 BIT_MASK 0x10 FORMAT "%13.11" ECU_ADDRESS 0x383038 /end MEASUREMENT
/begin MEASUREMENT B_for52 "KF-Bereich 52 fertig gelernt" UBYTE B_TRUE 1 100 0 1 BIT_MASK 0x10 FORMAT "%13.11" ECU_ADDRESS 0x383039 /end MEASUREMENT
/begin MEASUREMENT B_for53 "KF-Bereich 53 fertig gelernt" UBYTE B_TRUE 1 100 0 1 BIT_MASK 0x10 FORMAT "%13.11" ECU_ADDRESS 0x38303A /end MEASUREMENT
/begin MEASUREMENT B_for61 "KF-Bereich 61 fertig gelernt" UBYTE B_TRUE 1 100 0 1 BIT_MASK 0x20 FORMAT "%13.11" ECU_ADDRESS 0x383038 /end MEASUREMENT
/begin MEASUREMENT B_for62 "KF-Bereich 62 fertig gelernt" UBYTE B_TRUE 1 100 0 1 BIT_MASK 0x20 FORMAT "%13.11" ECU_ADDRESS 0x383039 /end MEASUREMENT
/begin MEASUREMENT B_for63 "KF-Bereich 63 fertig gelernt" UBYTE B_TRUE 1 100 0 1 BIT_MASK 0x20 FORMAT "%13.11" ECU_ADDRESS 0x38303A /end MEASUREMENT
/begin MEASUREMENT B_for71 "KF-Bereich 71 fertig gelernt" UBYTE B_TRUE 1 100 0 1 BIT_MASK 0x40 FORMAT "%13.11" ECU_ADDRESS 0x383038 /end MEASUREMENT
/begin MEASUREMENT B_for72 "KF-Bereich 72 fertig gelernt" UBYTE B_TRUE 1 100 0 1 BIT_MASK 0x40 FORMAT "%13.11" ECU_ADDRESS 0x383039 /end MEASUREMENT
/begin MEASUREMENT B_for73 "KF-Bereich 73 fertig gelernt" UBYTE B_TRUE 1 100 0 1 BIT_MASK 0x40 FORMAT "%13.11" ECU_ADDRESS 0x38303A /end MEASUREMENT
/begin MEASUREMENT B_for81 "KF-Bereich 81 fertig gelernt" UBYTE B_TRUE 1 100 0 1 BIT_MASK 0x80 FORMAT "%13.11" ECU_ADDRESS 0x383038 /end MEASUREMENT
/begin MEASUREMENT B_for82 "KF-Bereich 82 fertig gelernt" UBYTE B_TRUE 1 100 0 1 BIT_MASK 0x80 FORMAT "%13.11" ECU_ADDRESS 0x383039 /end MEASUREMENT
/begin MEASUREMENT B_for83 "KF-Bereich 83 fertig gelernt" UBYTE B_TRUE 1 100 0 1 BIT_MASK 0x80 FORMAT "%13.11" ECU_ADDRESS 0x38303A /end MEASUREMENT
/begin MEASUREMENT B_fordo_m "Monitor, Bedingung Adaption in mind. einem dominanten Bereich ready" UBYTE B_TRUE 1 100 0 1 BIT_MASK 0x20 FORMAT "%13.11" ECU_ADDRESS 0xE518 /end MEASUREMENT
/begin MEASUREMENT B_forn01 "mindestens ein Bereich im Drehzahlbereich 01 hat fertig gelernt" UBYTE B_TRUE 1 100 0 1 BIT_MASK 0x1 FORMAT "%13.11" ECU_ADDRESS 0x383036 /end MEASUREMENT
/begin MEASUREMENT B_forn02 "mindestens ein Bereich im Drehzahlbereich 02 hat fertig gelernt" UBYTE B_TRUE 1 100 0 1 BIT_MASK 0x2 FORMAT "%13.11" ECU_ADDRESS 0x383036 /end MEASUREMENT
/begin MEASUREMENT B_forn03 "mindestens ein Bereich im Drehzahlbereich 03 hat fertig gelernt" UBYTE B_TRUE 1 100 0 1 BIT_MASK 0x4 FORMAT "%13.11" ECU_ADDRESS 0x383036 /end MEASUREMENT
/begin MEASUREMENT B_forn04 "mindestens ein Bereich im Drehzahlbereich 04 hat fertig gelernt" UBYTE B_TRUE 1 100 0 1 BIT_MASK 0x8 FORMAT "%13.11" ECU_ADDRESS 0x383036 /end MEASUREMENT
/begin MEASUREMENT B_forn05 "mindestens ein Bereich im Drehzahlbereich 05 hat fertig gelernt" UBYTE B_TRUE 1 100 0 1 BIT_MASK 0x10 FORMAT "%13.11" ECU_ADDRESS 0x383036 /end MEASUREMENT
/begin MEASUREMENT B_forn06 "mindestens ein Bereich im Drehzahlbereich 06 hat fertig gelernt" UBYTE B_TRUE 1 100 0 1 BIT_MASK 0x20 FORMAT "%13.11" ECU_ADDRESS 0x383036 /end MEASUREMENT
/begin MEASUREMENT B_forn07 "mindestens ein Bereich im Drehzahlbereich 07 hat fertig gelernt" UBYTE B_TRUE 1 100 0 1 BIT_MASK 0x40 FORMAT "%13.11" ECU_ADDRESS 0x383036 /end MEASUREMENT
/begin MEASUREMENT B_forn08 "mindestens ein Bereich im Drehzahlbereich 08 hat fertig gelernt" UBYTE B_TRUE 1 100 0 1 BIT_MASK 0x80 FORMAT "%13.11" ECU_ADDRESS 0x383036 /end MEASUREMENT
/begin MEASUREMENT B_forn_m "Monitor, Bedingung Adaption im aktuellen Drehzahlbereich ready" UBYTE B_TRUE 1 100 0 1 BIT_MASK 0x40 FORMAT "%13.11" ECU_ADDRESS 0xE518 /end MEASUREMENT
/begin MEASUREMENT B_forset "Reset der fuel-on/-off Adaption" UWORD B_TRUE 1 100 0 1 BIT_MASK 0x4000 FORMAT "%13.11" ECU_ADDRESS 0xFDDE /end MEASUREMENT
/begin MEASUREMENT B_forun "Status fuel-on/-off Adaption aktiv" UBYTE B_TRUE 1 100 0 1 BIT_MASK 0x10 FORMAT "%13.11" ECU_ADDRESS 0x383035 /end MEASUREMENT
/begin MEASUREMENT B_for_m "Monitor, Bedingung Adaption im aktuellen Bereich ready" UBYTE B_TRUE 1 100 0 1 BIT_MASK 0x10 FORMAT "%13.11" ECU_ADDRESS 0xE518 /end MEASUREMENT
/begin MEASUREMENT B_fos "Bedingung fuel-on/-off aktueller Bereich ist ein Schubbereich" UBYTE B_TRUE 1 100 0 1 BIT_MASK 0x4 FORMAT "%13.11" ECU_ADDRESS 0x383034 /end MEASUREMENT
/begin MEASUREMENT B_foxfg "Bedingung fuel-on/-off freigegeben" UBYTE B_TRUE 1 100 0 1 BIT_MASK 0x8 FORMAT "%13.11" ECU_ADDRESS 0x383035 /end MEASUREMENT
/begin MEASUREMENT B_frdlsv "Bedingung Lambdareglerreset durch %DLSV" UBYTE B_TRUE 1 100 0 1 BIT_MASK 0x1 FORMAT "%13.11" ECU_ADDRESS 0x380C35 /end MEASUREMENT
/begin MEASUREMENT B_frdlsv2 "Bedingung Lambdareglerreset, Bank 2" UBYTE B_TRUE 1 100 0 1 BIT_MASK 0x4 FORMAT "%13.11" ECU_ADDRESS 0x380C35 /end MEASUREMENT
/begin MEASUREMENT B_lsads "Bedingung Sonde hat Adernschluß" UBYTE B_TRUE 1 100 0 1 BIT_MASK 0x10 FORMAT "%13.11" ECU_ADDRESS 0x383108 /end MEASUREMENT
/begin MEASUREMENT B_lsads2 "Bedingung Sonde hat Adernschluß Bank2" UBYTE B_TRUE 1 100 0 1 BIT_MASK 0x10 FORMAT "%13.11" ECU_ADDRESS 0x383109 /end MEASUREMENT
/begin MEASUREMENT B_lsfet "Bedingung Sondenspannung hat Nebenschluß nach Ubatt" UBYTE B_TRUE 1 100 0 1 BIT_MASK 0x2 FORMAT "%13.11" ECU_ADDRESS 0x383108 /end MEASUREMENT
/begin MEASUREMENT B_lsfet2 "Bedingung Sondenspannung hat Nebenschluß nach Ubatt Bank2" UBYTE B_TRUE 1 100 0 1 BIT_MASK 0x2 FORMAT "%13.11" ECU_ADDRESS 0x383109 /end MEASUREMENT
/begin MEASUREMENT B_lshub "Bedingung Sonde begrenzter Spannungshub" UBYTE B_TRUE 1 100 0 1 BIT_MASK 0x4 FORMAT "%13.11" ECU_ADDRESS 0x383108 /end MEASUREMENT
/begin MEASUREMENT B_lshub2 "Bedingung Sonde begrenzter Spannungshub Bank 2" UBYTE B_TRUE 1 100 0 1 BIT_MASK 0x4 FORMAT "%13.11" ECU_ADDRESS 0x383109 /end MEASUREMENT
/begin MEASUREMENT B_lsvklt "Bedingung Lambdasonde vor Kat kalt" UBYTE B_TRUE 1 100 0 1 BIT_MASK 0x40 FORMAT "%13.11" ECU_ADDRESS 0x383108 /end MEASUREMENT
/begin MEASUREMENT B_lsvklt2 "Bedingung Lambdasonde vor Kat kalt Bank2" UBYTE B_TRUE 1 100 0 1 BIT_MASK 0x40 FORMAT "%13.11" ECU_ADDRESS 0x383109 /end MEASUREMENT
/begin MEASUREMENT B_lsvn "Bedingung Nebenschluß bei kalter Sonde vor Kat" UBYTE B_TRUE 1 100 0 1 BIT_MASK 0x8 FORMAT "%13.11" ECU_ADDRESS 0x383108 /end MEASUREMENT
/begin MEASUREMENT B_lsvn2 "Bedingung Nebenschluß bei kalter Sonde vor Kat, Bank2" UBYTE B_TRUE 1 100 0 1 BIT_MASK 0x8 FORMAT "%13.11" ECU_ADDRESS 0x383109 /end MEASUREMENT
/begin MEASUREMENT B_lsvvsp "Bedingung Vertauschte Lambda-Sonden, Regelung sperren" UWORD B_TRUE 1 100 0 1 BIT_MASK 0x1 FORMAT "%13.11" ECU_ADDRESS 0xFDD6 /end MEASUREMENT
/begin MEASUREMENT B_luaerk_m "Monitor, Aussetzer erkannt in DMDLUA" UBYTE B_TRUE 1 100 0 1 BIT_MASK 0x2 FORMAT "%13.11" ECU_ADDRESS 0xE518 /end MEASUREMENT
/begin MEASUREMENT B_luerk_m "Monitor, Aussetzer erkannt in DMDLU" UBYTE B_TRUE 1 100 0 1 BIT_MASK 0x4 FORMAT "%13.11" ECU_ADDRESS 0xE3E6 /end MEASUREMENT
/begin MEASUREMENT B_lustop_m "Laufunruhe-Berechnung gesperrt, Monitor-Größe" UBYTE B_TRUE 1 100 0 1 BIT_MASK 0x8 FORMAT "%13.11" ECU_ADDRESS 0xE3E6 /end MEASUREMENT
/begin MEASUREMENT B_maxflsv "Kurzsschluß nach UBatt bei Sonde vor KAT erkannt" UBYTE B_TRUE 1 100 0 1 BIT_MASK 0x1 FORMAT "%13.11" ECU_ADDRESS 0x380C36 /end MEASUREMENT
/begin MEASUREMENT B_maxflsv2 "Kurzsschluß nach UBatt bei Sonde vor KAT erkannt Bank2" UBYTE B_TRUE 1 100 0 1 BIT_MASK 0x8 FORMAT "%13.11" ECU_ADDRESS 0x380C36 /end MEASUREMENT
/begin MEASUREMENT B_mderk "Aussetzer erkannt, Verknüpfung mehrerer Funktionen" UWORD B_TRUE 1 100 0 1 BIT_MASK 0x10 FORMAT "%13.11" ECU_ADDRESS 0xFDDE /end MEASUREMENT
/begin MEASUREMENT B_mdstim_m "Monitor, Zündungsaussetzer eingestellt, Stimuli-Signal vom Aussetzergenerator" UBYTE B_TRUE 1 100 0 1 BIT_MASK 0x2 FORMAT "%13.11" ECU_ADDRESS 0xE3E6 /end MEASUREMENT
/begin MEASUREMENT B_mdzyl1_m "Monitor, Zylinder-1-Kennung" UBYTE B_TRUE 1 100 0 1 BIT_MASK 0x10 FORMAT "%13.11" ECU_ADDRESS 0xE3E6 /end MEASUREMENT
/begin MEASUREMENT B_nolsv "Bedingung Diagnosefunktion mit i.O.-Meldung vor KAT beendet." UBYTE B_TRUE 1 100 0 1 BIT_MASK 0x1 FORMAT "%13.11" ECU_ADDRESS 0x380C38 /end MEASUREMENT
/begin MEASUREMENT B_nolsv2 "Bedingung Diagnosefunktion mit i.O.-Meldung vor KATbeendet  Bank2" UBYTE B_TRUE 1 100 0 1 BIT_MASK 0x1 FORMAT "%13.11" ECU_ADDRESS 0x380C39 /end MEASUREMENT
/begin MEASUREMENT B_nplflsv "Adernschluß bei Sonde vor KAT erkannt" UBYTE B_TRUE 1 100 0 1 BIT_MASK 0x4 FORMAT "%13.11" ECU_ADDRESS 0x380C36 /end MEASUREMENT
/begin MEASUREMENT B_nplflsv2 "Adernschluß bei Sonde vor KAT erkannt Bank2" UBYTE B_TRUE 1 100 0 1 BIT_MASK 0x20 FORMAT "%13.11" ECU_ADDRESS 0x380C36 /end MEASUREMENT
/begin MEASUREMENT B_plok "Plausibilität der FSE-Werte in allen Drehzahlbereichen gegeben" UWORD B_TRUE 1 100 0 1 BIT_MASK 0x4 FORMAT "%13.11" ECU_ADDRESS 0xFD48 /end MEASUREMENT
/begin MEASUREMENT B_plok01 "Plausibilität der FSE-Werte im Drehzahlbereich 01 gegeben" UBYTE B_TRUE 1 100 0 1 BIT_MASK 0x1 FORMAT "%13.11" ECU_ADDRESS 0x383037 /end MEASUREMENT
/begin MEASUREMENT B_plok02 "Plausibilität der FSE-Werte im Drehzahlbereich 02 gegeben" UBYTE B_TRUE 1 100 0 1 BIT_MASK 0x2 FORMAT "%13.11" ECU_ADDRESS 0x383037 /end MEASUREMENT
/begin MEASUREMENT B_plok03 "Plausibilität der FSE-Werte im Drehzahlbereich 03 gegeben" UBYTE B_TRUE 1 100 0 1 BIT_MASK 0x4 FORMAT "%13.11" ECU_ADDRESS 0x383037 /end MEASUREMENT
/begin MEASUREMENT B_plok04 "Plausibilität der FSE-Werte im Drehzahlbereich 04 gegeben" UBYTE B_TRUE 1 100 0 1 BIT_MASK 0x8 FORMAT "%13.11" ECU_ADDRESS 0x383037 /end MEASUREMENT
/begin MEASUREMENT B_plok05 "Plausibilität der FSE-Werte im Drehzahlbereich 05 gegeben" UBYTE B_TRUE 1 100 0 1 BIT_MASK 0x10 FORMAT "%13.11" ECU_ADDRESS 0x383037 /end MEASUREMENT
/begin MEASUREMENT B_plok06 "Plausibilität der FSE-Werte im Drehzahlbereich 06 gegeben" UBYTE B_TRUE 1 100 0 1 BIT_MASK 0x20 FORMAT "%13.11" ECU_ADDRESS 0x383037 /end MEASUREMENT
/begin MEASUREMENT B_plok07 "Plausibilität der FSE-Werte im Drehzahlbereich 07 gegeben" UBYTE B_TRUE 1 100 0 1 BIT_MASK 0x40 FORMAT "%13.11" ECU_ADDRESS 0x383037 /end MEASUREMENT
/begin MEASUREMENT B_plok08 "Plausibilität der FSE-Werte im Drehzahlbereich 08 gegeben" UBYTE B_TRUE 1 100 0 1 BIT_MASK 0x80 FORMAT "%13.11" ECU_ADDRESS 0x383037 /end MEASUREMENT
/begin MEASUREMENT B_plokn_m "Monitor, Plausibilität der FSE-Werte im aktuellen Drehzahlbereich gegeben" UBYTE B_TRUE 1 100 0 1 BIT_MASK 0x80 FORMAT "%13.11" ECU_ADDRESS 0xE518 /end MEASUREMENT
/begin MEASUREMENT B_refmax "Beding. Sondenspg. im plausiblen Bereich zwischen USREF und USMAX vor KAT" UWORD B_TRUE 1 100 0 1 BIT_MASK 0x10 FORMAT "%13.11" ECU_ADDRESS 0xFD84 /end MEASUREMENT
/begin MEASUREMENT B_refmax2 "Beding. Sondenspg. im plausiblen Bereich zwischen USREF und USMAX vor KAT Bank2" UWORD B_TRUE 1 100 0 1 BIT_MASK 0x20 FORMAT "%13.11" ECU_ADDRESS 0xFD84 /end MEASUREMENT
/begin MEASUREMENT B_risigv "Bedingung Signalunterbrechung Sondenmasse mit Ri-Diagnose vor KAT" UBYTE B_TRUE 1 100 0 1 BIT_MASK 0x2 FORMAT "%13.11" ECU_ADDRESS 0x380C38 /end MEASUREMENT
/begin MEASUREMENT B_risigv2 "Bedingung Signalunterbrechung Sondenmasse mit Ri-Diagnose vor KAT Bank2" UBYTE B_TRUE 1 100 0 1 BIT_MASK 0x2 FORMAT "%13.11" ECU_ADDRESS 0x380C39 /end MEASUREMENT
/begin MEASUREMENT B_sbbvk "Bedingung Sonde betriebsbereit vor Kat" UWORD B_TRUE 1 100 0 1 BIT_MASK 0x10 FORMAT "%13.11" ECU_ADDRESS 0xFD3E /end MEASUREMENT
/begin MEASUREMENT B_sbbvk2 "Bedingung Sonde betriebsbereit vor Kat, Bank 2" UWORD B_TRUE 1 100 0 1 BIT_MASK 0x20 FORMAT "%13.11" ECU_ADDRESS 0xFD3E /end MEASUREMENT
/begin MEASUREMENT B_sigflsv "Signalunterbrechung (Kabelbruch) bei Sonde vor KAT erkannt" UBYTE B_TRUE 1 100 0 1 BIT_MASK 0x2 FORMAT "%13.11" ECU_ADDRESS 0x380C36 /end MEASUREMENT
/begin MEASUREMENT B_sigflsv2 "Signalunterbrechung (Kabelbruch) bei Sonde vor KAT erkannt Bank2" UBYTE B_TRUE 1 100 0 1 BIT_MASK 0x10 FORMAT "%13.11" ECU_ADDRESS 0x380C36 /end MEASUREMENT
/begin MEASUREMENT B_tnalu_m "Monitor, Testphase nach erkanntem Aussetzer" UBYTE B_TRUE 1 100 0 1 BIT_MASK 0x8 FORMAT "%13.11" ECU_ADDRESS 0xE518 /end MEASUREMENT
/begin MEASUREMENT B_trsa "Bedingung Kabelbruch für Sonde vor KAT" UBYTE B_TRUE 1 100 0 1 BIT_MASK 0x1 FORMAT "%13.11" ECU_ADDRESS 0x380C37 /end MEASUREMENT
/begin MEASUREMENT B_trsa2 "Bedingung Kabelbruch für Sonde vor KAT Bank2" UBYTE B_TRUE 1 100 0 1 BIT_MASK 0x4 FORMAT "%13.11" ECU_ADDRESS 0x380C37 /end MEASUREMENT
/begin MEASUREMENT B_tsroov_m "Monitor, Bedingung Segmentzeit-Wordoverflow" UBYTE B_TRUE 1 100 0 1 BIT_MASK 0x20 FORMAT "%13.11" ECU_ADDRESS 0xE3E6 /end MEASUREMENT
/begin MEASUREMENT B_ttbmh "Bedingung theoretische Sondenbetriebsbereitschaft mit Heizung" UWORD B_TRUE 1 100 0 1 BIT_MASK 0x40 FORMAT "%13.11" ECU_ADDRESS 0xFD84 /end MEASUREMENT
/begin MEASUREMENT B_ttbmh2 "Bedingung theoretische Sondenbetriebsbereitschaft mit Heizung  Bank2" UWORD B_TRUE 1 100 0 1 BIT_MASK 0x80 FORMAT "%13.11" ECU_ADDRESS 0xFD84 /end MEASUREMENT
/begin MEASUREMENT B_ueinv "Bedingung Vorbereitung zur Einschaltung der Sondenbetriebsbereitschaft vor KAT" UBYTE B_TRUE 1 100 0 1 BIT_MASK 0x8 FORMAT "%13.11" ECU_ADDRESS 0x380C38 /end MEASUREMENT
/begin MEASUREMENT B_ueinv2 "Bedingung Vorbereitung zur Einschaltung der Sondenbetriebsbereitschaft v. KAT 2" UBYTE B_TRUE 1 100 0 1 BIT_MASK 0x8 FORMAT "%13.11" ECU_ADDRESS 0x380C39 /end MEASUREMENT
/begin MEASUREMENT B_uvsig "Bedingung Sondenspannung vor KAT im Spannungsband für Signalunterbrechung" UWORD B_TRUE 1 100 0 1 BIT_MASK 0x100 FORMAT "%13.11" ECU_ADDRESS 0xFD84 /end MEASUREMENT
/begin MEASUREMENT B_uvsig2 "Bedingung Sondenspg. vor KAT im Spannungsband für Signalunterbrechung Bank2" UWORD B_TRUE 1 100 0 1 BIT_MASK 0x200 FORMAT "%13.11" ECU_ADDRESS 0xFD84 /end MEASUREMENT
/begin MEASUREMENT B_vadge "Bedingung Verdacht auf Adernschluß oder Gemischfehler" UBYTE B_TRUE 1 100 0 1 BIT_MASK 0x20 FORMAT "%13.11" ECU_ADDRESS 0x380C38 /end MEASUREMENT
/begin MEASUREMENT B_vadge2 "Bedingung Verdacht auf Adernschluß oder Gemischfehler Bank2" UBYTE B_TRUE 1 100 0 1 BIT_MASK 0x20 FORMAT "%13.11" ECU_ADDRESS 0x380C39 /end MEASUREMENT
/begin MEASUREMENT B_vcsd "Verdacht CSD bei Sonde vor KAT" UBYTE B_TRUE 1 100 0 1 BIT_MASK 0x2 FORMAT "%13.11" ECU_ADDRESS 0x380C37 /end MEASUREMENT
/begin MEASUREMENT B_vcsd2 "Verdacht CSD bei Sonde vor KAT, Bank 2" UBYTE B_TRUE 1 100 0 1 BIT_MASK 0x8 FORMAT "%13.11" ECU_ADDRESS 0x380C37 /end MEASUREMENT
/begin MEASUREMENT B_vgeflr "Bedingung Verdacht auf Gemischfehler" UBYTE B_TRUE 1 100 0 1 BIT_MASK 0x20 FORMAT "%13.11" ECU_ADDRESS 0x383108 /end MEASUREMENT
/begin MEASUREMENT B_vgeflr2 "Bedingung Verdacht auf Gemischfehler Bank 2" UBYTE B_TRUE 1 100 0 1 BIT_MASK 0x20 FORMAT "%13.11" ECU_ADDRESS 0x383109 /end MEASUREMENT
/begin MEASUREMENT B_vsigf "Verdacht Signalfehler bei Sonde vor KAT" UBYTE B_TRUE 1 100 0 1 BIT_MASK 0x2 FORMAT "%13.11" ECU_ADDRESS 0x380C35 /end MEASUREMENT
/begin MEASUREMENT B_vsigf2 "Verdacht Signalfehler bei Sonde vor KAT, Bank 2" UBYTE B_TRUE 1 100 0 1 BIT_MASK 0x8 FORMAT "%13.11" ECU_ADDRESS 0x380C35 /end MEASUREMENT
/begin MEASUREMENT cfoxx "zeigt die Eigenschaften des aktuellen KF-Bereiches der Fuel-on/-off Adaption" UBYTE dez 1 100 0 255 FORMAT "%5.1" ECU_ADDRESS 0x383034 /end MEASUREMENT
/begin MEASUREMENT dfse01 "Status Plausibilitätsprüfung der fuel-on/-off Adaption im Drehzahlber.01 erfüllt" SBYTE dtsegn_b11p25divZyl 1 100 -1.40625 1.39526 FORMAT "%5.3" ECU_ADDRESS 0x380B8D /end MEASUREMENT
/begin MEASUREMENT dfse02 "Status Plausibilitätsprüfung der fuel-on/-off Adaption im Drehzahlber.02erfüllt" SBYTE dtsegn_b11p25divZyl 1 100 -1.40625 1.39526 FORMAT "%5.3" ECU_ADDRESS 0x380B8E /end MEASUREMENT
/begin MEASUREMENT dfse03 "Status Plausibilitätsprüfung der fuel-on/-off Adaption im Drehzahlber.3 erfüllt" SBYTE dtsegn_b11p25divZyl 1 100 -1.40625 1.39526 FORMAT "%5.3" ECU_ADDRESS 0x380B8F /end MEASUREMENT
/begin MEASUREMENT dfse04 "Status Plausibilitätsprüfung der fuel-on/-off Adaption im Drehzahlber.4 erfüllt" SBYTE dtsegn_b11p25divZyl 1 100 -1.40625 1.39526 FORMAT "%5.3" ECU_ADDRESS 0x380B90 /end MEASUREMENT
/begin MEASUREMENT dfse05 "Status Plausibilitätsprüfung der fuel-on/-off Adaption im Drehzahlber.5 erfüllt" SBYTE dtsegn_b11p25divZyl 1 100 -1.40625 1.39526 FORMAT "%5.3" ECU_ADDRESS 0x380B91 /end MEASUREMENT
/begin MEASUREMENT dfse06 "Status Plausibilitätsprüfung der fuel-on/-off Adaption im Drehzahlber.6 erfüllt" SBYTE dtsegn_b11p25divZyl 1 100 -1.40625 1.39526 FORMAT "%5.3" ECU_ADDRESS 0x380B92 /end MEASUREMENT
/begin MEASUREMENT dfse07 "Status Plausibilitätsprüfung der fuel-on/-off Adaption im Drehzahlber.7 erfüllt" SBYTE dtsegn_b11p25divZyl 1 100 -1.40625 1.39526 FORMAT "%5.3" ECU_ADDRESS 0x380B93 /end MEASUREMENT
/begin MEASUREMENT dfse08 "Status Plausibilitätsprüfung der fuel-on/-off Adaption im Drehzahlber.8 erfüllt" SBYTE dtsegn_b11p25divZyl 1 100 -1.40625 1.39526 FORMAT "%5.3" ECU_ADDRESS 0x380B94 /end MEASUREMENT
/begin MEASUREMENT dfsen "Differenz der FSE-Werte im Normalbetrieb im aktuellen n-Bereich" SBYTE dtsegn_b11p25divZyl 1 100 -1.40625 1.39526 FORMAT "%5.3" ECU_ADDRESS 0x380B95 /end MEASUREMENT
/begin MEASUREMENT dfseresz "Resetzähler Plausibilitätsprüfung FSE" UWORD dez 1 100 0 65535 FORMAT "%8.2" ECU_ADDRESS 0x383582 /end MEASUREMENT
/begin MEASUREMENT DLSVerrors "" UBYTE dez 1 100 0 255 FORMAT "%5.1" ECU_ADDRESS 0x380C36 /end MEASUREMENT
/begin MEASUREMENT DLSVintbits "" UBYTE dez 1 100 0 255 FORMAT "%5.1" ECU_ADDRESS 0x380C37 /end MEASUREMENT
/begin MEASUREMENT dlurs "Laufunruhedifferenz-Referenzwert, signed" SBYTE luquant 1 100 -90.9495 90.2389 FORMAT "%5.2" ECU_ADDRESS 0x380BB6 /end MEASUREMENT
/begin MEASUREMENT dlurs_m "Monitor, Laufunruhedifferenz-Referenzwert, signed, verzögerte Ausgabe" SBYTE luquant 1 100 -90.9495 90.2389 FORMAT "%5.2" ECU_ADDRESS 0xE516 /end MEASUREMENT
/begin MEASUREMENT dluts "Laufunruhedifferenz-Testgröße, signed" SBYTE luquant 1 100 -90.9495 90.2389 FORMAT "%5.2" ECU_ADDRESS 0x380B99 /end MEASUREMENT
/begin MEASUREMENT dluts1 "Differenz Laufunruhe-Testgröße, signed" SBYTE luquant 1 100 -90.9495 90.2389 FORMAT "%5.2" ECU_ADDRESS 0x380B9A /end MEASUREMENT
/begin MEASUREMENT dluts2 "Differenz Laufunruhe-Testgröße, signed" SBYTE luquant 1 100 -90.9495 90.2389 FORMAT "%5.2" ECU_ADDRESS 0x380B9B /end MEASUREMENT
/begin MEASUREMENT dluts3 "Differenz Laufunruhe-Testgröße, signed" SBYTE luquant 1 100 -90.9495 90.2389 FORMAT "%5.2" ECU_ADDRESS 0x380B9C /end MEASUREMENT
/begin MEASUREMENT dluts4 "Differenz Laufunruhe-Testgröße, signed" SBYTE luquant 1 100 -90.9495 90.2389 FORMAT "%5.2" ECU_ADDRESS 0x380B9D /end MEASUREMENT
/begin MEASUREMENT dluts5 "Differenz Laufunruhe-Testgröße, signed" SBYTE luquant 1 100 -90.9495 90.2389 FORMAT "%5.2" ECU_ADDRESS 0x380B9E /end MEASUREMENT
/begin MEASUREMENT dluts6 "Differenz Laufunruhe-Testgröße, signed" SBYTE luquant 1 100 -90.9495 90.2389 FORMAT "%5.2" ECU_ADDRESS 0x380B9F /end MEASUREMENT
/begin MEASUREMENT dluts7 "Differenz Laufunruhe-Testgröße, signed" SBYTE luquant 1 100 -90.9495 90.2389 FORMAT "%5.2" ECU_ADDRESS 0x380BA0 /end MEASUREMENT
/begin MEASUREMENT dluts8 "Differenz Laufunruhe-Testgröße, signed" SBYTE luquant 1 100 -90.9495 90.2389 FORMAT "%5.2" ECU_ADDRESS 0x380BA1 /end MEASUREMENT
/begin MEASUREMENT dluts_m "Monitor, Laufunruhedifferenz-Testgröße, signed, verzögerte Ausgabe" SBYTE luquant 1 100 -90.9495 90.2389 FORMAT "%5.2" ECU_ADDRESS 0xE515 /end MEASUREMENT
/begin MEASUREMENT esst_sdz03dmub "" UWORD dez 1 100 0 65535 FORMAT "%8.2" ECU_ADDRESS 0x380FF2 /end MEASUREMENT
/begin MEASUREMENT esst_sdz08dmub "" UWORD dez 1 100 0 65535 FORMAT "%8.2" ECU_ADDRESS 0x380FF4 /end MEASUREMENT
/begin MEASUREMENT famal "Faktor zur Absenkung des LUR-Wertes bei Mehrfachaussetzern, aus KFFAMALU" UBYTE fak_ub_b1 1 100 0 0.996094 ECU_ADDRESS 0x380B8B /end MEASUREMENT
/begin MEASUREMENT fdmd_m "Statusflag diagnose misfire detection, Monitor, verzögerte Ausgabe" UBYTE DEZ 1 100 0 255 FORMAT "%5.1" ECU_ADDRESS 0xE518 /end MEASUREMENT
/begin MEASUREMENT fflutn "Filterfaktor über n für Filterung der Laufunruhe" UBYTE fak_ub_b1 1 100 0 0.996094 ECU_ADDRESS 0x380BA2 /end MEASUREMENT
/begin MEASUREMENT ffon "Statusbyte Übersicht fuel-on Adaption" UBYTE dez 1 100 0 255 FORMAT "%5.1" ECU_ADDRESS 0x383035 /end MEASUREMENT
/begin MEASUREMENT ffonn1 "Statusbyte fuel-on/-off Adaption (KF-Bereiche fertig gelernt)" UBYTE dez 1 100 0 255 FORMAT "%5.1" ECU_ADDRESS 0x383038 /end MEASUREMENT
/begin MEASUREMENT ffonn2 "Statusbyte fuel-on/-off Adaption (KF-Bereiche fertig gelernt)" UBYTE dez 1 100 0 255 FORMAT "%5.1" ECU_ADDRESS 0x383039 /end MEASUREMENT
/begin MEASUREMENT ffonn3 "Statusbyte fuel-on/-off Adaption (KF-Bereiche fertig gelernt)" UBYTE dez 1 100 0 255 FORMAT "%5.1" ECU_ADDRESS 0x38303A /end MEASUREMENT
/begin MEASUREMENT fforn1 "Statusbyte fuel-on/-off Adaption (n-Bereiche fertig gelernt)" UBYTE dez 1 100 0 255 FORMAT "%5.1" ECU_ADDRESS 0x383036 /end MEASUREMENT
/begin MEASUREMENT ffpl1 "Statusbyte der fuel-on/-off Adaption (FSE-Werte der Drz.-Bereiche plausibel I)" UBYTE dez 1 100 0 255 FORMAT "%5.1" ECU_ADDRESS 0x383037 /end MEASUREMENT
/begin MEASUREMENT flg_m "Monitor Status Laufunruhe-Berechnung" UBYTE DEZ 1 100 0 255 FORMAT "%5.1" ECU_ADDRESS 0xE3E6 /end MEASUREMENT
/begin MEASUREMENT flmx "aktuell maximaler Lernfilterwert" SWORD dtsegn_b720divZyl 1 100 -90 89.9973 FORMAT "%8.5" ECU_ADDRESS 0x381AE8 /end MEASUREMENT
/begin MEASUREMENT flmxresz "Resetzähler Lernfilterwert weggelaufen" UWORD dez 1 100 0 65535 FORMAT "%8.2" ECU_ADDRESS 0x383584 /end MEASUREMENT
/begin MEASUREMENT fln11_02 "Lernfilterwert, negativ, Betriebsbereich 11, Zylinder 2" SWORD dtsegn_b720divZyl 1 100 -90 89.9973 FORMAT "%8.5" ECU_ADDRESS 0x383192 /end MEASUREMENT
/begin MEASUREMENT fln11_03 "Lernfilterwert, negativ" SWORD dtsegn_b720divZyl 1 100 -90 89.9973 FORMAT "%8.5" ECU_ADDRESS 0x3831C2 /end MEASUREMENT
/begin MEASUREMENT fln11_04 "Lernfilterwert, negativ" SWORD dtsegn_b720divZyl 1 100 -90 89.9973 FORMAT "%8.5" ECU_ADDRESS 0x3831F2 /end MEASUREMENT
/begin MEASUREMENT fln11_05 "Lernfilterwert, negativ" SWORD dtsegn_b720divZyl 1 100 -90 89.9973 FORMAT "%8.5" ECU_ADDRESS 0x383222 /end MEASUREMENT
/begin MEASUREMENT fln11_06 "Lernfilterwert, negativ" SWORD dtsegn_b720divZyl 1 100 -90 89.9973 FORMAT "%8.5" ECU_ADDRESS 0x383252 /end MEASUREMENT
/begin MEASUREMENT fln11_07 "Lernfilterwert, negativ" SWORD dtsegn_b720divZyl 1 100 -90 89.9973 FORMAT "%8.5" ECU_ADDRESS 0x383282 /end MEASUREMENT
/begin MEASUREMENT fln11_08 "Lernfilterwert, negativ" SWORD dtsegn_b720divZyl 1 100 -90 89.9973 FORMAT "%8.5" ECU_ADDRESS 0x3832B2 /end MEASUREMENT
/begin MEASUREMENT fln12_02 "Lernfilterwert, negativ" SWORD dtsegn_b720divZyl 1 100 -90 89.9973 FORMAT "%8.5" ECU_ADDRESS 0x3831A2 /end MEASUREMENT
/begin MEASUREMENT fln12_03 "Lernfilterwert, negativ" SWORD dtsegn_b720divZyl 1 100 -90 89.9973 FORMAT "%8.5" ECU_ADDRESS 0x3831D2 /end MEASUREMENT
/begin MEASUREMENT fln12_04 "Lernfilterwert, negativ" SWORD dtsegn_b720divZyl 1 100 -90 89.9973 FORMAT "%8.5" ECU_ADDRESS 0x383202 /end MEASUREMENT
/begin MEASUREMENT fln12_05 "Lernfilterwert, negativ" SWORD dtsegn_b720divZyl 1 100 -90 89.9973 FORMAT "%8.5" ECU_ADDRESS 0x383232 /end MEASUREMENT
/begin MEASUREMENT fln12_06 "Lernfilterwert, negativ" SWORD dtsegn_b720divZyl 1 100 -90 89.9973 FORMAT "%8.5" ECU_ADDRESS 0x383262 /end MEASUREMENT
/begin MEASUREMENT fln12_07 "Lernfilterwert, negativ" SWORD dtsegn_b720divZyl 1 100 -90 89.9973 FORMAT "%8.5" ECU_ADDRESS 0x383292 /end MEASUREMENT
/begin MEASUREMENT fln12_08 "Lernfilterwert, negativ" SWORD dtsegn_b720divZyl 1 100 -90 89.9973 FORMAT "%8.5" ECU_ADDRESS 0x3832C2 /end MEASUREMENT
/begin MEASUREMENT fln13_02 "Lernfilterwert, negativ" SWORD dtsegn_b720divZyl 1 100 -90 89.9973 FORMAT "%8.5" ECU_ADDRESS 0x3831B2 /end MEASUREMENT
/begin MEASUREMENT fln13_03 "Lernfilterwert, negativ" SWORD dtsegn_b720divZyl 1 100 -90 89.9973 FORMAT "%8.5" ECU_ADDRESS 0x3831E2 /end MEASUREMENT
/begin MEASUREMENT fln13_04 "Lernfilterwert, negativ" SWORD dtsegn_b720divZyl 1 100 -90 89.9973 FORMAT "%8.5" ECU_ADDRESS 0x383212 /end MEASUREMENT
/begin MEASUREMENT fln13_05 "Lernfilterwert, negativ" SWORD dtsegn_b720divZyl 1 100 -90 89.9973 FORMAT "%8.5" ECU_ADDRESS 0x383242 /end MEASUREMENT
/begin MEASUREMENT fln13_06 "Lernfilterwert, negativ" SWORD dtsegn_b720divZyl 1 100 -90 89.9973 FORMAT "%8.5" ECU_ADDRESS 0x383272 /end MEASUREMENT
/begin MEASUREMENT fln13_07 "Lernfilterwert, negativ" SWORD dtsegn_b720divZyl 1 100 -90 89.9973 FORMAT "%8.5" ECU_ADDRESS 0x3832A2 /end MEASUREMENT
/begin MEASUREMENT fln13_08 "Lernfilterwert, negativ" SWORD dtsegn_b720divZyl 1 100 -90 89.9973 FORMAT "%8.5" ECU_ADDRESS 0x3832D2 /end MEASUREMENT
/begin MEASUREMENT fln21_02 "Lernfilterwert, negativ" SWORD dtsegn_b720divZyl 1 100 -90 89.9973 FORMAT "%8.5" ECU_ADDRESS 0x383194 /end MEASUREMENT
/begin MEASUREMENT fln21_03 "Lernfilterwert, negativ" SWORD dtsegn_b720divZyl 1 100 -90 89.9973 FORMAT "%8.5" ECU_ADDRESS 0x3831C4 /end MEASUREMENT
/begin MEASUREMENT fln21_04 "Lernfilterwert, negativ" SWORD dtsegn_b720divZyl 1 100 -90 89.9973 FORMAT "%8.5" ECU_ADDRESS 0x3831F4 /end MEASUREMENT
/begin MEASUREMENT fln21_05 "Lernfilterwert, negativ" SWORD dtsegn_b720divZyl 1 100 -90 89.9973 FORMAT "%8.5" ECU_ADDRESS 0x383224 /end MEASUREMENT
/begin MEASUREMENT fln21_06 "Lernfilterwert, negativ" SWORD dtsegn_b720divZyl 1 100 -90 89.9973 FORMAT "%8.5" ECU_ADDRESS 0x383254 /end MEASUREMENT
/begin MEASUREMENT fln21_07 "Lernfilterwert, negativ" SWORD dtsegn_b720divZyl 1 100 -90 89.9973 FORMAT "%8.5" ECU_ADDRESS 0x383284 /end MEASUREMENT
/begin MEASUREMENT fln21_08 "Lernfilterwert, negativ" SWORD dtsegn_b720divZyl 1 100 -90 89.9973 FORMAT "%8.5" ECU_ADDRESS 0x3832B4 /end MEASUREMENT
/begin MEASUREMENT fln22_02 "Lernfilterwert, negativ" SWORD dtsegn_b720divZyl 1 100 -90 89.9973 FORMAT "%8.5" ECU_ADDRESS 0x3831A4 /end MEASUREMENT
/begin MEASUREMENT fln22_03 "Lernfilterwert, negativ" SWORD dtsegn_b720divZyl 1 100 -90 89.9973 FORMAT "%8.5" ECU_ADDRESS 0x3831D4 /end MEASUREMENT
/begin MEASUREMENT fln22_04 "Lernfilterwert, negativ" SWORD dtsegn_b720divZyl 1 100 -90 89.9973 FORMAT "%8.5" ECU_ADDRESS 0x383204 /end MEASUREMENT
/begin MEASUREMENT fln22_05 "Lernfilterwert, negativ" SWORD dtsegn_b720divZyl 1 100 -90 89.9973 FORMAT "%8.5" ECU_ADDRESS 0x383234 /end MEASUREMENT
/begin MEASUREMENT fln22_06 "Lernfilterwert, negativ" SWORD dtsegn_b720divZyl 1 100 -90 89.9973 FORMAT "%8.5" ECU_ADDRESS 0x383264 /end MEASUREMENT
/begin MEASUREMENT fln22_07 "Lernfilterwert, negativ" SWORD dtsegn_b720divZyl 1 100 -90 89.9973 FORMAT "%8.5" ECU_ADDRESS 0x383294 /end MEASUREMENT
/begin MEASUREMENT fln22_08 "Lernfilterwert, negativ" SWORD dtsegn_b720divZyl 1 100 -90 89.9973 FORMAT "%8.5" ECU_ADDRESS 0x3832C4 /end MEASUREMENT
/begin MEASUREMENT fln23_02 "Lernfilterwert, negativ" SWORD dtsegn_b720divZyl 1 100 -90 89.9973 FORMAT "%8.5" ECU_ADDRESS 0x3831B4 /end MEASUREMENT
/begin MEASUREMENT fln23_03 "Lernfilterwert, negativ" SWORD dtsegn_b720divZyl 1 100 -90 89.9973 FORMAT "%8.5" ECU_ADDRESS 0x3831E4 /end MEASUREMENT
/begin MEASUREMENT fln23_04 "Lernfilterwert, negativ" SWORD dtsegn_b720divZyl 1 100 -90 89.9973 FORMAT "%8.5" ECU_ADDRESS 0x383214 /end MEASUREMENT
/begin MEASUREMENT fln23_05 "Lernfilterwert, negativ" SWORD dtsegn_b720divZyl 1 100 -90 89.9973 FORMAT "%8.5" ECU_ADDRESS 0x383244 /end MEASUREMENT
/begin MEASUREMENT fln23_06 "Lernfilterwert, negativ" SWORD dtsegn_b720divZyl 1 100 -90 89.9973 FORMAT "%8.5" ECU_ADDRESS 0x383274 /end MEASUREMENT
/begin MEASUREMENT fln23_07 "Lernfilterwert, negativ" SWORD dtsegn_b720divZyl 1 100 -90 89.9973 FORMAT "%8.5" ECU_ADDRESS 0x3832A4 /end MEASUREMENT
/begin MEASUREMENT fln23_08 "Lernfilterwert, negativ" SWORD dtsegn_b720divZyl 1 100 -90 89.9973 FORMAT "%8.5" ECU_ADDRESS 0x3832D4 /end MEASUREMENT
/begin MEASUREMENT fln31_02 "Lernfilterwert, negativ" SWORD dtsegn_b720divZyl 1 100 -90 89.9973 FORMAT "%8.5" ECU_ADDRESS 0x383196 /end MEASUREMENT
/begin MEASUREMENT fln31_03 "Lernfilterwert, negativ" SWORD dtsegn_b720divZyl 1 100 -90 89.9973 FORMAT "%8.5" ECU_ADDRESS 0x3831C6 /end MEASUREMENT
/begin MEASUREMENT fln31_04 "Lernfilterwert, negativ" SWORD dtsegn_b720divZyl 1 100 -90 89.9973 FORMAT "%8.5" ECU_ADDRESS 0x3831F6 /end MEASUREMENT
/begin MEASUREMENT fln31_05 "Lernfilterwert, negativ" SWORD dtsegn_b720divZyl 1 100 -90 89.9973 FORMAT "%8.5" ECU_ADDRESS 0x383226 /end MEASUREMENT
/begin MEASUREMENT fln31_06 "Lernfilterwert, negativ" SWORD dtsegn_b720divZyl 1 100 -90 89.9973 FORMAT "%8.5" ECU_ADDRESS 0x383256 /end MEASUREMENT
/begin MEASUREMENT fln31_07 "Lernfilterwert, negativ" SWORD dtsegn_b720divZyl 1 100 -90 89.9973 FORMAT "%8.5" ECU_ADDRESS 0x383286 /end MEASUREMENT
/begin MEASUREMENT fln31_08 "Lernfilterwert, negativ" SWORD dtsegn_b720divZyl 1 100 -90 89.9973 FORMAT "%8.5" ECU_ADDRESS 0x3832B6 /end MEASUREMENT
/begin MEASUREMENT fln32_02 "Lernfilterwert, negativ" SWORD dtsegn_b720divZyl 1 100 -90 89.9973 FORMAT "%8.5" ECU_ADDRESS 0x3831A6 /end MEASUREMENT
/begin MEASUREMENT fln32_03 "Lernfilterwert, negativ" SWORD dtsegn_b720divZyl 1 100 -90 89.9973 FORMAT "%8.5" ECU_ADDRESS 0x3831D6 /end MEASUREMENT
/begin MEASUREMENT fln32_04 "Lernfilterwert, negativ" SWORD dtsegn_b720divZyl 1 100 -90 89.9973 FORMAT "%8.5" ECU_ADDRESS 0x383206 /end MEASUREMENT
/begin MEASUREMENT fln32_05 "Lernfilterwert, negativ" SWORD dtsegn_b720divZyl 1 100 -90 89.9973 FORMAT "%8.5" ECU_ADDRESS 0x383236 /end MEASUREMENT
/begin MEASUREMENT fln32_06 "Lernfilterwert, negativ" SWORD dtsegn_b720divZyl 1 100 -90 89.9973 FORMAT "%8.5" ECU_ADDRESS 0x383266 /end MEASUREMENT
/begin MEASUREMENT fln32_07 "Lernfilterwert, negativ" SWORD dtsegn_b720divZyl 1 100 -90 89.9973 FORMAT "%8.5" ECU_ADDRESS 0x383296 /end MEASUREMENT
/begin MEASUREMENT fln32_08 "Lernfilterwert, negativ" SWORD dtsegn_b720divZyl 1 100 -90 89.9973 FORMAT "%8.5" ECU_ADDRESS 0x3832C6 /end MEASUREMENT
/begin MEASUREMENT fln33_02 "Lernfilterwert, negativ" SWORD dtsegn_b720divZyl 1 100 -90 89.9973 FORMAT "%8.5" ECU_ADDRESS 0x3831B6 /end MEASUREMENT
/begin MEASUREMENT fln33_03 "Lernfilterwert, negativ" SWORD dtsegn_b720divZyl 1 100 -90 89.9973 FORMAT "%8.5" ECU_ADDRESS 0x3831E6 /end MEASUREMENT
/begin MEASUREMENT fln33_04 "Lernfilterwert, negativ" SWORD dtsegn_b720divZyl 1 100 -90 89.9973 FORMAT "%8.5" ECU_ADDRESS 0x383216 /end MEASUREMENT
/begin MEASUREMENT fln33_05 "Lernfilterwert, negativ" SWORD dtsegn_b720divZyl 1 100 -90 89.9973 FORMAT "%8.5" ECU_ADDRESS 0x383246 /end MEASUREMENT
/begin MEASUREMENT fln33_06 "Lernfilterwert, negativ" SWORD dtsegn_b720divZyl 1 100 -90 89.9973 FORMAT "%8.5" ECU_ADDRESS 0x383276 /end MEASUREMENT
/begin MEASUREMENT fln33_07 "Lernfilterwert, negativ" SWORD dtsegn_b720divZyl 1 100 -90 89.9973 FORMAT "%8.5" ECU_ADDRESS 0x3832A6 /end MEASUREMENT
/begin MEASUREMENT fln33_08 "Lernfilterwert, negativ" SWORD dtsegn_b720divZyl 1 100 -90 89.9973 FORMAT "%8.5" ECU_ADDRESS 0x3832D6 /end MEASUREMENT
/begin MEASUREMENT fln41_02 "Lernfilterwert, negativ" SWORD dtsegn_b720divZyl 1 100 -90 89.9973 FORMAT "%8.5" ECU_ADDRESS 0x383198 /end MEASUREMENT
/begin MEASUREMENT fln41_03 "Lernfilterwert, negativ" SWORD dtsegn_b720divZyl 1 100 -90 89.9973 FORMAT "%8.5" ECU_ADDRESS 0x3831C8 /end MEASUREMENT
/begin MEASUREMENT fln41_04 "Lernfilterwert, negativ" SWORD dtsegn_b720divZyl 1 100 -90 89.9973 FORMAT "%8.5" ECU_ADDRESS 0x3831F8 /end MEASUREMENT
/begin MEASUREMENT fln41_05 "Lernfilterwert, negativ" SWORD dtsegn_b720divZyl 1 100 -90 89.9973 FORMAT "%8.5" ECU_ADDRESS 0x383228 /end MEASUREMENT
/begin MEASUREMENT fln41_06 "Lernfilterwert, negativ" SWORD dtsegn_b720divZyl 1 100 -90 89.9973 FORMAT "%8.5" ECU_ADDRESS 0x383258 /end MEASUREMENT
/begin MEASUREMENT fln41_07 "Lernfilterwert, negativ" SWORD dtsegn_b720divZyl 1 100 -90 89.9973 FORMAT "%8.5" ECU_ADDRESS 0x383288 /end MEASUREMENT
/begin MEASUREMENT fln41_08 "Lernfilterwert, negativ" SWORD dtsegn_b720divZyl 1 100 -90 89.9973 FORMAT "%8.5" ECU_ADDRESS 0x3832B8 /end MEASUREMENT
/begin MEASUREMENT fln42_02 "Lernfilterwert, negativ" SWORD dtsegn_b720divZyl 1 100 -90 89.9973 FORMAT "%8.5" ECU_ADDRESS 0x3831A8 /end MEASUREMENT
/begin MEASUREMENT fln42_03 "Lernfilterwert, negativ" SWORD dtsegn_b720divZyl 1 100 -90 89.9973 FORMAT "%8.5" ECU_ADDRESS 0x3831D8 /end MEASUREMENT
/begin MEASUREMENT fln42_04 "Lernfilterwert, negativ" SWORD dtsegn_b720divZyl 1 100 -90 89.9973 FORMAT "%8.5" ECU_ADDRESS 0x383208 /end MEASUREMENT
/begin MEASUREMENT fln42_05 "Lernfilterwert, negativ" SWORD dtsegn_b720divZyl 1 100 -90 89.9973 FORMAT "%8.5" ECU_ADDRESS 0x383238 /end MEASUREMENT
/begin MEASUREMENT fln42_06 "Lernfilterwert, negativ" SWORD dtsegn_b720divZyl 1 100 -90 89.9973 FORMAT "%8.5" ECU_ADDRESS 0x383268 /end MEASUREMENT
/begin MEASUREMENT fln42_07 "Lernfilterwert, negativ" SWORD dtsegn_b720divZyl 1 100 -90 89.9973 FORMAT "%8.5" ECU_ADDRESS 0x383298 /end MEASUREMENT
/begin MEASUREMENT fln42_08 "Lernfilterwert, negativ" SWORD dtsegn_b720divZyl 1 100 -90 89.9973 FORMAT "%8.5" ECU_ADDRESS 0x3832C8 /end MEASUREMENT
/begin MEASUREMENT fln43_02 "Lernfilterwert, negativ" SWORD dtsegn_b720divZyl 1 100 -90 89.9973 FORMAT "%8.5" ECU_ADDRESS 0x3831B8 /end MEASUREMENT
/begin MEASUREMENT fln43_03 "Lernfilterwert, negativ" SWORD dtsegn_b720divZyl 1 100 -90 89.9973 FORMAT "%8.5" ECU_ADDRESS 0x3831E8 /end MEASUREMENT
/begin MEASUREMENT fln43_04 "Lernfilterwert, negativ" SWORD dtsegn_b720divZyl 1 100 -90 89.9973 FORMAT "%8.5" ECU_ADDRESS 0x383218 /end MEASUREMENT
/begin MEASUREMENT fln43_05 "Lernfilterwert, negativ" SWORD dtsegn_b720divZyl 1 100 -90 89.9973 FORMAT "%8.5" ECU_ADDRESS 0x383248 /end MEASUREMENT
/begin MEASUREMENT fln43_06 "Lernfilterwert, negativ" SWORD dtsegn_b720divZyl 1 100 -90 89.9973 FORMAT "%8.5" ECU_ADDRESS 0x383278 /end MEASUREMENT
/begin MEASUREMENT fln43_07 "Lernfilterwert, negativ" SWORD dtsegn_b720divZyl 1 100 -90 89.9973 FORMAT "%8.5" ECU_ADDRESS 0x3832A8 /end MEASUREMENT
/begin MEASUREMENT fln43_08 "Lernfilterwert, negativ" SWORD dtsegn_b720divZyl 1 100 -90 89.9973 FORMAT "%8.5" ECU_ADDRESS 0x3832D8 /end MEASUREMENT
/begin MEASUREMENT fln51_02 "Lernfilterwert, negativ" SWORD dtsegn_b720divZyl 1 100 -90 89.9973 FORMAT "%8.5" ECU_ADDRESS 0x38319A /end MEASUREMENT
/begin MEASUREMENT fln51_03 "Lernfilterwert, negativ" SWORD dtsegn_b720divZyl 1 100 -90 89.9973 FORMAT "%8.5" ECU_ADDRESS 0x3831CA /end MEASUREMENT
/begin MEASUREMENT fln51_04 "Lernfilterwert, negativ" SWORD dtsegn_b720divZyl 1 100 -90 89.9973 FORMAT "%8.5" ECU_ADDRESS 0x3831FA /end MEASUREMENT
/begin MEASUREMENT fln51_05 "Lernfilterwert, negativ" SWORD dtsegn_b720divZyl 1 100 -90 89.9973 FORMAT "%8.5" ECU_ADDRESS 0x38322A /end MEASUREMENT
/begin MEASUREMENT fln51_06 "Lernfilterwert, negativ" SWORD dtsegn_b720divZyl 1 100 -90 89.9973 FORMAT "%8.5" ECU_ADDRESS 0x38325A /end MEASUREMENT
/begin MEASUREMENT fln51_07 "Lernfilterwert, negativ" SWORD dtsegn_b720divZyl 1 100 -90 89.9973 FORMAT "%8.5" ECU_ADDRESS 0x38328A /end MEASUREMENT
/begin MEASUREMENT fln51_08 "Lernfilterwert, negativ" SWORD dtsegn_b720divZyl 1 100 -90 89.9973 FORMAT "%8.5" ECU_ADDRESS 0x3832BA /end MEASUREMENT
/begin MEASUREMENT fln52_02 "Lernfilterwert, negativ" SWORD dtsegn_b720divZyl 1 100 -90 89.9973 FORMAT "%8.5" ECU_ADDRESS 0x3831AA /end MEASUREMENT
/begin MEASUREMENT fln52_03 "Lernfilterwert, negativ" SWORD dtsegn_b720divZyl 1 100 -90 89.9973 FORMAT "%8.5" ECU_ADDRESS 0x3831DA /end MEASUREMENT
/begin MEASUREMENT fln52_04 "Lernfilterwert, negativ" SWORD dtsegn_b720divZyl 1 100 -90 89.9973 FORMAT "%8.5" ECU_ADDRESS 0x38320A /end MEASUREMENT
/begin MEASUREMENT fln52_05 "Lernfilterwert, negativ" SWORD dtsegn_b720divZyl 1 100 -90 89.9973 FORMAT "%8.5" ECU_ADDRESS 0x38323A /end MEASUREMENT
/begin MEASUREMENT fln52_06 "Lernfilterwert, negativ" SWORD dtsegn_b720divZyl 1 100 -90 89.9973 FORMAT "%8.5" ECU_ADDRESS 0x38326A /end MEASUREMENT
/begin MEASUREMENT fln52_07 "Lernfilterwert, negativ" SWORD dtsegn_b720divZyl 1 100 -90 89.9973 FORMAT "%8.5" ECU_ADDRESS 0x38329A /end MEASUREMENT
/begin MEASUREMENT fln52_08 "Lernfilterwert, negativ" SWORD dtsegn_b720divZyl 1 100 -90 89.9973 FORMAT "%8.5" ECU_ADDRESS 0x3832CA /end MEASUREMENT
/begin MEASUREMENT fln53_02 "Lernfilterwert, negativ" SWORD dtsegn_b720divZyl 1 100 -90 89.9973 FORMAT "%8.5" ECU_ADDRESS 0x3831BA /end MEASUREMENT
/begin MEASUREMENT fln53_03 "Lernfilterwert, negativ" SWORD dtsegn_b720divZyl 1 100 -90 89.9973 FORMAT "%8.5" ECU_ADDRESS 0x3831EA /end MEASUREMENT
/begin MEASUREMENT fln53_04 "Lernfilterwert, negativ" SWORD dtsegn_b720divZyl 1 100 -90 89.9973 FORMAT "%8.5" ECU_ADDRESS 0x38321A /end MEASUREMENT
/begin MEASUREMENT fln53_05 "Lernfilterwert, negativ" SWORD dtsegn_b720divZyl 1 100 -90 89.9973 FORMAT "%8.5" ECU_ADDRESS 0x38324A /end MEASUREMENT
/begin MEASUREMENT fln53_06 "Lernfilterwert, negativ" SWORD dtsegn_b720divZyl 1 100 -90 89.9973 FORMAT "%8.5" ECU_ADDRESS 0x38327A /end MEASUREMENT
/begin MEASUREMENT fln53_07 "Lernfilterwert, negativ" SWORD dtsegn_b720divZyl 1 100 -90 89.9973 FORMAT "%8.5" ECU_ADDRESS 0x3832AA /end MEASUREMENT
/begin MEASUREMENT fln53_08 "Lernfilterwert, negativ" SWORD dtsegn_b720divZyl 1 100 -90 89.9973 FORMAT "%8.5" ECU_ADDRESS 0x3832DA /end MEASUREMENT
/begin MEASUREMENT fln61_02 "Lernfilterwert, negativ" SWORD dtsegn_b720divZyl 1 100 -90 89.9973 FORMAT "%8.5" ECU_ADDRESS 0x38319C /end MEASUREMENT
/begin MEASUREMENT fln61_03 "Lernfilterwert, negativ" SWORD dtsegn_b720divZyl 1 100 -90 89.9973 FORMAT "%8.5" ECU_ADDRESS 0x3831CC /end MEASUREMENT
/begin MEASUREMENT fln61_04 "Lernfilterwert, negativ" SWORD dtsegn_b720divZyl 1 100 -90 89.9973 FORMAT "%8.5" ECU_ADDRESS 0x3831FC /end MEASUREMENT
/begin MEASUREMENT fln61_05 "Lernfilterwert, negativ" SWORD dtsegn_b720divZyl 1 100 -90 89.9973 FORMAT "%8.5" ECU_ADDRESS 0x38322C /end MEASUREMENT
/begin MEASUREMENT fln61_06 "Lernfilterwert, negativ" SWORD dtsegn_b720divZyl 1 100 -90 89.9973 FORMAT "%8.5" ECU_ADDRESS 0x38325C /end MEASUREMENT
/begin MEASUREMENT fln61_07 "Lernfilterwert, negativ" SWORD dtsegn_b720divZyl 1 100 -90 89.9973 FORMAT "%8.5" ECU_ADDRESS 0x38328C /end MEASUREMENT
/begin MEASUREMENT fln61_08 "Lernfilterwert, negativ" SWORD dtsegn_b720divZyl 1 100 -90 89.9973 FORMAT "%8.5" ECU_ADDRESS 0x3832BC /end MEASUREMENT
/begin MEASUREMENT fln62_02 "Lernfilterwert, negativ" SWORD dtsegn_b720divZyl 1 100 -90 89.9973 FORMAT "%8.5" ECU_ADDRESS 0x3831AC /end MEASUREMENT
/begin MEASUREMENT fln62_03 "Lernfilterwert, negativ" SWORD dtsegn_b720divZyl 1 100 -90 89.9973 FORMAT "%8.5" ECU_ADDRESS 0x3831DC /end MEASUREMENT
/begin MEASUREMENT fln62_04 "Lernfilterwert, negativ" SWORD dtsegn_b720divZyl 1 100 -90 89.9973 FORMAT "%8.5" ECU_ADDRESS 0x38320C /end MEASUREMENT
/begin MEASUREMENT fln62_05 "Lernfilterwert, negativ" SWORD dtsegn_b720divZyl 1 100 -90 89.9973 FORMAT "%8.5" ECU_ADDRESS 0x38323C /end MEASUREMENT
/begin MEASUREMENT fln62_06 "Lernfilterwert, negativ" SWORD dtsegn_b720divZyl 1 100 -90 89.9973 FORMAT "%8.5" ECU_ADDRESS 0x38326C /end MEASUREMENT
/begin MEASUREMENT fln62_07 "Lernfilterwert, negativ" SWORD dtsegn_b720divZyl 1 100 -90 89.9973 FORMAT "%8.5" ECU_ADDRESS 0x38329C /end MEASUREMENT
/begin MEASUREMENT fln62_08 "Lernfilterwert, negativ" SWORD dtsegn_b720divZyl 1 100 -90 89.9973 FORMAT "%8.5" ECU_ADDRESS 0x3832CC /end MEASUREMENT
/begin MEASUREMENT fln63_02 "Lernfilterwert, negativ" SWORD dtsegn_b720divZyl 1 100 -90 89.9973 FORMAT "%8.5" ECU_ADDRESS 0x3831BC /end MEASUREMENT
/begin MEASUREMENT fln63_03 "Lernfilterwert, negativ" SWORD dtsegn_b720divZyl 1 100 -90 89.9973 FORMAT "%8.5" ECU_ADDRESS 0x3831EC /end MEASUREMENT
/begin MEASUREMENT fln63_04 "Lernfilterwert, negativ" SWORD dtsegn_b720divZyl 1 100 -90 89.9973 FORMAT "%8.5" ECU_ADDRESS 0x38321C /end MEASUREMENT
/begin MEASUREMENT fln63_05 "Lernfilterwert, negativ" SWORD dtsegn_b720divZyl 1 100 -90 89.9973 FORMAT "%8.5" ECU_ADDRESS 0x38324C /end MEASUREMENT
/begin MEASUREMENT fln63_06 "Lernfilterwert, negativ" SWORD dtsegn_b720divZyl 1 100 -90 89.9973 FORMAT "%8.5" ECU_ADDRESS 0x38327C /end MEASUREMENT
/begin MEASUREMENT fln63_07 "Lernfilterwert, negativ" SWORD dtsegn_b720divZyl 1 100 -90 89.9973 FORMAT "%8.5" ECU_ADDRESS 0x3832AC /end MEASUREMENT
/begin MEASUREMENT fln63_08 "Lernfilterwert, negativ" SWORD dtsegn_b720divZyl 1 100 -90 89.9973 FORMAT "%8.5" ECU_ADDRESS 0x3832DC /end MEASUREMENT
/begin MEASUREMENT fln71_02 "Lernfilterwert, negativ" SWORD dtsegn_b720divZyl 1 100 -90 89.9973 FORMAT "%8.5" ECU_ADDRESS 0x38319E /end MEASUREMENT
/begin MEASUREMENT fln71_03 "Lernfilterwert, negativ" SWORD dtsegn_b720divZyl 1 100 -90 89.9973 FORMAT "%8.5" ECU_ADDRESS 0x3831CE /end MEASUREMENT
/begin MEASUREMENT fln71_04 "Lernfilterwert, negativ" SWORD dtsegn_b720divZyl 1 100 -90 89.9973 FORMAT "%8.5" ECU_ADDRESS 0x3831FE /end MEASUREMENT
/begin MEASUREMENT fln71_05 "Lernfilterwert, negativ" SWORD dtsegn_b720divZyl 1 100 -90 89.9973 FORMAT "%8.5" ECU_ADDRESS 0x38322E /end MEASUREMENT
/begin MEASUREMENT fln71_06 "Lernfilterwert, negativ" SWORD dtsegn_b720divZyl 1 100 -90 89.9973 FORMAT "%8.5" ECU_ADDRESS 0x38325E /end MEASUREMENT
/begin MEASUREMENT fln71_07 "Lernfilterwert, negativ" SWORD dtsegn_b720divZyl 1 100 -90 89.9973 FORMAT "%8.5" ECU_ADDRESS 0x38328E /end MEASUREMENT
/begin MEASUREMENT fln71_08 "Lernfilterwert, negativ" SWORD dtsegn_b720divZyl 1 100 -90 89.9973 FORMAT "%8.5" ECU_ADDRESS 0x3832BE /end MEASUREMENT
/begin MEASUREMENT fln72_02 "Lernfilterwert, negativ" SWORD dtsegn_b720divZyl 1 100 -90 89.9973 FORMAT "%8.5" ECU_ADDRESS 0x3831AE /end MEASUREMENT
/begin MEASUREMENT fln72_03 "Lernfilterwert, negativ" SWORD dtsegn_b720divZyl 1 100 -90 89.9973 FORMAT "%8.5" ECU_ADDRESS 0x3831DE /end MEASUREMENT
/begin MEASUREMENT fln72_04 "Lernfilterwert, negativ" SWORD dtsegn_b720divZyl 1 100 -90 89.9973 FORMAT "%8.5" ECU_ADDRESS 0x38320E /end MEASUREMENT
/begin MEASUREMENT fln72_05 "Lernfilterwert, negativ" SWORD dtsegn_b720divZyl 1 100 -90 89.9973 FORMAT "%8.5" ECU_ADDRESS 0x38323E /end MEASUREMENT
/begin MEASUREMENT fln72_06 "Lernfilterwert, negativ" SWORD dtsegn_b720divZyl 1 100 -90 89.9973 FORMAT "%8.5" ECU_ADDRESS 0x38326E /end MEASUREMENT
/begin MEASUREMENT fln72_07 "Lernfilterwert, negativ" SWORD dtsegn_b720divZyl 1 100 -90 89.9973 FORMAT "%8.5" ECU_ADDRESS 0x38329E /end MEASUREMENT
/begin MEASUREMENT fln72_08 "Lernfilterwert, negativ" SWORD dtsegn_b720divZyl 1 100 -90 89.9973 FORMAT "%8.5" ECU_ADDRESS 0x3832CE /end MEASUREMENT
/begin MEASUREMENT fln73_02 "Lernfilterwert, negativ" SWORD dtsegn_b720divZyl 1 100 -90 89.9973 FORMAT "%8.5" ECU_ADDRESS 0x3831BE /end MEASUREMENT
/begin MEASUREMENT fln73_03 "Lernfilterwert, negativ" SWORD dtsegn_b720divZyl 1 100 -90 89.9973 FORMAT "%8.5" ECU_ADDRESS 0x3831EE /end MEASUREMENT
/begin MEASUREMENT fln73_04 "Lernfilterwert, negativ" SWORD dtsegn_b720divZyl 1 100 -90 89.9973 FORMAT "%8.5" ECU_ADDRESS 0x38321E /end MEASUREMENT
/begin MEASUREMENT fln73_05 "Lernfilterwert, negativ" SWORD dtsegn_b720divZyl 1 100 -90 89.9973 FORMAT "%8.5" ECU_ADDRESS 0x38324E /end MEASUREMENT
/begin MEASUREMENT fln73_06 "Lernfilterwert, negativ" SWORD dtsegn_b720divZyl 1 100 -90 89.9973 FORMAT "%8.5" ECU_ADDRESS 0x38327E /end MEASUREMENT
/begin MEASUREMENT fln73_07 "Lernfilterwert, negativ" SWORD dtsegn_b720divZyl 1 100 -90 89.9973 FORMAT "%8.5" ECU_ADDRESS 0x3832AE /end MEASUREMENT
/begin MEASUREMENT fln73_08 "Lernfilterwert, negativ" SWORD dtsegn_b720divZyl 1 100 -90 89.9973 FORMAT "%8.5" ECU_ADDRESS 0x3832DE /end MEASUREMENT
/begin MEASUREMENT fln81_02 "Lernfilterwert, negativ" SWORD dtsegn_b720divZyl 1 100 -90 89.9973 FORMAT "%8.5" ECU_ADDRESS 0x3831A0 /end MEASUREMENT
/begin MEASUREMENT fln81_03 "Lernfilterwert, negativ" SWORD dtsegn_b720divZyl 1 100 -90 89.9973 FORMAT "%8.5" ECU_ADDRESS 0x3831D0 /end MEASUREMENT
/begin MEASUREMENT fln81_04 "Lernfilterwert, negativ" SWORD dtsegn_b720divZyl 1 100 -90 89.9973 FORMAT "%8.5" ECU_ADDRESS 0x383200 /end MEASUREMENT
/begin MEASUREMENT fln81_05 "Lernfilterwert, negativ" SWORD dtsegn_b720divZyl 1 100 -90 89.9973 FORMAT "%8.5" ECU_ADDRESS 0x383230 /end MEASUREMENT
/begin MEASUREMENT fln81_06 "Lernfilterwert, negativ" SWORD dtsegn_b720divZyl 1 100 -90 89.9973 FORMAT "%8.5" ECU_ADDRESS 0x383260 /end MEASUREMENT
/begin MEASUREMENT fln81_07 "Lernfilterwert, negativ" SWORD dtsegn_b720divZyl 1 100 -90 89.9973 FORMAT "%8.5" ECU_ADDRESS 0x383290 /end MEASUREMENT
/begin MEASUREMENT fln81_08 "Lernfilterwert, negativ" SWORD dtsegn_b720divZyl 1 100 -90 89.9973 FORMAT "%8.5" ECU_ADDRESS 0x3832C0 /end MEASUREMENT
/begin MEASUREMENT fln82_02 "Lernfilterwert, negativ" SWORD dtsegn_b720divZyl 1 100 -90 89.9973 FORMAT "%8.5" ECU_ADDRESS 0x3831B0 /end MEASUREMENT
/begin MEASUREMENT fln82_03 "Lernfilterwert, negativ" SWORD dtsegn_b720divZyl 1 100 -90 89.9973 FORMAT "%8.5" ECU_ADDRESS 0x3831E0 /end MEASUREMENT
/begin MEASUREMENT fln82_04 "Lernfilterwert, negativ" SWORD dtsegn_b720divZyl 1 100 -90 89.9973 FORMAT "%8.5" ECU_ADDRESS 0x383210 /end MEASUREMENT
/begin MEASUREMENT fln82_05 "Lernfilterwert, negativ" SWORD dtsegn_b720divZyl 1 100 -90 89.9973 FORMAT "%8.5" ECU_ADDRESS 0x383240 /end MEASUREMENT
/begin MEASUREMENT fln82_06 "Lernfilterwert, negativ" SWORD dtsegn_b720divZyl 1 100 -90 89.9973 FORMAT "%8.5" ECU_ADDRESS 0x383270 /end MEASUREMENT
/begin MEASUREMENT fln82_07 "Lernfilterwert, negativ" SWORD dtsegn_b720divZyl 1 100 -90 89.9973 FORMAT "%8.5" ECU_ADDRESS 0x3832A0 /end MEASUREMENT
/begin MEASUREMENT fln82_08 "Lernfilterwert, negativ" SWORD dtsegn_b720divZyl 1 100 -90 89.9973 FORMAT "%8.5" ECU_ADDRESS 0x3832D0 /end MEASUREMENT
/begin MEASUREMENT fln83_02 "Lernfilterwert, negativ" SWORD dtsegn_b720divZyl 1 100 -90 89.9973 FORMAT "%8.5" ECU_ADDRESS 0x3831C0 /end MEASUREMENT
/begin MEASUREMENT fln83_03 "Lernfilterwert, negativ" SWORD dtsegn_b720divZyl 1 100 -90 89.9973 FORMAT "%8.5" ECU_ADDRESS 0x3831F0 /end MEASUREMENT
/begin MEASUREMENT fln83_04 "Lernfilterwert, negativ" SWORD dtsegn_b720divZyl 1 100 -90 89.9973 FORMAT "%8.5" ECU_ADDRESS 0x383220 /end MEASUREMENT
/begin MEASUREMENT fln83_05 "Lernfilterwert, negativ" SWORD dtsegn_b720divZyl 1 100 -90 89.9973 FORMAT "%8.5" ECU_ADDRESS 0x383250 /end MEASUREMENT
/begin MEASUREMENT fln83_06 "Lernfilterwert, negativ" SWORD dtsegn_b720divZyl 1 100 -90 89.9973 FORMAT "%8.5" ECU_ADDRESS 0x383280 /end MEASUREMENT
/begin MEASUREMENT fln83_07 "Lernfilterwert, negativ" SWORD dtsegn_b720divZyl 1 100 -90 89.9973 FORMAT "%8.5" ECU_ADDRESS 0x3832B0 /end MEASUREMENT
/begin MEASUREMENT fln83_08 "Lernfilterwert, negativ" SWORD dtsegn_b720divZyl 1 100 -90 89.9973 FORMAT "%8.5" ECU_ADDRESS 0x3832E0 /end MEASUREMENT
/begin MEASUREMENT flp11_02 "Lernfilterwert, positiv" SWORD dtsegn_b720divZyl 1 100 -90 89.9973 FORMAT "%8.5" ECU_ADDRESS 0x3832E2 /end MEASUREMENT
/begin MEASUREMENT flp11_03 "Lernfilterwert, positiv" SWORD dtsegn_b720divZyl 1 100 -90 89.9973 FORMAT "%8.5" ECU_ADDRESS 0x383312 /end MEASUREMENT
/begin MEASUREMENT flp11_04 "Lernfilterwert, positiv" SWORD dtsegn_b720divZyl 1 100 -90 89.9973 FORMAT "%8.5" ECU_ADDRESS 0x383342 /end MEASUREMENT
/begin MEASUREMENT flp11_05 "Lernfilterwert, positiv" SWORD dtsegn_b720divZyl 1 100 -90 89.9973 FORMAT "%8.5" ECU_ADDRESS 0x383372 /end MEASUREMENT
/begin MEASUREMENT flp11_06 "Lernfilterwert, positiv" SWORD dtsegn_b720divZyl 1 100 -90 89.9973 FORMAT "%8.5" ECU_ADDRESS 0x3833A2 /end MEASUREMENT
/begin MEASUREMENT flp11_07 "Lernfilterwert, positiv" SWORD dtsegn_b720divZyl 1 100 -90 89.9973 FORMAT "%8.5" ECU_ADDRESS 0x3833D2 /end MEASUREMENT
/begin MEASUREMENT flp11_08 "Lernfilterwert, positiv" SWORD dtsegn_b720divZyl 1 100 -90 89.9973 FORMAT "%8.5" ECU_ADDRESS 0x383402 /end MEASUREMENT
/begin MEASUREMENT flp12_02 "Lernfilterwert, positiv" SWORD dtsegn_b720divZyl 1 100 -90 89.9973 FORMAT "%8.5" ECU_ADDRESS 0x3832F2 /end MEASUREMENT
/begin MEASUREMENT flp12_03 "Lernfilterwert, positiv" SWORD dtsegn_b720divZyl 1 100 -90 89.9973 FORMAT "%8.5" ECU_ADDRESS 0x383322 /end MEASUREMENT
/begin MEASUREMENT flp12_04 "Lernfilterwert, positiv" SWORD dtsegn_b720divZyl 1 100 -90 89.9973 FORMAT "%8.5" ECU_ADDRESS 0x383352 /end MEASUREMENT
/begin MEASUREMENT flp12_05 "Lernfilterwert, positiv" SWORD dtsegn_b720divZyl 1 100 -90 89.9973 FORMAT "%8.5" ECU_ADDRESS 0x383382 /end MEASUREMENT
/begin MEASUREMENT flp12_06 "Lernfilterwert, positiv" SWORD dtsegn_b720divZyl 1 100 -90 89.9973 FORMAT "%8.5" ECU_ADDRESS 0x3833B2 /end MEASUREMENT
/begin MEASUREMENT flp12_07 "Lernfilterwert, positiv" SWORD dtsegn_b720divZyl 1 100 -90 89.9973 FORMAT "%8.5" ECU_ADDRESS 0x3833E2 /end MEASUREMENT
/begin MEASUREMENT flp12_08 "Lernfilterwert, positiv" SWORD dtsegn_b720divZyl 1 100 -90 89.9973 FORMAT "%8.5" ECU_ADDRESS 0x383412 /end MEASUREMENT
/begin MEASUREMENT flp13_02 "Lernfilterwert, positiv" SWORD dtsegn_b720divZyl 1 100 -90 89.9973 FORMAT "%8.5" ECU_ADDRESS 0x383302 /end MEASUREMENT
/begin MEASUREMENT flp13_03 "Lernfilterwert, positiv" SWORD dtsegn_b720divZyl 1 100 -90 89.9973 FORMAT "%8.5" ECU_ADDRESS 0x383332 /end MEASUREMENT
/begin MEASUREMENT flp13_04 "Lernfilterwert, positiv" SWORD dtsegn_b720divZyl 1 100 -90 89.9973 FORMAT "%8.5" ECU_ADDRESS 0x383362 /end MEASUREMENT
/begin MEASUREMENT flp13_05 "Lernfilterwert, positiv" SWORD dtsegn_b720divZyl 1 100 -90 89.9973 FORMAT "%8.5" ECU_ADDRESS 0x383392 /end MEASUREMENT
/begin MEASUREMENT flp13_06 "Lernfilterwert, positiv" SWORD dtsegn_b720divZyl 1 100 -90 89.9973 FORMAT "%8.5" ECU_ADDRESS 0x3833C2 /end MEASUREMENT
/begin MEASUREMENT flp13_07 "Lernfilterwert, positiv" SWORD dtsegn_b720divZyl 1 100 -90 89.9973 FORMAT "%8.5" ECU_ADDRESS 0x3833F2 /end MEASUREMENT
/begin MEASUREMENT flp13_08 "Lernfilterwert, positiv" SWORD dtsegn_b720divZyl 1 100 -90 89.9973 FORMAT "%8.5" ECU_ADDRESS 0x383422 /end MEASUREMENT
/begin MEASUREMENT flp21_02 "Lernfilterwert, positiv" SWORD dtsegn_b720divZyl 1 100 -90 89.9973 FORMAT "%8.5" ECU_ADDRESS 0x3832E4 /end MEASUREMENT
/begin MEASUREMENT flp21_03 "Lernfilterwert, positiv" SWORD dtsegn_b720divZyl 1 100 -90 89.9973 FORMAT "%8.5" ECU_ADDRESS 0x383314 /end MEASUREMENT
/begin MEASUREMENT flp21_04 "Lernfilterwert, positiv" SWORD dtsegn_b720divZyl 1 100 -90 89.9973 FORMAT "%8.5" ECU_ADDRESS 0x383344 /end MEASUREMENT
/begin MEASUREMENT flp21_05 "Lernfilterwert, positiv" SWORD dtsegn_b720divZyl 1 100 -90 89.9973 FORMAT "%8.5" ECU_ADDRESS 0x383374 /end MEASUREMENT
/begin MEASUREMENT flp21_06 "Lernfilterwert, positiv" SWORD dtsegn_b720divZyl 1 100 -90 89.9973 FORMAT "%8.5" ECU_ADDRESS 0x3833A4 /end MEASUREMENT
/begin MEASUREMENT flp21_07 "Lernfilterwert, positiv" SWORD dtsegn_b720divZyl 1 100 -90 89.9973 FORMAT "%8.5" ECU_ADDRESS 0x3833D4 /end MEASUREMENT
/begin MEASUREMENT flp21_08 "Lernfilterwert, positiv" SWORD dtsegn_b720divZyl 1 100 -90 89.9973 FORMAT "%8.5" ECU_ADDRESS 0x383404 /end MEASUREMENT
/begin MEASUREMENT flp22_02 "Lernfilterwert, positiv" SWORD dtsegn_b720divZyl 1 100 -90 89.9973 FORMAT "%8.5" ECU_ADDRESS 0x3832F4 /end MEASUREMENT
/begin MEASUREMENT flp22_03 "Lernfilterwert, positiv" SWORD dtsegn_b720divZyl 1 100 -90 89.9973 FORMAT "%8.5" ECU_ADDRESS 0x383324 /end MEASUREMENT
/begin MEASUREMENT flp22_04 "Lernfilterwert, positiv" SWORD dtsegn_b720divZyl 1 100 -90 89.9973 FORMAT "%8.5" ECU_ADDRESS 0x383354 /end MEASUREMENT
/begin MEASUREMENT flp22_05 "Lernfilterwert, positiv" SWORD dtsegn_b720divZyl 1 100 -90 89.9973 FORMAT "%8.5" ECU_ADDRESS 0x383384 /end MEASUREMENT
/begin MEASUREMENT flp22_06 "Lernfilterwert, positiv" SWORD dtsegn_b720divZyl 1 100 -90 89.9973 FORMAT "%8.5" ECU_ADDRESS 0x3833B4 /end MEASUREMENT
/begin MEASUREMENT flp22_07 "Lernfilterwert, positiv" SWORD dtsegn_b720divZyl 1 100 -90 89.9973 FORMAT "%8.5" ECU_ADDRESS 0x3833E4 /end MEASUREMENT
/begin MEASUREMENT flp22_08 "Lernfilterwert, positiv" SWORD dtsegn_b720divZyl 1 100 -90 89.9973 FORMAT "%8.5" ECU_ADDRESS 0x383414 /end MEASUREMENT
/begin MEASUREMENT flp23_02 "Lernfilterwert, positiv" SWORD dtsegn_b720divZyl 1 100 -90 89.9973 FORMAT "%8.5" ECU_ADDRESS 0x383304 /end MEASUREMENT
/begin MEASUREMENT flp23_03 "Lernfilterwert, positiv" SWORD dtsegn_b720divZyl 1 100 -90 89.9973 FORMAT "%8.5" ECU_ADDRESS 0x383334 /end MEASUREMENT
/begin MEASUREMENT flp23_04 "Lernfilterwert, positiv" SWORD dtsegn_b720divZyl 1 100 -90 89.9973 FORMAT "%8.5" ECU_ADDRESS 0x383364 /end MEASUREMENT
/begin MEASUREMENT flp23_05 "Lernfilterwert, positiv" SWORD dtsegn_b720divZyl 1 100 -90 89.9973 FORMAT "%8.5" ECU_ADDRESS 0x383394 /end MEASUREMENT
/begin MEASUREMENT flp23_06 "Lernfilterwert, positiv" SWORD dtsegn_b720divZyl 1 100 -90 89.9973 FORMAT "%8.5" ECU_ADDRESS 0x3833C4 /end MEASUREMENT
/begin MEASUREMENT flp23_07 "Lernfilterwert, positiv" SWORD dtsegn_b720divZyl 1 100 -90 89.9973 FORMAT "%8.5" ECU_ADDRESS 0x3833F4 /end MEASUREMENT
/begin MEASUREMENT flp23_08 "Lernfilterwert, positiv" SWORD dtsegn_b720divZyl 1 100 -90 89.9973 FORMAT "%8.5" ECU_ADDRESS 0x383424 /end MEASUREMENT
/begin MEASUREMENT flp31_02 "Lernfilterwert, positiv" SWORD dtsegn_b720divZyl 1 100 -90 89.9973 FORMAT "%8.5" ECU_ADDRESS 0x3832E6 /end MEASUREMENT
/begin MEASUREMENT flp31_03 "Lernfilterwert, positiv" SWORD dtsegn_b720divZyl 1 100 -90 89.9973 FORMAT "%8.5" ECU_ADDRESS 0x383316 /end MEASUREMENT
/begin MEASUREMENT flp31_04 "Lernfilterwert, positiv" SWORD dtsegn_b720divZyl 1 100 -90 89.9973 FORMAT "%8.5" ECU_ADDRESS 0x383346 /end MEASUREMENT
/begin MEASUREMENT flp31_05 "Lernfilterwert, positiv" SWORD dtsegn_b720divZyl 1 100 -90 89.9973 FORMAT "%8.5" ECU_ADDRESS 0x383376 /end MEASUREMENT
/begin MEASUREMENT flp31_06 "Lernfilterwert, positiv" SWORD dtsegn_b720divZyl 1 100 -90 89.9973 FORMAT "%8.5" ECU_ADDRESS 0x3833A6 /end MEASUREMENT
/begin MEASUREMENT flp31_07 "Lernfilterwert, positiv" SWORD dtsegn_b720divZyl 1 100 -90 89.9973 FORMAT "%8.5" ECU_ADDRESS 0x3833D6 /end MEASUREMENT
/begin MEASUREMENT flp31_08 "Lernfilterwert, positiv" SWORD dtsegn_b720divZyl 1 100 -90 89.9973 FORMAT "%8.5" ECU_ADDRESS 0x383406 /end MEASUREMENT
/begin MEASUREMENT flp32_02 "Lernfilterwert, positiv" SWORD dtsegn_b720divZyl 1 100 -90 89.9973 FORMAT "%8.5" ECU_ADDRESS 0x3832F6 /end MEASUREMENT
/begin MEASUREMENT flp32_03 "Lernfilterwert, positiv" SWORD dtsegn_b720divZyl 1 100 -90 89.9973 FORMAT "%8.5" ECU_ADDRESS 0x383326 /end MEASUREMENT
/begin MEASUREMENT flp32_04 "Lernfilterwert, positiv" SWORD dtsegn_b720divZyl 1 100 -90 89.9973 FORMAT "%8.5" ECU_ADDRESS 0x383356 /end MEASUREMENT
/begin MEASUREMENT flp32_05 "Lernfilterwert, positiv" SWORD dtsegn_b720divZyl 1 100 -90 89.9973 FORMAT "%8.5" ECU_ADDRESS 0x383386 /end MEASUREMENT
/begin MEASUREMENT flp32_06 "Lernfilterwert, positiv" SWORD dtsegn_b720divZyl 1 100 -90 89.9973 FORMAT "%8.5" ECU_ADDRESS 0x3833B6 /end MEASUREMENT
/begin MEASUREMENT flp32_07 "Lernfilterwert, positiv" SWORD dtsegn_b720divZyl 1 100 -90 89.9973 FORMAT "%8.5" ECU_ADDRESS 0x3833E6 /end MEASUREMENT
/begin MEASUREMENT flp32_08 "Lernfilterwert, positiv" SWORD dtsegn_b720divZyl 1 100 -90 89.9973 FORMAT "%8.5" ECU_ADDRESS 0x383416 /end MEASUREMENT
/begin MEASUREMENT flp33_02 "Lernfilterwert, positiv" SWORD dtsegn_b720divZyl 1 100 -90 89.9973 FORMAT "%8.5" ECU_ADDRESS 0x383306 /end MEASUREMENT
/begin MEASUREMENT flp33_03 "Lernfilterwert, positiv" SWORD dtsegn_b720divZyl 1 100 -90 89.9973 FORMAT "%8.5" ECU_ADDRESS 0x383336 /end MEASUREMENT
/begin MEASUREMENT flp33_04 "Lernfilterwert, positiv" SWORD dtsegn_b720divZyl 1 100 -90 89.9973 FORMAT "%8.5" ECU_ADDRESS 0x383366 /end MEASUREMENT
/begin MEASUREMENT flp33_05 "Lernfilterwert, positiv" SWORD dtsegn_b720divZyl 1 100 -90 89.9973 FORMAT "%8.5" ECU_ADDRESS 0x383396 /end MEASUREMENT
/begin MEASUREMENT flp33_06 "Lernfilterwert, positiv" SWORD dtsegn_b720divZyl 1 100 -90 89.9973 FORMAT "%8.5" ECU_ADDRESS 0x3833C6 /end MEASUREMENT
/begin MEASUREMENT flp33_07 "Lernfilterwert, positiv" SWORD dtsegn_b720divZyl 1 100 -90 89.9973 FORMAT "%8.5" ECU_ADDRESS 0x3833F6 /end MEASUREMENT
/begin MEASUREMENT flp33_08 "Lernfilterwert, positiv" SWORD dtsegn_b720divZyl 1 100 -90 89.9973 FORMAT "%8.5" ECU_ADDRESS 0x383426 /end MEASUREMENT
/begin MEASUREMENT flp41_02 "Lernfilterwert, positiv" SWORD dtsegn_b720divZyl 1 100 -90 89.9973 FORMAT "%8.5" ECU_ADDRESS 0x3832E8 /end MEASUREMENT
/begin MEASUREMENT flp41_03 "Lernfilterwert, positiv" SWORD dtsegn_b720divZyl 1 100 -90 89.9973 FORMAT "%8.5" ECU_ADDRESS 0x383318 /end MEASUREMENT
/begin MEASUREMENT flp41_04 "Lernfilterwert, positiv" SWORD dtsegn_b720divZyl 1 100 -90 89.9973 FORMAT "%8.5" ECU_ADDRESS 0x383348 /end MEASUREMENT
/begin MEASUREMENT flp41_05 "Lernfilterwert, positiv" SWORD dtsegn_b720divZyl 1 100 -90 89.9973 FORMAT "%8.5" ECU_ADDRESS 0x383378 /end MEASUREMENT
/begin MEASUREMENT flp41_06 "Lernfilterwert, positiv" SWORD dtsegn_b720divZyl 1 100 -90 89.9973 FORMAT "%8.5" ECU_ADDRESS 0x3833A8 /end MEASUREMENT
/begin MEASUREMENT flp41_07 "Lernfilterwert, positiv" SWORD dtsegn_b720divZyl 1 100 -90 89.9973 FORMAT "%8.5" ECU_ADDRESS 0x3833D8 /end MEASUREMENT
/begin MEASUREMENT flp41_08 "Lernfilterwert, positiv" SWORD dtsegn_b720divZyl 1 100 -90 89.9973 FORMAT "%8.5" ECU_ADDRESS 0x383408 /end MEASUREMENT
/begin MEASUREMENT flp42_02 "Lernfilterwert, positiv" SWORD dtsegn_b720divZyl 1 100 -90 89.9973 FORMAT "%8.5" ECU_ADDRESS 0x3832F8 /end MEASUREMENT
/begin MEASUREMENT flp42_03 "Lernfilterwert, positiv" SWORD dtsegn_b720divZyl 1 100 -90 89.9973 FORMAT "%8.5" ECU_ADDRESS 0x383328 /end MEASUREMENT
/begin MEASUREMENT flp42_04 "Lernfilterwert, positiv" SWORD dtsegn_b720divZyl 1 100 -90 89.9973 FORMAT "%8.5" ECU_ADDRESS 0x383358 /end MEASUREMENT
/begin MEASUREMENT flp42_05 "Lernfilterwert, positiv" SWORD dtsegn_b720divZyl 1 100 -90 89.9973 FORMAT "%8.5" ECU_ADDRESS 0x383388 /end MEASUREMENT
/begin MEASUREMENT flp42_06 "Lernfilterwert, positiv" SWORD dtsegn_b720divZyl 1 100 -90 89.9973 FORMAT "%8.5" ECU_ADDRESS 0x3833B8 /end MEASUREMENT
/begin MEASUREMENT flp42_07 "Lernfilterwert, positiv" SWORD dtsegn_b720divZyl 1 100 -90 89.9973 FORMAT "%8.5" ECU_ADDRESS 0x3833E8 /end MEASUREMENT
/begin MEASUREMENT flp42_08 "Lernfilterwert, positiv" SWORD dtsegn_b720divZyl 1 100 -90 89.9973 FORMAT "%8.5" ECU_ADDRESS 0x383418 /end MEASUREMENT
/begin MEASUREMENT flp43_02 "Lernfilterwert, positiv" SWORD dtsegn_b720divZyl 1 100 -90 89.9973 FORMAT "%8.5" ECU_ADDRESS 0x383308 /end MEASUREMENT
/begin MEASUREMENT flp43_03 "Lernfilterwert, positiv" SWORD dtsegn_b720divZyl 1 100 -90 89.9973 FORMAT "%8.5" ECU_ADDRESS 0x383338 /end MEASUREMENT
/begin MEASUREMENT flp43_04 "Lernfilterwert, positiv" SWORD dtsegn_b720divZyl 1 100 -90 89.9973 FORMAT "%8.5" ECU_ADDRESS 0x383368 /end MEASUREMENT
/begin MEASUREMENT flp43_05 "Lernfilterwert, positiv" SWORD dtsegn_b720divZyl 1 100 -90 89.9973 FORMAT "%8.5" ECU_ADDRESS 0x383398 /end MEASUREMENT
/begin MEASUREMENT flp43_06 "Lernfilterwert, positiv" SWORD dtsegn_b720divZyl 1 100 -90 89.9973 FORMAT "%8.5" ECU_ADDRESS 0x3833C8 /end MEASUREMENT
/begin MEASUREMENT flp43_07 "Lernfilterwert, positiv" SWORD dtsegn_b720divZyl 1 100 -90 89.9973 FORMAT "%8.5" ECU_ADDRESS 0x3833F8 /end MEASUREMENT
/begin MEASUREMENT flp43_08 "Lernfilterwert, positiv" SWORD dtsegn_b720divZyl 1 100 -90 89.9973 FORMAT "%8.5" ECU_ADDRESS 0x383428 /end MEASUREMENT
/begin MEASUREMENT flp51_02 "Lernfilterwert, positiv" SWORD dtsegn_b720divZyl 1 100 -90 89.9973 FORMAT "%8.5" ECU_ADDRESS 0x3832EA /end MEASUREMENT
/begin MEASUREMENT flp51_03 "Lernfilterwert, positiv" SWORD dtsegn_b720divZyl 1 100 -90 89.9973 FORMAT "%8.5" ECU_ADDRESS 0x38331A /end MEASUREMENT
/begin MEASUREMENT flp51_04 "Lernfilterwert, positiv" SWORD dtsegn_b720divZyl 1 100 -90 89.9973 FORMAT "%8.5" ECU_ADDRESS 0x38334A /end MEASUREMENT
/begin MEASUREMENT flp51_05 "Lernfilterwert, positiv" SWORD dtsegn_b720divZyl 1 100 -90 89.9973 FORMAT "%8.5" ECU_ADDRESS 0x38337A /end MEASUREMENT
/begin MEASUREMENT flp51_06 "Lernfilterwert, positiv" SWORD dtsegn_b720divZyl 1 100 -90 89.9973 FORMAT "%8.5" ECU_ADDRESS 0x3833AA /end MEASUREMENT
/begin MEASUREMENT flp51_07 "Lernfilterwert, positiv" SWORD dtsegn_b720divZyl 1 100 -90 89.9973 FORMAT "%8.5" ECU_ADDRESS 0x3833DA /end MEASUREMENT
/begin MEASUREMENT flp51_08 "Lernfilterwert, positiv" SWORD dtsegn_b720divZyl 1 100 -90 89.9973 FORMAT "%8.5" ECU_ADDRESS 0x38340A /end MEASUREMENT
/begin MEASUREMENT flp52_02 "Lernfilterwert, positiv" SWORD dtsegn_b720divZyl 1 100 -90 89.9973 FORMAT "%8.5" ECU_ADDRESS 0x3832FA /end MEASUREMENT
/begin MEASUREMENT flp52_03 "Lernfilterwert, positiv" SWORD dtsegn_b720divZyl 1 100 -90 89.9973 FORMAT "%8.5" ECU_ADDRESS 0x38332A /end MEASUREMENT
/begin MEASUREMENT flp52_04 "Lernfilterwert, positiv" SWORD dtsegn_b720divZyl 1 100 -90 89.9973 FORMAT "%8.5" ECU_ADDRESS 0x38335A /end MEASUREMENT
/begin MEASUREMENT flp52_05 "Lernfilterwert, positiv" SWORD dtsegn_b720divZyl 1 100 -90 89.9973 FORMAT "%8.5" ECU_ADDRESS 0x38338A /end MEASUREMENT
/begin MEASUREMENT flp52_06 "Lernfilterwert, positiv" SWORD dtsegn_b720divZyl 1 100 -90 89.9973 FORMAT "%8.5" ECU_ADDRESS 0x3833BA /end MEASUREMENT
/begin MEASUREMENT flp52_07 "Lernfilterwert, positiv" SWORD dtsegn_b720divZyl 1 100 -90 89.9973 FORMAT "%8.5" ECU_ADDRESS 0x3833EA /end MEASUREMENT
/begin MEASUREMENT flp52_08 "Lernfilterwert, positiv" SWORD dtsegn_b720divZyl 1 100 -90 89.9973 FORMAT "%8.5" ECU_ADDRESS 0x38341A /end MEASUREMENT
/begin MEASUREMENT flp53_02 "Lernfilterwert, positiv" SWORD dtsegn_b720divZyl 1 100 -90 89.9973 FORMAT "%8.5" ECU_ADDRESS 0x38330A /end MEASUREMENT
/begin MEASUREMENT flp53_03 "Lernfilterwert, positiv" SWORD dtsegn_b720divZyl 1 100 -90 89.9973 FORMAT "%8.5" ECU_ADDRESS 0x38333A /end MEASUREMENT
/begin MEASUREMENT flp53_04 "Lernfilterwert, positiv" SWORD dtsegn_b720divZyl 1 100 -90 89.9973 FORMAT "%8.5" ECU_ADDRESS 0x38336A /end MEASUREMENT
/begin MEASUREMENT flp53_05 "Lernfilterwert, positiv" SWORD dtsegn_b720divZyl 1 100 -90 89.9973 FORMAT "%8.5" ECU_ADDRESS 0x38339A /end MEASUREMENT
/begin MEASUREMENT flp53_06 "Lernfilterwert, positiv" SWORD dtsegn_b720divZyl 1 100 -90 89.9973 FORMAT "%8.5" ECU_ADDRESS 0x3833CA /end MEASUREMENT
/begin MEASUREMENT flp53_07 "Lernfilterwert, positiv" SWORD dtsegn_b720divZyl 1 100 -90 89.9973 FORMAT "%8.5" ECU_ADDRESS 0x3833FA /end MEASUREMENT
/begin MEASUREMENT flp53_08 "Lernfilterwert, positiv" SWORD dtsegn_b720divZyl 1 100 -90 89.9973 FORMAT "%8.5" ECU_ADDRESS 0x38342A /end MEASUREMENT
/begin MEASUREMENT flp61_02 "Lernfilterwert, positiv" SWORD dtsegn_b720divZyl 1 100 -90 89.9973 FORMAT "%8.5" ECU_ADDRESS 0x3832EC /end MEASUREMENT
/begin MEASUREMENT flp61_03 "Lernfilterwert, positiv" SWORD dtsegn_b720divZyl 1 100 -90 89.9973 FORMAT "%8.5" ECU_ADDRESS 0x38331C /end MEASUREMENT
/begin MEASUREMENT flp61_04 "Lernfilterwert, positiv" SWORD dtsegn_b720divZyl 1 100 -90 89.9973 FORMAT "%8.5" ECU_ADDRESS 0x38334C /end MEASUREMENT
/begin MEASUREMENT flp61_05 "Lernfilterwert, positiv" SWORD dtsegn_b720divZyl 1 100 -90 89.9973 FORMAT "%8.5" ECU_ADDRESS 0x38337C /end MEASUREMENT
/begin MEASUREMENT flp61_06 "Lernfilterwert, positiv" SWORD dtsegn_b720divZyl 1 100 -90 89.9973 FORMAT "%8.5" ECU_ADDRESS 0x3833AC /end MEASUREMENT
/begin MEASUREMENT flp61_07 "Lernfilterwert, positiv" SWORD dtsegn_b720divZyl 1 100 -90 89.9973 FORMAT "%8.5" ECU_ADDRESS 0x3833DC /end MEASUREMENT
/begin MEASUREMENT flp61_08 "Lernfilterwert, positiv" SWORD dtsegn_b720divZyl 1 100 -90 89.9973 FORMAT "%8.5" ECU_ADDRESS 0x38340C /end MEASUREMENT
/begin MEASUREMENT flp62_02 "Lernfilterwert, positiv" SWORD dtsegn_b720divZyl 1 100 -90 89.9973 FORMAT "%8.5" ECU_ADDRESS 0x3832FC /end MEASUREMENT
/begin MEASUREMENT flp62_03 "Lernfilterwert, positiv" SWORD dtsegn_b720divZyl 1 100 -90 89.9973 FORMAT "%8.5" ECU_ADDRESS 0x38332C /end MEASUREMENT
/begin MEASUREMENT flp62_04 "Lernfilterwert, positiv" SWORD dtsegn_b720divZyl 1 100 -90 89.9973 FORMAT "%8.5" ECU_ADDRESS 0x38335C /end MEASUREMENT
/begin MEASUREMENT flp62_05 "Lernfilterwert, positiv" SWORD dtsegn_b720divZyl 1 100 -90 89.9973 FORMAT "%8.5" ECU_ADDRESS 0x38338C /end MEASUREMENT
/begin MEASUREMENT flp62_06 "Lernfilterwert, positiv" SWORD dtsegn_b720divZyl 1 100 -90 89.9973 FORMAT "%8.5" ECU_ADDRESS 0x3833BC /end MEASUREMENT
/begin MEASUREMENT flp62_07 "Lernfilterwert, positiv" SWORD dtsegn_b720divZyl 1 100 -90 89.9973 FORMAT "%8.5" ECU_ADDRESS 0x3833EC /end MEASUREMENT
/begin MEASUREMENT flp62_08 "Lernfilterwert, positiv" SWORD dtsegn_b720divZyl 1 100 -90 89.9973 FORMAT "%8.5" ECU_ADDRESS 0x38341C /end MEASUREMENT
/begin MEASUREMENT flp63_02 "Lernfilterwert, positiv" SWORD dtsegn_b720divZyl 1 100 -90 89.9973 FORMAT "%8.5" ECU_ADDRESS 0x38330C /end MEASUREMENT
/begin MEASUREMENT flp63_03 "Lernfilterwert, positiv" SWORD dtsegn_b720divZyl 1 100 -90 89.9973 FORMAT "%8.5" ECU_ADDRESS 0x38333C /end MEASUREMENT
/begin MEASUREMENT flp63_04 "Lernfilterwert, positiv" SWORD dtsegn_b720divZyl 1 100 -90 89.9973 FORMAT "%8.5" ECU_ADDRESS 0x38336C /end MEASUREMENT
/begin MEASUREMENT flp63_05 "Lernfilterwert, positiv" SWORD dtsegn_b720divZyl 1 100 -90 89.9973 FORMAT "%8.5" ECU_ADDRESS 0x38339C /end MEASUREMENT
/begin MEASUREMENT flp63_06 "Lernfilterwert, positiv" SWORD dtsegn_b720divZyl 1 100 -90 89.9973 FORMAT "%8.5" ECU_ADDRESS 0x3833CC /end MEASUREMENT
/begin MEASUREMENT flp63_07 "Lernfilterwert, positiv" SWORD dtsegn_b720divZyl 1 100 -90 89.9973 FORMAT "%8.5" ECU_ADDRESS 0x3833FC /end MEASUREMENT
/begin MEASUREMENT flp63_08 "Lernfilterwert, positiv" SWORD dtsegn_b720divZyl 1 100 -90 89.9973 FORMAT "%8.5" ECU_ADDRESS 0x38342C /end MEASUREMENT
/begin MEASUREMENT flp71_02 "Lernfilterwert, positiv" SWORD dtsegn_b720divZyl 1 100 -90 89.9973 FORMAT "%8.5" ECU_ADDRESS 0x3832EE /end MEASUREMENT
/begin MEASUREMENT flp71_03 "Lernfilterwert, positiv" SWORD dtsegn_b720divZyl 1 100 -90 89.9973 FORMAT "%8.5" ECU_ADDRESS 0x38331E /end MEASUREMENT
/begin MEASUREMENT flp71_04 "Lernfilterwert, positiv" SWORD dtsegn_b720divZyl 1 100 -90 89.9973 FORMAT "%8.5" ECU_ADDRESS 0x38334E /end MEASUREMENT
/begin MEASUREMENT flp71_05 "Lernfilterwert, positiv" SWORD dtsegn_b720divZyl 1 100 -90 89.9973 FORMAT "%8.5" ECU_ADDRESS 0x38337E /end MEASUREMENT
/begin MEASUREMENT flp71_06 "Lernfilterwert, positiv" SWORD dtsegn_b720divZyl 1 100 -90 89.9973 FORMAT "%8.5" ECU_ADDRESS 0x3833AE /end MEASUREMENT
/begin MEASUREMENT flp71_07 "Lernfilterwert, positiv" SWORD dtsegn_b720divZyl 1 100 -90 89.9973 FORMAT "%8.5" ECU_ADDRESS 0x3833DE /end MEASUREMENT
/begin MEASUREMENT flp71_08 "Lernfilterwert, positiv" SWORD dtsegn_b720divZyl 1 100 -90 89.9973 FORMAT "%8.5" ECU_ADDRESS 0x38340E /end MEASUREMENT
/begin MEASUREMENT flp72_02 "Lernfilterwert, positiv" SWORD dtsegn_b720divZyl 1 100 -90 89.9973 FORMAT "%8.5" ECU_ADDRESS 0x3832FE /end MEASUREMENT
/begin MEASUREMENT flp72_03 "Lernfilterwert, positiv" SWORD dtsegn_b720divZyl 1 100 -90 89.9973 FORMAT "%8.5" ECU_ADDRESS 0x38332E /end MEASUREMENT
/begin MEASUREMENT flp72_04 "Lernfilterwert, positiv" SWORD dtsegn_b720divZyl 1 100 -90 89.9973 FORMAT "%8.5" ECU_ADDRESS 0x38335E /end MEASUREMENT
/begin MEASUREMENT flp72_05 "Lernfilterwert, positiv" SWORD dtsegn_b720divZyl 1 100 -90 89.9973 FORMAT "%8.5" ECU_ADDRESS 0x38338E /end MEASUREMENT
/begin MEASUREMENT flp72_06 "Lernfilterwert, positiv" SWORD dtsegn_b720divZyl 1 100 -90 89.9973 FORMAT "%8.5" ECU_ADDRESS 0x3833BE /end MEASUREMENT
/begin MEASUREMENT flp72_07 "Lernfilterwert, positiv" SWORD dtsegn_b720divZyl 1 100 -90 89.9973 FORMAT "%8.5" ECU_ADDRESS 0x3833EE /end MEASUREMENT
/begin MEASUREMENT flp72_08 "Lernfilterwert, positiv" SWORD dtsegn_b720divZyl 1 100 -90 89.9973 FORMAT "%8.5" ECU_ADDRESS 0x38341E /end MEASUREMENT
/begin MEASUREMENT flp73_02 "Lernfilterwert, positiv" SWORD dtsegn_b720divZyl 1 100 -90 89.9973 FORMAT "%8.5" ECU_ADDRESS 0x38330E /end MEASUREMENT
/begin MEASUREMENT flp73_03 "Lernfilterwert, positiv" SWORD dtsegn_b720divZyl 1 100 -90 89.9973 FORMAT "%8.5" ECU_ADDRESS 0x38333E /end MEASUREMENT
/begin MEASUREMENT flp73_04 "Lernfilterwert, positiv" SWORD dtsegn_b720divZyl 1 100 -90 89.9973 FORMAT "%8.5" ECU_ADDRESS 0x38336E /end MEASUREMENT
/begin MEASUREMENT flp73_05 "Lernfilterwert, positiv" SWORD dtsegn_b720divZyl 1 100 -90 89.9973 FORMAT "%8.5" ECU_ADDRESS 0x38339E /end MEASUREMENT
/begin MEASUREMENT flp73_06 "Lernfilterwert, positiv" SWORD dtsegn_b720divZyl 1 100 -90 89.9973 FORMAT "%8.5" ECU_ADDRESS 0x3833CE /end MEASUREMENT
/begin MEASUREMENT flp73_07 "Lernfilterwert, positiv" SWORD dtsegn_b720divZyl 1 100 -90 89.9973 FORMAT "%8.5" ECU_ADDRESS 0x3833FE /end MEASUREMENT
/begin MEASUREMENT flp73_08 "Lernfilterwert, positiv" SWORD dtsegn_b720divZyl 1 100 -90 89.9973 FORMAT "%8.5" ECU_ADDRESS 0x38342E /end MEASUREMENT
/begin MEASUREMENT flp81_02 "Lernfilterwert, positiv" SWORD dtsegn_b720divZyl 1 100 -90 89.9973 FORMAT "%8.5" ECU_ADDRESS 0x3832F0 /end MEASUREMENT
/begin MEASUREMENT flp81_03 "Lernfilterwert, positiv" SWORD dtsegn_b720divZyl 1 100 -90 89.9973 FORMAT "%8.5" ECU_ADDRESS 0x383320 /end MEASUREMENT
/begin MEASUREMENT flp81_04 "Lernfilterwert, positiv" SWORD dtsegn_b720divZyl 1 100 -90 89.9973 FORMAT "%8.5" ECU_ADDRESS 0x383350 /end MEASUREMENT
/begin MEASUREMENT flp81_05 "Lernfilterwert, positiv" SWORD dtsegn_b720divZyl 1 100 -90 89.9973 FORMAT "%8.5" ECU_ADDRESS 0x383380 /end MEASUREMENT
/begin MEASUREMENT flp81_06 "Lernfilterwert, positiv" SWORD dtsegn_b720divZyl 1 100 -90 89.9973 FORMAT "%8.5" ECU_ADDRESS 0x3833B0 /end MEASUREMENT
/begin MEASUREMENT flp81_07 "Lernfilterwert, positiv" SWORD dtsegn_b720divZyl 1 100 -90 89.9973 FORMAT "%8.5" ECU_ADDRESS 0x3833E0 /end MEASUREMENT
/begin MEASUREMENT flp81_08 "Lernfilterwert, positiv" SWORD dtsegn_b720divZyl 1 100 -90 89.9973 FORMAT "%8.5" ECU_ADDRESS 0x383410 /end MEASUREMENT
/begin MEASUREMENT flp82_02 "Lernfilterwert, positiv" SWORD dtsegn_b720divZyl 1 100 -90 89.9973 FORMAT "%8.5" ECU_ADDRESS 0x383300 /end MEASUREMENT
/begin MEASUREMENT flp82_03 "Lernfilterwert, positiv" SWORD dtsegn_b720divZyl 1 100 -90 89.9973 FORMAT "%8.5" ECU_ADDRESS 0x383330 /end MEASUREMENT
/begin MEASUREMENT flp82_04 "Lernfilterwert, positiv" SWORD dtsegn_b720divZyl 1 100 -90 89.9973 FORMAT "%8.5" ECU_ADDRESS 0x383360 /end MEASUREMENT
/begin MEASUREMENT flp82_05 "Lernfilterwert, positiv" SWORD dtsegn_b720divZyl 1 100 -90 89.9973 FORMAT "%8.5" ECU_ADDRESS 0x383390 /end MEASUREMENT
/begin MEASUREMENT flp82_06 "Lernfilterwert, positiv" SWORD dtsegn_b720divZyl 1 100 -90 89.9973 FORMAT "%8.5" ECU_ADDRESS 0x3833C0 /end MEASUREMENT
/begin MEASUREMENT flp82_07 "Lernfilterwert, positiv" SWORD dtsegn_b720divZyl 1 100 -90 89.9973 FORMAT "%8.5" ECU_ADDRESS 0x3833F0 /end MEASUREMENT
/begin MEASUREMENT flp82_08 "Lernfilterwert, positiv" SWORD dtsegn_b720divZyl 1 100 -90 89.9973 FORMAT "%8.5" ECU_ADDRESS 0x383420 /end MEASUREMENT
/begin MEASUREMENT flp83_02 "Lernfilterwert, positiv" SWORD dtsegn_b720divZyl 1 100 -90 89.9973 FORMAT "%8.5" ECU_ADDRESS 0x383310 /end MEASUREMENT
/begin MEASUREMENT flp83_03 "Lernfilterwert, positiv" SWORD dtsegn_b720divZyl 1 100 -90 89.9973 FORMAT "%8.5" ECU_ADDRESS 0x383340 /end MEASUREMENT
/begin MEASUREMENT flp83_04 "Lernfilterwert, positiv" SWORD dtsegn_b720divZyl 1 100 -90 89.9973 FORMAT "%8.5" ECU_ADDRESS 0x383370 /end MEASUREMENT
/begin MEASUREMENT flp83_05 "Lernfilterwert, positiv" SWORD dtsegn_b720divZyl 1 100 -90 89.9973 FORMAT "%8.5" ECU_ADDRESS 0x3833A0 /end MEASUREMENT
/begin MEASUREMENT flp83_06 "Lernfilterwert, positiv" SWORD dtsegn_b720divZyl 1 100 -90 89.9973 FORMAT "%8.5" ECU_ADDRESS 0x3833D0 /end MEASUREMENT
/begin MEASUREMENT flp83_07 "Lernfilterwert, positiv" SWORD dtsegn_b720divZyl 1 100 -90 89.9973 FORMAT "%8.5" ECU_ADDRESS 0x383400 /end MEASUREMENT
/begin MEASUREMENT flp83_08 "Lernfilterwert, positiv" SWORD dtsegn_b720divZyl 1 100 -90 89.9973 FORMAT "%8.5" ECU_ADDRESS 0x383430 /end MEASUREMENT
/begin MEASUREMENT flurkh "Faktor zur Absenkung des LUR-Wertes bei Katheizen, aus KL LURKH" UBYTE fak_ub_b1 1 100 0 0.996094 ECU_ADDRESS 0x380AD2 /end MEASUREMENT
/begin MEASUREMENT fluts "Filter der Laufunruhe-Testgröße" SWORD luquant_w 1 100 -90.9495 90.9467 FORMAT "%8.5" ECU_ADDRESS 0x381AB8 /end MEASUREMENT
/begin MEASUREMENT fluts1 "Filter der Laufunruhe-Testgröße von Zylinder 1 bzw. Zündung 1, signed" SWORD luquant_w 1 100 -90.9495 90.9467 FORMAT "%8.5" ECU_ADDRESS 0x381ABA /end MEASUREMENT
/begin MEASUREMENT fluts2 "Filter der Laufunruhe-Testgröße von Zylinder 2 bzw. Zündung 2, signed" SWORD luquant_w 1 100 -90.9495 90.9467 FORMAT "%8.5" ECU_ADDRESS 0x381ABC /end MEASUREMENT
/begin MEASUREMENT fluts3 "Filter der Laufunruhe-Testgröße von Zylinder 3 bzw. Zündung 3, signed" SWORD luquant_w 1 100 -90.9495 90.9467 FORMAT "%8.5" ECU_ADDRESS 0x381ABE /end MEASUREMENT
/begin MEASUREMENT fluts4 "Filter der Laufunruhe-Testgröße von Zylinder 4 bzw. Zündung 4, signed" SWORD luquant_w 1 100 -90.9495 90.9467 FORMAT "%8.5" ECU_ADDRESS 0x381AC0 /end MEASUREMENT
/begin MEASUREMENT fluts5 "Filter der Laufunruhe-Testgröße von Zylinder 5 bzw. Zündung 5, signed" SWORD luquant_w 1 100 -90.9495 90.9467 FORMAT "%8.5" ECU_ADDRESS 0x381AC2 /end MEASUREMENT
/begin MEASUREMENT fluts6 "Filter der Laufunruhe-Testgröße von Zylinder 6 bzw. Zündung 6, signed" SWORD luquant_w 1 100 -90.9495 90.9467 FORMAT "%8.5" ECU_ADDRESS 0x381AC4 /end MEASUREMENT
/begin MEASUREMENT fluts7 "Filter der Laufunruhe-Testgröße von Zylinder 7 bzw. Zündung 7, signed" SWORD luquant_w 1 100 -90.9495 90.9467 FORMAT "%8.5" ECU_ADDRESS 0x381AC6 /end MEASUREMENT
/begin MEASUREMENT fluts8 "Filter der Laufunruhe-Testgröße von Zylinder 8 bzw. Zündung 8, signed" SWORD luquant_w 1 100 -90.9495 90.9467 FORMAT "%8.5" ECU_ADDRESS 0x381AC8 /end MEASUREMENT
/begin MEASUREMENT fluts_m "Monitor, gefilterte Laufunruhetestgröße, signed, verzögerte Ausgabe" SWORD luquant_w 1 100 -90.9495 90.9467 FORMAT "%8.5" ECU_ADDRESS 0xE3EE /end MEASUREMENT
/begin MEASUREMENT fostat "Status der fuel-on/-off Adaption im aktuellen Betriebsbereich" UBYTE dez 1 100 0 255 FORMAT "%5.1" ECU_ADDRESS 0x380B8C /end MEASUREMENT
/begin MEASUREMENT fostat_m "Monitor, Status der Adpation im akt. Bereich, verzögerte Ausgabe" UBYTE dez 1 100 0 255 FORMAT "%5.1" ECU_ADDRESS 0xE519 /end MEASUREMENT
/begin MEASUREMENT frdlsv2_w "Regelfaktoranforderung durch %DLSV, Bank 2" UWORD fak_uw_b2 1 100 0 1.99997 FORMAT "%8.6" ECU_ADDRESS 0x381F92 /end MEASUREMENT
/begin MEASUREMENT frdlsv_w "Regelfaktoranforderung durch %DLSV" UWORD fak_uw_b2 1 100 0 1.99997 FORMAT "%8.6" ECU_ADDRESS 0x381F94 /end MEASUREMENT
/begin MEASUREMENT fs11_02 "Filterwert Segmentabweichung, Betriebsbereich 11, Zündung 2" UWORD dtsegn_b720divZylP5 1 100 -90 89.9973 FORMAT "%8.5" ECU_ADDRESS 0x383432 /end MEASUREMENT
/begin MEASUREMENT fs11_03 "Filterwert Segmentabweichung, Betriebsbereich 11, Zündung 3" UWORD dtsegn_b720divZylP5 1 100 -90 89.9973 FORMAT "%8.5" ECU_ADDRESS 0x383462 /end MEASUREMENT
/begin MEASUREMENT fs11_04 "Filterwert Segmentabweichung, Betriebsbereich 11, Zündung 4" UWORD dtsegn_b720divZylP5 1 100 -90 89.9973 FORMAT "%8.5" ECU_ADDRESS 0x383492 /end MEASUREMENT
/begin MEASUREMENT fs11_05 "Filterwert Segmentabweichung, Betriebsbereich 11, Zündung 5" UWORD dtsegn_b720divZylP5 1 100 -90 89.9973 FORMAT "%8.5" ECU_ADDRESS 0x3834C2 /end MEASUREMENT
/begin MEASUREMENT fs11_06 "Filterwert Segmentabweichung, Betriebsbereich 11, Zündung 6" UWORD dtsegn_b720divZylP5 1 100 -90 89.9973 FORMAT "%8.5" ECU_ADDRESS 0x3834F2 /end MEASUREMENT
/begin MEASUREMENT fs11_07 "Filterwert Segmentabweichung, Betriebsbereich 11, Zündung 7" UWORD dtsegn_b720divZylP5 1 100 -90 89.9973 FORMAT "%8.5" ECU_ADDRESS 0x383522 /end MEASUREMENT
/begin MEASUREMENT fs11_08 "Filterwert Segmentabweichung, Betriebsbereich 11, Zündung 8" UWORD dtsegn_b720divZylP5 1 100 -90 89.9973 FORMAT "%8.5" ECU_ADDRESS 0x383552 /end MEASUREMENT
/begin MEASUREMENT fs12_02 "Filterwert Segmentabweichung, Betriebsbereich 12, Zündung 2" UWORD dtsegn_b720divZylP5 1 100 -90 89.9973 FORMAT "%8.5" ECU_ADDRESS 0x383442 /end MEASUREMENT
/begin MEASUREMENT fs12_03 "Filterwert Segmentabweichung, Betriebsbereich 12, Zündung 3" UWORD dtsegn_b720divZylP5 1 100 -90 89.9973 FORMAT "%8.5" ECU_ADDRESS 0x383472 /end MEASUREMENT
/begin MEASUREMENT fs12_04 "Filterwert Segmentabweichung, Betriebsbereich 12, Zündung 4" UWORD dtsegn_b720divZylP5 1 100 -90 89.9973 FORMAT "%8.5" ECU_ADDRESS 0x3834A2 /end MEASUREMENT
/begin MEASUREMENT fs12_05 "Filterwert Segmentabweichung, Betriebsbereich 12, Zündung 5" UWORD dtsegn_b720divZylP5 1 100 -90 89.9973 FORMAT "%8.5" ECU_ADDRESS 0x3834D2 /end MEASUREMENT
/begin MEASUREMENT fs12_06 "Filterwert Segmentabweichung, Betriebsbereich 12, Zündung 6" UWORD dtsegn_b720divZylP5 1 100 -90 89.9973 FORMAT "%8.5" ECU_ADDRESS 0x383502 /end MEASUREMENT
/begin MEASUREMENT fs12_07 "Filterwert Segmentabweichung, Betriebsbereich 12, Zündung 7" UWORD dtsegn_b720divZylP5 1 100 -90 89.9973 FORMAT "%8.5" ECU_ADDRESS 0x383532 /end MEASUREMENT
/begin MEASUREMENT fs12_08 "Filterwert Segmentabweichung, Betriebsbereich 12, Zündung 8" UWORD dtsegn_b720divZylP5 1 100 -90 89.9973 FORMAT "%8.5" ECU_ADDRESS 0x383562 /end MEASUREMENT
/begin MEASUREMENT fs13_02 "Filterwert Segmentabweichung, Betriebsbereich 13, Zündung 2" UWORD dtsegn_b720divZylP5 1 100 -90 89.9973 FORMAT "%8.5" ECU_ADDRESS 0x383452 /end MEASUREMENT
/begin MEASUREMENT fs13_03 "Filterwert Segmentabweichung, Betriebsbereich 13, Zündung 3" UWORD dtsegn_b720divZylP5 1 100 -90 89.9973 FORMAT "%8.5" ECU_ADDRESS 0x383482 /end MEASUREMENT
/begin MEASUREMENT fs13_04 "Filterwert Segmentabweichung, Betriebsbereich 13, Zündung 4" UWORD dtsegn_b720divZylP5 1 100 -90 89.9973 FORMAT "%8.5" ECU_ADDRESS 0x3834B2 /end MEASUREMENT
/begin MEASUREMENT fs13_05 "Filterwert Segmentabweichung, Betriebsbereich 13, Zündung 5" UWORD dtsegn_b720divZylP5 1 100 -90 89.9973 FORMAT "%8.5" ECU_ADDRESS 0x3834E2 /end MEASUREMENT
/begin MEASUREMENT fs13_06 "Filterwert Segmentabweichung, Betriebsbereich 13, Zündung 6" UWORD dtsegn_b720divZylP5 1 100 -90 89.9973 FORMAT "%8.5" ECU_ADDRESS 0x383512 /end MEASUREMENT
/begin MEASUREMENT fs13_07 "Filterwert Segmentabweichung, Betriebsbereich 13, Zündung 7" UWORD dtsegn_b720divZylP5 1 100 -90 89.9973 FORMAT "%8.5" ECU_ADDRESS 0x383542 /end MEASUREMENT
/begin MEASUREMENT fs13_08 "Filterwert Segmentabweichung, Betriebsbereich 13, Zündung 8" UWORD dtsegn_b720divZylP5 1 100 -90 89.9973 FORMAT "%8.5" ECU_ADDRESS 0x383572 /end MEASUREMENT
/begin MEASUREMENT fs21_02 "Filterwert Segmentabweichung, Betriebsbereich 21, Zündung 2" UWORD dtsegn_b720divZylP5 1 100 -90 89.9973 FORMAT "%8.5" ECU_ADDRESS 0x383434 /end MEASUREMENT
/begin MEASUREMENT fs21_03 "Filterwert Segmentabweichung, Betriebsbereich 21, Zündung 3" UWORD dtsegn_b720divZylP5 1 100 -90 89.9973 FORMAT "%8.5" ECU_ADDRESS 0x383464 /end MEASUREMENT
/begin MEASUREMENT fs21_04 "Filterwert Segmentabweichung, Betriebsbereich 21, Zündung 4" UWORD dtsegn_b720divZylP5 1 100 -90 89.9973 FORMAT "%8.5" ECU_ADDRESS 0x383494 /end MEASUREMENT
/begin MEASUREMENT fs21_05 "Filterwert Segmentabweichung, Betriebsbereich 21, Zündung 5" UWORD dtsegn_b720divZylP5 1 100 -90 89.9973 FORMAT "%8.5" ECU_ADDRESS 0x3834C4 /end MEASUREMENT
/begin MEASUREMENT fs21_06 "Filterwert Segmentabweichung, Betriebsbereich 21, Zündung 6" UWORD dtsegn_b720divZylP5 1 100 -90 89.9973 FORMAT "%8.5" ECU_ADDRESS 0x3834F4 /end MEASUREMENT
/begin MEASUREMENT fs21_07 "Filterwert Segmentabweichung, Betriebsbereich 21, Zündung 7" UWORD dtsegn_b720divZylP5 1 100 -90 89.9973 FORMAT "%8.5" ECU_ADDRESS 0x383524 /end MEASUREMENT
/begin MEASUREMENT fs21_08 "Filterwert Segmentabweichung, Betriebsbereich 21, Zündung 8" UWORD dtsegn_b720divZylP5 1 100 -90 89.9973 FORMAT "%8.5" ECU_ADDRESS 0x383554 /end MEASUREMENT
/begin MEASUREMENT fs22_02 "Filterwert Segmentabweichung, Betriebsbereich 22, Zündung 2" UWORD dtsegn_b720divZylP5 1 100 -90 89.9973 FORMAT "%8.5" ECU_ADDRESS 0x383444 /end MEASUREMENT
/begin MEASUREMENT fs22_03 "Filterwert Segmentabweichung, Betriebsbereich 22, Zündung 3" UWORD dtsegn_b720divZylP5 1 100 -90 89.9973 FORMAT "%8.5" ECU_ADDRESS 0x383474 /end MEASUREMENT
/begin MEASUREMENT fs22_04 "Filterwert Segmentabweichung, Betriebsbereich 22, Zündung 4" UWORD dtsegn_b720divZylP5 1 100 -90 89.9973 FORMAT "%8.5" ECU_ADDRESS 0x3834A4 /end MEASUREMENT
/begin MEASUREMENT fs22_05 "Filterwert Segmentabweichung, Betriebsbereich 22, Zündung 5" UWORD dtsegn_b720divZylP5 1 100 -90 89.9973 FORMAT "%8.5" ECU_ADDRESS 0x3834D4 /end MEASUREMENT
/begin MEASUREMENT fs22_06 "Filterwert Segmentabweichung, Betriebsbereich 22, Zündung 6" UWORD dtsegn_b720divZylP5 1 100 -90 89.9973 FORMAT "%8.5" ECU_ADDRESS 0x383504 /end MEASUREMENT
/begin MEASUREMENT fs22_07 "Filterwert Segmentabweichung, Betriebsbereich 22, Zündung 7" UWORD dtsegn_b720divZylP5 1 100 -90 89.9973 FORMAT "%8.5" ECU_ADDRESS 0x383534 /end MEASUREMENT
/begin MEASUREMENT fs22_08 "Filterwert Segmentabweichung, Betriebsbereich 22, Zündung 8" UWORD dtsegn_b720divZylP5 1 100 -90 89.9973 FORMAT "%8.5" ECU_ADDRESS 0x383564 /end MEASUREMENT
/begin MEASUREMENT fs23_02 "Filterwert Segmentabweichung, Betriebsbereich 23, Zündung 2" UWORD dtsegn_b720divZylP5 1 100 -90 89.9973 FORMAT "%8.5" ECU_ADDRESS 0x383454 /end MEASUREMENT
/begin MEASUREMENT fs23_03 "Filterwert Segmentabweichung, Betriebsbereich 23, Zündung 3" UWORD dtsegn_b720divZylP5 1 100 -90 89.9973 FORMAT "%8.5" ECU_ADDRESS 0x383484 /end MEASUREMENT
/begin MEASUREMENT fs23_04 "Filterwert Segmentabweichung, Betriebsbereich 23, Zündung 4" UWORD dtsegn_b720divZylP5 1 100 -90 89.9973 FORMAT "%8.5" ECU_ADDRESS 0x3834B4 /end MEASUREMENT
/begin MEASUREMENT fs23_05 "Filterwert Segmentabweichung, Betriebsbereich 23, Zündung 5" UWORD dtsegn_b720divZylP5 1 100 -90 89.9973 FORMAT "%8.5" ECU_ADDRESS 0x3834E4 /end MEASUREMENT
/begin MEASUREMENT fs23_06 "Filterwert Segmentabweichung, Betriebsbereich 23, Zündung 6" UWORD dtsegn_b720divZylP5 1 100 -90 89.9973 FORMAT "%8.5" ECU_ADDRESS 0x383514 /end MEASUREMENT
/begin MEASUREMENT fs23_07 "Filterwert Segmentabweichung, Betriebsbereich 23, Zündung 7" UWORD dtsegn_b720divZylP5 1 100 -90 89.9973 FORMAT "%8.5" ECU_ADDRESS 0x383544 /end MEASUREMENT
/begin MEASUREMENT fs23_08 "Filterwert Segmentabweichung, Betriebsbereich 23, Zündung 8" UWORD dtsegn_b720divZylP5 1 100 -90 89.9973 FORMAT "%8.5" ECU_ADDRESS 0x383574 /end MEASUREMENT
/begin MEASUREMENT fs31_02 "Filterwert Segmentabweichung, Betriebsbereich 31, Zylinder 2" UWORD dtsegn_b720divZylP5 1 100 -90 89.9973 FORMAT "%8.5" ECU_ADDRESS 0x383436 /end MEASUREMENT
/begin MEASUREMENT fs31_03 "Filterwert Segmentabweichung, Betriebsbereich 31" UWORD dtsegn_b720divZylP5 1 100 -90 89.9973 FORMAT "%8.5" ECU_ADDRESS 0x383466 /end MEASUREMENT
/begin MEASUREMENT fs31_04 "Filterwert Segmentabweichung, Betriebsbereich 31" UWORD dtsegn_b720divZylP5 1 100 -90 89.9973 FORMAT "%8.5" ECU_ADDRESS 0x383496 /end MEASUREMENT
/begin MEASUREMENT fs31_05 "Filterwert Segmentabweichung, Betriebsbereich 31" UWORD dtsegn_b720divZylP5 1 100 -90 89.9973 FORMAT "%8.5" ECU_ADDRESS 0x3834C6 /end MEASUREMENT
/begin MEASUREMENT fs31_06 "Filterwert Segmentabweichung, Betriebsbereich 31" UWORD dtsegn_b720divZylP5 1 100 -90 89.9973 FORMAT "%8.5" ECU_ADDRESS 0x3834F6 /end MEASUREMENT
/begin MEASUREMENT fs31_07 "Filterwert Segmentabweichung, Betriebsbereich 31" UWORD dtsegn_b720divZylP5 1 100 -90 89.9973 FORMAT "%8.5" ECU_ADDRESS 0x383526 /end MEASUREMENT
/begin MEASUREMENT fs31_08 "Filterwert Segmentabweichung, Betriebsbereich 31" UWORD dtsegn_b720divZylP5 1 100 -90 89.9973 FORMAT "%8.5" ECU_ADDRESS 0x383556 /end MEASUREMENT
/begin MEASUREMENT fs32_02 "Filterwert Segmentabweichung, Betriebsbereich 32, Zylinder 2" UWORD dtsegn_b720divZylP5 1 100 -90 89.9973 FORMAT "%8.5" ECU_ADDRESS 0x383446 /end MEASUREMENT
/begin MEASUREMENT fs32_03 "Filterwert Segmentabweichung, Betriebsbereich 32" UWORD dtsegn_b720divZylP5 1 100 -90 89.9973 FORMAT "%8.5" ECU_ADDRESS 0x383476 /end MEASUREMENT
/begin MEASUREMENT fs32_04 "Filterwert Segmentabweichung, Betriebsbereich 32" UWORD dtsegn_b720divZylP5 1 100 -90 89.9973 FORMAT "%8.5" ECU_ADDRESS 0x3834A6 /end MEASUREMENT
/begin MEASUREMENT fs32_05 "Filterwert Segmentabweichung, Betriebsbereich 32" UWORD dtsegn_b720divZylP5 1 100 -90 89.9973 FORMAT "%8.5" ECU_ADDRESS 0x3834D6 /end MEASUREMENT
/begin MEASUREMENT fs32_06 "Filterwert Segmentabweichung, Betriebsbereich 32" UWORD dtsegn_b720divZylP5 1 100 -90 89.9973 FORMAT "%8.5" ECU_ADDRESS 0x383506 /end MEASUREMENT
/begin MEASUREMENT fs32_07 "Filterwert Segmentabweichung, Betriebsbereich 32" UWORD dtsegn_b720divZylP5 1 100 -90 89.9973 FORMAT "%8.5" ECU_ADDRESS 0x383536 /end MEASUREMENT
/begin MEASUREMENT fs32_08 "Filterwert Segmentabweichung, Betriebsbereich 32" UWORD dtsegn_b720divZylP5 1 100 -90 89.9973 FORMAT "%8.5" ECU_ADDRESS 0x383566 /end MEASUREMENT
/begin MEASUREMENT fs33_02 "Filterwert Segmentabweichung, Betriebsbereich 33, Zylinder 2" UWORD dtsegn_b720divZylP5 1 100 -90 89.9973 FORMAT "%8.5" ECU_ADDRESS 0x383456 /end MEASUREMENT
/begin MEASUREMENT fs33_03 "Filterwert Segmentabweichung, Betriebsbereich 33" UWORD dtsegn_b720divZylP5 1 100 -90 89.9973 FORMAT "%8.5" ECU_ADDRESS 0x383486 /end MEASUREMENT
/begin MEASUREMENT fs33_04 "Filterwert Segmentabweichung, Betriebsbereich 33" UWORD dtsegn_b720divZylP5 1 100 -90 89.9973 FORMAT "%8.5" ECU_ADDRESS 0x3834B6 /end MEASUREMENT
/begin MEASUREMENT fs33_05 "Filterwert Segmentabweichung, Betriebsbereich 33" UWORD dtsegn_b720divZylP5 1 100 -90 89.9973 FORMAT "%8.5" ECU_ADDRESS 0x3834E6 /end MEASUREMENT
/begin MEASUREMENT fs33_06 "Filterwert Segmentabweichung, Betriebsbereich 33" UWORD dtsegn_b720divZylP5 1 100 -90 89.9973 FORMAT "%8.5" ECU_ADDRESS 0x383516 /end MEASUREMENT
/begin MEASUREMENT fs33_07 "Filterwert Segmentabweichung, Betriebsbereich 33" UWORD dtsegn_b720divZylP5 1 100 -90 89.9973 FORMAT "%8.5" ECU_ADDRESS 0x383546 /end MEASUREMENT
/begin MEASUREMENT fs33_08 "Filterwert Segmentabweichung, Betriebsbereich 33" UWORD dtsegn_b720divZylP5 1 100 -90 89.9973 FORMAT "%8.5" ECU_ADDRESS 0x383576 /end MEASUREMENT
/begin MEASUREMENT fs41_02 "Filterwert Segmentabweichung, Betriebsbereich 41, Zylinder 2" UWORD dtsegn_b720divZylP5 1 100 -90 89.9973 FORMAT "%8.5" ECU_ADDRESS 0x383438 /end MEASUREMENT
/begin MEASUREMENT fs41_03 "Filterwert Segmentabweichung, Betriebsbereich 41" UWORD dtsegn_b720divZylP5 1 100 -90 89.9973 FORMAT "%8.5" ECU_ADDRESS 0x383468 /end MEASUREMENT
/begin MEASUREMENT fs41_04 "Filterwert Segmentabweichung, Betriebsbereich 41" UWORD dtsegn_b720divZylP5 1 100 -90 89.9973 FORMAT "%8.5" ECU_ADDRESS 0x383498 /end MEASUREMENT
/begin MEASUREMENT fs41_05 "Filterwert Segmentabweichung, Betriebsbereich 41" UWORD dtsegn_b720divZylP5 1 100 -90 89.9973 FORMAT "%8.5" ECU_ADDRESS 0x3834C8 /end MEASUREMENT
/begin MEASUREMENT fs41_06 "Filterwert Segmentabweichung, Betriebsbereich 41" UWORD dtsegn_b720divZylP5 1 100 -90 89.9973 FORMAT "%8.5" ECU_ADDRESS 0x3834F8 /end MEASUREMENT
/begin MEASUREMENT fs41_07 "Filterwert Segmentabweichung, Betriebsbereich 41" UWORD dtsegn_b720divZylP5 1 100 -90 89.9973 FORMAT "%8.5" ECU_ADDRESS 0x383528 /end MEASUREMENT
/begin MEASUREMENT fs41_08 "Filterwert Segmentabweichung, Betriebsbereich 41" UWORD dtsegn_b720divZylP5 1 100 -90 89.9973 FORMAT "%8.5" ECU_ADDRESS 0x383558 /end MEASUREMENT
/begin MEASUREMENT fs42_02 "Filterwert Segmentabweichung, Betriebsbereich 42, Zylinder 2" UWORD dtsegn_b720divZylP5 1 100 -90 89.9973 FORMAT "%8.5" ECU_ADDRESS 0x383448 /end MEASUREMENT
/begin MEASUREMENT fs42_03 "Filterwert Segmentabweichung, Betriebsbereich 42" UWORD dtsegn_b720divZylP5 1 100 -90 89.9973 FORMAT "%8.5" ECU_ADDRESS 0x383478 /end MEASUREMENT
/begin MEASUREMENT fs42_04 "Filterwert Segmentabweichung, Betriebsbereich 42" UWORD dtsegn_b720divZylP5 1 100 -90 89.9973 FORMAT "%8.5" ECU_ADDRESS 0x3834A8 /end MEASUREMENT
/begin MEASUREMENT fs42_05 "Filterwert Segmentabweichung, Betriebsbereich 42" UWORD dtsegn_b720divZylP5 1 100 -90 89.9973 FORMAT "%8.5" ECU_ADDRESS 0x3834D8 /end MEASUREMENT
/begin MEASUREMENT fs42_06 "Filterwert Segmentabweichung, Betriebsbereich 42" UWORD dtsegn_b720divZylP5 1 100 -90 89.9973 FORMAT "%8.5" ECU_ADDRESS 0x383508 /end MEASUREMENT
/begin MEASUREMENT fs42_07 "Filterwert Segmentabweichung, Betriebsbereich 42" UWORD dtsegn_b720divZylP5 1 100 -90 89.9973 FORMAT "%8.5" ECU_ADDRESS 0x383538 /end MEASUREMENT
/begin MEASUREMENT fs42_08 "Filterwert Segmentabweichung, Betriebsbereich 42" UWORD dtsegn_b720divZylP5 1 100 -90 89.9973 FORMAT "%8.5" ECU_ADDRESS 0x383568 /end MEASUREMENT
/begin MEASUREMENT fs43_02 "Filterwert Segmentabweichung, Betriebsbereich 43, Zylinder 2" UWORD dtsegn_b720divZylP5 1 100 -90 89.9973 FORMAT "%8.5" ECU_ADDRESS 0x383458 /end MEASUREMENT
/begin MEASUREMENT fs43_03 "Filterwert Segmentabweichung, Betriebsbereich 43" UWORD dtsegn_b720divZylP5 1 100 -90 89.9973 FORMAT "%8.5" ECU_ADDRESS 0x383488 /end MEASUREMENT
/begin MEASUREMENT fs43_04 "Filterwert Segmentabweichung, Betriebsbereich 43" UWORD dtsegn_b720divZylP5 1 100 -90 89.9973 FORMAT "%8.5" ECU_ADDRESS 0x3834B8 /end MEASUREMENT
/begin MEASUREMENT fs43_05 "Filterwert Segmentabweichung, Betriebsbereich 43" UWORD dtsegn_b720divZylP5 1 100 -90 89.9973 FORMAT "%8.5" ECU_ADDRESS 0x3834E8 /end MEASUREMENT
/begin MEASUREMENT fs43_06 "Filterwert Segmentabweichung, Betriebsbereich 43" UWORD dtsegn_b720divZylP5 1 100 -90 89.9973 FORMAT "%8.5" ECU_ADDRESS 0x383518 /end MEASUREMENT
/begin MEASUREMENT fs43_07 "Filterwert Segmentabweichung, Betriebsbereich 43" UWORD dtsegn_b720divZylP5 1 100 -90 89.9973 FORMAT "%8.5" ECU_ADDRESS 0x383548 /end MEASUREMENT
/begin MEASUREMENT fs43_08 "Filterwert Segmentabweichung, Betriebsbereich 43" UWORD dtsegn_b720divZylP5 1 100 -90 89.9973 FORMAT "%8.5" ECU_ADDRESS 0x383578 /end MEASUREMENT
/begin MEASUREMENT fs51_02 "Filterwert Segmentabweichung, Betriebsbereich 51, Zylinder 2" UWORD dtsegn_b720divZylP5 1 100 -90 89.9973 FORMAT "%8.5" ECU_ADDRESS 0x38343A /end MEASUREMENT
/begin MEASUREMENT fs51_03 "Filterwert Segmentabweichung, Betriebsbereich 51" UWORD dtsegn_b720divZylP5 1 100 -90 89.9973 FORMAT "%8.5" ECU_ADDRESS 0x38346A /end MEASUREMENT
/begin MEASUREMENT fs51_04 "Filterwert Segmentabweichung, Betriebsbereich 51" UWORD dtsegn_b720divZylP5 1 100 -90 89.9973 FORMAT "%8.5" ECU_ADDRESS 0x38349A /end MEASUREMENT
/begin MEASUREMENT fs51_05 "Filterwert Segmentabweichung, Betriebsbereich 51" UWORD dtsegn_b720divZylP5 1 100 -90 89.9973 FORMAT "%8.5" ECU_ADDRESS 0x3834CA /end MEASUREMENT
/begin MEASUREMENT fs51_06 "Filterwert Segmentabweichung, Betriebsbereich 51" UWORD dtsegn_b720divZylP5 1 100 -90 89.9973 FORMAT "%8.5" ECU_ADDRESS 0x3834FA /end MEASUREMENT
/begin MEASUREMENT fs51_07 "Filterwert Segmentabweichung, Betriebsbereich 51" UWORD dtsegn_b720divZylP5 1 100 -90 89.9973 FORMAT "%8.5" ECU_ADDRESS 0x38352A /end MEASUREMENT
/begin MEASUREMENT fs51_08 "Filterwert Segmentabweichung, Betriebsbereich 51" UWORD dtsegn_b720divZylP5 1 100 -90 89.9973 FORMAT "%8.5" ECU_ADDRESS 0x38355A /end MEASUREMENT
/begin MEASUREMENT fs52_02 "Filterwert Segmentabweichung, Betriebsbereich 52, Zylinder 2" UWORD dtsegn_b720divZylP5 1 100 -90 89.9973 FORMAT "%8.5" ECU_ADDRESS 0x38344A /end MEASUREMENT
/begin MEASUREMENT fs52_03 "Filterwert Segmentabweichung, Betriebsbereich 52" UWORD dtsegn_b720divZylP5 1 100 -90 89.9973 FORMAT "%8.5" ECU_ADDRESS 0x38347A /end MEASUREMENT
/begin MEASUREMENT fs52_04 "Filterwert Segmentabweichung, Betriebsbereich 52" UWORD dtsegn_b720divZylP5 1 100 -90 89.9973 FORMAT "%8.5" ECU_ADDRESS 0x3834AA /end MEASUREMENT
/begin MEASUREMENT fs52_05 "Filterwert Segmentabweichung, Betriebsbereich 52" UWORD dtsegn_b720divZylP5 1 100 -90 89.9973 FORMAT "%8.5" ECU_ADDRESS 0x3834DA /end MEASUREMENT
/begin MEASUREMENT fs52_06 "Filterwert Segmentabweichung, Betriebsbereich 52" UWORD dtsegn_b720divZylP5 1 100 -90 89.9973 FORMAT "%8.5" ECU_ADDRESS 0x38350A /end MEASUREMENT
/begin MEASUREMENT fs52_07 "Filterwert Segmentabweichung, Betriebsbereich 52" UWORD dtsegn_b720divZylP5 1 100 -90 89.9973 FORMAT "%8.5" ECU_ADDRESS 0x38353A /end MEASUREMENT
/begin MEASUREMENT fs52_08 "Filterwert Segmentabweichung, Betriebsbereich 52" UWORD dtsegn_b720divZylP5 1 100 -90 89.9973 FORMAT "%8.5" ECU_ADDRESS 0x38356A /end MEASUREMENT
/begin MEASUREMENT fs53_02 "Filterwert Segmentabweichung, Betriebsbereich 53, Zylinder 2" UWORD dtsegn_b720divZylP5 1 100 -90 89.9973 FORMAT "%8.5" ECU_ADDRESS 0x38345A /end MEASUREMENT
/begin MEASUREMENT fs53_03 "Filterwert Segmentabweichung, Betriebsbereich 53" UWORD dtsegn_b720divZylP5 1 100 -90 89.9973 FORMAT "%8.5" ECU_ADDRESS 0x38348A /end MEASUREMENT
/begin MEASUREMENT fs53_04 "Filterwert Segmentabweichung, Betriebsbereich 53" UWORD dtsegn_b720divZylP5 1 100 -90 89.9973 FORMAT "%8.5" ECU_ADDRESS 0x3834BA /end MEASUREMENT
/begin MEASUREMENT fs53_05 "Filterwert Segmentabweichung, Betriebsbereich 53" UWORD dtsegn_b720divZylP5 1 100 -90 89.9973 FORMAT "%8.5" ECU_ADDRESS 0x3834EA /end MEASUREMENT
/begin MEASUREMENT fs53_06 "Filterwert Segmentabweichung, Betriebsbereich 53" UWORD dtsegn_b720divZylP5 1 100 -90 89.9973 FORMAT "%8.5" ECU_ADDRESS 0x38351A /end MEASUREMENT
/begin MEASUREMENT fs53_07 "Filterwert Segmentabweichung, Betriebsbereich 53" UWORD dtsegn_b720divZylP5 1 100 -90 89.9973 FORMAT "%8.5" ECU_ADDRESS 0x38354A /end MEASUREMENT
/begin MEASUREMENT fs53_08 "Filterwert Segmentabweichung, Betriebsbereich 53" UWORD dtsegn_b720divZylP5 1 100 -90 89.9973 FORMAT "%8.5" ECU_ADDRESS 0x38357A /end MEASUREMENT
/begin MEASUREMENT fs61_02 "Filterwert Segmentabweichung, Betriebsbereich 61, Zylinder 2" UWORD dtsegn_b720divZylP5 1 100 -90 89.9973 FORMAT "%8.5" ECU_ADDRESS 0x38343C /end MEASUREMENT
/begin MEASUREMENT fs61_03 "Filterwert Segmentabweichung, Betriebsbereich 61" UWORD dtsegn_b720divZylP5 1 100 -90 89.9973 FORMAT "%8.5" ECU_ADDRESS 0x38346C /end MEASUREMENT
/begin MEASUREMENT fs61_04 "Filterwert Segmentabweichung, Betriebsbereich 61" UWORD dtsegn_b720divZylP5 1 100 -90 89.9973 FORMAT "%8.5" ECU_ADDRESS 0x38349C /end MEASUREMENT
/begin MEASUREMENT fs61_05 "Filterwert Segmentabweichung, Betriebsbereich 61" UWORD dtsegn_b720divZylP5 1 100 -90 89.9973 FORMAT "%8.5" ECU_ADDRESS 0x3834CC /end MEASUREMENT
/begin MEASUREMENT fs61_06 "Filterwert Segmentabweichung, Betriebsbereich 61" UWORD dtsegn_b720divZylP5 1 100 -90 89.9973 FORMAT "%8.5" ECU_ADDRESS 0x3834FC /end MEASUREMENT
/begin MEASUREMENT fs61_07 "Filterwert Segmentabweichung, Betriebsbereich 61" UWORD dtsegn_b720divZylP5 1 100 -90 89.9973 FORMAT "%8.5" ECU_ADDRESS 0x38352C /end MEASUREMENT
/begin MEASUREMENT fs61_08 "Filterwert Segmentabweichung, Betriebsbereich 61" UWORD dtsegn_b720divZylP5 1 100 -90 89.9973 FORMAT "%8.5" ECU_ADDRESS 0x38355C /end MEASUREMENT
/begin MEASUREMENT fs62_02 "Filterwert Segmentabweichung, Betriebsbereich 62, Zylinder 2" UWORD dtsegn_b720divZylP5 1 100 -90 89.9973 FORMAT "%8.5" ECU_ADDRESS 0x38344C /end MEASUREMENT
/begin MEASUREMENT fs62_03 "Filterwert Segmentabweichung, Betriebsbereich 62" UWORD dtsegn_b720divZylP5 1 100 -90 89.9973 FORMAT "%8.5" ECU_ADDRESS 0x38347C /end MEASUREMENT
/begin MEASUREMENT fs62_04 "Filterwert Segmentabweichung, Betriebsbereich 62" UWORD dtsegn_b720divZylP5 1 100 -90 89.9973 FORMAT "%8.5" ECU_ADDRESS 0x3834AC /end MEASUREMENT
/begin MEASUREMENT fs62_05 "Filterwert Segmentabweichung, Betriebsbereich 62" UWORD dtsegn_b720divZylP5 1 100 -90 89.9973 FORMAT "%8.5" ECU_ADDRESS 0x3834DC /end MEASUREMENT
/begin MEASUREMENT fs62_06 "Filterwert Segmentabweichung, Betriebsbereich 62" UWORD dtsegn_b720divZylP5 1 100 -90 89.9973 FORMAT "%8.5" ECU_ADDRESS 0x38350C /end MEASUREMENT
/begin MEASUREMENT fs62_07 "Filterwert Segmentabweichung, Betriebsbereich 62" UWORD dtsegn_b720divZylP5 1 100 -90 89.9973 FORMAT "%8.5" ECU_ADDRESS 0x38353C /end MEASUREMENT
/begin MEASUREMENT fs62_08 "Filterwert Segmentabweichung, Betriebsbereich 62" UWORD dtsegn_b720divZylP5 1 100 -90 89.9973 FORMAT "%8.5" ECU_ADDRESS 0x38356C /end MEASUREMENT
/begin MEASUREMENT fs63_02 "Filterwert Segmentabweichung, Betriebsbereich 63, Zylinder 2" UWORD dtsegn_b720divZylP5 1 100 -90 89.9973 FORMAT "%8.5" ECU_ADDRESS 0x38345C /end MEASUREMENT
/begin MEASUREMENT fs63_03 "Filterwert Segmentabweichung, Betriebsbereich 63" UWORD dtsegn_b720divZylP5 1 100 -90 89.9973 FORMAT "%8.5" ECU_ADDRESS 0x38348C /end MEASUREMENT
/begin MEASUREMENT fs63_04 "Filterwert Segmentabweichung, Betriebsbereich 63" UWORD dtsegn_b720divZylP5 1 100 -90 89.9973 FORMAT "%8.5" ECU_ADDRESS 0x3834BC /end MEASUREMENT
/begin MEASUREMENT fs63_05 "Filterwert Segmentabweichung, Betriebsbereich 63" UWORD dtsegn_b720divZylP5 1 100 -90 89.9973 FORMAT "%8.5" ECU_ADDRESS 0x3834EC /end MEASUREMENT
/begin MEASUREMENT fs63_06 "Filterwert Segmentabweichung, Betriebsbereich 63" UWORD dtsegn_b720divZylP5 1 100 -90 89.9973 FORMAT "%8.5" ECU_ADDRESS 0x38351C /end MEASUREMENT
/begin MEASUREMENT fs63_07 "Filterwert Segmentabweichung, Betriebsbereich 63" UWORD dtsegn_b720divZylP5 1 100 -90 89.9973 FORMAT "%8.5" ECU_ADDRESS 0x38354C /end MEASUREMENT
/begin MEASUREMENT fs63_08 "Filterwert Segmentabweichung, Betriebsbereich 63" UWORD dtsegn_b720divZylP5 1 100 -90 89.9973 FORMAT "%8.5" ECU_ADDRESS 0x38357C /end MEASUREMENT
/begin MEASUREMENT fs71_02 "Filterwert Segmentabweichung, Betriebsbereich 71, Zylinder 2" UWORD dtsegn_b720divZylP5 1 100 -90 89.9973 FORMAT "%8.5" ECU_ADDRESS 0x38343E /end MEASUREMENT
/begin MEASUREMENT fs71_03 "Filterwert Segmentabweichung, Betriebsbereich 71, Zylinder 3" UWORD dtsegn_b720divZylP5 1 100 -90 89.9973 FORMAT "%8.5" ECU_ADDRESS 0x38346E /end MEASUREMENT
/begin MEASUREMENT fs71_04 "Filterwert Segmentabweichung, Betriebsbereich 71, Zylinder 4" UWORD dtsegn_b720divZylP5 1 100 -90 89.9973 FORMAT "%8.5" ECU_ADDRESS 0x38349E /end MEASUREMENT
/begin MEASUREMENT fs71_05 "Filterwert Segmentabweichung, Betriebsbereich 71, Zylinder 5" UWORD dtsegn_b720divZylP5 1 100 -90 89.9973 FORMAT "%8.5" ECU_ADDRESS 0x3834CE /end MEASUREMENT
/begin MEASUREMENT fs71_06 "Filterwert Segmentabweichung, Betriebsbereich 71, Zylinder 6" UWORD dtsegn_b720divZylP5 1 100 -90 89.9973 FORMAT "%8.5" ECU_ADDRESS 0x3834FE /end MEASUREMENT
/begin MEASUREMENT fs71_07 "Filterwert Segmentabweichung, Betriebsbereich 71, Zylinder 7" UWORD dtsegn_b720divZylP5 1 100 -90 89.9973 FORMAT "%8.5" ECU_ADDRESS 0x38352E /end MEASUREMENT
/begin MEASUREMENT fs71_08 "Filterwert Segmentabweichung, Betriebsbereich 71, Zylinder 8" UWORD dtsegn_b720divZylP5 1 100 -90 89.9973 FORMAT "%8.5" ECU_ADDRESS 0x38355E /end MEASUREMENT
/begin MEASUREMENT fs72_02 "Filterwert Segmentabweichung, Betriebsbereich 72, Zylinder 2" UWORD dtsegn_b720divZylP5 1 100 -90 89.9973 FORMAT "%8.5" ECU_ADDRESS 0x38344E /end MEASUREMENT
/begin MEASUREMENT fs72_03 "Filterwert Segmentabweichung, Betriebsbereich 72, Zylinder 3" UWORD dtsegn_b720divZylP5 1 100 -90 89.9973 FORMAT "%8.5" ECU_ADDRESS 0x38347E /end MEASUREMENT
/begin MEASUREMENT fs72_04 "Filterwert Segmentabweichung, Betriebsbereich 72, Zylinder 4" UWORD dtsegn_b720divZylP5 1 100 -90 89.9973 FORMAT "%8.5" ECU_ADDRESS 0x3834AE /end MEASUREMENT
/begin MEASUREMENT fs72_05 "Filterwert Segmentabweichung, Betriebsbereich 72, Zylinder 5" UWORD dtsegn_b720divZylP5 1 100 -90 89.9973 FORMAT "%8.5" ECU_ADDRESS 0x3834DE /end MEASUREMENT
/begin MEASUREMENT fs72_06 "Filterwert Segmentabweichung, Betriebsbereich 72, Zylinder 6" UWORD dtsegn_b720divZylP5 1 100 -90 89.9973 FORMAT "%8.5" ECU_ADDRESS 0x38350E /end MEASUREMENT
/begin MEASUREMENT fs72_07 "Filterwert Segmentabweichung, Betriebsbereich 72, Zylinder 7" UWORD dtsegn_b720divZylP5 1 100 -90 89.9973 FORMAT "%8.5" ECU_ADDRESS 0x38353E /end MEASUREMENT
/begin MEASUREMENT fs72_08 "Filterwert Segmentabweichung, Betriebsbereich 72, Zylinder 8" UWORD dtsegn_b720divZylP5 1 100 -90 89.9973 FORMAT "%8.5" ECU_ADDRESS 0x38356E /end MEASUREMENT
/begin MEASUREMENT fs73_02 "Filterwert Segmentabweichung, Betriebsbereich 73, Zylinder 2" UWORD dtsegn_b720divZylP5 1 100 -90 89.9973 FORMAT "%8.5" ECU_ADDRESS 0x38345E /end MEASUREMENT
/begin MEASUREMENT fs73_03 "Filterwert Segmentabweichung, Betriebsbereich 73, Zylinder 3" UWORD dtsegn_b720divZylP5 1 100 -90 89.9973 FORMAT "%8.5" ECU_ADDRESS 0x38348E /end MEASUREMENT
/begin MEASUREMENT fs73_04 "Filterwert Segmentabweichung, Betriebsbereich 73, Zylinder 4" UWORD dtsegn_b720divZylP5 1 100 -90 89.9973 FORMAT "%8.5" ECU_ADDRESS 0x3834BE /end MEASUREMENT
/begin MEASUREMENT fs73_05 "Filterwert Segmentabweichung, Betriebsbereich 73, Zylinder 5" UWORD dtsegn_b720divZylP5 1 100 -90 89.9973 FORMAT "%8.5" ECU_ADDRESS 0x3834EE /end MEASUREMENT
/begin MEASUREMENT fs73_06 "Filterwert Segmentabweichung, Betriebsbereich 73, Zylinder 6" UWORD dtsegn_b720divZylP5 1 100 -90 89.9973 FORMAT "%8.5" ECU_ADDRESS 0x38351E /end MEASUREMENT
/begin MEASUREMENT fs73_07 "Filterwert Segmentabweichung, Betriebsbereich 73, Zylinder 7" UWORD dtsegn_b720divZylP5 1 100 -90 89.9973 FORMAT "%8.5" ECU_ADDRESS 0x38354E /end MEASUREMENT
/begin MEASUREMENT fs73_08 "Filterwert Segmentabweichung, Betriebsbereich 73, Zylinder 8" UWORD dtsegn_b720divZylP5 1 100 -90 89.9973 FORMAT "%8.5" ECU_ADDRESS 0x38357E /end MEASUREMENT
/begin MEASUREMENT fs81_02 "Filterwert Segmentabweichung, Betriebsbereich 81, Zylinder 2" UWORD dtsegn_b720divZylP5 1 100 -90 89.9973 FORMAT "%8.5" ECU_ADDRESS 0x383440 /end MEASUREMENT
/begin MEASUREMENT fs81_03 "Filterwert Segmentabweichung, Betriebsbereich 81, Zylinder 3" UWORD dtsegn_b720divZylP5 1 100 -90 89.9973 FORMAT "%8.5" ECU_ADDRESS 0x383470 /end MEASUREMENT
/begin MEASUREMENT fs81_04 "Filterwert Segmentabweichung, Betriebsbereich 81, Zylinder 4" UWORD dtsegn_b720divZylP5 1 100 -90 89.9973 FORMAT "%8.5" ECU_ADDRESS 0x3834A0 /end MEASUREMENT
/begin MEASUREMENT fs81_05 "Filterwert Segmentabweichung, Betriebsbereich 81, Zylinder 5" UWORD dtsegn_b720divZylP5 1 100 -90 89.9973 FORMAT "%8.5" ECU_ADDRESS 0x3834D0 /end MEASUREMENT
/begin MEASUREMENT fs81_06 "Filterwert Segmentabweichung, Betriebsbereich 81, Zylinder 6" UWORD dtsegn_b720divZylP5 1 100 -90 89.9973 FORMAT "%8.5" ECU_ADDRESS 0x383500 /end MEASUREMENT
/begin MEASUREMENT fs81_07 "Filterwert Segmentabweichung, Betriebsbereich 81, Zylinder 7" UWORD dtsegn_b720divZylP5 1 100 -90 89.9973 FORMAT "%8.5" ECU_ADDRESS 0x383530 /end MEASUREMENT
/begin MEASUREMENT fs81_08 "Filterwert Segmentabweichung, Betriebsbereich 81, Zylinder 8" UWORD dtsegn_b720divZylP5 1 100 -90 89.9973 FORMAT "%8.5" ECU_ADDRESS 0x383560 /end MEASUREMENT
/begin MEASUREMENT fs82_02 "Filterwert Segmentabweichung, Betriebsbereich 82, Zylinder 2" UWORD dtsegn_b720divZylP5 1 100 -90 89.9973 FORMAT "%8.5" ECU_ADDRESS 0x383450 /end MEASUREMENT
/begin MEASUREMENT fs82_03 "Filterwert Segmentabweichung, Betriebsbereich 82, Zylinder 3" UWORD dtsegn_b720divZylP5 1 100 -90 89.9973 FORMAT "%8.5" ECU_ADDRESS 0x383480 /end MEASUREMENT
/begin MEASUREMENT fs82_04 "Filterwert Segmentabweichung, Betriebsbereich 82, Zylinder 4" UWORD dtsegn_b720divZylP5 1 100 -90 89.9973 FORMAT "%8.5" ECU_ADDRESS 0x3834B0 /end MEASUREMENT
/begin MEASUREMENT fs82_05 "Filterwert Segmentabweichung, Betriebsbereich 82, Zylinder 5" UWORD dtsegn_b720divZylP5 1 100 -90 89.9973 FORMAT "%8.5" ECU_ADDRESS 0x3834E0 /end MEASUREMENT
/begin MEASUREMENT fs82_06 "Filterwert Segmentabweichung, Betriebsbereich 82, Zylinder 6" UWORD dtsegn_b720divZylP5 1 100 -90 89.9973 FORMAT "%8.5" ECU_ADDRESS 0x383510 /end MEASUREMENT
/begin MEASUREMENT fs82_07 "Filterwert Segmentabweichung, Betriebsbereich 82, Zylinder 7" UWORD dtsegn_b720divZylP5 1 100 -90 89.9973 FORMAT "%8.5" ECU_ADDRESS 0x383540 /end MEASUREMENT
/begin MEASUREMENT fs82_08 "Filterwert Segmentabweichung, Betriebsbereich 82, Zylinder 8" UWORD dtsegn_b720divZylP5 1 100 -90 89.9973 FORMAT "%8.5" ECU_ADDRESS 0x383570 /end MEASUREMENT
/begin MEASUREMENT fs83_02 "Filterwert Segmentabweichung, Betriebsbereich 83, Zylinder 2" UWORD dtsegn_b720divZylP5 1 100 -90 89.9973 FORMAT "%8.5" ECU_ADDRESS 0x383460 /end MEASUREMENT
/begin MEASUREMENT fs83_03 "Filterwert Segmentabweichung, Betriebsbereich 83, Zylinder 3" UWORD dtsegn_b720divZylP5 1 100 -90 89.9973 FORMAT "%8.5" ECU_ADDRESS 0x383490 /end MEASUREMENT
/begin MEASUREMENT fs83_04 "Filterwert Segmentabweichung, Betriebsbereich 83, Zylinder 4" UWORD dtsegn_b720divZylP5 1 100 -90 89.9973 FORMAT "%8.5" ECU_ADDRESS 0x3834C0 /end MEASUREMENT
/begin MEASUREMENT fs83_05 "Filterwert Segmentabweichung, Betriebsbereich 83, Zylinder 5" UWORD dtsegn_b720divZylP5 1 100 -90 89.9973 FORMAT "%8.5" ECU_ADDRESS 0x3834F0 /end MEASUREMENT
/begin MEASUREMENT fs83_06 "Filterwert Segmentabweichung, Betriebsbereich 83, Zylinder 6" UWORD dtsegn_b720divZylP5 1 100 -90 89.9973 FORMAT "%8.5" ECU_ADDRESS 0x383520 /end MEASUREMENT
/begin MEASUREMENT fs83_07 "Filterwert Segmentabweichung, Betriebsbereich 83, Zylinder 7" UWORD dtsegn_b720divZylP5 1 100 -90 89.9973 FORMAT "%8.5" ECU_ADDRESS 0x383550 /end MEASUREMENT
/begin MEASUREMENT fs83_08 "Filterwert Segmentabweichung, Betriebsbereich 83, Zylinder 8" UWORD dtsegn_b720divZylP5 1 100 -90 89.9973 FORMAT "%8.5" ECU_ADDRESS 0x383580 /end MEASUREMENT
/begin MEASUREMENT fse "aktueller Filterwert Segmentabweichung, zur Segmentzeit-Korrektur" SBYTE dtsegn_b11p25divZyl 1 100 -1.40625 1.39526 FORMAT "%5.3" ECU_ADDRESS 0x380BAF /end MEASUREMENT
/begin MEASUREMENT fse11_02 "Filterwert Segmentabweichung, eingerechnet" UBYTE dtsegno_b11p25divZyl 1 100 -1.40625 1.39526 FORMAT "%5.3" ECU_ADDRESS 0x38303B /end MEASUREMENT
/begin MEASUREMENT fse11_03 "Filterwert Segmentabweichung, eingerechnet" UBYTE dtsegno_b11p25divZyl 1 100 -1.40625 1.39526 FORMAT "%5.3" ECU_ADDRESS 0x383053 /end MEASUREMENT
/begin MEASUREMENT fse11_04 "Filterwert Segmentabweichung, eingerechnet" UBYTE dtsegno_b11p25divZyl 1 100 -1.40625 1.39526 FORMAT "%5.3" ECU_ADDRESS 0x38306B /end MEASUREMENT
/begin MEASUREMENT fse11_05 "Filterwert Segmentabweichung, eingerechnet" UBYTE dtsegno_b11p25divZyl 1 100 -1.40625 1.39526 FORMAT "%5.3" ECU_ADDRESS 0x383083 /end MEASUREMENT
/begin MEASUREMENT fse11_06 "Filterwert Segmentabweichung, eingerechnet" UBYTE dtsegno_b11p25divZyl 1 100 -1.40625 1.39526 FORMAT "%5.3" ECU_ADDRESS 0x38309B /end MEASUREMENT
/begin MEASUREMENT fse11_07 "Filterwert Segmentabweichung, eingerechnet" UBYTE dtsegno_b11p25divZyl 1 100 -1.40625 1.39526 FORMAT "%5.3" ECU_ADDRESS 0x3830B3 /end MEASUREMENT
/begin MEASUREMENT fse11_08 "Filterwert Segmentabweichung, eingerechnet" UBYTE dtsegno_b11p25divZyl 1 100 -1.40625 1.39526 FORMAT "%5.3" ECU_ADDRESS 0x3830CB /end MEASUREMENT
/begin MEASUREMENT fse12_02 "Filterwert Segmentabweichung, eingerechnet" UBYTE dtsegno_b11p25divZyl 1 100 -1.40625 1.39526 FORMAT "%5.3" ECU_ADDRESS 0x383043 /end MEASUREMENT
/begin MEASUREMENT fse12_03 "Filterwert Segmentabweichung, eingerechnet" UBYTE dtsegno_b11p25divZyl 1 100 -1.40625 1.39526 FORMAT "%5.3" ECU_ADDRESS 0x38305B /end MEASUREMENT
/begin MEASUREMENT fse12_04 "Filterwert Segmentabweichung, eingerechnet" UBYTE dtsegno_b11p25divZyl 1 100 -1.40625 1.39526 FORMAT "%5.3" ECU_ADDRESS 0x383073 /end MEASUREMENT
/begin MEASUREMENT fse12_05 "Filterwert Segmentabweichung, eingerechnet" UBYTE dtsegno_b11p25divZyl 1 100 -1.40625 1.39526 FORMAT "%5.3" ECU_ADDRESS 0x38308B /end MEASUREMENT
/begin MEASUREMENT fse12_06 "Filterwert Segmentabweichung, eingerechnet" UBYTE dtsegno_b11p25divZyl 1 100 -1.40625 1.39526 FORMAT "%5.3" ECU_ADDRESS 0x3830A3 /end MEASUREMENT
/begin MEASUREMENT fse12_07 "Filterwert Segmentabweichung, eingerechnet" UBYTE dtsegno_b11p25divZyl 1 100 -1.40625 1.39526 FORMAT "%5.3" ECU_ADDRESS 0x3830BB /end MEASUREMENT
/begin MEASUREMENT fse12_08 "Filterwert Segmentabweichung, eingerechnet" UBYTE dtsegno_b11p25divZyl 1 100 -1.40625 1.39526 FORMAT "%5.3" ECU_ADDRESS 0x3830D3 /end MEASUREMENT
/begin MEASUREMENT fse13_02 "Filterwert Segmentabweichung, eingerechnet" UBYTE dtsegno_b11p25divZyl 1 100 -1.40625 1.39526 FORMAT "%5.3" ECU_ADDRESS 0x38304B /end MEASUREMENT
/begin MEASUREMENT fse13_03 "Filterwert Segmentabweichung, eingerechnet" UBYTE dtsegno_b11p25divZyl 1 100 -1.40625 1.39526 FORMAT "%5.3" ECU_ADDRESS 0x383063 /end MEASUREMENT
/begin MEASUREMENT fse13_04 "Filterwert Segmentabweichung, eingerechnet" UBYTE dtsegno_b11p25divZyl 1 100 -1.40625 1.39526 FORMAT "%5.3" ECU_ADDRESS 0x38307B /end MEASUREMENT
/begin MEASUREMENT fse13_05 "Filterwert Segmentabweichung, eingerechnet" UBYTE dtsegno_b11p25divZyl 1 100 -1.40625 1.39526 FORMAT "%5.3" ECU_ADDRESS 0x383093 /end MEASUREMENT
/begin MEASUREMENT fse13_06 "Filterwert Segmentabweichung, eingerechnet" UBYTE dtsegno_b11p25divZyl 1 100 -1.40625 1.39526 FORMAT "%5.3" ECU_ADDRESS 0x3830AB /end MEASUREMENT
/begin MEASUREMENT fse13_07 "Filterwert Segmentabweichung, eingerechnet" UBYTE dtsegno_b11p25divZyl 1 100 -1.40625 1.39526 FORMAT "%5.3" ECU_ADDRESS 0x3830C3 /end MEASUREMENT
/begin MEASUREMENT fse13_08 "Filterwert Segmentabweichung, eingerechnet" UBYTE dtsegno_b11p25divZyl 1 100 -1.40625 1.39526 FORMAT "%5.3" ECU_ADDRESS 0x3830DB /end MEASUREMENT
/begin MEASUREMENT fse21_02 "Filterwert Segmentabweichung, eingerechnet" UBYTE dtsegno_b11p25divZyl 1 100 -1.40625 1.39526 FORMAT "%5.3" ECU_ADDRESS 0x38303C /end MEASUREMENT
/begin MEASUREMENT fse21_03 "Filterwert Segmentabweichung, eingerechnet" UBYTE dtsegno_b11p25divZyl 1 100 -1.40625 1.39526 FORMAT "%5.3" ECU_ADDRESS 0x383054 /end MEASUREMENT
/begin MEASUREMENT fse21_04 "Filterwert Segmentabweichung, eingerechnet" UBYTE dtsegno_b11p25divZyl 1 100 -1.40625 1.39526 FORMAT "%5.3" ECU_ADDRESS 0x38306C /end MEASUREMENT
/begin MEASUREMENT fse21_05 "Filterwert Segmentabweichung, eingerechnet" UBYTE dtsegno_b11p25divZyl 1 100 -1.40625 1.39526 FORMAT "%5.3" ECU_ADDRESS 0x383084 /end MEASUREMENT
/begin MEASUREMENT fse21_06 "Filterwert Segmentabweichung, eingerechnet" UBYTE dtsegno_b11p25divZyl 1 100 -1.40625 1.39526 FORMAT "%5.3" ECU_ADDRESS 0x38309C /end MEASUREMENT
/begin MEASUREMENT fse21_07 "Filterwert Segmentabweichung, eingerechnet" UBYTE dtsegno_b11p25divZyl 1 100 -1.40625 1.39526 FORMAT "%5.3" ECU_ADDRESS 0x3830B4 /end MEASUREMENT
/begin MEASUREMENT fse21_08 "Filterwert Segmentabweichung, eingerechnet" UBYTE dtsegno_b11p25divZyl 1 100 -1.40625 1.39526 FORMAT "%5.3" ECU_ADDRESS 0x3830CC /end MEASUREMENT
/begin MEASUREMENT fse22_02 "Filterwert Segmentabweichung, eingerechnet" UBYTE dtsegno_b11p25divZyl 1 100 -1.40625 1.39526 FORMAT "%5.3" ECU_ADDRESS 0x383044 /end MEASUREMENT
/begin MEASUREMENT fse22_03 "Filterwert Segmentabweichung, eingerechnet" UBYTE dtsegno_b11p25divZyl 1 100 -1.40625 1.39526 FORMAT "%5.3" ECU_ADDRESS 0x38305C /end MEASUREMENT
/begin MEASUREMENT fse22_04 "Filterwert Segmentabweichung, eingerechnet" UBYTE dtsegno_b11p25divZyl 1 100 -1.40625 1.39526 FORMAT "%5.3" ECU_ADDRESS 0x383074 /end MEASUREMENT
/begin MEASUREMENT fse22_05 "Filterwert Segmentabweichung, eingerechnet" UBYTE dtsegno_b11p25divZyl 1 100 -1.40625 1.39526 FORMAT "%5.3" ECU_ADDRESS 0x38308C /end MEASUREMENT
/begin MEASUREMENT fse22_06 "Filterwert Segmentabweichung, eingerechnet" UBYTE dtsegno_b11p25divZyl 1 100 -1.40625 1.39526 FORMAT "%5.3" ECU_ADDRESS 0x3830A4 /end MEASUREMENT
/begin MEASUREMENT fse22_07 "Filterwert Segmentabweichung, eingerechnet" UBYTE dtsegno_b11p25divZyl 1 100 -1.40625 1.39526 FORMAT "%5.3" ECU_ADDRESS 0x3830BC /end MEASUREMENT
/begin MEASUREMENT fse22_08 "Filterwert Segmentabweichung, eingerechnet" UBYTE dtsegno_b11p25divZyl 1 100 -1.40625 1.39526 FORMAT "%5.3" ECU_ADDRESS 0x3830D4 /end MEASUREMENT
/begin MEASUREMENT fse23_02 "Filterwert Segmentabweichung, eingerechnet" UBYTE dtsegno_b11p25divZyl 1 100 -1.40625 1.39526 FORMAT "%5.3" ECU_ADDRESS 0x38304C /end MEASUREMENT
/begin MEASUREMENT fse23_03 "Filterwert Segmentabweichung, eingerechnet" UBYTE dtsegno_b11p25divZyl 1 100 -1.40625 1.39526 FORMAT "%5.3" ECU_ADDRESS 0x383064 /end MEASUREMENT
/begin MEASUREMENT fse23_04 "Filterwert Segmentabweichung, eingerechnet" UBYTE dtsegno_b11p25divZyl 1 100 -1.40625 1.39526 FORMAT "%5.3" ECU_ADDRESS 0x38307C /end MEASUREMENT
/begin MEASUREMENT fse23_05 "Filterwert Segmentabweichung, eingerechnet" UBYTE dtsegno_b11p25divZyl 1 100 -1.40625 1.39526 FORMAT "%5.3" ECU_ADDRESS 0x383094 /end MEASUREMENT
/begin MEASUREMENT fse23_06 "Filterwert Segmentabweichung, eingerechnet" UBYTE dtsegno_b11p25divZyl 1 100 -1.40625 1.39526 FORMAT "%5.3" ECU_ADDRESS 0x3830AC /end MEASUREMENT
/begin MEASUREMENT fse23_07 "Filterwert Segmentabweichung, eingerechnet" UBYTE dtsegno_b11p25divZyl 1 100 -1.40625 1.39526 FORMAT "%5.3" ECU_ADDRESS 0x3830C4 /end MEASUREMENT
/begin MEASUREMENT fse23_08 "Filterwert Segmentabweichung, eingerechnet" UBYTE dtsegno_b11p25divZyl 1 100 -1.40625 1.39526 FORMAT "%5.3" ECU_ADDRESS 0x3830DC /end MEASUREMENT
/begin MEASUREMENT fse31_02 "Filterwert Segmentabweichung, eingerechnet" UBYTE dtsegno_b11p25divZyl 1 100 -1.40625 1.39526 FORMAT "%5.3" ECU_ADDRESS 0x38303D /end MEASUREMENT
/begin MEASUREMENT fse31_03 "Filterwert Segmentabweichung, eingerechnet" UBYTE dtsegno_b11p25divZyl 1 100 -1.40625 1.39526 FORMAT "%5.3" ECU_ADDRESS 0x383055 /end MEASUREMENT
/begin MEASUREMENT fse31_04 "Filterwert Segmentabweichung, eingerechnet" UBYTE dtsegno_b11p25divZyl 1 100 -1.40625 1.39526 FORMAT "%5.3" ECU_ADDRESS 0x38306D /end MEASUREMENT
/begin MEASUREMENT fse31_05 "Filterwert Segmentabweichung, eingerechnet" UBYTE dtsegno_b11p25divZyl 1 100 -1.40625 1.39526 FORMAT "%5.3" ECU_ADDRESS 0x383085 /end MEASUREMENT
/begin MEASUREMENT fse31_06 "Filterwert Segmentabweichung, eingerechnet" UBYTE dtsegno_b11p25divZyl 1 100 -1.40625 1.39526 FORMAT "%5.3" ECU_ADDRESS 0x38309D /end MEASUREMENT
/begin MEASUREMENT fse31_07 "Filterwert Segmentabweichung, eingerechnet" UBYTE dtsegno_b11p25divZyl 1 100 -1.40625 1.39526 FORMAT "%5.3" ECU_ADDRESS 0x3830B5 /end MEASUREMENT
/begin MEASUREMENT fse31_08 "Filterwert Segmentabweichung, eingerechnet" UBYTE dtsegno_b11p25divZyl 1 100 -1.40625 1.39526 FORMAT "%5.3" ECU_ADDRESS 0x3830CD /end MEASUREMENT
/begin MEASUREMENT fse32_02 "Filterwert Segmentabweichung, eingerechnet" UBYTE dtsegno_b11p25divZyl 1 100 -1.40625 1.39526 FORMAT "%5.3" ECU_ADDRESS 0x383045 /end MEASUREMENT
/begin MEASUREMENT fse32_03 "Filterwert Segmentabweichung, eingerechnet" UBYTE dtsegno_b11p25divZyl 1 100 -1.40625 1.39526 FORMAT "%5.3" ECU_ADDRESS 0x38305D /end MEASUREMENT
/begin MEASUREMENT fse32_04 "Filterwert Segmentabweichung, eingerechnet" UBYTE dtsegno_b11p25divZyl 1 100 -1.40625 1.39526 FORMAT "%5.3" ECU_ADDRESS 0x383075 /end MEASUREMENT
/begin MEASUREMENT fse32_05 "Filterwert Segmentabweichung, eingerechnet" UBYTE dtsegno_b11p25divZyl 1 100 -1.40625 1.39526 FORMAT "%5.3" ECU_ADDRESS 0x38308D /end MEASUREMENT
/begin MEASUREMENT fse32_06 "Filterwert Segmentabweichung, eingerechnet" UBYTE dtsegno_b11p25divZyl 1 100 -1.40625 1.39526 FORMAT "%5.3" ECU_ADDRESS 0x3830A5 /end MEASUREMENT
/begin MEASUREMENT fse32_07 "Filterwert Segmentabweichung, eingerechnet" UBYTE dtsegno_b11p25divZyl 1 100 -1.40625 1.39526 FORMAT "%5.3" ECU_ADDRESS 0x3830BD /end MEASUREMENT
/begin MEASUREMENT fse32_08 "Filterwert Segmentabweichung, eingerechnet" UBYTE dtsegno_b11p25divZyl 1 100 -1.40625 1.39526 FORMAT "%5.3" ECU_ADDRESS 0x3830D5 /end MEASUREMENT
/begin MEASUREMENT fse33_02 "Filterwert Segmentabweichung, eingerechnet" UBYTE dtsegno_b11p25divZyl 1 100 -1.40625 1.39526 FORMAT "%5.3" ECU_ADDRESS 0x38304D /end MEASUREMENT
/begin MEASUREMENT fse33_03 "Filterwert Segmentabweichung, eingerechnet" UBYTE dtsegno_b11p25divZyl 1 100 -1.40625 1.39526 FORMAT "%5.3" ECU_ADDRESS 0x383065 /end MEASUREMENT
/begin MEASUREMENT fse33_04 "Filterwert Segmentabweichung, eingerechnet" UBYTE dtsegno_b11p25divZyl 1 100 -1.40625 1.39526 FORMAT "%5.3" ECU_ADDRESS 0x38307D /end MEASUREMENT
/begin MEASUREMENT fse33_05 "Filterwert Segmentabweichung, eingerechnet" UBYTE dtsegno_b11p25divZyl 1 100 -1.40625 1.39526 FORMAT "%5.3" ECU_ADDRESS 0x383095 /end MEASUREMENT
/begin MEASUREMENT fse33_06 "Filterwert Segmentabweichung, eingerechnet" UBYTE dtsegno_b11p25divZyl 1 100 -1.40625 1.39526 FORMAT "%5.3" ECU_ADDRESS 0x3830AD /end MEASUREMENT
/begin MEASUREMENT fse33_07 "Filterwert Segmentabweichung, eingerechnet" UBYTE dtsegno_b11p25divZyl 1 100 -1.40625 1.39526 FORMAT "%5.3" ECU_ADDRESS 0x3830C5 /end MEASUREMENT
/begin MEASUREMENT fse33_08 "Filterwert Segmentabweichung, eingerechnet" UBYTE dtsegno_b11p25divZyl 1 100 -1.40625 1.39526 FORMAT "%5.3" ECU_ADDRESS 0x3830DD /end MEASUREMENT
/begin MEASUREMENT fse41_02 "Filterwert Segmentabweichung, eingerechnet" UBYTE dtsegno_b11p25divZyl 1 100 -1.40625 1.39526 FORMAT "%5.3" ECU_ADDRESS 0x38303E /end MEASUREMENT
/begin MEASUREMENT fse41_03 "Filterwert Segmentabweichung, eingerechnet" UBYTE dtsegno_b11p25divZyl 1 100 -1.40625 1.39526 FORMAT "%5.3" ECU_ADDRESS 0x383056 /end MEASUREMENT
/begin MEASUREMENT fse41_04 "Filterwert Segmentabweichung, eingerechnet" UBYTE dtsegno_b11p25divZyl 1 100 -1.40625 1.39526 FORMAT "%5.3" ECU_ADDRESS 0x38306E /end MEASUREMENT
/begin MEASUREMENT fse41_05 "Filterwert Segmentabweichung, eingerechnet" UBYTE dtsegno_b11p25divZyl 1 100 -1.40625 1.39526 FORMAT "%5.3" ECU_ADDRESS 0x383086 /end MEASUREMENT
/begin MEASUREMENT fse41_06 "Filterwert Segmentabweichung, eingerechnet" UBYTE dtsegno_b11p25divZyl 1 100 -1.40625 1.39526 FORMAT "%5.3" ECU_ADDRESS 0x38309E /end MEASUREMENT
/begin MEASUREMENT fse41_07 "Filterwert Segmentabweichung, eingerechnet" UBYTE dtsegno_b11p25divZyl 1 100 -1.40625 1.39526 FORMAT "%5.3" ECU_ADDRESS 0x3830B6 /end MEASUREMENT
/begin MEASUREMENT fse41_08 "Filterwert Segmentabweichung, eingerechnet" UBYTE dtsegno_b11p25divZyl 1 100 -1.40625 1.39526 FORMAT "%5.3" ECU_ADDRESS 0x3830CE /end MEASUREMENT
/begin MEASUREMENT fse42_02 "Filterwert Segmentabweichung, eingerechnet" UBYTE dtsegno_b11p25divZyl 1 100 -1.40625 1.39526 FORMAT "%5.3" ECU_ADDRESS 0x383046 /end MEASUREMENT
/begin MEASUREMENT fse42_03 "Filterwert Segmentabweichung, eingerechnet" UBYTE dtsegno_b11p25divZyl 1 100 -1.40625 1.39526 FORMAT "%5.3" ECU_ADDRESS 0x38305E /end MEASUREMENT
/begin MEASUREMENT fse42_04 "Filterwert Segmentabweichung, eingerechnet" UBYTE dtsegno_b11p25divZyl 1 100 -1.40625 1.39526 FORMAT "%5.3" ECU_ADDRESS 0x383076 /end MEASUREMENT
/begin MEASUREMENT fse42_05 "Filterwert Segmentabweichung, eingerechnet" UBYTE dtsegno_b11p25divZyl 1 100 -1.40625 1.39526 FORMAT "%5.3" ECU_ADDRESS 0x38308E /end MEASUREMENT
/begin MEASUREMENT fse42_06 "Filterwert Segmentabweichung, eingerechnet" UBYTE dtsegno_b11p25divZyl 1 100 -1.40625 1.39526 FORMAT "%5.3" ECU_ADDRESS 0x3830A6 /end MEASUREMENT
/begin MEASUREMENT fse42_07 "Filterwert Segmentabweichung, eingerechnet" UBYTE dtsegno_b11p25divZyl 1 100 -1.40625 1.39526 FORMAT "%5.3" ECU_ADDRESS 0x3830BE /end MEASUREMENT
/begin MEASUREMENT fse42_08 "Filterwert Segmentabweichung, eingerechnet" UBYTE dtsegno_b11p25divZyl 1 100 -1.40625 1.39526 FORMAT "%5.3" ECU_ADDRESS 0x3830D6 /end MEASUREMENT
/begin MEASUREMENT fse43_02 "Filterwert Segmentabweichung, eingerechnet" UBYTE dtsegno_b11p25divZyl 1 100 -1.40625 1.39526 FORMAT "%5.3" ECU_ADDRESS 0x38304E /end MEASUREMENT
/begin MEASUREMENT fse43_03 "Filterwert Segmentabweichung, eingerechnet" UBYTE dtsegno_b11p25divZyl 1 100 -1.40625 1.39526 FORMAT "%5.3" ECU_ADDRESS 0x383066 /end MEASUREMENT
/begin MEASUREMENT fse43_04 "Filterwert Segmentabweichung, eingerechnet" UBYTE dtsegno_b11p25divZyl 1 100 -1.40625 1.39526 FORMAT "%5.3" ECU_ADDRESS 0x38307E /end MEASUREMENT
/begin MEASUREMENT fse43_05 "Filterwert Segmentabweichung, eingerechnet" UBYTE dtsegno_b11p25divZyl 1 100 -1.40625 1.39526 FORMAT "%5.3" ECU_ADDRESS 0x383096 /end MEASUREMENT
/begin MEASUREMENT fse43_06 "Filterwert Segmentabweichung, eingerechnet" UBYTE dtsegno_b11p25divZyl 1 100 -1.40625 1.39526 FORMAT "%5.3" ECU_ADDRESS 0x3830AE /end MEASUREMENT
/begin MEASUREMENT fse43_07 "Filterwert Segmentabweichung, eingerechnet" UBYTE dtsegno_b11p25divZyl 1 100 -1.40625 1.39526 FORMAT "%5.3" ECU_ADDRESS 0x3830C6 /end MEASUREMENT
/begin MEASUREMENT fse43_08 "Filterwert Segmentabweichung, eingerechnet" UBYTE dtsegno_b11p25divZyl 1 100 -1.40625 1.39526 FORMAT "%5.3" ECU_ADDRESS 0x3830DE /end MEASUREMENT
/begin MEASUREMENT fse51_02 "Filterwert Segmentabweichung, eingerechnet" UBYTE dtsegno_b11p25divZyl 1 100 -1.40625 1.39526 FORMAT "%5.3" ECU_ADDRESS 0x38303F /end MEASUREMENT
/begin MEASUREMENT fse51_03 "Filterwert Segmentabweichung, eingerechnet" UBYTE dtsegno_b11p25divZyl 1 100 -1.40625 1.39526 FORMAT "%5.3" ECU_ADDRESS 0x383057 /end MEASUREMENT
/begin MEASUREMENT fse51_04 "Filterwert Segmentabweichung, eingerechnet" UBYTE dtsegno_b11p25divZyl 1 100 -1.40625 1.39526 FORMAT "%5.3" ECU_ADDRESS 0x38306F /end MEASUREMENT
/begin MEASUREMENT fse51_05 "Filterwert Segmentabweichung, eingerechnet" UBYTE dtsegno_b11p25divZyl 1 100 -1.40625 1.39526 FORMAT "%5.3" ECU_ADDRESS 0x383087 /end MEASUREMENT
/begin MEASUREMENT fse51_06 "Filterwert Segmentabweichung, eingerechnet" UBYTE dtsegno_b11p25divZyl 1 100 -1.40625 1.39526 FORMAT "%5.3" ECU_ADDRESS 0x38309F /end MEASUREMENT
/begin MEASUREMENT fse51_07 "Filterwert Segmentabweichung, eingerechnet" UBYTE dtsegno_b11p25divZyl 1 100 -1.40625 1.39526 FORMAT "%5.3" ECU_ADDRESS 0x3830B7 /end MEASUREMENT
/begin MEASUREMENT fse51_08 "Filterwert Segmentabweichung, eingerechnet" UBYTE dtsegno_b11p25divZyl 1 100 -1.40625 1.39526 FORMAT "%5.3" ECU_ADDRESS 0x3830CF /end MEASUREMENT
/begin MEASUREMENT fse52_02 "Filterwert Segmentabweichung, eingerechnet" UBYTE dtsegno_b11p25divZyl 1 100 -1.40625 1.39526 FORMAT "%5.3" ECU_ADDRESS 0x383047 /end MEASUREMENT
/begin MEASUREMENT fse52_03 "Filterwert Segmentabweichung, eingerechnet" UBYTE dtsegno_b11p25divZyl 1 100 -1.40625 1.39526 FORMAT "%5.3" ECU_ADDRESS 0x38305F /end MEASUREMENT
/begin MEASUREMENT fse52_04 "Filterwert Segmentabweichung, eingerechnet" UBYTE dtsegno_b11p25divZyl 1 100 -1.40625 1.39526 FORMAT "%5.3" ECU_ADDRESS 0x383077 /end MEASUREMENT
/begin MEASUREMENT fse52_05 "Filterwert Segmentabweichung, eingerechnet" UBYTE dtsegno_b11p25divZyl 1 100 -1.40625 1.39526 FORMAT "%5.3" ECU_ADDRESS 0x38308F /end MEASUREMENT
/begin MEASUREMENT fse52_06 "Filterwert Segmentabweichung, eingerechnet" UBYTE dtsegno_b11p25divZyl 1 100 -1.40625 1.39526 FORMAT "%5.3" ECU_ADDRESS 0x3830A7 /end MEASUREMENT
/begin MEASUREMENT fse52_07 "Filterwert Segmentabweichung, eingerechnet" UBYTE dtsegno_b11p25divZyl 1 100 -1.40625 1.39526 FORMAT "%5.3" ECU_ADDRESS 0x3830BF /end MEASUREMENT
/begin MEASUREMENT fse52_08 "Filterwert Segmentabweichung, eingerechnet" UBYTE dtsegno_b11p25divZyl 1 100 -1.40625 1.39526 FORMAT "%5.3" ECU_ADDRESS 0x3830D7 /end MEASUREMENT
/begin MEASUREMENT fse53_02 "Filterwert Segmentabweichung, eingerechnet" UBYTE dtsegno_b11p25divZyl 1 100 -1.40625 1.39526 FORMAT "%5.3" ECU_ADDRESS 0x38304F /end MEASUREMENT
/begin MEASUREMENT fse53_03 "Filterwert Segmentabweichung, eingerechnet" UBYTE dtsegno_b11p25divZyl 1 100 -1.40625 1.39526 FORMAT "%5.3" ECU_ADDRESS 0x383067 /end MEASUREMENT
/begin MEASUREMENT fse53_04 "Filterwert Segmentabweichung, eingerechnet" UBYTE dtsegno_b11p25divZyl 1 100 -1.40625 1.39526 FORMAT "%5.3" ECU_ADDRESS 0x38307F /end MEASUREMENT
/begin MEASUREMENT fse53_05 "Filterwert Segmentabweichung, eingerechnet" UBYTE dtsegno_b11p25divZyl 1 100 -1.40625 1.39526 FORMAT "%5.3" ECU_ADDRESS 0x383097 /end MEASUREMENT
/begin MEASUREMENT fse53_06 "Filterwert Segmentabweichung, eingerechnet" UBYTE dtsegno_b11p25divZyl 1 100 -1.40625 1.39526 FORMAT "%5.3" ECU_ADDRESS 0x3830AF /end MEASUREMENT
/begin MEASUREMENT fse53_07 "Filterwert Segmentabweichung, eingerechnet" UBYTE dtsegno_b11p25divZyl 1 100 -1.40625 1.39526 FORMAT "%5.3" ECU_ADDRESS 0x3830C7 /end MEASUREMENT
/begin MEASUREMENT fse53_08 "Filterwert Segmentabweichung, eingerechnet" UBYTE dtsegno_b11p25divZyl 1 100 -1.40625 1.39526 FORMAT "%5.3" ECU_ADDRESS 0x3830DF /end MEASUREMENT
/begin MEASUREMENT fse61_02 "Filterwert Segmentabweichung, eingerechnet" UBYTE dtsegno_b11p25divZyl 1 100 -1.40625 1.39526 FORMAT "%5.3" ECU_ADDRESS 0x383040 /end MEASUREMENT
/begin MEASUREMENT fse61_03 "Filterwert Segmentabweichung, eingerechnet" UBYTE dtsegno_b11p25divZyl 1 100 -1.40625 1.39526 FORMAT "%5.3" ECU_ADDRESS 0x383058 /end MEASUREMENT
/begin MEASUREMENT fse61_04 "Filterwert Segmentabweichung, eingerechnet" UBYTE dtsegno_b11p25divZyl 1 100 -1.40625 1.39526 FORMAT "%5.3" ECU_ADDRESS 0x383070 /end MEASUREMENT
/begin MEASUREMENT fse61_05 "Filterwert Segmentabweichung, eingerechnet" UBYTE dtsegno_b11p25divZyl 1 100 -1.40625 1.39526 FORMAT "%5.3" ECU_ADDRESS 0x383088 /end MEASUREMENT
/begin MEASUREMENT fse61_06 "Filterwert Segmentabweichung, eingerechnet" UBYTE dtsegno_b11p25divZyl 1 100 -1.40625 1.39526 FORMAT "%5.3" ECU_ADDRESS 0x3830A0 /end MEASUREMENT
/begin MEASUREMENT fse61_07 "Filterwert Segmentabweichung, eingerechnet" UBYTE dtsegno_b11p25divZyl 1 100 -1.40625 1.39526 FORMAT "%5.3" ECU_ADDRESS 0x3830B8 /end MEASUREMENT
/begin MEASUREMENT fse61_08 "Filterwert Segmentabweichung, eingerechnet" UBYTE dtsegno_b11p25divZyl 1 100 -1.40625 1.39526 FORMAT "%5.3" ECU_ADDRESS 0x3830D0 /end MEASUREMENT
/begin MEASUREMENT fse62_02 "Filterwert Segmentabweichung, eingerechnet" UBYTE dtsegno_b11p25divZyl 1 100 -1.40625 1.39526 FORMAT "%5.3" ECU_ADDRESS 0x383048 /end MEASUREMENT
/begin MEASUREMENT fse62_03 "Filterwert Segmentabweichung, eingerechnet" UBYTE dtsegno_b11p25divZyl 1 100 -1.40625 1.39526 FORMAT "%5.3" ECU_ADDRESS 0x383060 /end MEASUREMENT
/begin MEASUREMENT fse62_04 "Filterwert Segmentabweichung, eingerechnet" UBYTE dtsegno_b11p25divZyl 1 100 -1.40625 1.39526 FORMAT "%5.3" ECU_ADDRESS 0x383078 /end MEASUREMENT
/begin MEASUREMENT fse62_05 "Filterwert Segmentabweichung, eingerechnet" UBYTE dtsegno_b11p25divZyl 1 100 -1.40625 1.39526 FORMAT "%5.3" ECU_ADDRESS 0x383090 /end MEASUREMENT
/begin MEASUREMENT fse62_06 "Filterwert Segmentabweichung, eingerechnet" UBYTE dtsegno_b11p25divZyl 1 100 -1.40625 1.39526 FORMAT "%5.3" ECU_ADDRESS 0x3830A8 /end MEASUREMENT
/begin MEASUREMENT fse62_07 "Filterwert Segmentabweichung, eingerechnet" UBYTE dtsegno_b11p25divZyl 1 100 -1.40625 1.39526 FORMAT "%5.3" ECU_ADDRESS 0x3830C0 /end MEASUREMENT
/begin MEASUREMENT fse62_08 "Filterwert Segmentabweichung, eingerechnet" UBYTE dtsegno_b11p25divZyl 1 100 -1.40625 1.39526 FORMAT "%5.3" ECU_ADDRESS 0x3830D8 /end MEASUREMENT
/begin MEASUREMENT fse63_02 "Filterwert Segmentabweichung, eingerechnet" UBYTE dtsegno_b11p25divZyl 1 100 -1.40625 1.39526 FORMAT "%5.3" ECU_ADDRESS 0x383050 /end MEASUREMENT
/begin MEASUREMENT fse63_03 "Filterwert Segmentabweichung, eingerechnet" UBYTE dtsegno_b11p25divZyl 1 100 -1.40625 1.39526 FORMAT "%5.3" ECU_ADDRESS 0x383068 /end MEASUREMENT
/begin MEASUREMENT fse63_04 "Filterwert Segmentabweichung, eingerechnet" UBYTE dtsegno_b11p25divZyl 1 100 -1.40625 1.39526 FORMAT "%5.3" ECU_ADDRESS 0x383080 /end MEASUREMENT
/begin MEASUREMENT fse63_05 "Filterwert Segmentabweichung, eingerechnet" UBYTE dtsegno_b11p25divZyl 1 100 -1.40625 1.39526 FORMAT "%5.3" ECU_ADDRESS 0x383098 /end MEASUREMENT
/begin MEASUREMENT fse63_06 "Filterwert Segmentabweichung, eingerechnet" UBYTE dtsegno_b11p25divZyl 1 100 -1.40625 1.39526 FORMAT "%5.3" ECU_ADDRESS 0x3830B0 /end MEASUREMENT
/begin MEASUREMENT fse63_07 "Filterwert Segmentabweichung, eingerechnet" UBYTE dtsegno_b11p25divZyl 1 100 -1.40625 1.39526 FORMAT "%5.3" ECU_ADDRESS 0x3830C8 /end MEASUREMENT
/begin MEASUREMENT fse63_08 "Filterwert Segmentabweichung, eingerechnet" UBYTE dtsegno_b11p25divZyl 1 100 -1.40625 1.39526 FORMAT "%5.3" ECU_ADDRESS 0x3830E0 /end MEASUREMENT
/begin MEASUREMENT fse71_02 "Filterwert Segmentabweichung, eingerechnet" UBYTE dtsegno_b11p25divZyl 1 100 -1.40625 1.39526 FORMAT "%5.3" ECU_ADDRESS 0x383041 /end MEASUREMENT
/begin MEASUREMENT fse71_03 "Filterwert Segmentabweichung, eingerechnet" UBYTE dtsegno_b11p25divZyl 1 100 -1.40625 1.39526 FORMAT "%5.3" ECU_ADDRESS 0x383059 /end MEASUREMENT
/begin MEASUREMENT fse71_04 "Filterwert Segmentabweichung, eingerechnet" UBYTE dtsegno_b11p25divZyl 1 100 -1.40625 1.39526 FORMAT "%5.3" ECU_ADDRESS 0x383071 /end MEASUREMENT
/begin MEASUREMENT fse71_05 "Filterwert Segmentabweichung, eingerechnet" UBYTE dtsegno_b11p25divZyl 1 100 -1.40625 1.39526 FORMAT "%5.3" ECU_ADDRESS 0x383089 /end MEASUREMENT
/begin MEASUREMENT fse71_06 "Filterwert Segmentabweichung, eingerechnet" UBYTE dtsegno_b11p25divZyl 1 100 -1.40625 1.39526 FORMAT "%5.3" ECU_ADDRESS 0x3830A1 /end MEASUREMENT
/begin MEASUREMENT fse71_07 "Filterwert Segmentabweichung, eingerechnet" UBYTE dtsegno_b11p25divZyl 1 100 -1.40625 1.39526 FORMAT "%5.3" ECU_ADDRESS 0x3830B9 /end MEASUREMENT
/begin MEASUREMENT fse71_08 "Filterwert Segmentabweichung, eingerechnet" UBYTE dtsegno_b11p25divZyl 1 100 -1.40625 1.39526 FORMAT "%5.3" ECU_ADDRESS 0x3830D1 /end MEASUREMENT
/begin MEASUREMENT fse72_02 "Filterwert Segmentabweichung, eingerechnet" UBYTE dtsegno_b11p25divZyl 1 100 -1.40625 1.39526 FORMAT "%5.3" ECU_ADDRESS 0x383049 /end MEASUREMENT
/begin MEASUREMENT fse72_03 "Filterwert Segmentabweichung, eingerechnet" UBYTE dtsegno_b11p25divZyl 1 100 -1.40625 1.39526 FORMAT "%5.3" ECU_ADDRESS 0x383061 /end MEASUREMENT
/begin MEASUREMENT fse72_04 "Filterwert Segmentabweichung, eingerechnet" UBYTE dtsegno_b11p25divZyl 1 100 -1.40625 1.39526 FORMAT "%5.3" ECU_ADDRESS 0x383079 /end MEASUREMENT
/begin MEASUREMENT fse72_05 "Filterwert Segmentabweichung, eingerechnet" UBYTE dtsegno_b11p25divZyl 1 100 -1.40625 1.39526 FORMAT "%5.3" ECU_ADDRESS 0x383091 /end MEASUREMENT
/begin MEASUREMENT fse72_06 "Filterwert Segmentabweichung, eingerechnet" UBYTE dtsegno_b11p25divZyl 1 100 -1.40625 1.39526 FORMAT "%5.3" ECU_ADDRESS 0x3830A9 /end MEASUREMENT
/begin MEASUREMENT fse72_07 "Filterwert Segmentabweichung, eingerechnet" UBYTE dtsegno_b11p25divZyl 1 100 -1.40625 1.39526 FORMAT "%5.3" ECU_ADDRESS 0x3830C1 /end MEASUREMENT
/begin MEASUREMENT fse72_08 "Filterwert Segmentabweichung, eingerechnet" UBYTE dtsegno_b11p25divZyl 1 100 -1.40625 1.39526 FORMAT "%5.3" ECU_ADDRESS 0x3830D9 /end MEASUREMENT
/begin MEASUREMENT fse73_02 "Filterwert Segmentabweichung, eingerechnet" UBYTE dtsegno_b11p25divZyl 1 100 -1.40625 1.39526 FORMAT "%5.3" ECU_ADDRESS 0x383051 /end MEASUREMENT
/begin MEASUREMENT fse73_03 "Filterwert Segmentabweichung, eingerechnet" UBYTE dtsegno_b11p25divZyl 1 100 -1.40625 1.39526 FORMAT "%5.3" ECU_ADDRESS 0x383069 /end MEASUREMENT
/begin MEASUREMENT fse73_04 "Filterwert Segmentabweichung, eingerechnet" UBYTE dtsegno_b11p25divZyl 1 100 -1.40625 1.39526 FORMAT "%5.3" ECU_ADDRESS 0x383081 /end MEASUREMENT
/begin MEASUREMENT fse73_05 "Filterwert Segmentabweichung, eingerechnet" UBYTE dtsegno_b11p25divZyl 1 100 -1.40625 1.39526 FORMAT "%5.3" ECU_ADDRESS 0x383099 /end MEASUREMENT
/begin MEASUREMENT fse73_06 "Filterwert Segmentabweichung, eingerechnet" UBYTE dtsegno_b11p25divZyl 1 100 -1.40625 1.39526 FORMAT "%5.3" ECU_ADDRESS 0x3830B1 /end MEASUREMENT
/begin MEASUREMENT fse73_07 "Filterwert Segmentabweichung, eingerechnet" UBYTE dtsegno_b11p25divZyl 1 100 -1.40625 1.39526 FORMAT "%5.3" ECU_ADDRESS 0x3830C9 /end MEASUREMENT
/begin MEASUREMENT fse73_08 "Filterwert Segmentabweichung, eingerechnet" UBYTE dtsegno_b11p25divZyl 1 100 -1.40625 1.39526 FORMAT "%5.3" ECU_ADDRESS 0x3830E1 /end MEASUREMENT
/begin MEASUREMENT fse81_02 "Filterwert Segmentabweichung, eingerechnet" UBYTE dtsegno_b11p25divZyl 1 100 -1.40625 1.39526 FORMAT "%5.3" ECU_ADDRESS 0x383042 /end MEASUREMENT
/begin MEASUREMENT fse81_03 "Filterwert Segmentabweichung, eingerechnet" UBYTE dtsegno_b11p25divZyl 1 100 -1.40625 1.39526 FORMAT "%5.3" ECU_ADDRESS 0x38305A /end MEASUREMENT
/begin MEASUREMENT fse81_04 "Filterwert Segmentabweichung, eingerechnet" UBYTE dtsegno_b11p25divZyl 1 100 -1.40625 1.39526 FORMAT "%5.3" ECU_ADDRESS 0x383072 /end MEASUREMENT
/begin MEASUREMENT fse81_05 "Filterwert Segmentabweichung, eingerechnet" UBYTE dtsegno_b11p25divZyl 1 100 -1.40625 1.39526 FORMAT "%5.3" ECU_ADDRESS 0x38308A /end MEASUREMENT
/begin MEASUREMENT fse81_06 "Filterwert Segmentabweichung, eingerechnet" UBYTE dtsegno_b11p25divZyl 1 100 -1.40625 1.39526 FORMAT "%5.3" ECU_ADDRESS 0x3830A2 /end MEASUREMENT
/begin MEASUREMENT fse81_07 "Filterwert Segmentabweichung, eingerechnet" UBYTE dtsegno_b11p25divZyl 1 100 -1.40625 1.39526 FORMAT "%5.3" ECU_ADDRESS 0x3830BA /end MEASUREMENT
/begin MEASUREMENT fse81_08 "Filterwert Segmentabweichung, eingerechnet" UBYTE dtsegno_b11p25divZyl 1 100 -1.40625 1.39526 FORMAT "%5.3" ECU_ADDRESS 0x3830D2 /end MEASUREMENT
/begin MEASUREMENT fse82_02 "Filterwert Segmentabweichung, eingerechnet" UBYTE dtsegno_b11p25divZyl 1 100 -1.40625 1.39526 FORMAT "%5.3" ECU_ADDRESS 0x38304A /end MEASUREMENT
/begin MEASUREMENT fse82_03 "Filterwert Segmentabweichung, eingerechnet" UBYTE dtsegno_b11p25divZyl 1 100 -1.40625 1.39526 FORMAT "%5.3" ECU_ADDRESS 0x383062 /end MEASUREMENT
/begin MEASUREMENT fse82_04 "Filterwert Segmentabweichung, eingerechnet" UBYTE dtsegno_b11p25divZyl 1 100 -1.40625 1.39526 FORMAT "%5.3" ECU_ADDRESS 0x38307A /end MEASUREMENT
/begin MEASUREMENT fse82_05 "Filterwert Segmentabweichung, eingerechnet" UBYTE dtsegno_b11p25divZyl 1 100 -1.40625 1.39526 FORMAT "%5.3" ECU_ADDRESS 0x383092 /end MEASUREMENT
/begin MEASUREMENT fse82_06 "Filterwert Segmentabweichung, eingerechnet" UBYTE dtsegno_b11p25divZyl 1 100 -1.40625 1.39526 FORMAT "%5.3" ECU_ADDRESS 0x3830AA /end MEASUREMENT
/begin MEASUREMENT fse82_07 "Filterwert Segmentabweichung, eingerechnet" UBYTE dtsegno_b11p25divZyl 1 100 -1.40625 1.39526 FORMAT "%5.3" ECU_ADDRESS 0x3830C2 /end MEASUREMENT
/begin MEASUREMENT fse82_08 "Filterwert Segmentabweichung, eingerechnet" UBYTE dtsegno_b11p25divZyl 1 100 -1.40625 1.39526 FORMAT "%5.3" ECU_ADDRESS 0x3830DA /end MEASUREMENT
/begin MEASUREMENT fse83_02 "Filterwert Segmentabweichung, eingerechnet" UBYTE dtsegno_b11p25divZyl 1 100 -1.40625 1.39526 FORMAT "%5.3" ECU_ADDRESS 0x383052 /end MEASUREMENT
/begin MEASUREMENT fse83_03 "Filterwert Segmentabweichung, eingerechnet" UBYTE dtsegno_b11p25divZyl 1 100 -1.40625 1.39526 FORMAT "%5.3" ECU_ADDRESS 0x38306A /end MEASUREMENT
/begin MEASUREMENT fse83_04 "Filterwert Segmentabweichung, eingerechnet" UBYTE dtsegno_b11p25divZyl 1 100 -1.40625 1.39526 FORMAT "%5.3" ECU_ADDRESS 0x383082 /end MEASUREMENT
/begin MEASUREMENT fse83_05 "Filterwert Segmentabweichung, eingerechnet" UBYTE dtsegno_b11p25divZyl 1 100 -1.40625 1.39526 FORMAT "%5.3" ECU_ADDRESS 0x38309A /end MEASUREMENT
/begin MEASUREMENT fse83_06 "Filterwert Segmentabweichung, eingerechnet" UBYTE dtsegno_b11p25divZyl 1 100 -1.40625 1.39526 FORMAT "%5.3" ECU_ADDRESS 0x3830B2 /end MEASUREMENT
/begin MEASUREMENT fse83_07 "Filterwert Segmentabweichung, eingerechnet" UBYTE dtsegno_b11p25divZyl 1 100 -1.40625 1.39526 FORMAT "%5.3" ECU_ADDRESS 0x3830CA /end MEASUREMENT
/begin MEASUREMENT fse83_08 "Filterwert Segmentabweichung, eingerechnet" UBYTE dtsegno_b11p25divZyl 1 100 -1.40625 1.39526 FORMAT "%5.3" ECU_ADDRESS 0x3830E2 /end MEASUREMENT
/begin MEASUREMENT idxfo "Index: Kennzeichnet den aktuellen KF-Bereich" UWORD dez 1 100 0 65535 FORMAT "%8.2" ECU_ADDRESS 0x381AD0 /end MEASUREMENT
/begin MEASUREMENT idxfob "Index: Kennzeichnet den aktuellen KF-Bereich (Drehz., Last)" UBYTE dez 1 100 0 255 FORMAT "%5.1" ECU_ADDRESS 0x380BB3 /end MEASUREMENT
/begin MEASUREMENT idxfon "Drehzahlindex für Betriebsbereich der fuel-on Adaption" UBYTE dez 1 100 0 255 FORMAT "%5.1" ECU_ADDRESS 0x381AD0 /end MEASUREMENT
/begin MEASUREMENT idxforl "Lastindex für Betriebsbereich der fuel-on Adaption" UBYTE dez 1 100 0 255 FORMAT "%5.1" ECU_ADDRESS 0x381AD1 /end MEASUREMENT
/begin MEASUREMENT luar "Laufunruhe-Abstandsmass-Referenzwert" SBYTE luquant 1 100 -90.9495 90.2389 FORMAT "%5.2" ECU_ADDRESS 0x380BA3 /end MEASUREMENT
/begin MEASUREMENT luarmn "Laufunruhe-Abstandsmass-Referenzwert Minimun" SBYTE luquant 1 100 -90.9495 90.2389 FORMAT "%5.2" ECU_ADDRESS 0x380BA4 /end MEASUREMENT
/begin MEASUREMENT luaroff "Laufunruhe-Abstandsmass-Referenzwert offset" UBYTE luquant 1 100 0 181.188 FORMAT "%5.1" ECU_ADDRESS 0x380BA5 /end MEASUREMENT
/begin MEASUREMENT luar_m "Monitor, Laufunruhe-Abstandsmaß-Referenzwert, verzögerte Ausgabe" SBYTE luquant 1 100 -90.9495 90.2389 FORMAT "%5.2" ECU_ADDRESS 0xE517 /end MEASUREMENT
/begin MEASUREMENT lums "Laufunruhe-Mittelwert für Erkennung Mehrfachaussetzer, signed" SBYTE luquant 1 100 -90.9495 90.2389 FORMAT "%5.2" ECU_ADDRESS 0xE3F3 /end MEASUREMENT
/begin MEASUREMENT lums_m "Monitor, Laufunruhe-Mittelwert für Erkennung Mehrfachaussetzer, signed" SBYTE luquant 1 100 -90.9495 90.2389 FORMAT "%5.2" ECU_ADDRESS 0xE3EB /end MEASUREMENT
/begin MEASUREMENT lunw "Laufunruhe über 1 NW-Umdr." UBYTE luquant 1 100 0 181.188 FORMAT "%5.1" ECU_ADDRESS 0x380BAD /end MEASUREMENT
/begin MEASUREMENT lurms "Laufunruhe-Referenzwert für Mehrfachaussetzererkennung, -> Vgl. mit Lum, signed" SBYTE luquant 1 100 -90.9495 90.2389 FORMAT "%5.2" ECU_ADDRESS 0x380BA9 /end MEASUREMENT
/begin MEASUREMENT lurms_m "Monitor, Laufunruhe-Referenzwert für Mehrfachaussetzererkenng, signed" SBYTE luquant 1 100 -90.9495 90.2389 FORMAT "%5.2" ECU_ADDRESS 0xE3EA /end MEASUREMENT
/begin MEASUREMENT lurs "Laufunruhe-Referenzwert, signed" SBYTE luquant 1 100 -90.9495 90.2389 FORMAT "%5.2" ECU_ADDRESS 0x380B79 /end MEASUREMENT
/begin MEASUREMENT lursktm "tmot-abhängiger offset zum Laufunruhe-Referenzwert dlurs, signed" SBYTE luquant 1 100 -90.9495 90.2389 FORMAT "%5.2" ECU_ADDRESS 0x380BB4 /end MEASUREMENT
/begin MEASUREMENT lurs_m "Monitor Laufunruhe-Referenzwert, signed" SBYTE luquant 1 100 -90.9495 90.2389 FORMAT "%5.2" ECU_ADDRESS 0xE3E8 /end MEASUREMENT
/begin MEASUREMENT lurs_min "Wert von LUR falls Adaption nicht abgeschlossen, Wert aus LURMIN*" UBYTE luquant 1 100 0 181.188 FORMAT "%5.1" ECU_ADDRESS 0x380B7A /end MEASUREMENT
/begin MEASUREMENT luts "Laufunruhe-Testgröße, signed" SBYTE luquant 1 100 -90.9495 90.2389 FORMAT "%5.2" ECU_ADDRESS 0xE51D /end MEASUREMENT
/begin MEASUREMENT luts1 "Laufunruhe-Testgröße von Zylinder 1 bzw. Zündung 1, signed" SBYTE luquant 1 100 -90.9495 90.2389 FORMAT "%5.2" ECU_ADDRESS 0x380B7F /end MEASUREMENT
/begin MEASUREMENT luts2 "Laufunruhe-Testgröße von Zylinder 2 bzw. Zündung 2, signed" SBYTE luquant 1 100 -90.9495 90.2389 FORMAT "%5.2" ECU_ADDRESS 0x380B80 /end MEASUREMENT
/begin MEASUREMENT luts3 "Laufunruhe-Testgröße von Zylinder 3 bzw. Zündung 3, signed" SBYTE luquant 1 100 -90.9495 90.2389 FORMAT "%5.2" ECU_ADDRESS 0x380B81 /end MEASUREMENT
/begin MEASUREMENT luts4 "Laufunruhe-Testgröße von Zylinder 4 bzw. Zündung 4, signed" SBYTE luquant 1 100 -90.9495 90.2389 FORMAT "%5.2" ECU_ADDRESS 0x380B82 /end MEASUREMENT
/begin MEASUREMENT luts5 "Laufunruhe-Testgröße von Zylinder 5 bzw. Zündung 5, signed" SBYTE luquant 1 100 -90.9495 90.2389 FORMAT "%5.2" ECU_ADDRESS 0x380B83 /end MEASUREMENT
/begin MEASUREMENT luts6 "Laufunruhe-Testgröße von Zylinder 6 bzw. Zündung 6, signed" SBYTE luquant 1 100 -90.9495 90.2389 FORMAT "%5.2" ECU_ADDRESS 0x380B84 /end MEASUREMENT
/begin MEASUREMENT luts7 "Laufunruhe-Testgröße von Zylinder 7 bzw. Zündung 7, signed" SBYTE luquant 1 100 -90.9495 90.2389 FORMAT "%5.2" ECU_ADDRESS 0x380B85 /end MEASUREMENT
/begin MEASUREMENT luts8 "Laufunruhe-Testgröße von Zylinder 8 bzw. Zündung 8, signed" SBYTE luquant 1 100 -90.9495 90.2389 FORMAT "%5.2" ECU_ADDRESS 0x380B86 /end MEASUREMENT
/begin MEASUREMENT lutsfi1 "gefilterte Laufunruhe-Testgröße von Zylinder 1, signed" SWORD luquant_w 1 100 -90.9495 90.9467 FORMAT "%8.5" ECU_ADDRESS 0x380FAC /end MEASUREMENT
/begin MEASUREMENT lutsfi2 "gefilterte Laufunruhe-Testgröße von Zylinder 2, signed" SWORD luquant_w 1 100 -90.9495 90.9467 FORMAT "%8.5" ECU_ADDRESS 0x380FAE /end MEASUREMENT
/begin MEASUREMENT lutsfi3 "gefilterte Laufunruhe-Testgröße von Zylinder 3, signed" SWORD luquant_w 1 100 -90.9495 90.9467 FORMAT "%8.5" ECU_ADDRESS 0x380FB0 /end MEASUREMENT
/begin MEASUREMENT lutsfi4 "gefilterte Laufunruhe-Testgröße von Zylinder 4, signed" SWORD luquant_w 1 100 -90.9495 90.9467 FORMAT "%8.5" ECU_ADDRESS 0x380FB2 /end MEASUREMENT
/begin MEASUREMENT lutsfi5 "gefilterte Laufunruhe-Testgröße von Zylinder 5, signed" SWORD luquant_w 1 100 -90.9495 90.9467 FORMAT "%8.5" ECU_ADDRESS 0x380FB4 /end MEASUREMENT
/begin MEASUREMENT lutsfi6 "gefilterte Laufunruhe-Testgröße von Zylinder 6, signed" SWORD luquant_w 1 100 -90.9495 90.9467 FORMAT "%8.5" ECU_ADDRESS 0x380FB6 /end MEASUREMENT
/begin MEASUREMENT lutsfi7 "gefilterte Laufunruhe-Testgröße von Zylinder 7, signed" SWORD luquant_w 1 100 -90.9495 90.9467 FORMAT "%8.5" ECU_ADDRESS 0x380FB8 /end MEASUREMENT
/begin MEASUREMENT lutsfi8 "gefilterte Laufunruhe-Testgröße von Zylinder 8, signed" SWORD luquant_w 1 100 -90.9495 90.9467 FORMAT "%8.5" ECU_ADDRESS 0x380FBA /end MEASUREMENT
/begin MEASUREMENT luts_m "Monitor Laufunruhe-Testgröße, signed" SBYTE luquant 1 100 -90.9495 90.2389 FORMAT "%5.2" ECU_ADDRESS 0xE3E7 /end MEASUREMENT
/begin MEASUREMENT mdzzyl "Zylinderzähler für Filterung Laufunruhewerte" UBYTE dez 1 100 0 255 FORMAT "%5.1" ECU_ADDRESS 0x380A15 /end MEASUREMENT
/begin MEASUREMENT rl_m "Monitor, relative Luftfüllung" UBYTE rel_ub_q0p75 1 100 0 191.25 FORMAT "%5.1" ECU_ADDRESS 0xE3E9 /end MEASUREMENT
/begin MEASUREMENT slfoo "" SWORD dtsegn_b720divZyl 1 100 -90 89.9973 FORMAT "%8.5" ECU_ADDRESS 0x381B28 /end MEASUREMENT
/begin MEASUREMENT ts01 "Segmentdauer Zylinder 1" UWORD tsquant 1 100 0 52428 FORMAT "%8.2" ECU_ADDRESS 0x381AA8 /end MEASUREMENT
/begin MEASUREMENT ts02 "Segmentdauer Zylinder 2" UWORD tsquant 1 100 0 52428 FORMAT "%8.2" ECU_ADDRESS 0x381AAA /end MEASUREMENT
/begin MEASUREMENT ts03 "Segmentdauer Zylinder 3" UWORD tsquant 1 100 0 52428 FORMAT "%8.2" ECU_ADDRESS 0x381AAC /end MEASUREMENT
/begin MEASUREMENT ts04 "Segmentdauer Zylinder 4" UWORD tsquant 1 100 0 52428 FORMAT "%8.2" ECU_ADDRESS 0x381AAE /end MEASUREMENT
/begin MEASUREMENT ts05 "Segmentdauer Zylinder 5" UWORD tsquant 1 100 0 52428 FORMAT "%8.2" ECU_ADDRESS 0x381AB0 /end MEASUREMENT
/begin MEASUREMENT ts06 "Segmentdauer Zylinder 6" UWORD tsquant 1 100 0 52428 FORMAT "%8.2" ECU_ADDRESS 0x381AB2 /end MEASUREMENT
/begin MEASUREMENT ts07 "Segmentdauer Zylinder 7" UWORD tsquant 1 100 0 52428 FORMAT "%8.2" ECU_ADDRESS 0x381AB4 /end MEASUREMENT
/begin MEASUREMENT ts08 "Segmentdauer Zylinder 8" UWORD tsquant 1 100 0 52428 FORMAT "%8.2" ECU_ADDRESS 0x381AB6 /end MEASUREMENT
/begin MEASUREMENT tsk_m "Monitor korrigierte Segmentdauer" UWORD tsquant 1 100 0 52428 FORMAT "%8.2" ECU_ADDRESS 0xE3EC /end MEASUREMENT
/begin MEASUREMENT ts_m "Monitor Segmentdauer" UWORD tsquant 1 100 0 52428 FORMAT "%8.2" ECU_ADDRESS 0xE3E4 /end MEASUREMENT
/begin MEASUREMENT usrvk "Regelschwelle für Regelung vor Kat" UBYTE spg_ub_q0p0052_o0p2 1 100 -0.2 1.13 FORMAT "%5.3" ECU_ADDRESS 0x380C3A /end MEASUREMENT
/begin MEASUREMENT usrvk2 "Regelschwelle für Regelung vor Kat, Bank 2" UBYTE spg_ub_q0p0052_o0p2 1 100 -0.2 1.13 FORMAT "%5.3" ECU_ADDRESS 0x380C3B /end MEASUREMENT
/begin MEASUREMENT xs02 "Segmentabweichung, normiert" UWORD dtsegn_b720divZyl 1 100 0 179.997 FORMAT "%8.4" ECU_ADDRESS 0x381B18 /end MEASUREMENT
/begin MEASUREMENT xs03 "Segmentabweichung, normiert" UWORD dtsegn_b720divZyl 1 100 0 179.997 FORMAT "%8.4" ECU_ADDRESS 0x381B1A /end MEASUREMENT
/begin MEASUREMENT xs04 "Segmentabweichung, normiert" UWORD dtsegn_b720divZyl 1 100 0 179.997 FORMAT "%8.4" ECU_ADDRESS 0x381B1C /end MEASUREMENT
/begin MEASUREMENT xs05 "Segmentabweichung, normiert" UWORD dtsegn_b720divZyl 1 100 0 179.997 FORMAT "%8.4" ECU_ADDRESS 0x381B1E /end MEASUREMENT
/begin MEASUREMENT xs06 "Segmentabweichung, normiert" UWORD dtsegn_b720divZyl 1 100 0 179.997 FORMAT "%8.4" ECU_ADDRESS 0x381B20 /end MEASUREMENT
/begin MEASUREMENT xs07 "Segmentabweichung, normiert" UWORD dtsegn_b720divZyl 1 100 0 179.997 FORMAT "%8.4" ECU_ADDRESS 0x381B22 /end MEASUREMENT
/begin MEASUREMENT xs08 "Segmentabweichung, normiert" UWORD dtsegn_b720divZyl 1 100 0 179.997 FORMAT "%8.4" ECU_ADDRESS 0x381B24 /end MEASUREMENT
/begin MEASUREMENT zwgeflr "Zählerwert Gemischfehler" UBYTE dez 1 100 0 255 FORMAT "%5.1" ECU_ADDRESS 0x38310A /end MEASUREMENT
/begin MEASUREMENT zwgeflr2 "Zählerwert Gemischfehler Bank 2" UBYTE dez 1 100 0 255 FORMAT "%5.1" ECU_ADDRESS 0x38310B /end MEASUREMENT
/begin FUNCTION DLSV "Diagnose; Sondenbetriebsbereitschaft vor Kat"
 /begin DEF_CHARACTERISTIC ABGMSIGV ANZGEM CWDLSV DRISIGV LACSDOFF RISIGRESV TMNEB TMSV TMSVA TNSTDN TRSA TSTOI TUSDU TUSDUC TUSEINV TUSFETT TVCSD TVSIG TVSIGMX TVTCSD USDBO USDBU USFHK USMHK USR USRCSD USREF USREFCSD USREFV USREM USREMV /end DEF_CHARACTERISTIC
 /begin REF_CHARACTERISTIC TABGMCSD TASIG TRSE TTBMH TUSKS TUSMAX UBDLS USMAX USMIN /end REF_CHARACTERISTIC
 /begin IN_MEASUREMENT B_atmtpa B_atmtpa2 B_cdlsh B_cdlsv B_dsls B_dtes B_esls B_frmax B_frmax2 B_frmin B_frmin2 B_hsve B_hsve2 B_lowra B_lr B_lr2 B_nmot B_pwf B_sls B_st cd_bits1_w fra2_w fra_w lamsons2_w lamsons_w rinv2_w rinv_w tabgm tabgm2 tmot tmotab ub ushk2_w ushk_w usvk2_w usvk_w /end IN_MEASUREMENT
 /begin OUT_MEASUREMENT B_dsven B_dsven2 B_frdlsv B_frdlsv2 B_sbbvk B_sbbvk2 B_ttbmh B_ttbmh2 B_vsigf B_vsigf2 frdlsv2_w frdlsv_w usrvk usrvk2 zwgeflr zwgeflr2 /end OUT_MEASUREMENT
 /begin LOC_MEASUREMENT B_adcsd B_adcsd2 B_adde B_adde2 B_adsvb B_adsvb2 B_lsads B_lsads2 B_lsfet B_lsfet2 B_lshub B_lshub2 B_lsvklt B_lsvklt2 B_lsvn B_lsvn2 B_maxflsv B_maxflsv2 B_nolsv B_nolsv2 B_nplflsv B_nplflsv2 B_refmax B_refmax2 B_risigv B_risigv2 B_sigflsv B_sigflsv2 B_trsa B_trsa2 B_ueinv B_ueinv2 B_uvsig B_uvsig2 B_vadge B_vadge2 B_vcsd B_vcsd2 B_vgeflr B_vgeflr2 DLSVerrors DLSVintbits /end LOC_MEASUREMENT
 /begin SUB_FUNCTION /end SUB_FUNCTION
/end FUNCTION
/begin FUNCTION DLSVV "Diagnose; Erkennung vertauschte Lambda-Sonden vor Kat" /begin DEF_CHARACTERISTIC CDLSVV FRDO FRDU TDLSVV TDWLSVV /end DEF_CHARACTERISTIC /begin REF_CHARACTERISTIC /end REF_CHARACTERISTIC /begin IN_MEASUREMENT B_enws B_lr B_lr2 fr2_w fr_w /end IN_MEASUREMENT /begin OUT_MEASUREMENT B_lsvvsp /end OUT_MEASUREMENT /begin LOC_MEASUREMENT /end LOC_MEASUREMENT /begin SUB_FUNCTION /end SUB_FUNCTION /end FUNCTION
/begin FUNCTION DMDDLU "Diagnose Misfire Detection Differenzbildung der Laufunruhe" /begin DEF_CHARACTERISTIC DLURMIN DMXRDL KFDLUR KFDLUR1 KFDLUR2 KFDLURZ NMIDLU /end DEF_CHARACTERISTIC /begin REF_CHARACTERISTIC SNM08DMUB SRL08DMUB /end REF_CHARACTERISTIC /begin IN_MEASUREMENT esst_snm08dmub esst_srl08dmub nmot rl /end IN_MEASUREMENT /begin OUT_MEASUREMENT B_dluerk_m dlurs_m dluts_m fdmd_m flg_m /end OUT_MEASUREMENT
 /begin LOC_MEASUREMENT dlurs dluts dluts1 dluts2 dluts3 dluts4 dluts5 dluts6 dluts7 dluts8 /end LOC_MEASUREMENT
 /begin SUB_FUNCTION /end SUB_FUNCTION
/end FUNCTION
/begin FUNCTION DMDFLU "Diagnose Misfire Detection Filterung der Laufunruhe" /begin DEF_CHARACTERISTIC ZLUTSFI /end DEF_CHARACTERISTIC /begin REF_CHARACTERISTIC /end REF_CHARACTERISTIC /begin IN_MEASUREMENT B_ll B_mdzyl1_m B_pwf luts_m /end IN_MEASUREMENT
 /begin OUT_MEASUREMENT lutsfi1 lutsfi2 lutsfi3 lutsfi4 lutsfi5 lutsfi6 lutsfi7 lutsfi8 /end OUT_MEASUREMENT
 /begin LOC_MEASUREMENT mdzzyl /end LOC_MEASUREMENT
 /begin SUB_FUNCTION /end SUB_FUNCTION
/end FUNCTION
/begin FUNCTION DMDFONA "" /begin DEF_CHARACTERISTIC /end DEF_CHARACTERISTIC /begin REF_CHARACTERISTIC /end REF_CHARACTERISTIC /begin IN_MEASUREMENT /end IN_MEASUREMENT /begin OUT_MEASUREMENT /end OUT_MEASUREMENT
 /begin LOC_MEASUREMENT anwfoh anwfos B_dmd_reset B_fodo B_fodon B_fof_m B_fohe B_fohold B_fontm B_fon_m B_for11 B_for12 B_for13 B_for21 B_for22 B_for23 B_for31 B_for32 B_for33 B_for41 B_for42 B_for43 B_for51 B_for52 B_for53 B_for61 B_for62 B_for63 B_for71 B_for72 B_for73 B_for81 B_for82 B_for83 B_forn01 B_forn02 B_forn03 B_forn04 B_forn05 B_forn06 B_forn07 B_forn08 B_forn_m B_forset B_forun B_fos B_foxfg B_plok B_plok01 B_plok02 B_plok03 B_plok04 B_plok05 B_plok06 B_plok07 B_plok08 B_plokn_m cfoxx dfse01 dfse02 dfse03 dfse04 dfse05 dfse06 dfse07 dfse08 dfsen ffon ffonn1 ffonn2 ffonn3 fforn1 ffpl1 flmx fln11_02 fln11_03 fln11_04 fln11_05 fln11_06 fln11_07 fln11_08 fln12_02 fln12_03 fln12_04 fln12_05 fln12_06 fln12_07 fln12_08 fln13_02 fln13_03 fln13_04 fln13_05 fln13_06 fln13_07 fln13_08 fln21_02 fln21_03 fln21_04 fln21_05 fln21_06 fln21_07 fln21_08 fln22_02 fln22_03 fln22_04 fln22_05 fln22_06 fln22_07 fln22_08 fln23_02 fln23_03 fln23_04 fln23_05 fln23_06 fln23_07 fln23_08 fln31_02 fln31_03 fln31_04 fln31_05 fln31_06 fln31_07 fln31_08 fln32_02 fln32_03 fln32_04 fln32_05 fln32_06 fln32_07 fln32_08 fln33_02 fln33_03 fln33_04 fln33_05 fln33_06 fln33_07 fln33_08 fln41_02 fln41_03 fln41_04 fln41_05 fln41_06 fln41_07 fln41_08 fln42_02 fln42_03 fln42_04 fln42_05 fln42_06 fln42_07 fln42_08 fln43_02 fln43_03 fln43_04 fln43_05 fln43_06 fln43_07 fln43_08 fln51_02 fln51_03 fln51_04 fln51_05 fln51_06 fln51_07 fln51_08 fln52_02 fln52_03 fln52_04 fln52_05 fln52_06 fln52_07 fln52_08 fln53_02 fln53_03 fln53_04 fln53_05 fln53_06 fln53_07 fln53_08 fln61_02 fln61_03 fln61_04 fln61_05 fln61_06 fln61_07 fln61_08 fln62_02 fln62_03 fln62_04 fln62_05 fln62_06 fln62_07 fln62_08 fln63_02 fln63_03 fln63_04 fln63_05 fln63_06 fln63_07 fln63_08 fln71_02 fln71_03 fln71_04 fln71_05 fln71_06 fln71_07 fln71_08 fln72_02 fln72_03 fln72_04 fln72_05 fln72_06 fln72_07 fln72_08 fln73_02 fln73_03 fln73_04 fln73_05 fln73_06 fln73_07 fln73_08 fln81_02 fln81_03 fln81_04 fln81_05 fln81_06 fln81_07 fln81_08 fln82_02 fln82_03 fln82_04 fln82_05 fln82_06 fln82_07 fln82_08 fln83_02 fln83_03 fln83_04 fln83_05 fln83_06 fln83_07 fln83_08 flp11_02 flp11_03 flp11_04 flp11_05 flp11_06 flp11_07 flp11_08 flp12_02 flp12_03 flp12_04 flp12_05 flp12_06 flp12_07 flp12_08 flp13_02 flp13_03 flp13_04 flp13_05 flp13_06 flp13_07 flp13_08 flp21_02 flp21_03 flp21_04 flp21_05 flp21_06 flp21_07 flp21_08 flp22_02 flp22_03 flp22_04 flp22_05 flp22_06 flp22_07 flp22_08 flp23_02 flp23_03 flp23_04 flp23_05 flp23_06 flp23_07 flp23_08 flp31_02 flp31_03 flp31_04 flp31_05 flp31_06 flp31_07 flp31_08 flp32_02 flp32_03 flp32_04 flp32_05 flp32_06 flp32_07 flp32_08 flp33_02 flp33_03 flp33_04 flp33_05 flp33_06 flp33_07 flp33_08 flp41_02 flp41_03 flp41_04 flp41_05 flp41_06 flp41_07 flp41_08 flp42_02 flp42_03 flp42_04 flp42_05 flp42_06 flp42_07 flp42_08 flp43_02 flp43_03 flp43_04 flp43_05 flp43_06 flp43_07 flp43_08 flp51_02 flp51_03 flp51_04 flp51_05 flp51_06 flp51_07 flp51_08 flp52_02 flp52_03 flp52_04 flp52_05 flp52_06 flp52_07 flp52_08 flp53_02 flp53_03 flp53_04 flp53_05 flp53_06 flp53_07 flp53_08 flp61_02 flp61_03 flp61_04 flp61_05 flp61_06 flp61_07 flp61_08 flp62_02 flp62_03 flp62_04 flp62_05 flp62_06 flp62_07 flp62_08 flp63_02 flp63_03 flp63_04 flp63_05 flp63_06 flp63_07 flp63_08 flp71_02 flp71_03 flp71_04 flp71_05 flp71_06 flp71_07 flp71_08 flp72_02 flp72_03 flp72_04 flp72_05 flp72_06 flp72_07 flp72_08 flp73_02 flp73_03 flp73_04 flp73_05 flp73_06 flp73_07 flp73_08 flp81_02 flp81_03 flp81_04 flp81_05 flp81_06 flp81_07 flp81_08 flp82_02 flp82_03 flp82_04 flp82_05 flp82_06 flp82_07 flp82_08 flp83_02 flp83_03 flp83_04 flp83_05 flp83_06 flp83_07 flp83_08 /end LOC_MEASUREMENT
 /begin SUB_FUNCTION /end SUB_FUNCTION
/end FUNCTION
/begin FUNCTION DMDFONB ""
 /begin DEF_CHARACTERISTIC ALFO ANWFOHE ANWFOST CDFO DFSEFO2N DFSEFON DFSERES FLFO FS1FO FS2FO KFCFO KFCFO2 LURFOST MDERKFON SDZ03DMUB SDZ03DMUB2 SDZ08DMUB SDZ08DMUB2 SFONTM SLFOO2N SLFOON SLFOU ZASMASK /end DEF_CHARACTERISTIC
 /begin REF_CHARACTERISTIC /end REF_CHARACTERISTIC
 /begin IN_MEASUREMENT B_autget nmot rl /end IN_MEASUREMENT
 /begin OUT_MEASUREMENT /end OUT_MEASUREMENT
 /begin LOC_MEASUREMENT B_fordo_m B_for_m B_tsroov_m dfseresz esst_sdz03dmub esst_sdz08dmub flmxresz fostat fostat_m fs11_02 fs11_03 fs11_04 fs11_05 fs11_06 fs11_07 fs11_08 fs12_02 fs12_03 fs12_04 fs12_05 fs12_06 fs12_07 fs12_08 fs13_02 fs13_03 fs13_04 fs13_05 fs13_06 fs13_07 fs13_08 fs21_02 fs21_03 fs21_04 fs21_05 fs21_06 fs21_07 fs21_08 fs22_02 fs22_03 fs22_04 fs22_05 fs22_06 fs22_07 fs22_08 fs23_02 fs23_03 fs23_04 fs23_05 fs23_06 fs23_07 fs23_08 fs31_02 fs31_03 fs31_04 fs31_05 fs31_06 fs31_07 fs31_08 fs32_02 fs32_03 fs32_04 fs32_05 fs32_06 fs32_07 fs32_08 fs33_02 fs33_03 fs33_04 fs33_05 fs33_06 fs33_07 fs33_08 fs41_02 fs41_03 fs41_04 fs41_05 fs41_06 fs41_07 fs41_08 fs42_02 fs42_03 fs42_04 fs42_05 fs42_06 fs42_07 fs42_08 fs43_02 fs43_03 fs43_04 fs43_05 fs43_06 fs43_07 fs43_08 fs51_02 fs51_03 fs51_04 fs51_05 fs51_06 fs51_07 fs51_08 fs52_02 fs52_03 fs52_04 fs52_05 fs52_06 fs52_07 fs52_08 fs53_02 fs53_03 fs53_04 fs53_05 fs53_06 fs53_07 fs53_08 fs61_02 fs61_03 fs61_04 fs61_05 fs61_06 fs61_07 fs61_08 fs62_02 fs62_03 fs62_04 fs62_05 fs62_06 fs62_07 fs62_08 fs63_02 fs63_03 fs63_04 fs63_05 fs63_06 fs63_07 fs63_08 fs71_02 fs71_03 fs71_04 fs71_05 fs71_06 fs71_07 fs71_08 fs72_02 fs72_03 fs72_04 fs72_05 fs72_06 fs72_07 fs72_08 fs73_02 fs73_03 fs73_04 fs73_05 fs73_06 fs73_07 fs73_08 fs81_02 fs81_03 fs81_04 fs81_05 fs81_06 fs81_07 fs81_08 fs82_02 fs82_03 fs82_04 fs82_05 fs82_06 fs82_07 fs82_08 fs83_02 fs83_03 fs83_04 fs83_05 fs83_06 fs83_07 fs83_08 fse fse11_02 fse11_03 fse11_04 fse11_05 fse11_06 fse11_07 fse11_08 fse12_02 fse12_03 fse12_04 fse12_05 fse12_06 fse12_07 fse12_08 fse13_02 fse13_03 fse13_04 fse13_05 fse13_06 fse13_07 fse13_08 fse21_02 fse21_03 fse21_04 fse21_05 fse21_06 fse21_07 fse21_08 fse22_02 fse22_03 fse22_04 fse22_05 fse22_06 fse22_07 fse22_08 fse23_02 fse23_03 fse23_04 fse23_05 fse23_06 fse23_07 fse23_08 fse31_02 fse31_03 fse31_04 fse31_05 fse31_06 fse31_07 fse31_08 fse32_02 fse32_03 fse32_04 fse32_05 fse32_06 fse32_07 fse32_08 fse33_02 fse33_03 fse33_04 fse33_05 fse33_06 fse33_07 fse33_08 fse41_02 fse41_03 fse41_04 fse41_05 fse41_06 fse41_07 fse41_08 fse42_02 fse42_03 fse42_04 fse42_05 fse42_06 fse42_07 fse42_08 fse43_02 fse43_03 fse43_04 fse43_05 fse43_06 fse43_07 fse43_08 fse51_02 fse51_03 fse51_04 fse51_05 fse51_06 fse51_07 fse51_08 fse52_02 fse52_03 fse52_04 fse52_05 fse52_06 fse52_07 fse52_08 fse53_02 fse53_03 fse53_04 fse53_05 fse53_06 fse53_07 fse53_08 fse61_02 fse61_03 fse61_04 fse61_05 fse61_06 fse61_07 fse61_08 fse62_02 fse62_03 fse62_04 fse62_05 fse62_06 fse62_07 fse62_08 fse63_02 fse63_03 fse63_04 fse63_05 fse63_06 fse63_07 fse63_08 fse71_02 fse71_03 fse71_04 fse71_05 fse71_06 fse71_07 fse71_08 fse72_02 fse72_03 fse72_04 fse72_05 fse72_06 fse72_07 fse72_08 fse73_02 fse73_03 fse73_04 fse73_05 fse73_06 fse73_07 fse73_08 fse81_02 fse81_03 fse81_04 fse81_05 fse81_06 fse81_07 fse81_08 fse82_02 fse82_03 fse82_04 fse82_05 fse82_06 fse82_07 fse82_08 fse83_02 fse83_03 fse83_04 fse83_05 fse83_06 fse83_07 fse83_08 idxfo idxfob idxfon idxforl lunw slfoo ts01 ts02 ts03 ts04 ts05 ts06 ts07 ts08 tsk_m ts_m xs02 xs03 xs04 xs05 xs06 xs07 xs08 /end LOC_MEASUREMENT
 /begin SUB_FUNCTION /end SUB_FUNCTION
/end FUNCTION
/begin FUNCTION DMDLAD "Logic and Delay; Log. Verknüpfung versch. Blöcke zur Aussetzererkennung" /begin DEF_CHARACTERISTIC /end DEF_CHARACTERISTIC /begin REF_CHARACTERISTIC /end REF_CHARACTERISTIC /begin IN_MEASUREMENT /end IN_MEASUREMENT /begin OUT_MEASUREMENT /end OUT_MEASUREMENT /begin LOC_MEASUREMENT B_mderk /end LOC_MEASUREMENT /begin SUB_FUNCTION /end SUB_FUNCTION /end FUNCTION
/begin FUNCTION DMDLU "Diagnose misfire detection; Laufunruhe"
 /begin DEF_CHARACTERISTIC ANALUN DMXRLU FIAMALU FIMALU FLUV1 FLUV2 KFAMAL KFAMAL1 KFLURB KFLURB1 KFLURB2 KFLURBZ KFLURM KFLURM1 LURBRL LURKH LURKTM LURMIN1 LURMIN2 LURMIN3 NFLUV P_ZYL TNALU /end DEF_CHARACTERISTIC
 /begin REF_CHARACTERISTIC SNM08DMUB SRL08DMUB STM08DMUB /end REF_CHARACTERISTIC
 /begin IN_MEASUREMENT B_cdmd B_kh B_ll cd_bits1_w dmrkh esst_snm08dmub esst_srl08dmub esst_stm08dmub nmot rl tmot vfzg /end IN_MEASUREMENT
 /begin OUT_MEASUREMENT B_analu_m B_luerk_m B_lustop_m B_mdstim_m B_mdzyl1_m B_tnalu_m flurkh lums_m lurms_m lurs_m lurs_min luts_m rl_m /end OUT_MEASUREMENT
 /begin LOC_MEASUREMENT famal lums lurms lurs lursktm luts luts1 luts2 luts3 luts4 luts5 luts6 luts7 luts8 /end LOC_MEASUREMENT
 /begin SUB_FUNCTION /end SUB_FUNCTION
/end FUNCTION
/begin FUNCTION DMDLUA "Diagnose Misfire Detection Laufunruhe Abstandsmass" /begin DEF_CHARACTERISTIC DMXRFL FLUTN KFLUAR KFLUAR1 KFLUAR2 KFLUARZ /end DEF_CHARACTERISTIC /begin REF_CHARACTERISTIC SNM08DMUB SRL08DMUB /end REF_CHARACTERISTIC /begin IN_MEASUREMENT esst_snm08dmub esst_srl08dmub nmot rl /end IN_MEASUREMENT /begin OUT_MEASUREMENT /end OUT_MEASUREMENT
 /begin LOC_MEASUREMENT B_luaerk_m fflutn fluts fluts1 fluts2 fluts3 fluts4 fluts5 fluts6 fluts7 fluts8 fluts_m luar luarmn luaroff luar_m /end LOC_MEASUREMENT
 /begin SUB_FUNCTION /end SUB_FUNCTION
/end FUNCTION
/begin COMPU_METHOD B_TRUE "boolsche Zustände, positive Logik" TAB_VERB "%6.3" "" COMPU_TAB_REF B_TRUE /end COMPU_METHOD
/begin COMPU_VTAB B_TRUE "boolsche Zustände, positive Logik" TAB_VERB 2 0 "----" 1 "TRUE" /end COMPU_VTAB
/begin COMPU_METHOD DEZ "1 : 1 Umrechnug (dez/hex)" RAT_FUNC "%6.2" "" COEFFS 0 1 0 0 0 1 /end COMPU_METHOD
/begin COMPU_METHOD dez "1 : 1 Umrechnug (dez/hex)" RAT_FUNC "%6.2" "" COEFFS 0 1 0 0 0 1 /end COMPU_METHOD
/begin COMPU_METHOD dtsegno_b11p25divZyl "" RAT_FUNC "%6.5" "grad/KW" COEFFS 0 91.0222 128 0 0 1 /end COMPU_METHOD
/begin COMPU_METHOD dtsegn_b11p25divZyl "" RAT_FUNC "%6.4" "grad/KW" COEFFS 0 91.0222 0 0 0 1 /end COMPU_METHOD
/begin COMPU_METHOD dtsegn_b720divZyl "" RAT_FUNC "%6.4" "grad/KW" COEFFS 0 364.089 0 0 0 1 /end COMPU_METHOD
/begin COMPU_METHOD dtsegn_b720divZylP5 "" RAT_FUNC "%6.2" "grad/KW" COEFFS 0 364.089 32768 0 0 1 /end COMPU_METHOD
/begin COMPU_METHOD fak_sw_b1 "" RAT_FUNC "%7.6" "-" COEFFS 0 65536 0 0 0 2 /end COMPU_METHOD
/begin COMPU_METHOD fak_ub_b1 "" RAT_FUNC "%6.4" "-" COEFFS 0 256 0 0 0 1 /end COMPU_METHOD
/begin COMPU_METHOD fak_ub_b4 "" RAT_FUNC "%6.4" "-" COEFFS 0 256 0 0 0 4 /end COMPU_METHOD
/begin COMPU_METHOD fak_uw_b2 "" RAT_FUNC "%7.6" "-" COEFFS 0 65536 0 0 0 2 /end COMPU_METHOD
/begin COMPU_METHOD luquant "Umrechnung Laufunruhe in DMD" RAT_FUNC "%6.3" "(Umdr./sec)^2" COEFFS 0 1.40737 0 0 0 1 /end COMPU_METHOD
/begin COMPU_METHOD luquant_w "Umrechnung Laufunruhe Word-Größen in DMD" RAT_FUNC "%6.4" "(Umdr./sec)^2" COEFFS 0 360.288 0 0 0 1 /end COMPU_METHOD
/begin COMPU_METHOD nmot_ub_q40 "" RAT_FUNC "%6.1" "Upm" COEFFS 0 1 0 0 0 40 /end COMPU_METHOD
/begin COMPU_METHOD rel_ub_b99p6 "" RAT_FUNC "%6.3" "%" COEFFS 0 256 0 0 0 100 /end COMPU_METHOD
/begin COMPU_METHOD rel_ub_q0p75 "" RAT_FUNC "%6.3" "%" COEFFS 0 1 0 0 0 0.75 /end COMPU_METHOD
/begin COMPU_METHOD r_uw_q2 "" RAT_FUNC "%6.2" "Ohm" COEFFS 0 1 0 0 0 2 /end COMPU_METHOD
/begin COMPU_METHOD spg_ub_q0p0052_o0p2 "" RAT_FUNC "%6.3" "V" COEFFS 0 255 51 0 0 1.33 /end COMPU_METHOD
/begin COMPU_METHOD spg_uw_q0p00488_o1 "" RAT_FUNC "%6.3" "V" COEFFS 0 1024 1024 0 0 5 /end COMPU_METHOD
/begin COMPU_METHOD t100msxs_ub_b25p5 "" RAT_FUNC "%6.3" "s" COEFFS 0 1 0 0 0 0.1 /end COMPU_METHOD
/begin COMPU_METHOD t100msxs_uw_b6553p5 "" RAT_FUNC "%6.3" "s" COEFFS 0 1 0 0 0 0.1 /end COMPU_METHOD
/begin COMPU_METHOD t100msxs_uw_q100 "" RAT_FUNC "%6.3" "s" COEFFS 0 1 0 0 0 0.1 /end COMPU_METHOD
/begin COMPU_METHOD t10msxs_ub_b2p55 "" RAT_FUNC "%6.4" "s" COEFFS 0 1 0 0 0 0.01 /end COMPU_METHOD
/begin COMPU_METHOD t1sxs_ub_b255 "" RAT_FUNC "%6.2" "s" COEFFS 0 1 0 0 0 1 /end COMPU_METHOD
/begin COMPU_METHOD t20msxs_ub_b5p1 "" RAT_FUNC "%6.4" "s" COEFFS 0 1 0 0 0 0.02 /end COMPU_METHOD
/begin COMPU_METHOD t20msxs_uw_b1310 "" RAT_FUNC "%7.4" "Sek." COEFFS 0 1 0 0 0 0.02 /end COMPU_METHOD
/begin COMPU_METHOD temp_ub_q0p75_o48 "" RAT_FUNC "%6.2" "Grad C" COEFFS 0 1 48 0 0 0.75 /end COMPU_METHOD
/begin COMPU_METHOD temp_ub_q5_o50 "" RAT_FUNC "%6.2" "Grad C" COEFFS 0 1 50 0 0 5 /end COMPU_METHOD
/begin COMPU_METHOD tsquant "Umrechnung Segmentzeit in DMD" RAT_FUNC "%6.2" "us" COEFFS 0 1.25 0 0 0 1 /end COMPU_METHOD
/begin RECORD_LAYOUT GkfWSb FNC_VALUES 1 SBYTE COLUMN_DIR DIRECT /end RECORD_LAYOUT
/begin RECORD_LAYOUT GkfWUb FNC_VALUES 1 UBYTE COLUMN_DIR DIRECT /end RECORD_LAYOUT
/begin RECORD_LAYOUT GklWSb FNC_VALUES 1 SBYTE COLUMN_DIR DIRECT /end RECORD_LAYOUT
/begin RECORD_LAYOUT GklWUb FNC_VALUES 1 UBYTE COLUMN_DIR DIRECT /end RECORD_LAYOUT
/begin RECORD_LAYOUT KlAUbSstUbWUb NO_AXIS_PTS_X 1 UBYTE AXIS_PTS_X 2 UBYTE INDEX_INCR DIRECT FNC_VALUES 3 UBYTE COLUMN_DIR DIRECT /end RECORD_LAYOUT
/begin RECORD_LAYOUT KwSb FNC_VALUES 1 SBYTE COLUMN_DIR DIRECT /end RECORD_LAYOUT
/begin RECORD_LAYOUT KwSw FNC_VALUES 1 SWORD COLUMN_DIR DIRECT /end RECORD_LAYOUT
/begin RECORD_LAYOUT KwUb FNC_VALUES 1 UBYTE COLUMN_DIR DIRECT /end RECORD_LAYOUT
/begin RECORD_LAYOUT KwUw FNC_VALUES 1 UWORD COLUMN_DIR DIRECT /end RECORD_LAYOUT
/begin RECORD_LAYOUT SstAUbSstUb NO_AXIS_PTS_X 1 UBYTE AXIS_PTS_X 2 UBYTE INDEX_INCR DIRECT /end RECORD_LAYOUT
/end MODULE
/end PROJECT
