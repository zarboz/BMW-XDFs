ASAP2_VERSION 1 3
/begin PROJECT BMW_ME72 "72111"
/begin HEADER "" VERSION "_721115A0" PROJECT_NO BMW_ME72 /end HEADER
/begin MODULE DIM ""
/begin MOD_COMMON "" BYTE_ORDER MSB_LAST ALIGNMENT_BYTE 1 ALIGNMENT_WORD 2 ALIGNMENT_LONG 2 /end MOD_COMMON
/begin CHARACTERISTIC ATVINI "Initialisierungswert für Stellgröße atv, Aktivieren über Codewort NOATV" VALUE 0x8127F4 KwSb 2.550 t100msxs_sb_q0p01 -1.280 1.270 FORMAT "%5.3" /end CHARACTERISTIC
/begin CHARACTERISTIC ATVINI2 "Initialisierungswert für Stellgröße atv, Bank 2, Aktivieren über Codewort NOATV" VALUE 0x8127F5 KwSb 2.550 t100msxs_sb_q0p01 -1.280 1.270 FORMAT "%5.3" /end CHARACTERISTIC
/begin CHARACTERISTIC ATVMN "untere Regelbereichsgrenze für Stellgröße atv" VALUE 0x8127F6 KwSb 2.550 t100msxs_sb_q0p01 -1.280 1.270 FORMAT "%5.3" /end CHARACTERISTIC
/begin CHARACTERISTIC ATVMX "obere Regelbereichsgrenze für Stellgröße atv" VALUE 0x8127F7 KwSb 2.550 t100msxs_sb_q0p01 -1.280 1.270 FORMAT "%5.3" /end CHARACTERISTIC
/begin CHARACTERISTIC AZKRLDYN "Anzahl Zündungen pro Zyl. bei KR-Lastdynamik" CURVE 0x81924A GklWUb 254.0 dez 1.000 255.0 FORMAT "%5.1"
 /begin AXIS_DESCR COM_AXIS nmot nmot_ub_q40 16 0.00 10200. AXIS_PTS_REF SNM16KRUB /end AXIS_DESCR
/end CHARACTERISTIC
/begin CHARACTERISTIC AZKRNDYN "Anzahl Zündungen für KR-Drehzahldynamik" CURVE 0x81925A GklWUb 254.0 dez 1.000 255.0 FORMAT "%5.1"
 /begin AXIS_DESCR COM_AXIS nmot nmot_ub_q40 16 0.00 10200. AXIS_PTS_REF SNM16KRUB /end AXIS_DESCR
/end CHARACTERISTIC
/begin CHARACTERISTIC CFRA "Codewort Adaption Regelhub in LR" VALUE 0x810079 KwUb 255.0 dez 0.00 255.0 FORMAT "%5.1" /end CHARACTERISTIC
/begin CHARACTERISTIC CLRHK "Codewort für Lambda - Regelung hinter Kat ein/aus" VALUE 0x8127F8 KwUb 255.0 dez 0.00 255.0 FORMAT "%5.1" /end CHARACTERISTIC
/begin CHARACTERISTIC CLRHKC "Codewort für Lambda - Regelung hinter Kat ein/aus" VALUE 0x81A63B KwUb 255.0 dez 0.00 255.0 FORMAT "%5.1" /end CHARACTERISTIC
/begin CHARACTERISTIC CLRKA "Codewort für Funktion O2-Kat-Ausräumen" VALUE 0x810068 KwUb 255.0 dez 0.00 255.0 FORMAT "%5.1" /end CHARACTERISTIC
/begin CHARACTERISTIC CLRZWTMS "Codewort Zwangseinschaltung LR gemäß CARB-Forderung" VALUE 0x81A5FD KwUb 255.0 dez 0.00 255.0 FORMAT "%5.1" /end CHARACTERISTIC
/begin CHARACTERISTIC CNFKUPPL "Konfigurationsflag für die Auswertung des Kuplg.schalters in der LLR" VALUE 0x811D34 KwUb 255.0 dez 0.00 255.0 FORMAT "%5.1" /end CHARACTERISTIC
/begin CHARACTERISTIC CWKR "Codewort Klopfregelung" VALUE 0x810056 KwUb 1.000 dez 0.00 1.000 FORMAT "%5.3" /end CHARACTERISTIC
/begin CHARACTERISTIC CWLLRMR "Codewort für LLR-Momentenreserve" VALUE 0x811D39 KwUb 255.0 dez 0.00 255.0 FORMAT "%5.1" /end CHARACTERISTIC
/begin CHARACTERISTIC DFRMN "Min. Lambda-Abweichung für Bestimmung Stationärbedingung und ÜK-Adaption" VALUE 0x81426E KwSw 1.999969 fak_sw_b1 -1.000000 0.9999695 FORMAT "%8.6" /end CHARACTERISTIC
/begin CHARACTERISTIC DFRSPS "Hub des Lambda-Regelfaktors (Sollwert)" VALUE 0x814270 KwSw 1.999969 fak_sw_b1 -1.000000 0.9999695 FORMAT "%8.6" /end CHARACTERISTIC
/begin CHARACTERISTIC DMLLRIMXN "Sicherheitskonzept: obere Begrenzung für dmllri" CURVE 0x811D94 GklWUb 99.61 rel_ub_b99p6 0.00 99.61 FORMAT "%5.2"
 /begin AXIS_DESCR COM_AXIS nmot nmot_ub_q40 6 0.00 10200. AXIS_PTS_REF SNM06LLUB /end AXIS_DESCR
/end CHARACTERISTIC
/begin CHARACTERISTIC DMLLRMN "Untere Begrenzung für dmllr_w" VALUE 0x815CB8 KwSw 199.9969 rel_sw_b100 -100.0000 99.99695 FORMAT "%8.4" /end CHARACTERISTIC
/begin CHARACTERISTIC DMLLRMXN "Sicherheitskonzept: obere Begrenzung für dmllr" CURVE 0x811D9A GklWUb 99.61 rel_ub_b99p6 0.00 99.61 FORMAT "%5.2"
 /begin AXIS_DESCR COM_AXIS nmot nmot_ub_q40 6 0.00 10200. AXIS_PTS_REF SNM06LLUB /end AXIS_DESCR
/end CHARACTERISTIC
/begin CHARACTERISTIC DMLLRZMN "untere Begrenzung für dmllrz_w" VALUE 0x815CBA KwSw 199.9969 rel_sw_b100 -100.0000 99.99695 FORMAT "%8.4" /end CHARACTERISTIC
/begin CHARACTERISTIC DMLLRZMXN "obere Begrenzung für dmllrz_w" CURVE 0x811DA0 GklWUb 99.61 rel_ub_b99p6 0.00 99.61 FORMAT "%5.2"
 /begin AXIS_DESCR COM_AXIS nmot nmot_ub_q40 6 0.00 10200. AXIS_PTS_REF SNM06LLUB /end AXIS_DESCR
/end CHARACTERISTIC
/begin CHARACTERISTIC DMRESFS "LLR: Abbaugeschwindigkeit der erhöhten Drehmomentreserve" VALUE 0x811D3A KwUb 4.845 relgrad_20ms_qn0p019 -4.845 0.00 FORMAT "%5.3" /end CHARACTERISTIC
/begin CHARACTERISTIC DMRESLL "LLR: Abbaugeschwindigkeit der erhöhten Drehmomentreserve" VALUE 0x811D3B KwUb 4.845 relgrad_20ms_qn0p019 -4.845 0.00 FORMAT "%5.3" /end CHARACTERISTIC
/begin CHARACTERISTIC DMRESLW "Momentenreserve bei Servolenkung" CURVE 0x815C9A KlAUwSstSwWUw 24.99765 rel_q0p09726 0.00 24.99765 FORMAT "%8.5"
 /begin AXIS_DESCR STD_AXIS lws_w lws_q0p04375 7 -1433.600 1433.556 FORMAT "%8.3" DEPOSIT ABSOLUTE /end AXIS_DESCR
/end CHARACTERISTIC
/begin CHARACTERISTIC DNLLR "Drehzahlband oberhalb nstat für LLR-Freigabe" VALUE 0x811D35 KwUb 2550. nmot_ub_q10 0.00 2550. FORMAT "%5.0" /end CHARACTERISTIC
/begin CHARACTERISTIC DNLLRES "LLR: Unterdrehzahlschwelle zur Erhöhung der Momentenreserve im LL" VALUE 0x811D3C KwSb 2550. nmotd_sb_q10 -1280. 1270. FORMAT "%5.0" /end CHARACTERISTIC
/begin CHARACTERISTIC DNMNI "Kleinstmöglicher Wert für dn beim I-Anteil" VALUE 0x811DA6 KwSb 2550. nmotd_sb_q10 -1280. 1270. FORMAT "%5.0" /end CHARACTERISTIC
/begin CHARACTERISTIC DNSNFX "Offset zur Bestimmung der oberen Grenze für die Solldrehzahlnachführung" VALUE 0x811D77 KwUb 2550. nmot_ub_q10 0.00 2550. FORMAT "%5.0" /end CHARACTERISTIC
/begin CHARACTERISTIC DTMR "Hysterese für Einschaltschwelle" VALUE 0x81A5FE KwUb 191.3 temp_ub_b191p25 0.00 191.3 FORMAT "%5.1" /end CHARACTERISTIC
/begin CHARACTERISTIC DTMTMRW "Temperaturdiff.-Schwelle für die Prüfung, ob Zwangseinschaltung LR nötig (CARB)" VALUE 0x81A5FF KwUb 191.3 temp_sb_q0p75 0.00 191.3 FORMAT "%5.1" /end CHARACTERISTIC
/begin CHARACTERISTIC DTVKAML "Delta-tv für Katalysator-Ausräumen (luftmassenabhängig)" CURVE 0x81A6FC GklWSb 2.550 t100msxs_sb_q0p01 -1.280 1.270 FORMAT "%5.3" /begin AXIS_DESCR COM_AXIS ml m_ub_b1020 5 0.00 1020. AXIS_PTS_REF SML05LKUB /end AXIS_DESCR /end CHARACTERISTIC
/begin CHARACTERISTIC DTVKAML2 "Delta-tv für Katalysator-Ausräumen (luftmassenabhängig) Bank2" CURVE 0x81A701 GklWSb 2.550 t100msxs_sb_q0p01 -1.280 1.270 FORMAT "%5.3" /begin AXIS_DESCR COM_AXIS ml m_ub_b1020 5 0.00 1020. AXIS_PTS_REF SML05LKUB /end AXIS_DESCR /end CHARACTERISTIC
/begin CHARACTERISTIC DVNG "LLR: D-Verstärkung abh. von ngfil bei stehendem Fahrzeug" CURVE 0x811DA7 GklWUb 0.1245 rel_ub_bn0p125 -0.1245 0.00 FORMAT "%6.4"
 /begin AXIS_DESCR COM_AXIS ngfil nmotg_sb_q100 6 -12800. 12700. AXIS_PTS_REF SNG06LLSB /end AXIS_DESCR
/end CHARACTERISTIC
/begin CHARACTERISTIC DVNGV "LLR: D-Verstärkung abh. von ngfil bei rollendem Fahrzeug" CURVE 0x811DAD GklWUb 0.9961 fak_ub_b1 0.00 0.9961
 /begin AXIS_DESCR COM_AXIS ngfil nmotg_sb_q100 6 -12800. 12700. AXIS_PTS_REF SNG06LLSB /end AXIS_DESCR
/end CHARACTERISTIC
/begin CHARACTERISTIC DVZNG "LLR: D-Zündungsanteil abh. vom ngfil bei stehendem Fzg." CURVE 0x811DB3 GklWUb 0.1245 rel_ub_bn0p125 -0.1245 0.00 FORMAT "%6.4"
 /begin AXIS_DESCR COM_AXIS ngfil nmotg_sb_q100 6 -12800. 12700. AXIS_PTS_REF SNG06LLSB /end AXIS_DESCR
/end CHARACTERISTIC
/begin CHARACTERISTIC DVZNGV "LLR: D-Zündungsanteil abh. vom ngfil bei rollendem Fzg." CURVE 0x811DB9 GklWUb 0.9961 fak_ub_b1 0.00 0.9961
 /begin AXIS_DESCR COM_AXIS ngfil nmotg_sb_q100 6 -12800. 12700. AXIS_PTS_REF SNG06LLSB /end AXIS_DESCR
/end CHARACTERISTIC
/begin CHARACTERISTIC DWKRMSN "delta Winkel KR Abstand zur gemittelten Spätverstellung" CURVE 0x819184 GklWUb 191.3 zw_ub_qn0p75 -191.3 0.00 FORMAT "%5.1"
 /begin AXIS_DESCR COM_AXIS nmot nmot_ub_q40 16 0.00 10200. AXIS_PTS_REF SNM16KRUB /end AXIS_DESCR
/end CHARACTERISTIC
/begin CHARACTERISTIC DYADMX "Max. Wert des add. Dynamikvorhalts" VALUE 0x810057 KwUb 24.00 zw_ub_qn0p75 -24.00 0.00 FORMAT "%5.2" /end CHARACTERISTIC
/begin CHARACTERISTIC DYADS "Add. Spätverstellung pro Zyk. durch lern. Dyn." VALUE 0x810058 KwUb 24.00 zw_ub_qn0p75 -24.00 0.00 FORMAT "%5.2" /end CHARACTERISTIC
/begin CHARACTERISTIC DYAMNV "Min. Wert des add. Dynamikvorhalts" VALUE 0x810059 KwUb 24.00 zw_ub_qn0p75 -24.00 0.00 FORMAT "%5.2" /end CHARACTERISTIC
/begin CHARACTERISTIC DYAVF "Abregelkonstante für Dynamikvorhalt" VALUE 0x81005A KwUb 254.0 dez 1.000 255.0 FORMAT "%5.1" /end CHARACTERISTIC
/begin CHARACTERISTIC DZWOAGR "AGR-ratenabhängiger  Offset des optimalen ZW" CURVE 0x812C28 KlAUbSstUbWSb 191.3 zw_sb_q0p75 -96.00 95.25 FORMAT "%5.2"
 /begin AXIS_DESCR STD_AXIS agrr rel_ub_b99p6 10 0.00 99.61 FORMAT "%5.2" DEPOSIT ABSOLUTE /end AXIS_DESCR
/end CHARACTERISTIC
/begin CHARACTERISTIC DZWOLA "Lambda-Abhängigkeit des optimalen Zündwinkels bezogen auf Lambda 1" CURVE 0x812C3E KlAUbSstUbWSb 191.3 zw_sb_q0p75 -96.00 95.25 FORMAT "%5.2"
 /begin AXIS_DESCR STD_AXIS lambas fak_ub_b2 10 0.00 1.992 FORMAT "%5.3" DEPOSIT ABSOLUTE /end AXIS_DESCR
/end CHARACTERISTIC
/begin CHARACTERISTIC DZWOM "temperaturabhängiger Offset des optimalen ZW" CURVE 0x812C54 KlAUbSstUbWSb 191.3 zw_sb_q0p75 -96.00 95.25 FORMAT "%5.2"
 /begin AXIS_DESCR STD_AXIS tmot temp_ub_q0p75_o48 5 -48.00 143.3 FORMAT "%5.1" DEPOSIT ABSOLUTE /end AXIS_DESCR
/end CHARACTERISTIC
/begin CHARACTERISTIC ETADZW "ZW-Wirkungsgrad in Abhängigkeit von delta ZW" CURVE 0x81018B FklWUb 127.5 rel_ub_b127p5 0.00 127.5 FORMAT "%5.1"
 /begin AXIS_DESCR FIX_AXIS dzw_kge zw_sb_q0p75 128 0.00 95.25 FORMAT "%5.2" FIX_AXIS_PAR 0 0 128 /end AXIS_DESCR
/end CHARACTERISTIC
/begin CHARACTERISTIC ETALAM "Lambda-Wirkungsgrad" CURVE 0x81020B KlAUbSstUbWUb 127.5 rel_ub_b127p5 0.00 127.5 FORMAT "%5.1"
 /begin AXIS_DESCR STD_AXIS lambas fak_ub_b2 10 0.00 1.992 FORMAT "%5.3" DEPOSIT ABSOLUTE /end AXIS_DESCR
/end CHARACTERISTIC
/begin CHARACTERISTIC FDDN "LLR: Gewichtungsfaktor für D-Verstärkung" CURVE 0x811DBF GklWUb 0.9961 fak_ub_b1 0.00 0.9961
 /begin AXIS_DESCR COM_AXIS dns nmotd_sb_q10 6 -1280. 1270. AXIS_PTS_REF SNS06LLSB /end AXIS_DESCR
/end CHARACTERISTIC
/begin CHARACTERISTIC FDDZN "LLR: Gewichtungsfaktor für D-Zündungsanteil" CURVE 0x811DC5 GklWUb 0.9961 fak_ub_b1 0.00 0.9961
 /begin AXIS_DESCR COM_AXIS dns nmotd_sb_q10 6 -1280. 1270. AXIS_PTS_REF SNS06LLSB /end AXIS_DESCR
/end CHARACTERISTIC
/begin CHARACTERISTIC FFRITMS "Faktor für I-Dynamik des Lambdareglers in Abhängigkeit von tmst" CURVE 0x81A4F8 KlAUbSstUbWUb 0.9961 fak_ub_b1 0.00 0.9961
 /begin AXIS_DESCR STD_AXIS tmst temp_ub_q0p75_o48 4 -48.00 143.3 FORMAT "%5.1" DEPOSIT ABSOLUTE /end AXIS_DESCR
/end CHARACTERISTIC
/begin CHARACTERISTIC FFWEKA "Gewichtungsfaktor zur Einrechnung Wiedereinsetzfaktor fwe in Fettfläche" VALUE 0x810069 KwUb 0.9961 fak_ub_b1 0.00 0.9961 /end CHARACTERISTIC
/begin CHARACTERISTIC FKAXAVKAT "Gewichtungsfaktor Sauerstoffspeicher in Abhängigkeit von avkatf" CURVE 0x81A706 KlAUbSstUbWUb 0.9961 fak_ub_b1 0.00 0.9961 /begin AXIS_DESCR STD_AXIS avkatf fak_ub_b1 5 0.00 0.9961 DEPOSIT ABSOLUTE /end AXIS_DESCR /end CHARACTERISTIC
/begin CHARACTERISTIC FKELDY "Korrekturfaktor für Klopferkennungsschwelle bei Lastdynamik" VALUE 0x810034 KwUb 2.000 fak_ub_b16 0.00 2.000 FORMAT "%5.3" /end CHARACTERISTIC
/begin CHARACTERISTIC FKELDYA "Korrekturfaktor für Klopferkennungsschwelle bei Lastdynamikadaption" VALUE 0x81005B KwUb 0.9375 fak_ub_b16 0.6250 1.563 FORMAT "%5.3" /end CHARACTERISTIC
/begin CHARACTERISTIC FKENDY "Korrekturfaktor für Klopferkennungsschwelle bei Drehzahldynamik" VALUE 0x810035 KwUb 2.000 fak_ub_b16 0.00 2.000 FORMAT "%5.3" /end CHARACTERISTIC
/begin CHARACTERISTIC FKVAUM "Umrechnungsfaktor Einspritzzeit in Kraftstoffverbrauch" VALUE 0x814298 KwUw 312.5000 tefuel_uw_b312p5 0.00 312.5000 FORMAT "%8.4" /end CHARACTERISTIC
/begin CHARACTERISTIC FLMLKAMA "Faktor zur Bewertung Schwellwert integr. Fettfl. f. Abbruch Kat-Ausr. Pre/Main" VALUE 0x81006A KwUb 7.969 fak_ub_b8 0.00 7.969 FORMAT "%5.3" /end CHARACTERISTIC
/begin CHARACTERISTIC FLMLKAMA2 "Fakt. zur Bewert. Schwellw. integr. Fettfl. f. Abbruch Kat-Ausr. Pre/Main, Bank2" VALUE 0x81006B KwUb 7.969 fak_ub_b8 0.00 7.969 FORMAT "%5.3" /end CHARACTERISTIC
/begin CHARACTERISTIC FLMLKAPR "Faktor zur Bewertung des gemessenen gespeicherten Sauerstoffs" VALUE 0x81006C KwUb 7.969 fak_ub_b8 0.00 7.969 FORMAT "%5.3" /end CHARACTERISTIC
/begin CHARACTERISTIC FLMLKAPR2 "Faktor zur Bewertung des gemessenen gespeicherten Sauerstoffs, Bank2" VALUE 0x81006D KwUb 7.969 fak_ub_b8 0.00 7.969 FORMAT "%5.3" /end CHARACTERISTIC
/begin CHARACTERISTIC FLRFKATE "Gewichtung des Adaptionswertes fkatei aus %TEB zur Anpassung der Reglerparameter" CURVE 0x8175F0 KlAUbSstSbWUb 1.992 fak_ub_b2 0.00 1.992 FORMAT "%5.3"
 /begin AXIS_DESCR STD_AXIS fkatei fak_sb_b1 5 -1.000 0.9922 FORMAT "%5.3" DEPOSIT ABSOLUTE /end AXIS_DESCR
/end CHARACTERISTIC
/begin CHARACTERISTIC FLRM "Faktor für I-Dynamik des Lambdareglers in Abhängigkeit von tmot" CURVE 0x8127C6 KlAUbSstUbWUb 3.984 fak_ub_b4 0.00 3.984 FORMAT "%5.3"
 /begin AXIS_DESCR STD_AXIS tmot temp_ub_q0p75_o48 5 -48.00 143.3 FORMAT "%5.1" DEPOSIT ABSOLUTE /end AXIS_DESCR
/end CHARACTERISTIC
/begin CHARACTERISTIC FMLKAMA "Faktor zur Bewertung Schwellwert integr. Luftm. f. Abbruch Kat-Ausr. Pre/Main" VALUE 0x81006E KwUb 7.969 fak_ub_b8 0.00 7.969 FORMAT "%5.3" /end CHARACTERISTIC
/begin CHARACTERISTIC FMLKAMA2 "Faktor zur Bewert. Schwellw. integr. Luftm. f. Abbruch Kat-Ausr. Pre/Main, Bank2" VALUE 0x81006F KwUb 7.969 fak_ub_b8 0.00 7.969 FORMAT "%5.3" /end CHARACTERISTIC
/begin CHARACTERISTIC FNSNF "Faktor für Solldrehzahlnachführung" VALUE 0x811D78 KwUb 0.9961 rel_ub_b1p0 0.00 0.9961 /end CHARACTERISTIC
/begin CHARACTERISTIC FNSSTM "Faktor zur Wichtung der Solldrehzahl im Start" CURVE 0x81A342 KlAUbSstUbWUb 1.992 fak_ub_b2 0.00 1.992 FORMAT "%5.3"
 /begin AXIS_DESCR STD_AXIS tmot temp_ub_q0p75_o48 6 -48.00 143.3 FORMAT "%5.1" DEPOSIT ABSOLUTE /end AXIS_DESCR
/end CHARACTERISTIC
/begin CHARACTERISTIC FRAOMN "untere Begrenzung des Korrekturfaktors frao" VALUE 0x8193E8 KwUb 1.992 fak_ub_b2 0.00 1.992 FORMAT "%5.3" /end CHARACTERISTIC
/begin CHARACTERISTIC FRAOMX "obere Begrenzung des Korrekturfaktors frao" VALUE 0x8193E9 KwUb 1.992 fak_ub_b2 0.00 1.992 FORMAT "%5.3" /end CHARACTERISTIC
/begin CHARACTERISTIC FRAORN "untere reduzierte Schwelle des Korrekturfaktors frao" VALUE 0x8193EA KwUb 1.992 fak_ub_b2 0.00 1.992 FORMAT "%5.3" /end CHARACTERISTIC
/begin CHARACTERISTIC FRAORX "obere reduzierte Schwelle des Korrekturfaktors frao" VALUE 0x8193EB KwUb 1.992 fak_ub_b2 0.00 1.992 FORMAT "%5.3" /end CHARACTERISTIC
/begin CHARACTERISTIC FRAUMN "untere Begrenzung des Korrekturfaktors frau" VALUE 0x8193EC KwUb 1.992 fak_ub_b2 0.00 1.992 FORMAT "%5.3" /end CHARACTERISTIC
/begin CHARACTERISTIC FRAUMX "obere Begrenzung des Korrekturfaktors frau" VALUE 0x8193ED KwUb 1.992 fak_ub_b2 0.00 1.992 FORMAT "%5.3" /end CHARACTERISTIC
/begin CHARACTERISTIC FRAURN "untere reduzierte Schwelle des Korrekturfaktors frau" VALUE 0x8193EE KwUb 1.992 fak_ub_b2 0.00 1.992 FORMAT "%5.3" /end CHARACTERISTIC
/begin CHARACTERISTIC FRAURX "obere reduzierte Schwelle des Korrekturfaktors frau" VALUE 0x8193EF KwUb 1.992 fak_ub_b2 0.00 1.992 FORMAT "%5.3" /end CHARACTERISTIC
/begin CHARACTERISTIC FRIPTES "Faktor zur Verstellung von fri und frp bei Fehler ""offenes TEV klemmt""" VALUE 0x81007A KwUb 3.984 fak_ub_b4 0.00 3.984 FORMAT "%5.3" /end CHARACTERISTIC
/begin CHARACTERISTIC FRMAX "obere Regelbereichsgrenze" VALUE 0x814272 KwUw 1.999969 fak_uw_b2 0.00 1.999969 FORMAT "%8.6" /end CHARACTERISTIC
/begin CHARACTERISTIC FRMIN "untere Regelbereichsgrenze" VALUE 0x8175FC KwUw 1.999969 fak_uw_b2 0.00 1.999969 FORMAT "%8.6" /end CHARACTERISTIC
/begin CHARACTERISTIC FRTEMX "obere Regelbereichsgrenze bei Fehler ""offen klemmendes TEV""" VALUE 0x814274 KwUw 1.999969 fak_uw_b2 0.00 1.999969 FORMAT "%8.6" /end CHARACTERISTIC
/begin CHARACTERISTIC ILMLKAXTK "Schwelle Fettfläche Kat-Ausräumen nach SA, Funktion der Kat-Temperatur" CURVE 0x81BAB8 KlAUwSstUwWUw 4660.267 m_uw_b4660 0.00 4660.267 FORMAT "%8.3"
 /begin AXIS_DESCR STD_AXIS tkatm_w temp_uw_q0p0195_o50 5 -50.00000 1229.980 FORMAT "%8.3" DEPOSIT ABSOLUTE /end AXIS_DESCR
/end CHARACTERISTIC
/begin CHARACTERISTIC ILMLKAXTK2 "Schwelle Fettfläche Kat-Ausräumen nach SA, Funktion der Kat-Temperartur" CURVE 0x81BACE KlAUwSstUwWUw 4660.267 m_uw_b4660 0.00 4660.267 FORMAT "%8.3"
 /begin AXIS_DESCR STD_AXIS tkatm2_w temp_uw_q0p0195_o50 5 -50.00000 1229.980 FORMAT "%8.3" DEPOSIT ABSOLUTE /end AXIS_DESCR
/end CHARACTERISTIC
/begin CHARACTERISTIC IMLAKMN "Schwellwert integr. Luftmasse f. Mindestdauer Katalysator-Ausräumen" VALUE 0x81426A KwUw 4660.267 m_uw_b4660 0.00 4660.267 FORMAT "%8.3" /end CHARACTERISTIC
/begin CHARACTERISTIC IMLAKMN2 "Schwellwert integr. Luftmasse f. Mindestdauer Katalysator-Ausräumen Bank2" VALUE 0x81426C KwUw 4660.267 m_uw_b4660 0.00 4660.267 FORMAT "%8.3" /end CHARACTERISTIC
/begin CHARACTERISTIC IMLKAXTK "Schwellwert f(tkatm_w) integr. Luftmasse f. Abbruch Katalysator-Ausräumen" CURVE 0x81BAE4 KlAUwSstUwWUw 4660.267 m_uw_b4660 0.00 4660.267 FORMAT "%8.3"
 /begin AXIS_DESCR STD_AXIS tkatm_w temp_uw_q0p0195_o50 5 -50.00000 1229.980 FORMAT "%8.3" DEPOSIT ABSOLUTE /end AXIS_DESCR
/end CHARACTERISTIC
/begin CHARACTERISTIC IMLKAXTK2 "Schwellwert f(tkatm2_w) integr. Luftmasse f. Abbruch Katalysator-Ausräumen" CURVE 0x81BAFA KlAUwSstUwWUw 4660.267 m_uw_b4660 0.00 4660.267 FORMAT "%8.3"
 /begin AXIS_DESCR STD_AXIS tkatm2_w temp_uw_q0p0195_o50 5 -50.00000 1229.980 FORMAT "%8.3" DEPOSIT ABSOLUTE /end AXIS_DESCR
/end CHARACTERISTIC
/begin CHARACTERISTIC IMLLASKH "imlpr-Schwelle für Übergang auf Lambda-Abgas-Vorgabe" VALUE 0x81A206 KwUb 0.9961 fak_ub_b1 0.00 0.9961 /end CHARACTERISTIC
/begin CHARACTERISTIC IMLSALR "Schwellwert integr. Luftmasse f. Einschaltverzögerung LR nach SA" VALUE 0x8175FE KwUw 4660.267 m_uw_b4660 0.00 4660.267 FORMAT "%8.3" /end CHARACTERISTIC
/begin CHARACTERISTIC IVDN "LLR: I-Verstärkung bei stehendem Fahrzeug" CURVE 0x811DCB GklWUb 0.9961 rel_ub_b1p0 0.00 0.9961
 /begin AXIS_DESCR COM_AXIS dn_w nmotd_sw_q0p25 8 -8192.000 8191.750 AXIS_PTS_REF SDN08LLSW /end AXIS_DESCR
/end CHARACTERISTIC
/begin CHARACTERISTIC IVDNV "LLR: I-Verstärkung bei rollendem Fahrzeug" CURVE 0x811DD3 GklWUb 0.9961 rel_ub_b1p0 0.00 0.9961
 /begin AXIS_DESCR COM_AXIS dn_w nmotd_sw_q0p25 8 -8192.000 8191.750 AXIS_PTS_REF SDN08LLSW /end AXIS_DESCR
/end CHARACTERISTIC
/begin CHARACTERISTIC KDLASHKI "Kennlinie über dlashkm, Bewertungsfaktor für I-Anteil in der LRHK" CURVE 0x81BA10 KlASwSstSwWSw 1.999969 fak_sw_b1 -1.000000 0.9999695 FORMAT "%8.6"
 /begin AXIS_DESCR STD_AXIS idlashkm_w fak_sw_b1 10 -1.000000 0.9999695 FORMAT "%8.6" DEPOSIT ABSOLUTE /end AXIS_DESCR
/end CHARACTERISTIC
/begin CHARACTERISTIC KDLASHKI2 "Kennlinie über dlashkm, Bewertungsfaktor für I-Anteil in der LRHK, Bank 2" CURVE 0x81BA3A KlASwSstSwWSw 1.999969 fak_sw_b1 -1.000000 0.9999695 FORMAT "%8.6"
 /begin AXIS_DESCR STD_AXIS dlashkm2_w fak_sw_b1 10 -1.000000 0.9999695 FORMAT "%8.6" DEPOSIT ABSOLUTE /end AXIS_DESCR
/end CHARACTERISTIC
/begin CHARACTERISTIC KDLASHKP "Kennlinie über dlashkm_w, Bewertungsfaktor für P-Anteil in der LRHK" CURVE 0x81BA64 KlASwSstSwWSw 1.999969 fak_sw_b1 -1.000000 0.9999695 FORMAT "%8.6"
 /begin AXIS_DESCR STD_AXIS idlashkm_w fak_sw_b1 10 -1.000000 0.9999695 FORMAT "%8.6" DEPOSIT ABSOLUTE /end AXIS_DESCR
/end CHARACTERISTIC
/begin CHARACTERISTIC KDLASHKP2 "Kennlinie über dlashkm, Bewertungsfaktor für P-Anteil in der LRHK, Bank 2" CURVE 0x81BA8E KlASwSstSwWSw 1.999969 fak_sw_b1 -1.000000 0.9999695 FORMAT "%8.6"
 /begin AXIS_DESCR STD_AXIS dlashkm2_w fak_sw_b1 10 -1.000000 0.9999695 FORMAT "%8.6" DEPOSIT ABSOLUTE /end AXIS_DESCR
/end CHARACTERISTIC
/begin CHARACTERISTIC KE1N "Klopferkennungsschwelle bei Zylinderzähler 1" CURVE 0x8190E4 GklWUb 15.94 fak_ub_b16 0.00 15.94 FORMAT "%5.2"
 /begin AXIS_DESCR COM_AXIS nmot nmot_ub_q40 16 0.00 10200. AXIS_PTS_REF SNM16KRUB /end AXIS_DESCR
/end CHARACTERISTIC
/begin CHARACTERISTIC KE2N "Klopferkennungsschwelle bei Zylinderzähler 2" CURVE 0x8190F4 GklWUb 15.94 fak_ub_b16 0.00 15.94 FORMAT "%5.2"
 /begin AXIS_DESCR COM_AXIS nmot nmot_ub_q40 16 0.00 10200. AXIS_PTS_REF SNM16KRUB /end AXIS_DESCR
/end CHARACTERISTIC
/begin CHARACTERISTIC KE3N "Klopferkennungsschwelle bei Zylinderzähler 3" CURVE 0x819104 GklWUb 15.94 fak_ub_b16 0.00 15.94 FORMAT "%5.2"
 /begin AXIS_DESCR COM_AXIS nmot nmot_ub_q40 16 0.00 10200. AXIS_PTS_REF SNM16KRUB /end AXIS_DESCR
/end CHARACTERISTIC
/begin CHARACTERISTIC KE4N "Klopferkennungsschwelle bei Zylinderzähler 4" CURVE 0x819114 GklWUb 15.94 fak_ub_b16 0.00 15.94 FORMAT "%5.2"
 /begin AXIS_DESCR COM_AXIS nmot nmot_ub_q40 16 0.00 10200. AXIS_PTS_REF SNM16KRUB /end AXIS_DESCR
/end CHARACTERISTIC
/begin CHARACTERISTIC KE5N "Klopferkennungsschwelle bei Zylinderzähler 5" CURVE 0x819124 GklWUb 15.94 fak_ub_b16 0.00 15.94 FORMAT "%5.2"
 /begin AXIS_DESCR COM_AXIS nmot nmot_ub_q40 16 0.00 10200. AXIS_PTS_REF SNM16KRUB /end AXIS_DESCR
/end CHARACTERISTIC
/begin CHARACTERISTIC KE6N "Klopferkennungsschwelle bei Zylinderzähler 6" CURVE 0x819134 GklWUb 15.94 fak_ub_b16 0.00 15.94 FORMAT "%5.2"
 /begin AXIS_DESCR COM_AXIS nmot nmot_ub_q40 16 0.00 10200. AXIS_PTS_REF SNM16KRUB /end AXIS_DESCR
/end CHARACTERISTIC
/begin CHARACTERISTIC KE7N "Klopferkennungsschwelle bei Zylinderzähler 7" CURVE 0x819144 GklWUb 15.94 fak_ub_b16 0.00 15.94 FORMAT "%5.2"
 /begin AXIS_DESCR COM_AXIS nmot nmot_ub_q40 16 0.00 10200. AXIS_PTS_REF SNM16KRUB /end AXIS_DESCR
/end CHARACTERISTIC
/begin CHARACTERISTIC KE8N "Klopferkennungsschwelle bei Zylinderzähler 8" CURVE 0x819154 GklWUb 15.94 fak_ub_b16 0.00 15.94 FORMAT "%5.2"
 /begin AXIS_DESCR COM_AXIS nmot nmot_ub_q40 16 0.00 10200. AXIS_PTS_REF SNM16KRUB /end AXIS_DESCR
/end CHARACTERISTIC
/begin CHARACTERISTIC KFDYES "Lastdynamikerkennungsschwelle" MAP 0x81A7C6 GkfWUw 767.9766 rel_uw_q0p0234 0.00 767.9766 FORMAT "%8.4"
 /begin AXIS_DESCR COM_AXIS nmot_w nmot_uw_q0p25 8 0.00 16383.75 AXIS_PTS_REF SNM08KRUW /end AXIS_DESCR
 /begin AXIS_DESCR COM_AXIS wdkba_w relDK_q0p02441 6 -800.0000 799.9756 AXIS_PTS_REF SWD06KRSW /end AXIS_DESCR
/end CHARACTERISTIC
/begin CHARACTERISTIC KFDYESOF "Dynamikvorhalt Offsetschwelle" MAP 0x81A826 GkfWUw 767.9766 rel_uw_q0p0234 0.00 767.9766 FORMAT "%8.4"
 /begin AXIS_DESCR COM_AXIS nmot_w nmot_uw_q0p25 8 0.00 16383.75 AXIS_PTS_REF SNM08KRUW /end AXIS_DESCR
 /begin AXIS_DESCR COM_AXIS wdkba_w relDK_q0p02441 6 -800.0000 799.9756 AXIS_PTS_REF SWD06KRSW /end AXIS_DESCR
/end CHARACTERISTIC
/begin CHARACTERISTIC KFFTV "Gewichtungskennfeld für TVLRH" MAP 0x81A63C GkfWUb 1.992 fak_ub_b2 0.00 1.992 FORMAT "%5.3"
 /begin AXIS_DESCR COM_AXIS nmot nmot_ub_q40 6 0.00 10200. AXIS_PTS_REF SNM06LHUB /end AXIS_DESCR
 /begin AXIS_DESCR COM_AXIS rl rel_ub_q0p75 6 0.00 191.3 AXIS_PTS_REF SRL06LHUB /end AXIS_DESCR
/end CHARACTERISTIC
/begin CHARACTERISTIC KFFTV2 "Gewichtungskennfeld für TVLRH Bank 2" MAP 0x81A660 GkfWUb 1.992 fak_ub_b2 0.00 1.992 FORMAT "%5.3"
 /begin AXIS_DESCR COM_AXIS nmot nmot_ub_q40 6 0.00 10200. AXIS_PTS_REF SNM06LHUB /end AXIS_DESCR
 /begin AXIS_DESCR COM_AXIS rl rel_ub_q0p75 6 0.00 191.3 AXIS_PTS_REF SRL06LHUB /end AXIS_DESCR
/end CHARACTERISTIC
/begin CHARACTERISTIC KFKRMX "Kennfeld maximale Spätverstellung durch Klopfen" MAP 0x819194 KfAxUbAyUbSstxUbSstyUbWUb 191.3 zw_ub_qn0p75 -191.3 0.00 FORMAT "%5.1"
 /begin AXIS_DESCR STD_AXIS nmot nmot_ub_q40 16 0.00 10200. FORMAT "%5.0" DEPOSIT ABSOLUTE /end AXIS_DESCR
 /begin AXIS_DESCR STD_AXIS rl rel_ub_q0p75 3 0.00 191.3 FORMAT "%5.1" DEPOSIT ABSOLUTE /end AXIS_DESCR
/end CHARACTERISTIC
/begin CHARACTERISTIC KFLAMFA "Kennfeld Lambda Fahrerwunsch" MAP 0x819F71 KfAxUbAyUbSstxUbSstyUbWUb 1.992 fak_ub_b2 0.00 1.992 FORMAT "%5.3"
 /begin AXIS_DESCR STD_AXIS nmot nmot_ub_q40 12 0.00 10200. FORMAT "%5.0" DEPOSIT ABSOLUTE /end AXIS_DESCR
 /begin AXIS_DESCR STD_AXIS rl rel_ub_q0p75 16 0.00 191.3 FORMAT "%5.1" DEPOSIT ABSOLUTE /end AXIS_DESCR
/end CHARACTERISTIC
/begin CHARACTERISTIC KFLANSKH "Kennfeld Lambda-Motor-Vorgabe bei Katheizen im Nachstart" MAP 0x81B482 KfAxUbAyUbSstxUbSstyUwWUw 15.89990 fak_uw_b16 0.09985352 15.99976 FORMAT "%8.5"
 /begin AXIS_DESCR STD_AXIS tmst temp_ub_q0p75_o48 6 -48.00 143.3 FORMAT "%5.1" DEPOSIT ABSOLUTE /end AXIS_DESCR
 /begin AXIS_DESCR STD_AXIS anztib_w dez 12 0.00 65535.00 FORMAT "%8.2" DEPOSIT ABSOLUTE /end AXIS_DESCR
/end CHARACTERISTIC
/begin CHARACTERISTIC KFLASKH "Kennfeld Lambda-Abgas-Soll bei Katheizen" MAP 0x81A207 KfAxUbAyUbSstxUbSstyUbWUb 1.992 fak_ub_b2 0.00 1.992 FORMAT "%5.3"
 /begin AXIS_DESCR STD_AXIS nmot nmot_ub_q40 8 0.00 10200. FORMAT "%5.0" DEPOSIT ABSOLUTE /end AXIS_DESCR
 /begin AXIS_DESCR STD_AXIS rl rel_ub_q0p75 8 0.00 191.3 FORMAT "%5.1" DEPOSIT ABSOLUTE /end AXIS_DESCR
/end CHARACTERISTIC
/begin CHARACTERISTIC KFLMSKH "Kennfeld Lambda-Motor-Soll bei Katheizen" MAP 0x81A259 KfAxUbAyUbSstxUbSstyUbWUb 1.992 fak_ub_b2 0.00 1.992 FORMAT "%5.3"
 /begin AXIS_DESCR STD_AXIS nmot nmot_ub_q40 8 0.00 10200. FORMAT "%5.0" DEPOSIT ABSOLUTE /end AXIS_DESCR
 /begin AXIS_DESCR STD_AXIS rl rel_ub_q0p75 8 0.00 191.3 FORMAT "%5.1" DEPOSIT ABSOLUTE /end AXIS_DESCR
/end CHARACTERISTIC
/begin CHARACTERISTIC KFLMSKH2 "Kennfeld Lambda Motor-Soll, ohne Kat" MAP 0x81A2AB KfAxUbAyUbSstxUbSstyUbWUb 1.992 fak_ub_b2 0.00 1.992 FORMAT "%5.3"
 /begin AXIS_DESCR STD_AXIS nmot nmot_ub_q40 8 0.00 10200. FORMAT "%5.0" DEPOSIT ABSOLUTE /end AXIS_DESCR
 /begin AXIS_DESCR STD_AXIS rl rel_ub_q0p75 8 0.00 191.3 FORMAT "%5.1" DEPOSIT ABSOLUTE /end AXIS_DESCR
/end CHARACTERISTIC
/begin CHARACTERISTIC KFMIOP "Kennfeld optimales Motormoment" MAP 0x812C60 GkfWUw 99.99847 rel_uw_b100 0.00 99.99847 FORMAT "%8.5"
 /begin AXIS_DESCR COM_AXIS nmot_w nmot_uw_q0p25 16 0.00 16383.75 AXIS_PTS_REF SNM16OPUW /end AXIS_DESCR
 /begin AXIS_DESCR COM_AXIS rl_w_kge rel_uw_q0p0234 16 0.00 1535.977 AXIS_PTS_REF SRL11OPUW /end AXIS_DESCR
/end CHARACTERISTIC
/begin CHARACTERISTIC KFMRES "LLR: Basis Momentenreserve im LL und ll-nahem Bereich" MAP 0x811D3D GkfWUb 24.90 rel_ub_b24p9 0.00 24.90 FORMAT "%5.2"
 /begin AXIS_DESCR COM_AXIS dns nmotd_sb_q10 6 -1280. 1270. AXIS_PTS_REF SNS06LLSB /end AXIS_DESCR
 /begin AXIS_DESCR COM_AXIS tmot temp_ub_q0p75_o48 4 -48.00 143.3 AXIS_PTS_REF STM04SAUB /end AXIS_DESCR
/end CHARACTERISTIC
/begin CHARACTERISTIC KFMRESFS "LLR: Basis Momentenreserve im LL und LL-nahem Bereich bei B_fs=1" MAP 0x811D55 GkfWUb 24.90 rel_ub_b24p9 0.00 24.90 FORMAT "%5.2"
 /begin AXIS_DESCR COM_AXIS dns nmotd_sb_q10 6 -1280. 1270. AXIS_PTS_REF SNS06LLSB /end AXIS_DESCR
 /begin AXIS_DESCR COM_AXIS tmot temp_ub_q0p75_o48 4 -48.00 143.3 AXIS_PTS_REF STM04SAUB /end AXIS_DESCR
/end CHARACTERISTIC
/begin CHARACTERISTIC KFRI "I - Kennfeld" MAP 0x81A501 GkfWUb 77.82 fak_ub_b77p81 0.00 77.82 FORMAT "%5.2"
 /begin AXIS_DESCR COM_AXIS nmot nmot_ub_q40 7 0.00 10200. AXIS_PTS_REF SNM07LRUB /end AXIS_DESCR
 /begin AXIS_DESCR COM_AXIS rl rel_ub_q0p75 6 0.00 191.3 AXIS_PTS_REF SRL06LRUB /end AXIS_DESCR
/end CHARACTERISTIC
/begin CHARACTERISTIC KFRI2 "LR-I-Kennfeld für Bank 2" MAP 0x81A52B GkfWUb 77.82 fak_ub_b77p81 0.00 77.82 FORMAT "%5.2"
 /begin AXIS_DESCR COM_AXIS nmot nmot_ub_q40 7 0.00 10200. AXIS_PTS_REF SNM07LRUB /end AXIS_DESCR
 /begin AXIS_DESCR COM_AXIS rl rel_ub_q0p75 6 0.00 191.3 AXIS_PTS_REF SRL06LRUB /end AXIS_DESCR
/end CHARACTERISTIC
/begin CHARACTERISTIC KFRP "P - Kennfeld" MAP 0x81A555 GkfWUb 9.766 fak_ub_b12p45 0.00 9.766 FORMAT "%5.3"
 /begin AXIS_DESCR COM_AXIS nmot nmot_ub_q40 7 0.00 10200. AXIS_PTS_REF SNM07LRUB /end AXIS_DESCR
 /begin AXIS_DESCR COM_AXIS rl rel_ub_q0p75 6 0.00 191.3 AXIS_PTS_REF SRL06LRUB /end AXIS_DESCR
/end CHARACTERISTIC
/begin CHARACTERISTIC KFRP2 "LR-P-Kennfeld für rechten Abgasstrang" MAP 0x81A57F GkfWUb 9.766 fak_ub_b12p45 0.00 9.766 FORMAT "%5.3"
 /begin AXIS_DESCR COM_AXIS nmot nmot_ub_q40 7 0.00 10200. AXIS_PTS_REF SNM07LRUB /end AXIS_DESCR
 /begin AXIS_DESCR COM_AXIS rl rel_ub_q0p75 6 0.00 191.3 AXIS_PTS_REF SRL06LRUB /end AXIS_DESCR
/end CHARACTERISTIC
/begin CHARACTERISTIC KFRTV "TV - Kennfeld (Lambdaregelung Reglerumschaltverzögerung)" MAP 0x81A5A9 GkfWSb 2.550 t10msxs_sb_q0p01 -1.280 1.270 FORMAT "%5.3"
 /begin AXIS_DESCR COM_AXIS nmot nmot_ub_q40 7 0.00 10200. AXIS_PTS_REF SNM07LRUB /end AXIS_DESCR
 /begin AXIS_DESCR COM_AXIS rl rel_ub_q0p75 6 0.00 191.3 AXIS_PTS_REF SRL06LRUB /end AXIS_DESCR
/end CHARACTERISTIC
/begin CHARACTERISTIC KFRTV2 "TV - Kennfeld (Lambdaregelung Reglerumschaltverzögerung) Bank2" MAP 0x81A5D3 GkfWSb 2.550 t10msxs_sb_q0p01 -1.280 1.270 FORMAT "%5.3"
 /begin AXIS_DESCR COM_AXIS nmot nmot_ub_q40 7 0.00 10200. AXIS_PTS_REF SNM07LRUB /end AXIS_DESCR
 /begin AXIS_DESCR COM_AXIS rl rel_ub_q0p75 6 0.00 191.3 AXIS_PTS_REF SRL06LRUB /end AXIS_DESCR
/end CHARACTERISTIC
/begin CHARACTERISTIC KFUSHK "Sondenspannungssollwert für Regelung hinter Kat. (statt KFUSRHK für Variantenk.)" MAP 0x81A684 GkfWUb 1.330 spg_ub_q0p0052_o0p2 -0.2000 1.130 FORMAT "%5.3"
 /begin AXIS_DESCR COM_AXIS nmot nmot_ub_q40 6 0.00 10200. AXIS_PTS_REF SNM06LHUB /end AXIS_DESCR
 /begin AXIS_DESCR COM_AXIS rl rel_ub_q0p75 6 0.00 191.3 AXIS_PTS_REF SRL06LHUB /end AXIS_DESCR
/end CHARACTERISTIC
/begin CHARACTERISTIC KFUSHK2 "Sondenspannungssollwert für Regelung hinter Kat. Bank2" MAP 0x81A6A8 GkfWUb 1.330 spg_ub_q0p0052_o0p2 -0.2000 1.130 FORMAT "%5.3"
 /begin AXIS_DESCR COM_AXIS nmot nmot_ub_q40 6 0.00 10200. AXIS_PTS_REF SNM06LHUB /end AXIS_DESCR
 /begin AXIS_DESCR COM_AXIS rl rel_ub_q0p75 6 0.00 191.3 AXIS_PTS_REF SRL06LHUB /end AXIS_DESCR
/end CHARACTERISTIC
/begin CHARACTERISTIC KFZWOP "optimaler Zündwinkel" MAP 0x810220 GkfWSb 191.3 zw_sb_q0p75 -96.00 95.25 FORMAT "%5.2"
 /begin AXIS_DESCR COM_AXIS nmot_w nmot_uw_q0p25 16 0.00 16383.75 AXIS_PTS_REF SNM16OPUW /end AXIS_DESCR
 /begin AXIS_DESCR COM_AXIS rl_w_kge rel_uw_q0p0234 16 0.00 1535.977 AXIS_PTS_REF SRL11OPUW /end AXIS_DESCR
/end CHARACTERISTIC
/begin CHARACTERISTIC KFZWOP2 "optimaler Zündwinkel Variante 2" MAP 0x810320 GkfWSb 191.3 zw_sb_q0p75 -96.00 95.25 FORMAT "%5.2"
 /begin AXIS_DESCR COM_AXIS nmot_w nmot_uw_q0p25 16 0.00 16383.75 AXIS_PTS_REF SNM16OPUW /end AXIS_DESCR
 /begin AXIS_DESCR COM_AXIS rl_w_kge rel_uw_q0p0234 16 0.00 1535.977 AXIS_PTS_REF SRL11OPUW /end AXIS_DESCR
/end CHARACTERISTIC
/begin CHARACTERISTIC KNSNF "Sperrband für Solldrehzahlnachführung" VALUE 0x811D79 KwUb 2550. nmot_ub_q10 0.00 2550. FORMAT "%5.0" /end CHARACTERISTIC
/begin CHARACTERISTIC KRAL1N "Klopfregeladaption Lastbereich 1" CURVE 0x8191D9 GklWUb 191.3 rel_ub_q0p75 0.00 191.3 FORMAT "%5.1"
 /begin AXIS_DESCR COM_AXIS nmot nmot_ub_q40 16 0.00 10200. AXIS_PTS_REF SNM16KRUB /end AXIS_DESCR
/end CHARACTERISTIC
/begin CHARACTERISTIC KRAL2N "Klopfregeladaption Lastbereich 2" CURVE 0x8191E9 GklWUb 191.3 rel_ub_q0p75 0.00 191.3 FORMAT "%5.1"
 /begin AXIS_DESCR COM_AXIS nmot nmot_ub_q40 16 0.00 10200. AXIS_PTS_REF SNM16KRUB /end AXIS_DESCR
/end CHARACTERISTIC
/begin CHARACTERISTIC KRALH "Klopfregeladaption Lasthysterese" VALUE 0x810046 KwUb 191.3 rel_ub_q0p75 0.00 191.3 FORMAT "%5.1" /end CHARACTERISTIC
/begin CHARACTERISTIC KRAN1 "Klopfregeladaption Drehzahlbereich, Stützstelle 1" VALUE 0x810047 KwUb 10200. nmot_ub_q40 0.00 10200. FORMAT "%5.0" /end CHARACTERISTIC
/begin CHARACTERISTIC KRAN2 "Klopfregeladaption Drehzahlbereich, Stützstelle 2" VALUE 0x810048 KwUb 10200. nmot_ub_q40 0.00 10200. FORMAT "%5.0" /end CHARACTERISTIC
/begin CHARACTERISTIC KRAN3 "Klopfregeladaption Drehzahlbereich, Stützstelle 3" VALUE 0x810049 KwUb 10200. nmot_ub_q40 0.00 10200. FORMAT "%5.0" /end CHARACTERISTIC
/begin CHARACTERISTIC KRAN4 "Klopfregeladaption Drehzahlbereich, Stützstelle 4" VALUE 0x81004A KwUb 10200. nmot_ub_q40 0.00 10200. FORMAT "%5.0" /end CHARACTERISTIC
/begin CHARACTERISTIC KRANH "Klopfregeladaption Drehzahlhysterese" VALUE 0x81004B KwUb 10200. nmot_ub_q40 0.00 10200. FORMAT "%5.0" /end CHARACTERISTIC
/begin CHARACTERISTIC KRDWA "Klopfregelung Differenz aktueller ZW zu Adaptionskennfeld" VALUE 0x81004C KwUb 191.3 zw_ub_q0p75 0.00 191.3 FORMAT "%5.1" /end CHARACTERISTIC
/begin CHARACTERISTIC KRDWSN "Klopfregelung delta - Winkel Sicherheit" CURVE 0x8191F9 GklWUb 191.3 zw_ub_qn0p75 -191.3 0.00 FORMAT "%5.1"
 /begin AXIS_DESCR COM_AXIS nmot nmot_ub_q40 16 0.00 10200. AXIS_PTS_REF SNM16KRUB /end AXIS_DESCR
/end CHARACTERISTIC
/begin CHARACTERISTIC KRFKN "Spätverstellung pro Klopfereignis" CURVE 0x819209 GklWUb 191.3 zw_ub_qn0p75 -191.3 0.00 FORMAT "%5.1"
 /begin AXIS_DESCR COM_AXIS nmot nmot_ub_q40 16 0.00 10200. AXIS_PTS_REF SNM16KRUB /end AXIS_DESCR
/end CHARACTERISTIC
/begin CHARACTERISTIC KRFTP1 "Tiefpassverhalten normal" VALUE 0x810036 KwUb 24.00 dez 8.000 32.00 FORMAT "%5.2" /end CHARACTERISTIC
/begin CHARACTERISTIC KRFTP2 "Tiefpassverhalten bei Drehzahldynamik" VALUE 0x810037 KwUb 14.00 dez 2.000 16.00 FORMAT "%5.2" /end CHARACTERISTIC
/begin CHARACTERISTIC KRFTP3 "Tiefpassverhalten bei Lastdynamik" VALUE 0x810038 KwUb 14.00 dez 2.000 16.00 FORMAT "%5.2" /end CHARACTERISTIC
/begin CHARACTERISTIC KRKFKS "Zuordnung der Kloperkennungskennlinie bei fehlender Zyl.-1-Erkennung" VALUE 0x810039 KwUb 255.0 dez 0.00 255.0 FORMAT "%5.1" /end CHARACTERISTIC
/begin CHARACTERISTIC KRLMDY "Lesen bei Lastbereichswechsel: immer oder nur bei Dynamik" VALUE 0x81004D KwUb 1.000 dez 0.00 1.000 FORMAT "%5.3" /end CHARACTERISTIC
/begin CHARACTERISTIC KRNMDY "Lesen bei Drehzahlbereichswechsel: immer oder nur bei Dynamik" VALUE 0x81004E KwUb 1.000 dez 0.00 1.000 FORMAT "%5.3" /end CHARACTERISTIC
/begin CHARACTERISTIC KRVFN "Anz. Zünd./Zyl., bzw. Zeitangabe von Frühverst. zu Frühverst. (Stufenbreite-KR)" CURVE 0x819219 GklWUb 254.0 dez 1.000 255.0 FORMAT "%5.1"
 /begin AXIS_DESCR COM_AXIS nmot nmot_ub_q40 16 0.00 10200. AXIS_PTS_REF SNM16KRUB /end AXIS_DESCR
/end CHARACTERISTIC
/begin CHARACTERISTIC KRVFSN "Anzahl Zündungen/Zyl., oder Zeitangabe für schnelle Frühverstellung der KR" CURVE 0x819229 GklWUb 254.0 dez 1.000 255.0 FORMAT "%5.1"
 /begin AXIS_DESCR COM_AXIS nmot nmot_ub_q40 16 0.00 10200. AXIS_PTS_REF SNM16KRUB /end AXIS_DESCR
/end CHARACTERISTIC
/begin CHARACTERISTIC KRVST "Verstärkung nach Start" VALUE 0x81003A KwUb 6.000 dez 0.00 6.000 FORMAT "%5.3" /end CHARACTERISTIC
/begin CHARACTERISTIC KRWKRUM "Speichern bei Klopfen: Wert vor oder nach Klopfen" VALUE 0x81004F KwUb 1.000 dez 0.00 1.000 FORMAT "%5.3" /end CHARACTERISTIC
/begin CHARACTERISTIC KSZA "Anzahl Klopfsensoren" VALUE 0x81003B KwUb 3.000 dez 1.000 4.000 FORMAT "%5.3" /end CHARACTERISTIC
/begin CHARACTERISTIC LALIUSH "Lambdalinearisierung, Sonde hinter Katalysator" CURVE 0x81761E KlAUwSstUwWUw 15.99976 fak_uw_b16 0.00 15.99976 FORMAT "%8.5"
 /begin AXIS_DESCR STD_AXIS ushk_w spg_uw_q0p00488_o1 10 -1.000000 318.9951 FORMAT "%8.4" DEPOSIT ABSOLUTE /end AXIS_DESCR
/end CHARACTERISTIC
/begin CHARACTERISTIC LALIUSH2 "Lambdalinearisierung, Sonde hinter Katalysator, Bank 2" CURVE 0x817648 KlAUwSstUwWUw 15.99976 fak_uw_b16 0.00 15.99976 FORMAT "%8.5"
 /begin AXIS_DESCR STD_AXIS ushk2_w spg_uw_q0p00488_o1 10 -1.000000 318.9951 FORMAT "%8.4" DEPOSIT ABSOLUTE /end AXIS_DESCR
/end CHARACTERISTIC
/begin CHARACTERISTIC LALIUSRH "Lambdalinearisierung, Sonde hinter Katalysator, Sollwert" CURVE 0x817672 KlAUbSstUbWUw 15.99976 fak_uw_b16 0.00 15.99976 FORMAT "%8.5"
 /begin AXIS_DESCR STD_AXIS usrhk spg_ub_q0p0052_o0p2 10 -0.2000 1.130 FORMAT "%5.3" DEPOSIT ABSOLUTE /end AXIS_DESCR
/end CHARACTERISTIC
/begin CHARACTERISTIC LALIUSRH2 "Lambdalinearisierung, Sonde hinter Katalysator, Sollwert Bank2" CURVE 0x817692 KlAUbSstUbWUw 15.99976 fak_uw_b16 0.00 15.99976 FORMAT "%8.5"
 /begin AXIS_DESCR STD_AXIS usrhk2 spg_ub_q0p0052_o0p2 10 -0.2000 1.130 FORMAT "%5.3" DEPOSIT ABSOLUTE /end AXIS_DESCR
/end CHARACTERISTIC
/begin CHARACTERISTIC LAMFAVL "Lambdawunsch Vollast" CURVE 0x81A04F KlAUbSstUbWUb 1.992 fak_ub_b2 0.00 1.992 FORMAT "%5.3"
 /begin AXIS_DESCR STD_AXIS nmot nmot_ub_q40 16 0.00 10200. FORMAT "%5.0" DEPOSIT ABSOLUTE /end AXIS_DESCR
/end CHARACTERISTIC
/begin CHARACTERISTIC LAMKAML "Lambdasollwert für Katalysator-Ausräumen (luftmassenabhängig)" CURVE 0x81BB10 GklWUw 15.99976 fak_uw_b16 0.00 15.99976 FORMAT "%8.5" /begin AXIS_DESCR COM_AXIS ml m_ub_b1020 5 0.00 1020. AXIS_PTS_REF SML05LKUB /end AXIS_DESCR /end CHARACTERISTIC
/begin CHARACTERISTIC LAMKAML2 "Lambdasollwert für Katalysator-Ausräumen (luftmassenabhängig), Bank 2" CURVE 0x81BB1A GklWUw 15.99976 fak_uw_b16 0.00 15.99976 FORMAT "%8.5" /begin AXIS_DESCR COM_AXIS ml m_ub_b1020 5 0.00 1020. AXIS_PTS_REF SML05LKUB /end AXIS_DESCR /end CHARACTERISTIC
/begin CHARACTERISTIC LAMLGF "Laufgrenze ""fett""" VALUE 0x811D2D KwUb 1.992 fak_ub_b2 0.00 1.992 FORMAT "%5.3" /end CHARACTERISTIC
/begin CHARACTERISTIC LAMLGMTM "Laufgrenze ""mager""" CURVE 0x81A072 GklWUb 1.992 fak_ub_b2 0.00 1.992 FORMAT "%5.3"
 /begin AXIS_DESCR COM_AXIS tmot temp_ub_q0p75_o48 12 -48.00 143.3 AXIS_PTS_REF STM12ESUB /end AXIS_DESCR
/end CHARACTERISTIC
/begin CHARACTERISTIC LAMSOSOF "Lambdasonde Soll Obergrenze für 1.0-Fenster" VALUE 0x815BF0 KwUw 15.99976 fak_uw_b16 0.00 15.99976 FORMAT "%8.5" /end CHARACTERISTIC
/begin CHARACTERISTIC LAMSOSUF "Lambdasonde Soll Untergrenze für 1.0-Fenster" VALUE 0x815BF2 KwUw 15.99976 fak_uw_b16 0.00 15.99976 FORMAT "%8.5" /end CHARACTERISTIC
/begin CHARACTERISTIC LASDSLA "Lambda-Abgas-Soll bei Sekundärluftadaption/Kurztest" CURVE 0x81A2FD KlAUbSstUbWUb 1.992 fak_ub_b2 0.00 1.992 FORMAT "%5.3"
 /begin AXIS_DESCR STD_AXIS ml m_ub_b1020 4 0.00 1020. FORMAT "%5.0" DEPOSIT ABSOLUTE /end AXIS_DESCR
/end CHARACTERISTIC
/begin CHARACTERISTIC LASHKAB "Startwert für dynamische Sollwertanhebung (lamsolh) in der LRHK" VALUE 0x8176B2 KwSw 0.9999695 fak_sw_b1 0.00 0.9999695 FORMAT "%9.7" /end CHARACTERISTIC
/begin CHARACTERISTIC LASOAB "Lambdasollwert bei Bankabschaltung" VALUE 0x811D2E KwUb 1.992 fak_ub_b2 0.00 1.992 FORMAT "%5.3" /end CHARACTERISTIC
/begin CHARACTERISTIC LASTMOT "Motortemp.-Korrektur von Lambda-Abgas-Soll" CURVE 0x81A306 KlAUbSstUbWUb 1.992 fak_ub_b2 0.00 1.992 FORMAT "%5.3"
 /begin AXIS_DESCR STD_AXIS tmot temp_ub_q0p75_o48 4 -48.00 143.3 FORMAT "%5.1" DEPOSIT ABSOLUTE /end AXIS_DESCR
/end CHARACTERISTIC
/begin CHARACTERISTIC LIMN "Untere Integratorbegrenzung bei stehendem Fahrzeug" VALUE 0x811DDB KwUb 24.90 rel_ub_bn24p9 -24.90 0.00 FORMAT "%5.2" /end CHARACTERISTIC
/begin CHARACTERISTIC LIMNDLLR "Untere Integratorbegrenzung bei Diagnose Leerlaufregelung" VALUE 0x811DDC KwUb 24.90 rel_ub_bn24p9 -24.90 0.00 FORMAT "%5.2" /end CHARACTERISTIC
/begin CHARACTERISTIC LIMNDTES "Untere Integratorbegrenzung bei DTES" VALUE 0x811DDD KwUb 24.90 rel_ub_bn24p9 -24.90 0.00 FORMAT "%5.2" /end CHARACTERISTIC
/begin CHARACTERISTIC LIMNV "Untere Integratorbegrenzung bei rollendem Fahrzeug" VALUE 0x811DDE KwUb 24.90 rel_ub_bn24p9 -24.90 0.00 FORMAT "%5.2" /end CHARACTERISTIC
/begin CHARACTERISTIC LIMX "Obere Integratorbegrenzung bei stehendem Fahrzeug" VALUE 0x811DDF KwUb 24.90 rel_ub_b24p9 0.00 24.90 FORMAT "%5.2" /end CHARACTERISTIC
/begin CHARACTERISTIC LIMXV "Obere Integratorbegrenzung bei rollendem Fahrzeug" VALUE 0x811DE0 KwUb 24.90 rel_ub_b24p9 0.00 24.90 FORMAT "%5.2" /end CHARACTERISTIC
/begin CHARACTERISTIC LISTM "Wert des Leerlaufintegrators im Start" CURVE 0x81A37A GklWUb 24.90 rel_ub_b24p9 0.00 24.90 FORMAT "%5.2"
 /begin AXIS_DESCR COM_AXIS tmot temp_ub_q0p75_o48 6 -48.00 143.3 AXIS_PTS_REF STM06LLUB /end AXIS_DESCR
/end CHARACTERISTIC
/begin CHARACTERISTIC LKRN "Lastschwelle Klopfregelung" CURVE 0x819239 GklWUb 191.3 rel_ub_q0p75 0.00 191.3 FORMAT "%5.1"
 /begin AXIS_DESCR COM_AXIS nmot nmot_ub_q40 16 0.00 10200. AXIS_PTS_REF SNM16KRUB /end AXIS_DESCR
/end CHARACTERISTIC
/begin CHARACTERISTIC LLRICNF "Configurationsbyte für LLR Integrator" VALUE 0x811DE1 KwUb 255.0 dez 0.00 255.0 FORMAT "%5.1" /end CHARACTERISTIC
/begin CHARACTERISTIC LMSTMOT "Motortemp.-Korrektur von Lambda-Motor-Soll" CURVE 0x81A30F KlAUbSstUbWUb 1.992 fak_ub_b2 0.00 1.992 FORMAT "%5.3"
 /begin AXIS_DESCR STD_AXIS tmot temp_ub_q0p75_o48 4 -48.00 143.3 FORMAT "%5.1" DEPOSIT ABSOLUTE /end AXIS_DESCR
/end CHARACTERISTIC
/begin CHARACTERISTIC LMSTMOT2 "Motortemp.-Korrektur von Lambda-Motor-Soll, ohne Kat" CURVE 0x81A318 KlAUbSstUbWUb 1.992 fak_ub_b2 0.00 1.992 FORMAT "%5.3"
 /begin AXIS_DESCR STD_AXIS tmot temp_ub_q0p75_o48 4 -48.00 143.3 FORMAT "%5.1" DEPOSIT ABSOLUTE /end AXIS_DESCR
/end CHARACTERISTIC
/begin CHARACTERISTIC MLNKAX "Luftmassenschwelle für Einschaltbereitschaft LRSHK I-Anteil" VALUE 0x8176B4 KwUw 7281.667 m_uw_b7281 0.00 7281.667 FORMAT "%8.3" /end CHARACTERISTIC
/begin CHARACTERISTIC MLO1 "obere Luftmengenschwelle Bereich 1" VALUE 0x81A996 KwUw 6553.500 m_uw_b6553p5 0.00 6553.500 FORMAT "%8.3" /end CHARACTERISTIC
/begin CHARACTERISTIC MLO2 "obere Luftmengenschwelle Bereich 2" VALUE 0x81427C KwUw 6553.500 m_uw_b6553p5 0.00 6553.500 FORMAT "%8.3" /end CHARACTERISTIC
/begin CHARACTERISTIC MLO3 "obere Luftmengenschwelle Bereich 3" VALUE 0x81A998 KwUw 6553.500 m_uw_b6553p5 0.00 6553.500 FORMAT "%8.3" /end CHARACTERISTIC
/begin CHARACTERISTIC MLU2 "untere Luftmengenschwelle Bereich 2" VALUE 0x81A99A KwUw 6553.500 m_uw_b6553p5 0.00 6553.500 FORMAT "%8.3" /end CHARACTERISTIC
/begin CHARACTERISTIC MLU4 "untere Luftmengenschwelle Bereich 4" VALUE 0x81427E KwUw 6553.500 m_uw_b6553p5 0.00 6553.500 FORMAT "%8.3" /end CHARACTERISTIC
/begin CHARACTERISTIC MRESFSM "LLR: Erhöhte Momentenreserve im LL nach einlegen der Fahrstufe" CURVE 0x811D6D GklWUb 24.90 rel_ub_b24p9 0.00 24.90 FORMAT "%5.2"
 /begin AXIS_DESCR COM_AXIS tmot temp_ub_q0p75_o48 4 -48.00 143.3 AXIS_PTS_REF STM04SAUB /end AXIS_DESCR
/end CHARACTERISTIC
/begin CHARACTERISTIC MRESLLM "LLR: Erhöhte Momentenreserve im LL nach Drehzahleinbruch" CURVE 0x811D71 GklWUb 24.90 rel_ub_b24p9 0.00 24.90 FORMAT "%5.2"
 /begin AXIS_DESCR COM_AXIS tmot temp_ub_q0p75_o48 4 -48.00 143.3 AXIS_PTS_REF STM04SAUB /end AXIS_DESCR
/end CHARACTERISTIC
/begin CHARACTERISTIC MRESTEV "Momentenreserve bei TEV-Drehzahlcheck" VALUE 0x811D75 KwSb 24.90 rel_sb_q0p0976 -12.50 12.40 FORMAT "%5.2" /end CHARACTERISTIC
/begin CHARACTERISTIC N0 "Umrechnungskonstante für Einrechnung Gemischkorrektur rkat" VALUE 0x81007E KwUb 10200. nmot_ub_q40 0.00 10200. FORMAT "%5.0" /end CHARACTERISTIC
/begin CHARACTERISTIC NDSU "Differenzdrehzahl für Integratorreset" VALUE 0x815CBC KwSw 8191.750 nmotd_sw_q0p25 0.00 8191.750 FORMAT "%8.3" /end CHARACTERISTIC
/begin CHARACTERISTIC NFHZ "Solldrehzahl bei eingeschalteter Frontscheibenheizung" VALUE 0x811D7A KwUb 2550. nmot_ub_q10 0.00 2550. FORMAT "%5.0" /end CHARACTERISTIC
/begin CHARACTERISTIC NFHZFS "Solldrehzahl bei eingeschalteter Frontscheibenheizung und B_fs=1" VALUE 0x811D7B KwUb 2550. nmot_ub_q10 0.00 2550. FORMAT "%5.0" /end CHARACTERISTIC
/begin CHARACTERISTIC NFSACVMN "Einstellbare Solldrehzahl bei AC und FS Minimum" VALUE 0x81A332 KwSb 2550. nmotd_sb_q10 -1280. 1270. FORMAT "%5.0" /end CHARACTERISTIC
/begin CHARACTERISTIC NFSACVMX "Einstellbare Solldrehzahl bei AC und FS Maximum" VALUE 0x81A333 KwSb 2550. nmotd_sb_q10 -1280. 1270. FORMAT "%5.0" /end CHARACTERISTIC
/begin CHARACTERISTIC NFSLRM "Solldrehzahl Fahrstufenschalter und Low Range ein" CURVE 0x81A34F GklWUb 2550. nmot_ub_q10 0.00 2550. FORMAT "%5.0"
 /begin AXIS_DESCR COM_AXIS tmot temp_ub_q0p75_o48 6 -48.00 143.3 AXIS_PTS_REF STM06LLUB /end AXIS_DESCR
/end CHARACTERISTIC
/begin CHARACTERISTIC NFSM "Solldrehzahl Fahrstufenschalter ein" CURVE 0x81A355 GklWUb 2550. nmot_ub_q10 0.00 2550. FORMAT "%5.0"
 /begin AXIS_DESCR COM_AXIS tmot temp_ub_q0p75_o48 6 -48.00 143.3 AXIS_PTS_REF STM06LLUB /end AXIS_DESCR
/end CHARACTERISTIC
/begin CHARACTERISTIC NFSMVMN "Einstellbare Solldrehzahl Minimum bei FS" VALUE 0x81A334 KwSb 2550. nmotd_sb_q10 -1280. 1270. FORMAT "%5.0" /end CHARACTERISTIC
/begin CHARACTERISTIC NFSMVMX "Einstellbare Solldrehzahl Maximum bei FS" VALUE 0x81A335 KwSb 2550. nmotd_sb_q10 -1280. 1270. FORMAT "%5.0" /end CHARACTERISTIC
/begin CHARACTERISTIC NGKRWN "Schwellwert Drehzahlgradient für Dynamikerkennung" CURVE 0x81A886 GklWSw 12773.60 nmotg_sw_q0p39 0.00 12773.60 FORMAT "%8.2"
 /begin AXIS_DESCR COM_AXIS nmot nmot_ub_q40 16 0.00 10200. AXIS_PTS_REF SNM16KRUB /end AXIS_DESCR
/end CHARACTERISTIC
/begin CHARACTERISTIC NGNSNF "Drehzahlgradientenschwelle zur Auslösung der Drehzahlnachführung" VALUE 0x811D7C KwUb 25500. nmotg_ub_q100 0.00 25500. FORMAT "%5.0" /end CHARACTERISTIC
/begin CHARACTERISTIC NKRF "Drehzahlschwelle für Klopfregelfreigabe" VALUE 0x810050 KwUb 10200. nmot_ub_q40 0.00 10200. FORMAT "%5.0" /end CHARACTERISTIC
/begin CHARACTERISTIC NKRFA "Drehzahlschwelle für Klopfregeladaptionsfreigabe" VALUE 0x810051 KwUb 10200. nmot_ub_q40 0.00 10200. FORMAT "%5.0" /end CHARACTERISTIC
/begin CHARACTERISTIC NKRUM "Drehzahlschwelle Umschalten Delta-Lastsignal für Lastdynamik" VALUE 0x81005C KwUb 10200. nmot_ub_q40 0.00 10200. FORMAT "%5.0" /end CHARACTERISTIC
/begin CHARACTERISTIC NLLM "Solldrehzahl" CURVE 0x81A35B GklWUb 2550. nmot_ub_q10 0.00 2550. FORMAT "%5.0"
 /begin AXIS_DESCR COM_AXIS tmot temp_ub_q0p75_o48 6 -48.00 143.3 AXIS_PTS_REF STM06LLUB /end AXIS_DESCR
/end CHARACTERISTIC
/begin CHARACTERISTIC NLLMVMN "Einstellbare LL-Solldrehzal Minimum" VALUE 0x81A336 KwSb 2550. nmotd_sb_q10 -1280. 1270. FORMAT "%5.0" /end CHARACTERISTIC
/begin CHARACTERISTIC NLLMVMX "Einstellbare LL-Solldrehzal Maximum" VALUE 0x81A337 KwSb 2550. nmotd_sb_q10 -1280. 1270. FORMAT "%5.0" /end CHARACTERISTIC
/begin CHARACTERISTIC NLRHO "obere Drehzahlgrenze für Regelung hinter Kat" VALUE 0x8127F9 KwUb 10200. nmot_ub_q40 0.00 10200. FORMAT "%5.0" /end CHARACTERISTIC
/begin CHARACTERISTIC NLRHU "untere Drehzahlgrenze für Regelung hinter Kat" VALUE 0x8127FA KwUb 10200. nmot_ub_q40 0.00 10200. FORMAT "%5.0" /end CHARACTERISTIC
/begin CHARACTERISTIC NLRKA "Drehzahlschwelle für Unterdrücken gesteuertes Kat-Ausräumen" VALUE 0x810070 KwUb 10200. nmot_ub_q40 0.00 10200. FORMAT "%5.0" /end CHARACTERISTIC
/begin CHARACTERISTIC NLRSHB "Drehzahlschwelle, Abschalten LR bei Schub, in Verbindung mit LL und TLLRSHB" VALUE 0x8127F1 KwUb 10200. nmot_ub_q40 0.00 10200. FORMAT "%5.0" /end CHARACTERISTIC
/begin CHARACTERISTIC NO1 "obere Drehzahlschwelle Bereich 1" VALUE 0x8193F0 KwUb 10200. nmot_ub_q40 0.00 10200. FORMAT "%5.0" /end CHARACTERISTIC
/begin CHARACTERISTIC NOLRA "Codewort für Adaptionsfreigabe" VALUE 0x8193F1 KwUb 255.0 dez 0.00 255.0 FORMAT "%5.1" /end CHARACTERISTIC
/begin CHARACTERISTIC NRKAB "Mindestdrehzahl für Begrenzung Stelleingriff rkat bei niedrigen Drehzahlen" VALUE 0x81007F KwUb 10200. nmot_ub_q40 0.00 10200. FORMAT "%5.0" /end CHARACTERISTIC
/begin CHARACTERISTIC NSAC "Solldrehzahl bei Klimaanlage ein (S_AC = 1)" VALUE 0x811D7D KwUb 2550. nmot_ub_q10 0.00 2550. FORMAT "%5.0" /end CHARACTERISTIC
/begin CHARACTERISTIC NSACFS "Solldrehzahl bei Klimaanlage ein (S_AC = 1) und eingelegter Fahrstufe (S_fs=1)" VALUE 0x811D7E KwUb 2550. nmot_ub_q10 0.00 2550. FORMAT "%5.0" /end CHARACTERISTIC
/begin CHARACTERISTIC NSACMVMN "Einstellbare LL-Solldrehzal Minimum bei AC" VALUE 0x81A338 KwSb 2550. nmotd_sb_q10 -1280. 1270. FORMAT "%5.0" /end CHARACTERISTIC
/begin CHARACTERISTIC NSACMVMX "Einstellbare LL-Solldrehzal Maximum bei AC" VALUE 0x81A339 KwSb 2550. nmotd_sb_q10 -1280. 1270. FORMAT "%5.0" /end CHARACTERISTIC
/begin CHARACTERISTIC NSLBVMN "Einstellbare LL-Solldrehzal Minimum bei Unterspannung" VALUE 0x81A33A KwSb 2550. nmotd_sb_q10 -1280. 1270. FORMAT "%5.0" /end CHARACTERISTIC
/begin CHARACTERISTIC NSLBVMX "Einstellbare LL-Solldrehzal Maximum bei Unterspannung" VALUE 0x81A33B KwSb 2550. nmotd_sb_q10 -1280. 1270. FORMAT "%5.0" /end CHARACTERISTIC
/begin CHARACTERISTIC NSLPP "Solldrehzahl abhängig vom Pumpendruck der Servolenkung" CURVE 0x81A361 KlAUbSstUbWUb 2550. nmot_ub_q10 0.00 2550. FORMAT "%5.0"
 /begin AXIS_DESCR STD_AXIS psl dez 4 0.00 255.0 FORMAT "%5.1" DEPOSIT ABSOLUTE /end AXIS_DESCR
/end CHARACTERISTIC
/begin CHARACTERISTIC NSLPPFS "Solldrehzahl abhängig vom Pumpendruck der Servolenkung bei B_fs=1" CURVE 0x81A36A KlAUbSstUbWUb 2550. nmot_ub_q10 0.00 2550. FORMAT "%5.0"
 /begin AXIS_DESCR STD_AXIS psl dez 4 0.00 255.0 FORMAT "%5.1" DEPOSIT ABSOLUTE /end AXIS_DESCR
/end CHARACTERISTIC
/begin CHARACTERISTIC NSLRM "Solldrehzahl für Low Range" CURVE 0x81A373 GklWUb 2550. nmot_ub_q10 0.00 2550. FORMAT "%5.0"
 /begin AXIS_DESCR COM_AXIS tmot temp_ub_q0p75_o48 6 -48.00 143.3 AXIS_PTS_REF STM06LLUB /end AXIS_DESCR
/end CHARACTERISTIC
/begin CHARACTERISTIC NSMNEGS "Soll-Drehzahlschwelle für Getriebesteuerung B_nsmin" VALUE 0x811D7F KwUb 2550. nmot_ub_q10 0.00 2550. FORMAT "%5.0" /end CHARACTERISTIC
/begin CHARACTERISTIC NSNOT "Solldrehzahlanhebung bei Drosselklappenfehler" VALUE 0x811D80 KwUb 2550. nmot_ub_q10 0.00 2550. FORMAT "%5.0" /end CHARACTERISTIC
/begin CHARACTERISTIC NSNOT1 "Solldrehzahlanhebung bei Notlauf" VALUE 0x811D81 KwUb 2550. nmot_ub_q10 0.00 2550. FORMAT "%5.0" /end CHARACTERISTIC
/begin CHARACTERISTIC NSNOT1FS "Solldrehzahlanhebung bei Notlauf und Fahrstufe EIN" VALUE 0x811D82 KwUb 2550. nmot_ub_q10 0.00 2550. FORMAT "%5.0" /end CHARACTERISTIC
/begin CHARACTERISTIC NSNOTFS "Solldrehzahlanhebung bei Pedalfehler" VALUE 0x811D83 KwUb 2550. nmot_ub_q10 0.00 2550. FORMAT "%5.0" /end CHARACTERISTIC
/begin CHARACTERISTIC NTEB "Angehobene Solldrehzahl bei stark beladenem AKF" VALUE 0x811D84 KwUb 2550. nmot_ub_q10 0.00 2550. FORMAT "%5.0" /end CHARACTERISTIC
/begin CHARACTERISTIC NTEBFS "Angehobene Solldrehzahl bei stark beladenem AKF und B_fs=1" VALUE 0x811D85 KwUb 2550. nmot_ub_q10 0.00 2550. FORMAT "%5.0" /end CHARACTERISTIC
/begin CHARACTERISTIC NU3 "untere Drehzahlschwelle Bereich 3" VALUE 0x8193F2 KwUb 10200. nmot_ub_q40 0.00 10200. FORMAT "%5.0" /end CHARACTERISTIC
/begin CHARACTERISTIC PLRHAV "Wichtungsfaktor des P-Anteils in der LRHK über KAT-Alterung" CURVE 0x8127FB KlAUbSstUbWUb 0.9961 fak_ub_b1 0.00 0.9961 /begin AXIS_DESCR STD_AXIS iavkatf fak_ub_b1 8 0.00 0.9961 DEPOSIT ABSOLUTE /end AXIS_DESCR /end CHARACTERISTIC
/begin CHARACTERISTIC PLRHAV2 "Wichtungsfaktor des P-Anteils in der LRHK über KAT-Alterung Bank 2" CURVE 0x81280C KlAUbSstUbWUb 0.9961 fak_ub_b1 0.00 0.9961 /begin AXIS_DESCR STD_AXIS avkatf2 fak_ub_b1 8 0.00 0.9961 DEPOSIT ABSOLUTE /end AXIS_DESCR /end CHARACTERISTIC
/begin CHARACTERISTIC PLRHML "P-Anteil LRHK, wirkt zusammen mit gewichteter Sondenspannungsdiff. hinter KAT" CURVE 0x81A6CC GklWSb 2.550 t100msxs_sb_q0p01 -1.280 1.270 FORMAT "%5.3" /begin AXIS_DESCR COM_AXIS ml m_ub_b1020 8 0.00 1020. AXIS_PTS_REF SML08LHUB /end AXIS_DESCR /end CHARACTERISTIC
/begin CHARACTERISTIC PLRHML2 "P-Anteil LRHK, wirkt zusammen mit gewichteter Sondenspannungsdiff. h.KAT Bank2" CURVE 0x81A6D4 GklWSb 2.550 t100msxs_sb_q0p01 -1.280 1.270 FORMAT "%5.3" /begin AXIS_DESCR COM_AXIS ml m_ub_b1020 8 0.00 1020. AXIS_PTS_REF SML08LHUB /end AXIS_DESCR /end CHARACTERISTIC
/begin CHARACTERISTIC PVDN "LLR: P-Verstärkung bei stehendem Fahrzeug" CURVE 0x811DE2 GklWUb 0.7782 rel_ub_b0p78 0.00 0.7782
 /begin AXIS_DESCR COM_AXIS dn_w nmotd_sw_q0p25 8 -8192.000 8191.750 AXIS_PTS_REF SDN08LLSW /end AXIS_DESCR
/end CHARACTERISTIC
/begin CHARACTERISTIC PVDNV "LLR: P-Verstärkung bei rollendem Fahrzeug" CURVE 0x811DEA GklWUb 0.7782 rel_ub_b0p78 0.00 0.7782
 /begin AXIS_DESCR COM_AXIS dn_w nmotd_sw_q0p25 8 -8192.000 8191.750 AXIS_PTS_REF SDN08LLSW /end AXIS_DESCR
/end CHARACTERISTIC
/begin CHARACTERISTIC PVDNVZ "LLR: P-Zündungsanteilverstärkung bei rollendem Fzg." CURVE 0x811DF2 GklWUb 0.7782 rel_ub_b0p78 0.00 0.7782
 /begin AXIS_DESCR COM_AXIS dn_w nmotd_sw_q0p25 8 -8192.000 8191.750 AXIS_PTS_REF SDN08LLSW /end AXIS_DESCR
/end CHARACTERISTIC
/begin CHARACTERISTIC PVDNZ "LLR: P-Zündungsanteilverstärkung bei stehendem Fzg." CURVE 0x811DFA GklWUb 0.7782 rel_ub_b0p78 0.00 0.7782
 /begin AXIS_DESCR COM_AXIS dn_w nmotd_sw_q0p25 8 -8192.000 8191.750 AXIS_PTS_REF SDN08LLSW /end AXIS_DESCR
/end CHARACTERISTIC
/begin CHARACTERISTIC PZWKRA "Prozentuale Häufigkeit der ZW-Ausgabe durch die KR während Dynamikadaption" VALUE 0x81005D KwUb 99.61 rel_ub_b99p6 0.00 99.61 FORMAT "%5.2" /end CHARACTERISTIC
/begin CHARACTERISTIC QUFRMN "minimaler fri-Quotient für Stationärbedingung Lambdaregler" VALUE 0x814276 KwUw 1.999969 fak_uw_b2 0.00 1.999969 FORMAT "%8.6" /end CHARACTERISTIC
/begin CHARACTERISTIC QUFRMX "maximaler fri-Quotient für Stationärbedingung Lambdaregler" VALUE 0x814278 KwUw 1.999969 fak_uw_b2 0.00 1.999969 FORMAT "%8.6" /end CHARACTERISTIC
/begin CHARACTERISTIC REFINI "Startwert Referenzpegel bei Klopfregelung aktiv" VALUE 0x81003C KwUb 0.7227 spg_ub_b5 0.2930 1.016 FORMAT "%5.3" /end CHARACTERISTIC
/begin CHARACTERISTIC RKATMN "untere Schwelle additive Korrektur pro Zeit" VALUE 0x81A99C KwSw 3071.953 rel_sw_b1536 -1536.000 1535.953 FORMAT "%8.3" /end CHARACTERISTIC
/begin CHARACTERISTIC RKATMX "obere Schwelle additive Korrektur pro Zeit" VALUE 0x81A99E KwSw 3071.953 rel_sw_b1536 -1536.000 1535.953 FORMAT "%8.3" /end CHARACTERISTIC
/begin CHARACTERISTIC RKATRN "reduzierte untere Schwelle additive Korrektur pro Zeit" VALUE 0x81A9A0 KwSw 3071.953 rel_sw_b1536 -1536.000 1535.953 FORMAT "%8.3" /end CHARACTERISTIC
/begin CHARACTERISTIC RKATRX "reduzierte obere Schwelle additive Korrektur pro Zeit" VALUE 0x81A9A2 KwSw 3071.953 rel_sw_b1536 -1536.000 1535.953 FORMAT "%8.3" /end CHARACTERISTIC
/begin CHARACTERISTIC RKAZMN "untere Schwelle additive Korrektur pro Zündung" VALUE 0x81A9A4 KwSw 3071.953 rel_sw_b1536 -1536.000 1535.953 FORMAT "%8.3" /end CHARACTERISTIC
/begin CHARACTERISTIC RKAZMX "obere Schwelle additive Korrektur pro Zündung" VALUE 0x81A9A6 KwSw 3071.953 rel_sw_b1536 -1536.000 1535.953 FORMAT "%8.3" /end CHARACTERISTIC
/begin CHARACTERISTIC RKAZRN "reduzierte untere Schwelle additive Korrektur pro Zündung" VALUE 0x81A9A8 KwSw 3071.953 rel_sw_b1536 -1536.000 1535.953 FORMAT "%8.3" /end CHARACTERISTIC
/begin CHARACTERISTIC RKAZRX "reduzierte obere Schwelle additive Korrektur pro Zündung" VALUE 0x81A9AA KwSw 3071.953 rel_sw_b1536 -1536.000 1535.953 FORMAT "%8.3" /end CHARACTERISTIC
/begin CHARACTERISTIC RKRMX1N "Maximaler Referenzpegel für Klopferkennungsschwelle Zyl.-gruppe 1" CURVE 0x819164 GklWUb 317.500 spg_ub_b320 1.25000 318.750
 /begin AXIS_DESCR COM_AXIS nmot nmot_ub_q40 16 0.00 10200. AXIS_PTS_REF SNM16KRUB /end AXIS_DESCR
/end CHARACTERISTIC
/begin CHARACTERISTIC RKRMX2N "Maximaler Referenzpegel für Klopferkennungsschwelle Zyl.-gruppe 2" CURVE 0x819174 GklWUb 317.500 spg_ub_b320 1.25000 318.750
 /begin AXIS_DESCR COM_AXIS nmot nmot_ub_q40 16 0.00 10200. AXIS_PTS_REF SNM16KRUB /end AXIS_DESCR
/end CHARACTERISTIC
/begin CHARACTERISTIC RLLRHON "Kennlinie über nmot, obere rL Regelgrenze für Regler hinter KAT" CURVE 0x81A6DC GklWUb 191.3 rel_ub_q0p75 0.00 191.3 FORMAT "%5.1"
 /begin AXIS_DESCR COM_AXIS nmot nmot_ub_q40 8 0.00 10200. AXIS_PTS_REF SNM08LHUB /end AXIS_DESCR
/end CHARACTERISTIC
/begin CHARACTERISTIC RLLRHUN "Kennlinie über nmot, untere rL Regelgrenze für Regler hinter KAT" CURVE 0x81A6E4 GklWUb 191.3 rel_ub_q0p75 0.00 191.3 FORMAT "%5.1"
 /begin AXIS_DESCR COM_AXIS nmot nmot_ub_q40 8 0.00 10200. AXIS_PTS_REF SNM08LHUB /end AXIS_DESCR
/end CHARACTERISTIC
/begin CHARACTERISTIC RLLRSHB "relative Lastschwelle, Abschalten LR bei SLS, in Verbindung mit LL und NLRSHB" VALUE 0x8127F2 KwUb 191.3 rel_ub_q0p75 0.00 191.3 FORMAT "%5.1" /end CHARACTERISTIC
/begin CHARACTERISTIC RLLRUN "Kennlinie über nmot, untere rL Regelgrenze für Regler vor KAT" CURVE 0x81A600 KlAUbSstUbWUb 191.3 rel_ub_q0p75 0.00 191.3 FORMAT "%5.1"
 /begin AXIS_DESCR STD_AXIS nmot nmot_ub_q40 8 0.00 10200. FORMAT "%5.0" DEPOSIT ABSOLUTE /end AXIS_DESCR
/end CHARACTERISTIC
/begin CHARACTERISTIC RLO2 "obere Lastschwelle Bereich 2" VALUE 0x8193F3 KwUb 191.3 rel_ub_q0p75 0.00 191.3 FORMAT "%5.1" /end CHARACTERISTIC
/begin CHARACTERISTIC RLO3 "obere rl - Schwelle Bereich 3" VALUE 0x8193F4 KwUb 191.3 rel_ub_q0p75 0.00 191.3 FORMAT "%5.1" /end CHARACTERISTIC
/begin CHARACTERISTIC RLRAN "Lastschwelle Lambdaregelung" CURVE 0x81A611 KlAUbSstUbWUb 191.3 rel_ub_q0p75 0.00 191.3 FORMAT "%5.1"
 /begin AXIS_DESCR STD_AXIS nmot nmot_ub_q40 8 0.00 10200. FORMAT "%5.0" DEPOSIT ABSOLUTE /end AXIS_DESCR
/end CHARACTERISTIC
/begin CHARACTERISTIC RLRVAO "obere rL - Schwelle für Auslösen Sperre LR bei VA" VALUE 0x81A622 KwUb 191.3 rel_ub_q0p75 0.00 191.3 FORMAT "%5.1" /end CHARACTERISTIC
/begin CHARACTERISTIC RLU2 "untere rl - Schwelle Bereich 2" VALUE 0x8193F5 KwUb 191.3 rel_ub_q0p75 0.00 191.3 FORMAT "%5.1" /end CHARACTERISTIC
/begin CHARACTERISTIC RLU3 "untere rl - Schwelle Bereich 3" VALUE 0x8193F6 KwUb 191.3 rel_ub_q0p75 0.00 191.3 FORMAT "%5.1" /end CHARACTERISTIC
/begin CHARACTERISTIC RLU4 "untere rl -Schwelle oberer multiplikativer Bereich" VALUE 0x8193F7 KwUb 191.3 rel_ub_q0p75 0.00 191.3 FORMAT "%5.1" /end CHARACTERISTIC
/begin AXIS_PTS SDN08LLSW "Stützstellenvert., Solldrehzahlabw., 08 Sst., LL-Regel." 0x815CBE dn_w SstASwSstSw 16383.75 nmotd_sw_q0p25 8 -8192.000 8191.750 FORMAT "%8.3" DEPOSIT ABSOLUTE /end AXIS_PTS
/begin AXIS_PTS SML05LKUB "5 Stützstellen für ?" 0x811927 ml SstAUbSstUb 1020. m_ub_b1020 5 0.00 1020. FORMAT "%5.0" DEPOSIT ABSOLUTE /end AXIS_PTS
/begin AXIS_PTS SML08LHUB "ml abhängige Stützstellen (Anzahl 8)" 0x8196C0 ml SstAUbSstUb 1020. m_ub_b1020 8 0.00 1020. FORMAT "%5.0" DEPOSIT ABSOLUTE /end AXIS_PTS
/begin AXIS_PTS SNG06LLSB "Stützstellenverteilung Drehzahlgradient, 6 Sst." 0x81192D ngfil SstAUbSstSb 25500. nmotg_sb_q100 6 -12800. 12700. FORMAT "%5.0" DEPOSIT ABSOLUTE /end AXIS_PTS
/begin AXIS_PTS SNM06LHUB "6 Stützstellen Drehzahl für ?" 0x8196CF nmot SstAUbSstUb 10200. nmot_ub_q40 6 0.00 10200. FORMAT "%5.0" DEPOSIT ABSOLUTE /end AXIS_PTS
/begin AXIS_PTS SNM06LLUB "Sützstellenverteilung für Motordrehzahl" 0x81193A nmot SstAUbSstUb 10200. nmot_ub_q40 6 0.00 10200. FORMAT "%5.0" DEPOSIT ABSOLUTE /end AXIS_PTS
/begin AXIS_PTS SNM07LRUB "Drehzahlstützstellen für Lambdaregelung" 0x811941 nmot SstAUbSstUb 10200. nmot_ub_q40 7 0.00 10200. FORMAT "%5.0" DEPOSIT ABSOLUTE /end AXIS_PTS
/begin AXIS_PTS SNM08KRUW "Stützstellenverteilung Drehzahl, 8 Sst." 0x81AAFA nmot_w SstAUwSstUw 16383.75 nmot_uw_q0p25 8 0.00 16383.75 FORMAT "%8.2" DEPOSIT ABSOLUTE /end AXIS_PTS
/begin AXIS_PTS SNM08LHUB "nmot abhängige Stützstellen (Anzahl 8)" 0x8196DE nmot SstAUbSstUb 10200. nmot_ub_q40 8 0.00 10200. FORMAT "%5.0" DEPOSIT ABSOLUTE /end AXIS_PTS
/begin AXIS_PTS SNM16KRUB "Stützstellenverteilung Drehzahl, 16 Sst." 0x8196F2 nmot SstAUbSstUb 10200. nmot_ub_q40 16 0.00 10200. FORMAT "%5.0" DEPOSIT ABSOLUTE /end AXIS_PTS
/begin AXIS_PTS SNM16OPUW "Stützstellenverteilung Drehzahl" 0x815686 nmot_w SstAUwSstUw 16383.75 nmot_uw_q0p25 16 0.00 16383.75 FORMAT "%8.2" DEPOSIT ABSOLUTE /end AXIS_PTS
/begin AXIS_PTS SNS06LLSB "Stützstellenvert., Solldrehzahlabw., 06 Sst., LL-Regel." 0x811D86 dns SstAUbSstSb 2550. nmotd_sb_q10 6 -1280. 1270. FORMAT "%5.0" DEPOSIT ABSOLUTE /end AXIS_PTS
/begin AXIS_PTS SRL06LHUB "6 Füllungsstützstellen für ?" 0x8119E3 rl SstAUbSstUb 191.3 rel_ub_q0p75 6 0.00 191.3 FORMAT "%5.1" DEPOSIT ABSOLUTE /end AXIS_PTS
/begin AXIS_PTS SRL06LRUB "6 Füllungsstützstellen für ?" 0x8119EA rl SstAUbSstUb 191.3 rel_ub_q0p75 6 0.00 191.3 FORMAT "%5.1" DEPOSIT ABSOLUTE /end AXIS_PTS
/begin AXIS_PTS SRL11OPUW "Stützstellenverteilung relative Luftfüllung" 0x812E60 rl_w_kge SstAUwSstUw 1535.977 rel_uw_q0p0234 16 0.00 1535.977 FORMAT "%8.3" DEPOSIT ABSOLUTE /end AXIS_PTS
/begin CHARACTERISTIC STKRLDY "Stützstellengrenzwert für KR-Adaption bei Lastdynamik" VALUE 0x810052 KwUb 255.0 dez 0.00 255.0 FORMAT "%5.1" /end CHARACTERISTIC
/begin CHARACTERISTIC STKRNDY "Stützstellengrenzwert für KR-Adaption bei Drehzahldynamik" VALUE 0x810053 KwUb 255.0 dez 0.00 255.0 FORMAT "%5.1" /end CHARACTERISTIC
/begin AXIS_PTS STM04SAUB "Stützstellenverteilung Motortemperatur, 4 Sst." 0x811A2E tmot SstAUbSstUb 191.3 temp_ub_q0p75_o48 4 -48.00 143.3 FORMAT "%5.1" DEPOSIT ABSOLUTE /end AXIS_PTS
/begin AXIS_PTS STM06LLUB "Stützstellenverteilung Motortemperatur, 6 Sst." 0x819747 tmot SstAUbSstUb 191.3 temp_ub_q0p75_o48 6 -48.00 143.3 FORMAT "%5.1" DEPOSIT ABSOLUTE /end AXIS_PTS
/begin AXIS_PTS STM08LEUB "8 Motortemperaturstützstellen für ?" 0x81975E tmot SstAUbSstUb 191.3 temp_ub_q0p75_o48 8 -48.00 143.3 FORMAT "%5.1" DEPOSIT ABSOLUTE /end AXIS_PTS
/begin AXIS_PTS STM12ESUB "SST-Verteilung für die Motortemperatur tmot" 0x81977A tmot SstAUbSstUb 191.3 temp_ub_q0p75_o48 12 -48.00 143.3 FORMAT "%5.1" DEPOSIT ABSOLUTE /end AXIS_PTS
/begin AXIS_PTS SWD06KRSW "Stützstellenverteilung DK-Winkel, 6 Sst." 0x81AB26 wdkba_w SstASwSstSw 1599.976 relDK_q0p02441 6 -800.0000 799.9756 FORMAT "%8.4" DEPOSIT ABSOLUTE /end AXIS_PTS
/begin CHARACTERISTIC TARA "Temperaturschwelle Ansaugluft" VALUE 0x811D2F KwUb 191.3 temp_ub_q0p75_o48 -48.00 143.3 FORMAT "%5.1" /end CHARACTERISTIC
/begin CHARACTERISTIC TARAU "Ansauglufttemperaturschwelle für Einschalten der Lambda - Regelung" VALUE 0x81A623 KwUb 191.3 temp_ub_q0p75_o48 -48.00 143.3 FORMAT "%5.1" /end CHARACTERISTIC
/begin CHARACTERISTIC TASHS "Schwelle Ansauglufttemp. für Auslösung TLRHS - Sperrzeit LR bei Heißstart" VALUE 0x81A624 KwUb 191.3 temp_ub_q0p75_o48 -48.00 143.3 FORMAT "%5.1" /end CHARACTERISTIC
/begin CHARACTERISTIC TBLRH "Sperrzeit für Regelung hinter Kat nach Freigabe durch Regelung vor Kat" VALUE 0x81281D KwUb 25.40 t100msxs_ub_b25p5 0.1000 25.50 FORMAT "%5.2" /end CHARACTERISTIC
/begin CHARACTERISTIC TBLRH2 "Sperrzeit für Regelung hinter Kat nach Freigabe durch Regelung vor Kat Bank 2" VALUE 0x81281E KwUb 25.40 t100msxs_ub_b25p5 0.1000 25.50 FORMAT "%5.2" /end CHARACTERISTIC
/begin CHARACTERISTIC TDFRKAD "Absteuerzeit für gesteuertes Katalysator-Ausräumen" VALUE 0x8176FC KwUw 1309.98001 zk20msxs_uw_b1310 0.0199893187 1310.00000 FORMAT "%10.5" /end CHARACTERISTIC
/begin CHARACTERISTIC TDFRKAU "Aufsteuerzeit für gesteuertes Katalysator-Ausräumen" VALUE 0x8176FE KwUw 1309.98001 zk20msxs_uw_b1310 0.0199893187 1310.00000 FORMAT "%10.5" /end CHARACTERISTIC
/begin CHARACTERISTIC TDMRESLL "Sperrzeit für die erhöhte Momentenreserve nach dem Start" VALUE 0x81A33F KwUb 51.00 t200msxs_ub_b51 0.00 51.00 FORMAT "%5.2" /end CHARACTERISTIC
/begin CHARACTERISTIC TKATMLRH "Einschaltschwelle Kat-Modelltemperatur  für Lambdaregelung hinter Kat" VALUE 0x81281F KwUb 1275. temp_ub_q5_o50 -50.00 1225. FORMAT "%5.0" /end CHARACTERISTIC
/begin CHARACTERISTIC TKATMLRH2 "Einschaltschwelle Kat-Modelltemperatur  für Lambdaregelung hinter Kat, Bank 2" VALUE 0x812820 KwUb 1275. temp_ub_q5_o50 -50.00 1225. FORMAT "%5.0" /end CHARACTERISTIC
/begin CHARACTERISTIC TLAFA "Vezögerungszeit bis Lambda Fahrerwunsch aktiv" VALUE 0x81A070 KwUb 25.50 t100msxs_ub_b25p5 0.00 25.50 FORMAT "%5.2" /end CHARACTERISTIC
/begin CHARACTERISTIC TLRBAM "Sperrzeit für Einschalten LR nach BA" CURVE 0x81A625 GklWUb 25.50 t100msxs_ub_b25p5 0.00 25.50 FORMAT "%5.2"
 /begin AXIS_DESCR COM_AXIS tmot temp_ub_q0p75_o48 8 -48.00 143.3 AXIS_PTS_REF STM08LEUB /end AXIS_DESCR
/end CHARACTERISTIC
/begin CHARACTERISTIC TLRHS "Sperrzeit LR bei Heißstart, ausgelöst über Schwellen TASHS und TMSHS" VALUE 0x81A62D KwUb 25.50 t100msxs_ub_b25p5 0.00 25.50 FORMAT "%5.2" /end CHARACTERISTIC
/begin CHARACTERISTIC TLRSIGN "Zeitkonstante für PT1-Filter zur Unterdrückung von elektr. Störungen auf usvk" VALUE 0x8127D1 KwUb 2.54996 zk10msxs_ub_b2p56 0.0100392 2.56000 FORMAT "%7.5" /end CHARACTERISTIC
/begin CHARACTERISTIC TLRTMS "Sperrzeit LR nach Start, abhängig von der Motortemperatur bei Start" CURVE 0x817600 KlAUbSstUbWUw 6553.500 t100msxs_uw_b6553p5 0.00 6553.500 FORMAT "%8.3"
 /begin AXIS_DESCR STD_AXIS tmst temp_ub_q0p75_o48 5 -48.00 143.3 FORMAT "%5.1" DEPOSIT ABSOLUTE /end AXIS_DESCR
/end CHARACTERISTIC
/begin CHARACTERISTIC TLRVAM "Sperrzeit für Einschalten LR nach VA" CURVE 0x81A62E GklWUb 25.50 t100msxs_ub_b25p5 0.00 25.50 FORMAT "%5.2"
 /begin AXIS_DESCR COM_AXIS tmot temp_ub_q0p75_o48 8 -48.00 143.3 AXIS_PTS_REF STM08LEUB /end AXIS_DESCR
/end CHARACTERISTIC
/begin CHARACTERISTIC TLRZWTMS "Zeit für Zwangseinschaltung LR (CARB-Forderung) nach Start" CURVE 0x817610 KlAUbSstUbWUw 6553.500 t100msxs_uw_b6553p5 0.00 6553.500 FORMAT "%8.3"
 /begin AXIS_DESCR STD_AXIS tmst temp_ub_q0p75_o48 4 -48.00 143.3 FORMAT "%5.1" DEPOSIT ABSOLUTE /end AXIS_DESCR
/end CHARACTERISTIC
/begin CHARACTERISTIC TMDYNA "TMOT - Schwelle für Lastdynamikadaption aktiv" VALUE 0x81005E KwUb 191.3 temp_ub_q0p75_o48 -48.00 143.3 FORMAT "%5.1" /end CHARACTERISTIC
/begin CHARACTERISTIC TMKR "Motortemperaturschwelle für Klopfregelung aktiv" VALUE 0x819249 KwUb 191.3 temp_ub_q0p75_o48 -48.00 143.3 FORMAT "%5.1" /end CHARACTERISTIC
/begin CHARACTERISTIC TMKRAN "Motortemperaturschwelle für adaptive Klopfregelung" CURVE 0x8109E9 KlAUbSstUbWUb 191.3 temp_ub_q0p75_o48 -48.00 143.3 FORMAT "%5.1"
 /begin AXIS_DESCR STD_AXIS nmot nmot_ub_q40 4 0.00 10200. FORMAT "%5.0" DEPOSIT ABSOLUTE /end AXIS_DESCR
/end CHARACTERISTIC
/begin CHARACTERISTIC TMLLRNS "Motortemperaturschwelle für Solldrehzahlverstellung über Tester" VALUE 0x81A33C KwUb 191.3 temp_ub_q0p75_o48 -48.00 143.3 FORMAT "%5.1" /end CHARACTERISTIC
/begin CHARACTERISTIC TMNV "Temperaturschwelle für DS2-Nsoll-Verstellung bei FS=0" VALUE 0x81A33D KwUb 191.3 temp_ub_q0p75_o48 -48.00 143.3 FORMAT "%5.1" /end CHARACTERISTIC
/begin CHARACTERISTIC TMNVFS "Temperaturschwelle für DS2-Nsoll-Verstellung bei FS=1" VALUE 0x81A33E KwUb 191.3 temp_ub_q0p75_o48 -48.00 143.3 FORMAT "%5.1" /end CHARACTERISTIC
/begin CHARACTERISTIC TMRA1 "Ausschaltbedingung (S_LL = 0)" VALUE 0x81A636 KwUb 191.3 temp_ub_q0p75_o48 -48.00 143.3 FORMAT "%5.1" /end CHARACTERISTIC
/begin CHARACTERISTIC TMRA2 "Ausschaltbedingung (S_LL = 1)" VALUE 0x81A637 KwUb 191.3 temp_ub_q0p75_o48 -48.00 143.3 FORMAT "%5.1" /end CHARACTERISTIC
/begin CHARACTERISTIC TMRAA "Einschalttemperatur LRA" VALUE 0x811D30 KwUb 191.3 temp_ub_q0p75_o48 -48.00 143.3 FORMAT "%5.1" /end CHARACTERISTIC
/begin CHARACTERISTIC TMRAK "Ausschaltschwelle der Lambda - Regelung bei niedriger Starttemperatur" VALUE 0x81A638 KwUb 191.3 temp_ub_q0p75_o48 -48.00 143.3 FORMAT "%5.1" /end CHARACTERISTIC
/begin CHARACTERISTIC TMSHS "Schwelle Motortemp. für Auslösung TLRHS - Sperrzeit LR bei Heißstart" VALUE 0x81A639 KwUb 191.3 temp_ub_q0p75_o48 -48.00 143.3 FORMAT "%5.1" /end CHARACTERISTIC
/begin CHARACTERISTIC TMVL "Motortemperaturschwelle für Vollasterkennung" VALUE 0x81A071 KwUb 191.3 temp_ub_q0p75_o48 -48.00 143.3 FORMAT "%5.1" /end CHARACTERISTIC
/begin CHARACTERISTIC TRAB "Überwachungszeit für Lastschwelle Lambdaregelung" VALUE 0x8127F3 KwUb 25.50 t100msxs_ub_b25p5 0.00 25.50 FORMAT "%5.2" /end CHARACTERISTIC
/begin CHARACTERISTIC TRAU "Überwachungszeit für untere Lastschwelle der Lambdaregelung" VALUE 0x81A63A KwUb 25.50 t100msxs_ub_b25p5 0.00 25.50 FORMAT "%5.2" /end CHARACTERISTIC
/begin CHARACTERISTIC TSAKAMN "Mindestdauer SA für Funktion Katalysator-Ausräumen" VALUE 0x810071 KwUb 5.100 t20msxs_ub_b5p1 0.00 5.100 FORMAT "%5.3" /end CHARACTERISTIC
/begin CHARACTERISTIC TSAKAMN2 "Mindestdauer SA für Funktion Katalysator-Ausräumen Bank2" VALUE 0x810072 KwUb 5.100 t20msxs_ub_b5p1 0.00 5.100 FORMAT "%5.3" /end CHARACTERISTIC
/begin CHARACTERISTIC TSBBVTMS "Verzögerung Einschalten LR nach Sondenbetriebsbereitschaft" CURVE 0x81BA02 KlAUbSstUbWUw 6553.500 t100msxs_uw_b6553p5 0.00 6553.500 FORMAT "%8.3"
 /begin AXIS_DESCR STD_AXIS tmst temp_ub_q0p75_o48 4 -48.00 143.3 FORMAT "%5.1" DEPOSIT ABSOLUTE /end AXIS_DESCR
/end CHARACTERISTIC
/begin CHARACTERISTIC TSPERN "Sperrzeit P-Sprung nach Sondensprung" CURVE 0x8127D2 KlAUbSstUbWUb 2.550 t10msxs_ub_b2p55 0.00 2.550 FORMAT "%5.3"
 /begin AXIS_DESCR STD_AXIS nmot nmot_ub_q40 7 0.00 10200. FORMAT "%5.0" DEPOSIT ABSOLUTE /end AXIS_DESCR
/end CHARACTERISTIC
/begin CHARACTERISTIC TSPERN2 "Sperrzeit P-Sprung nach Sondensprung, Bank 2" CURVE 0x8127E1 KlAUbSstUbWUb 2.550 t10msxs_ub_b2p55 0.00 2.550 FORMAT "%5.3"
 /begin AXIS_DESCR STD_AXIS nmot nmot_ub_q40 7 0.00 10200. FORMAT "%5.0" DEPOSIT ABSOLUTE /end AXIS_DESCR
/end CHARACTERISTIC
/begin CHARACTERISTIC TVDK "Verzögerungszeit nach Schließen der Drosselklappe" VALUE 0x811D36 KwUb 5.100 t20msxs_ub_b5p1 0.00 5.100 FORMAT "%5.3" /end CHARACTERISTIC
/begin CHARACTERISTIC TVKUPPL "Verzögerungszeit für die Information des Kupplungsschalter" VALUE 0x811D37 KwUb 5.100 t20msxs_ub_b5p1 0.00 5.100 FORMAT "%5.3" /end CHARACTERISTIC
/begin CHARACTERISTIC TVLISTUM "Verbotszeit für negativen Integratoranteil nach Start" CURVE 0x811E02 KlAUbSstUbWUb 5.100 t20msxs_ub_b5p1 0.00 5.100 FORMAT "%5.3"
 /begin AXIS_DESCR STD_AXIS tmot temp_ub_q0p75_o48 3 -48.00 143.3 FORMAT "%5.1" DEPOSIT ABSOLUTE /end AXIS_DESCR
/end CHARACTERISTIC
/begin CHARACTERISTIC TVLLRMRTEV "Verzögerungszeit MD-Reserve Wegnahme nach TEV-Drehzahlprü." VALUE 0x811D76 KwUb 51.00 t200msxs_ub_b51 0.00 51.00 FORMAT "%5.2" /end CHARACTERISTIC
/begin CHARACTERISTIC TVLRA "Verzögerungszeit für Aktivierung Gemischadaption nach Lambdaregelung aktiv" VALUE 0x811D31 KwUb 25.40 t100msxs_ub_b25p5 0.1000 25.50 FORMAT "%5.2" /end CHARACTERISTIC
/begin CHARACTERISTIC TVRESFS "Haltezeit für die erhöhte Momentenrerserve nach Einlegen der Fahrstufe" VALUE 0x81A340 KwUb 51.00 t200msxs_ub_b51 0.00 51.00 FORMAT "%5.2" /end CHARACTERISTIC
/begin CHARACTERISTIC TVRESLL "Haltezeit für die erhöhte Momentenrerserve nach Drehzahleinbruch" VALUE 0x81A341 KwUb 51.00 t200msxs_ub_b51 0.00 51.00 FORMAT "%5.2" /end CHARACTERISTIC
/begin CHARACTERISTIC ULRRND "Feinverschiebung der gefilterten Lambdasondenspannung bei Signalfehlerverdacht" VALUE 0x8127F0 KwUb 0.005195 spg_q20p374Em6 0.00 0.005195 FORMAT "%8.6" /end CHARACTERISTIC
/begin CHARACTERISTIC USHKAMN "Sondenspannung hinter Kat für Erkennung Kat ist mit O2 gefüllt" VALUE 0x810073 KwUb 1.330 spg_ub_q0p0052_o0p2 -0.2000 1.130 FORMAT "%5.3" /end CHARACTERISTIC
/begin CHARACTERISTIC USHKAMN2 "Sondenspannung hinter Kat für Erkennung Kat ist mit O2 gefüllt, Bank 2" VALUE 0x810074 KwUb 1.330 spg_ub_q0p0052_o0p2 -0.2000 1.130 FORMAT "%5.3" /end CHARACTERISTIC
/begin CHARACTERISTIC USHKAMX "Sondenspannung hinter Kat für Abbruch Kat-Ausräumen" VALUE 0x810075 KwUb 1.330 spg_ub_q0p0052_o0p2 -0.2000 1.130 FORMAT "%5.3" /end CHARACTERISTIC
/begin CHARACTERISTIC USHKAMX2 "Sondenspannung hinter Kat für Abbruch Kat-Ausräumen Bank2" VALUE 0x810076 KwUb 1.330 spg_ub_q0p0052_o0p2 -0.2000 1.130 FORMAT "%5.3" /end CHARACTERISTIC
/begin CHARACTERISTIC USRDUMMY "" VALUE 0x81007B KwUb 1.330 spg_ub_q0p0052_o0p2 -0.2000 1.130 FORMAT "%5.3" /end CHARACTERISTIC
/begin CHARACTERISTIC USVKAMX "Sondenspannung vor Kat für Erkennung Magerbedingung Kat-Ausräumen" VALUE 0x810077 KwUb 1.330 spg_ub_q0p0052_o0p2 -0.2000 1.130 FORMAT "%5.3" /end CHARACTERISTIC
/begin CHARACTERISTIC USVKAMX2 "Sondenspannung vor Kat für Abbruch Kat-Ausräumen, Bank 2" VALUE 0x810078 KwUb 1.330 spg_ub_q0p0052_o0p2 -0.2000 1.130 FORMAT "%5.3" /end CHARACTERISTIC
/begin CHARACTERISTIC VLLR "Fahrzeuggeschwindigkeitsschwelle für Leerlaufregelung" VALUE 0x811D38 KwUb 318.8 vfzg_ub_q1p25 0.00 318.8 FORMAT "%5.1" /end CHARACTERISTIC
/begin CHARACTERISTIC WDKARN "DK-Winkel-Schwelle für Gemischadaption aktiv" CURVE 0x81A07E KlAUbSstUbWUb 99.61 rel_ub_b99p6 0.00 99.61 FORMAT "%5.2"
 /begin AXIS_DESCR STD_AXIS nmot nmot_ub_q40 10 0.00 10200. FORMAT "%5.0" DEPOSIT ABSOLUTE /end AXIS_DESCR
/end CHARACTERISTIC
/begin CHARACTERISTIC ZDFR "Abregelfaktor Tiefpaß für Adaption Regelhub von fr" VALUE 0x81427A KwUw 0.9999847 fak_uw_b1 0.00 0.9999847 FORMAT "%9.7" /end CHARACTERISTIC
/begin CHARACTERISTIC ZFLASKH "Zeitkonstante für Übergang auf Lambda-Abgas-Vorgabe" VALUE 0x81A321 KwUb 25.4996 zk100msxs_ub_b25p5 0.100392 25.6000 FORMAT "%7.4" /end CHARACTERISTIC
/begin CHARACTERISTIC ZKFRAOA "Zeitkonstante für frao-Integrator, f(Anzahl Starts mit Ölverdünnung)" CURVE 0x81D11E KlAUwSstUwWUw 4.999924 zk200msxs_uw_b5 0.00 4.999924 FORMAT "%8.6"
 /begin AXIS_DESCR STD_AXIS abo dez 3 0.00 65535.00 FORMAT "%8.2" DEPOSIT ABSOLUTE /end AXIS_DESCR
/end CHARACTERISTIC
/begin CHARACTERISTIC ZKFRAUA "Zeitkonstante für frau-Integrator, f(Anzahl Stats mit Ölverdünnung)" CURVE 0x81D12C KlAUwSstUwWUw 4.999924 zk200msxs_uw_b5 0.00 4.999924 FORMAT "%8.6"
 /begin AXIS_DESCR STD_AXIS abo dez 3 0.00 65535.00 FORMAT "%8.2" DEPOSIT ABSOLUTE /end AXIS_DESCR
/end CHARACTERISTIC
/begin CHARACTERISTIC ZKLLRD "Zeitkonstante für die Abregelung des D-Anteils" VALUE 0x815CD0 KwUw 1309.98001 zk20msxs_uw_b1310 0.0199893187 1310.00000 FORMAT "%10.5" /end CHARACTERISTIC
/begin CHARACTERISTIC ZKLLRDZ "Zeitkonstante zum Abregeln des D-Zündungsanteils" VALUE 0x815CD2 KwUw 1309.98001 zk20msxs_uw_b1310 0.0199893187 1310.00000 FORMAT "%10.5" /end CHARACTERISTIC
/begin CHARACTERISTIC ZKNS "Zeitkonstante für Solldrehzahl bei Umschaltung" VALUE 0x811D8D KwUb 5.08000 zk20msxs_ub_b5p1 0.0200000 5.10000 FORMAT "%7.5" /end CHARACTERISTIC
/begin CHARACTERISTIC ZKRKATA "Integrationsgeschwindigkeit Integrator rkat, f(abo)" CURVE 0x81D13A KlAUwSstUwWUw 959.9854 zk200msxs_uw_b960 0.00 959.9854 FORMAT "%8.4"
 /begin AXIS_DESCR STD_AXIS abo dez 3 0.00 65535.00 FORMAT "%8.2" DEPOSIT ABSOLUTE /end AXIS_DESCR
/end CHARACTERISTIC
/begin CHARACTERISTIC ZKRKAZ "Integrationsgeschwindigkeit Integrator rkaz" VALUE 0x81A9AC KwUw 959.9854 zk200msxs_uw_b960 0.00 959.9854 FORMAT "%8.4" /end CHARACTERISTIC
/begin CHARACTERISTIC ZLASHKAB "Zeitkonstante für Abregelung der dyn. Sollwertanhebung (dlasohkab) rin der LRHK" VALUE 0x8176B6 KwUw 655.350000 zk10msxs_uw_b655 0.0100001526 655.360000 FORMAT "%10.6" /end CHARACTERISTIC
/begin CHARACTERISTIC ZLASOHML "Zeitkonstante für PT1-Filter des Pseudo-Lambda hinter Kat" CURVE 0x8176B8 KlAUwSstUwWUw 655.350000 zk10msxs_uw_b655 0.0100001526 655.360000 FORMAT "%10.6"
 /begin AXIS_DESCR STD_AXIS ml_w m_uw_b6553p5 8 0.00 6553.500 FORMAT "%8.3" DEPOSIT ABSOLUTE /end AXIS_DESCR
/end CHARACTERISTIC
/begin CHARACTERISTIC ZLASOHML2 "Zeitkonstante für PT1-Filter des Pseudo-Lambda hinter Kat, Bank 2" CURVE 0x8176DA KlAUwSstUwWUw 655.350000 zk10msxs_uw_b655 0.0100001526 655.360000 FORMAT "%10.6"
 /begin AXIS_DESCR STD_AXIS ml_w m_uw_b6553p5 8 0.00 6553.500 FORMAT "%8.3" DEPOSIT ABSOLUTE /end AXIS_DESCR
/end CHARACTERISTIC
/begin CHARACTERISTIC ZLIBG "Filterzeitkonstante für die Nachführung der Integratorgrenzen" VALUE 0x811E09 KwUb 5.08000 zk20msxs_ub_b5p1 0.0200000 5.10000 FORMAT "%7.5" /end CHARACTERISTIC
/begin CHARACTERISTIC ZLRFRI "Zeitkonstante zum Aufregeln des tmst abhängigen Gewichtungsfaktor FFRITMS" VALUE 0x81BA00 KwUw 6553.4999985 zk100msxs_uw_b655 0.10000152590 6553.6000000 FORMAT "%12.7" /end CHARACTERISTIC
/begin CHARACTERISTIC ZLRHML "Luftmassendurchsatz abhängige Zeitkonstante für Lambdaregler hinter Katalysator" CURVE 0x81A6EC GklWUb 9.961 tgrad_ub_q0p039 0.00 9.961 FORMAT "%5.3" /begin AXIS_DESCR COM_AXIS ml m_ub_b1020 8 0.00 1020. AXIS_PTS_REF SML08LHUB /end AXIS_DESCR /end CHARACTERISTIC
/begin CHARACTERISTIC ZLRHML2 "Luftmassendurchsatz abhängige Zeitkonstante für Lambdaregler h. Kat. Bank 2" CURVE 0x81A6F4 GklWUb 9.961 tgrad_ub_q0p039 0.00 9.961 FORMAT "%5.3" /begin AXIS_DESCR COM_AXIS ml m_ub_b1020 8 0.00 1020. AXIS_PTS_REF SML08LHUB /end AXIS_DESCR /end CHARACTERISTIC
/begin CHARACTERISTIC ZNGKR "Zeitkonstante Tiefpaß für Drehzahlgradient" VALUE 0x81425E KwUw 655.350000 zk10msxs_uw_b655 0.0100001526 655.360000 FORMAT "%10.6" /end CHARACTERISTIC
/begin CHARACTERISTIC ZNSM "Zeitkonstante für Solldrehzahlabregelung" CURVE 0x811D8E GklWUb 5.08000 zk20msxs_ub_b5p1 0.0200000 5.10000 FORMAT "%7.5"
 /begin AXIS_DESCR COM_AXIS tmot temp_ub_q0p75_o48 6 -48.00 143.3 AXIS_PTS_REF STM06LLUB /end AXIS_DESCR
/end CHARACTERISTIC
/begin CHARACTERISTIC ZNSUB "Zeitkonstante für Mindestsolldrehzahl bei Unterspannung" VALUE 0x81A379 KwUb 50.9992 zk200msxs_ub_b51p2 0.200784 51.2000 FORMAT "%7.4" /end CHARACTERISTIC
/begin CHARACTERISTIC ZYRKR "Zylinderzuordnung für maximale Referenzpegelbegrenzung Klopfregelung" VALUE 0x81003D KwUb 255.0 dez 0.00 255.0 FORMAT "%5.1" /end CHARACTERISTIC
/begin MEASUREMENT atv "aktueller Lernkennfeld-Integratorwert der Regelung hinter Kat" SBYTE t100msxs_sb_q0p01 1 100 -1.28 1.27 FORMAT "%5.3" ECU_ADDRESS 0x382FDC /end MEASUREMENT
/begin MEASUREMENT atv2 "aktueller Lernkennfeld-Integratorwert der Regelung hinter Kat Bank2" SBYTE t100msxs_sb_q0p01 1 100 -1.28 1.27 FORMAT "%5.3" ECU_ADDRESS 0x382FDD /end MEASUREMENT
/begin MEASUREMENT atvinii "Initialisierungswert für Integrator atv" SBYTE t100msxs_sb_q0p01 1 100 -1.28 1.27 FORMAT "%5.3" ECU_ADDRESS 0x380D85 /end MEASUREMENT
/begin MEASUREMENT atvinii2 "Initialisierungswert für Integrator atv, Bank 2" SBYTE t100msxs_sb_q0p01 1 100 -1.28 1.27 FORMAT "%5.3" ECU_ADDRESS 0x380D86 /end MEASUREMENT
/begin MEASUREMENT B_atvini "Bedingung Integrator atv initialisieren" UBYTE B_TRUE 1 100 0 1 BIT_MASK 0x1 FORMAT "%13.11" ECU_ADDRESS 0x380D8C /end MEASUREMENT
/begin MEASUREMENT B_atvini2 "Bedingung Integrator atv initialisieren, Bank 2" UBYTE B_TRUE 1 100 0 1 BIT_MASK 0x2 FORMAT "%13.11" ECU_ADDRESS 0x380D8C /end MEASUREMENT
/begin MEASUREMENT B_blrka "Bedingung gesteuertes Katalysator-Ausräumen angefordert" UWORD B_TRUE 1 100 0 1 BIT_MASK 0x8000 FORMAT "%13.11" ECU_ADDRESS 0xFD2E /end MEASUREMENT
/begin MEASUREMENT B_blrka2 "Bedingung gesteuertes Katalysator-Ausräumen angefordert, Bank 2" UWORD B_TRUE 1 100 0 1 BIT_MASK 0x1 FORMAT "%13.11" ECU_ADDRESS 0xFD30 /end MEASUREMENT
/begin MEASUREMENT B_bvdel "ODER-Verknüpfung der verzögerten Sperrbedingungen B_bag / B_vag" UWORD B_TRUE 1 100 0 1 BIT_MASK 0x4 FORMAT "%13.11" ECU_ADDRESS 0xFDD6 /end MEASUREMENT
/begin MEASUREMENT B_c95_g0 "Ansteuerung der Verstärkerstufe des CC195 (PIN G0)" UWORD B_TRUE 1 100 0 1 BIT_MASK 0x1 FORMAT "%13.11" ECU_ADDRESS 0xFD3C /end MEASUREMENT
/begin MEASUREMENT B_c95_g1 "Ansteuerung der Verstärkerstufe des CC195 (Pin G1)" UWORD B_TRUE 1 100 0 1 BIT_MASK 0x2 FORMAT "%13.11" ECU_ADDRESS 0xFD3C /end MEASUREMENT
/begin MEASUREMENT B_c95_g2 "Ansteuerung der Verstärkerstufe des CC195 (Pin G2)" UWORD B_TRUE 1 100 0 1 BIT_MASK 0x4 FORMAT "%13.11" ECU_ADDRESS 0xFD3C /end MEASUREMENT
/begin MEASUREMENT B_dfrf "Bedingung Anfettung in LR erkannt" UWORD B_TRUE 1 100 0 1 BIT_MASK 0x20 FORMAT "%13.11" ECU_ADDRESS 0xFD32 /end MEASUREMENT
/begin MEASUREMENT B_dfrf2 "Bedingung Anfettung in LR erkannt, Bank2" UWORD B_TRUE 1 100 0 1 BIT_MASK 0x40 FORMAT "%13.11" ECU_ADDRESS 0xFD32 /end MEASUREMENT
/begin MEASUREMENT B_dfrm "Bedingung Ausmagerung in LR erkannt" UWORD B_TRUE 1 100 0 1 BIT_MASK 0x80 FORMAT "%13.11" ECU_ADDRESS 0xFD32 /end MEASUREMENT
/begin MEASUREMENT B_dfrm2 "Bedingung Ausmagerung in LR erkannt, Bank2" UWORD B_TRUE 1 100 0 1 BIT_MASK 0x100 FORMAT "%13.11" ECU_ADDRESS 0xFD32 /end MEASUREMENT
/begin MEASUREMENT B_drlkrdy "Flag für n > NKRUM" UWORD B_TRUE 1 100 0 1 BIT_MASK 0x400 FORMAT "%13.11" ECU_ADDRESS 0xFD28 /end MEASUREMENT
/begin MEASUREMENT B_eobdlr "OBDII-Summenfehler. sperrt die LR" UWORD B_TRUE 1 100 0 1 BIT_MASK 0x8 FORMAT "%13.11" ECU_ADDRESS 0xFDD6 /end MEASUREMENT
/begin MEASUREMENT B_eobdlr2 "OBDII-Summenfehler. sperrt die LR, Bank 2" UWORD B_TRUE 1 100 0 1 BIT_MASK 0x10 FORMAT "%13.11" ECU_ADDRESS 0xFDD6 /end MEASUREMENT
/begin MEASUREMENT B_fallsa "Bedingung: Funktionsanforderung Drehzahländerung durch Tester aktiv" UWORD B_TRUE 1 100 0 1 BIT_MASK 0x2000 FORMAT "%13.11" ECU_ADDRESS 0xFD9A /end MEASUREMENT
/begin MEASUREMENT B_frab "Bedingung Regelfaktor fr außerhalb adaptierten Band" UWORD B_TRUE 1 100 0 1 BIT_MASK 0x200 FORMAT "%13.11" ECU_ADDRESS 0xFD32 /end MEASUREMENT
/begin MEASUREMENT B_frab2 "Bedingung Regelfaktor fr außerhalb adaptierten Band, Bank 2" UWORD B_TRUE 1 100 0 1 BIT_MASK 0x400 FORMAT "%13.11" ECU_ADDRESS 0xFD32 /end MEASUREMENT
/begin MEASUREMENT B_frao "Einschaltbedingung für Adaption von frao" UWORD B_TRUE 1 100 0 1 BIT_MASK 0x10 FORMAT "%13.11" ECU_ADDRESS 0xFD62 /end MEASUREMENT
/begin MEASUREMENT B_fraor "Bedingung frao-Integrator außerhalb reduzierter Bereich" UWORD B_TRUE 1 100 0 1 BIT_MASK 0x20 FORMAT "%13.11" ECU_ADDRESS 0xFD62 /end MEASUREMENT
/begin MEASUREMENT B_fraor2 "Bedingung frao2-Integrator außerhalb reduzierter Bereich" UWORD B_TRUE 1 100 0 1 BIT_MASK 0x40 FORMAT "%13.11" ECU_ADDRESS 0xFD62 /end MEASUREMENT
/begin MEASUREMENT B_frau "Einschaltbedingung für Adaption von frau" UWORD B_TRUE 1 100 0 1 BIT_MASK 0x80 FORMAT "%13.11" ECU_ADDRESS 0xFD62 /end MEASUREMENT
/begin MEASUREMENT B_fraur "Bedingung frau-Integrator außerhalb reduzierter Bereich" UWORD B_TRUE 1 100 0 1 BIT_MASK 0x100 FORMAT "%13.11" ECU_ADDRESS 0xFD62 /end MEASUREMENT
/begin MEASUREMENT B_fraur2 "Bedingung frau2-Integrator außerhalb reduzierter Bereich" UWORD B_TRUE 1 100 0 1 BIT_MASK 0x200 FORMAT "%13.11" ECU_ADDRESS 0xFD62 /end MEASUREMENT
/begin MEASUREMENT B_frini "Bedingung Regelfaktor fr initialisieren" UWORD B_TRUE 1 100 0 1 BIT_MASK 0x2000 FORMAT "%13.11" ECU_ADDRESS 0xFD2E /end MEASUREMENT
/begin MEASUREMENT B_frini2 "Bedingung Regelfaktor fr initialisieren, Bank 2" UWORD B_TRUE 1 100 0 1 BIT_MASK 0x4000 FORMAT "%13.11" ECU_ADDRESS 0xFD2E /end MEASUREMENT
/begin MEASUREMENT B_frmax "Lambda-Regelung setzt Bit sobald FR am Anschlag FRMAX" UWORD B_TRUE 1 100 0 1 BIT_MASK 0x800 FORMAT "%13.11" ECU_ADDRESS 0xFD32 /end MEASUREMENT
/begin MEASUREMENT B_frmax2 "Lambda-Regelung setzt Bit sobald FR am Anschlag FRMAX, Bank 2" UWORD B_TRUE 1 100 0 1 BIT_MASK 0x1000 FORMAT "%13.11" ECU_ADDRESS 0xFD32 /end MEASUREMENT
/begin MEASUREMENT B_frmin "Lambda-Regelung setzt Bit sobald FR am Anschlag FRMIN" UWORD B_TRUE 1 100 0 1 BIT_MASK 0x2000 FORMAT "%13.11" ECU_ADDRESS 0xFD32 /end MEASUREMENT
/begin MEASUREMENT B_frmin2 "Lambda-Regelung setzt Bit sobald FR am Anschlag FRMIN, Bank 2" UWORD B_TRUE 1 100 0 1 BIT_MASK 0x4000 FORMAT "%13.11" ECU_ADDRESS 0xFD32 /end MEASUREMENT
/begin MEASUREMENT B_frmini "Bildung fr-Mittelwert: Bed. Initialisieren von frm_w" UWORD B_TRUE 1 100 0 1 BIT_MASK 0x8000 FORMAT "%13.11" ECU_ADDRESS 0xFD32 /end MEASUREMENT
/begin MEASUREMENT B_frmini2 "Bildung fr-Mittelwert: Bed. Initialisieren von frm_w, Bank 2" UWORD B_TRUE 1 100 0 1 BIT_MASK 0x1 FORMAT "%13.11" ECU_ADDRESS 0xFD34 /end MEASUREMENT
/begin MEASUREMENT B_frsp "Bedingung Reglersprung" UWORD B_TRUE 1 100 0 1 BIT_MASK 0x2 FORMAT "%13.11" ECU_ADDRESS 0xFD34 /end MEASUREMENT
/begin MEASUREMENT B_frsp2 "Bedingung Reglersprung, Bank 2" UWORD B_TRUE 1 100 0 1 BIT_MASK 0x4 FORMAT "%13.11" ECU_ADDRESS 0xFD34 /end MEASUREMENT
/begin MEASUREMENT B_fslr "Bed. LR aktiv/inaktiv bei Fettschutz (lamsons_w < 1.0)" UWORD B_TRUE 1 100 0 1 BIT_MASK 0x20 FORMAT "%13.11" ECU_ADDRESS 0xFDD6 /end MEASUREMENT
/begin MEASUREMENT B_fslr2 "Bed. LR aktiv/inaktiv während Fettschutz (lamsons_w < 1.0), Bank 2" UWORD B_TRUE 1 100 0 1 BIT_MASK 0x40 FORMAT "%13.11" ECU_ADDRESS 0xFDD6 /end MEASUREMENT
/begin MEASUREMENT B_gasp "Bedingung Grundadaption gesperrt" UWORD B_TRUE 1 100 0 1 BIT_MASK 0x1 FORMAT "%13.11" ECU_ADDRESS 0xFD3A /end MEASUREMENT
/begin MEASUREMENT B_ilmlkat "Bedingung gültige Messung des Sauerstoffspeichers" UWORD B_TRUE 1 100 0 1 BIT_MASK 0x2 FORMAT "%13.11" ECU_ADDRESS 0xFD30 /end MEASUREMENT
/begin MEASUREMENT B_ilmlkat2 "Bedingung gültige Messung des Sauerstoffspeichers, Bank 2" UWORD B_TRUE 1 100 0 1 BIT_MASK 0x4 FORMAT "%13.11" ECU_ADDRESS 0xFD30 /end MEASUREMENT
/begin MEASUREMENT B_inifrm "Bildung fr-Mittelwert: Bed. Auswahl Initialisierungswert von frm_w" UWORD B_TRUE 1 100 0 1 BIT_MASK 0x8 FORMAT "%13.11" ECU_ADDRESS 0xFD34 /end MEASUREMENT
/begin MEASUREMENT B_inifrm2 "Bildung fr-Mittelwert: Bed. Auswahl Initialisierungswert von frm_w, Bank 2" UWORD B_TRUE 1 100 0 1 BIT_MASK 0x10 FORMAT "%13.11" ECU_ADDRESS 0xFD34 /end MEASUREMENT
/begin MEASUREMENT B_int "LR: Bedingung Integration erlaubt" UWORD B_TRUE 1 100 0 1 BIT_MASK 0x20 FORMAT "%13.11" ECU_ADDRESS 0xFD34 /end MEASUREMENT
/begin MEASUREMENT B_int2 "LR Bank2: Bedingung Integration erlaubt" UWORD B_TRUE 1 100 0 1 BIT_MASK 0x40 FORMAT "%13.11" ECU_ADDRESS 0xFD34 /end MEASUREMENT
/begin MEASUREMENT B_kawe "Faktor fwe aktiv während Kat-Ausräumen, Bank 1" UWORD B_TRUE 1 100 0 1 BIT_MASK 0x8 FORMAT "%13.11" ECU_ADDRESS 0xFD30 /end MEASUREMENT
/begin MEASUREMENT B_kawe2 "Faktor fwe aktiv während Kat-Ausräumen, Bank 2" UWORD B_TRUE 1 100 0 1 BIT_MASK 0x10 FORMAT "%13.11" ECU_ADDRESS 0xFD30 /end MEASUREMENT
/begin MEASUREMENT B_kl "Bedingung für erkannte Klopfer" UWORD B_TRUE 1 100 0 1 BIT_MASK 0x8 FORMAT "%13.11" ECU_ADDRESS 0xFD28 /end MEASUREMENT
/begin MEASUREMENT B_kldynrm "Bedingung normales Klopfen bei adapt. Lastdynamik" UWORD B_TRUE 1 100 0 1 BIT_MASK 0x800 FORMAT "%13.11" ECU_ADDRESS 0xFD28 /end MEASUREMENT
/begin MEASUREMENT B_kldystk "Bedingung starkes Klopfen bei adapt. Lastdynamik" UWORD B_TRUE 1 100 0 1 BIT_MASK 0x1000 FORMAT "%13.11" ECU_ADDRESS 0xFD28 /end MEASUREMENT
/begin MEASUREMENT B_kr "Bedingung Klopfregelung aktiv" UWORD B_TRUE 1 100 0 1 BIT_MASK 0x2 FORMAT "%13.11" ECU_ADDRESS 0xFD4C /end MEASUREMENT
/begin MEASUREMENT B_kra "Bedingung KR-Adaption aktiv" UWORD B_TRUE 1 100 0 1 BIT_MASK 0x4 FORMAT "%13.11" ECU_ADDRESS 0xFD4C /end MEASUREMENT
/begin MEASUREMENT B_krldy "Bedingung Lastdynamik für Klopferkennung aktiv" UWORD B_TRUE 1 100 0 1 BIT_MASK 0x2000 FORMAT "%13.11" ECU_ADDRESS 0xFD28 /end MEASUREMENT
/begin MEASUREMENT B_krldya "Bedingung Lastdynamikvorhalt und -adaption aktiv" UWORD B_TRUE 1 100 0 1 BIT_MASK 0x4000 FORMAT "%13.11" ECU_ADDRESS 0xFD28 /end MEASUREMENT
/begin MEASUREMENT B_krldyf "Bedingung Adaption Lastdynamikvorhalt nach früh freigegeben" UWORD B_TRUE 1 100 0 1 BIT_MASK 0x8000 FORMAT "%13.11" ECU_ADDRESS 0xFD28 /end MEASUREMENT
/begin MEASUREMENT B_krlmdy "" UWORD B_TRUE 1 100 0 1 BIT_MASK 0x8 FORMAT "%13.11" ECU_ADDRESS 0xFD4C /end MEASUREMENT
/begin MEASUREMENT B_krndy "Bedingung Drehzahldynamik für Klopferkennung aktiv" UWORD B_TRUE 1 100 0 1 BIT_MASK 0x1 FORMAT "%13.11" ECU_ADDRESS 0xFD2A /end MEASUREMENT
/begin MEASUREMENT B_krnmdy "" UWORD B_TRUE 1 100 0 1 BIT_MASK 0x10 FORMAT "%13.11" ECU_ADDRESS 0xFD4C /end MEASUREMENT
/begin MEASUREMENT B_lalgf "Bedingung Laufgrenze ""Lambda fett"" aktiv" UWORD B_TRUE 1 100 0 1 BIT_MASK 0x1 FORMAT "%13.11" ECU_ADDRESS 0xFD98 /end MEASUREMENT
/begin MEASUREMENT B_lalgf2 "Bedingung Laufgrenze ""Lambda fett"" aktiv" UWORD B_TRUE 1 100 0 1 BIT_MASK 0x2 FORMAT "%13.11" ECU_ADDRESS 0xFD98 /end MEASUREMENT
/begin MEASUREMENT B_lambts "Lambda für Bauteileschutz ist aktiv" UWORD B_TRUE 1 100 0 1 BIT_MASK 0x4 FORMAT "%13.11" ECU_ADDRESS 0xFD98 /end MEASUREMENT
/begin MEASUREMENT B_lambts2 "Lambda für Bauteileschutz ist aktiv (Bank2)" UWORD B_TRUE 1 100 0 1 BIT_MASK 0x8 FORMAT "%13.11" ECU_ADDRESS 0xFD98 /end MEASUREMENT
/begin MEASUREMENT B_lamka "Lambda für Kat-Ausräumen aktiv" UWORD B_TRUE 1 100 0 1 BIT_MASK 0x10 FORMAT "%13.11" ECU_ADDRESS 0xFD98 /end MEASUREMENT
/begin MEASUREMENT B_lamka2 "Lambda für Kat-Ausräumen aktiv" UWORD B_TRUE 1 100 0 1 BIT_MASK 0x20 FORMAT "%13.11" ECU_ADDRESS 0xFD98 /end MEASUREMENT
/begin MEASUREMENT B_lamnswl "Lambda-Motor-Soll für Nachstart und Warmlauf aktiv" UWORD B_TRUE 1 100 0 1 BIT_MASK 0x40 FORMAT "%13.11" ECU_ADDRESS 0xFD98 /end MEASUREMENT
/begin MEASUREMENT B_lamsdef "Bedingung : definierte Soll-Lambda" UWORD B_TRUE 1 100 0 1 BIT_MASK 0x80 FORMAT "%13.11" ECU_ADDRESS 0xFD98 /end MEASUREMENT
/begin MEASUREMENT B_ldef "Bedingung : definierte Soll-Lambda Bank1" UWORD B_TRUE 1 100 0 1 BIT_MASK 0x100 FORMAT "%13.11" ECU_ADDRESS 0xFD98 /end MEASUREMENT
/begin MEASUREMENT B_ldef2 "Bedingung : definierte Soll-Lambda Bank2" UWORD B_TRUE 1 100 0 1 BIT_MASK 0x200 FORMAT "%13.11" ECU_ADDRESS 0xFD98 /end MEASUREMENT
/begin MEASUREMENT B_llr "Bedingung Leerlaufregelung" UWORD B_TRUE 1 100 0 1 BIT_MASK 0x200 FORMAT "%13.11" ECU_ADDRESS 0xFD9A /end MEASUREMENT
/begin MEASUREMENT B_llrein "Bedingung LLR Betriebsbereit nach Start" UWORD B_TRUE 1 100 0 1 BIT_MASK 0x8000 FORMAT "%13.11" ECU_ADDRESS 0xFD44 /end MEASUREMENT
/begin MEASUREMENT B_llri "Bedingung I-Anteil der LLR aktiv" UWORD B_TRUE 1 100 0 1 BIT_MASK 0x400 FORMAT "%13.11" ECU_ADDRESS 0xFD9A /end MEASUREMENT
/begin MEASUREMENT B_llrimx "Bedingung dmllri hat Sicherheitsgrenze erreicht" UWORD B_TRUE 1 100 0 1 BIT_MASK 0x1 FORMAT "%13.11" ECU_ADDRESS 0xFD9C /end MEASUREMENT
/begin MEASUREMENT B_llrpd "Bedingung PD-Anteil der LLR aktiv" UWORD B_TRUE 1 100 0 1 BIT_MASK 0x800 FORMAT "%13.11" ECU_ADDRESS 0xFD9A /end MEASUREMENT
/begin MEASUREMENT B_lr "LREB: Bedingung Lambdaregelung (vor Kat); (Bank 1)" UWORD B_TRUE 1 100 0 1 BIT_MASK 0x200 FORMAT "%13.11" ECU_ADDRESS 0xFD2E /end MEASUREMENT
/begin MEASUREMENT B_lr2 "Bedingung Lambdaregelung (vor Kat); Bank 2" UWORD B_TRUE 1 100 0 1 BIT_MASK 0x400 FORMAT "%13.11" ECU_ADDRESS 0xFD2E /end MEASUREMENT
/begin MEASUREMENT B_lr2s "CARB FREEZE FRAME, Bank1 bit 1, LR: Regelbetrieb mit zwei Sonden" UBYTE B_TRUE 1 100 0 1 BIT_MASK 0x2 FORMAT "%13.11" ECU_ADDRESS 0x380D83 /end MEASUREMENT
/begin MEASUREMENT B_lr2s2 "CARB FREEZE FRAME, Bank2 Bit 1, LR: Regelbetrieb mit zwei Sonden" UBYTE B_TRUE 1 100 0 1 BIT_MASK 0x2 FORMAT "%13.11" ECU_ADDRESS 0x380D84 /end MEASUREMENT
/begin MEASUREMENT B_lra "Bedingung Gemischadaption freigegeben" UWORD B_TRUE 1 100 0 1 BIT_MASK 0x2 FORMAT "%13.11" ECU_ADDRESS 0xFD3A /end MEASUREMENT
/begin MEASUREMENT B_lra2 "Bedingung Gemischadaption 2 freigegeben" UWORD B_TRUE 1 100 0 1 BIT_MASK 0x4 FORMAT "%13.11" ECU_ADDRESS 0xFD3A /end MEASUREMENT
/begin MEASUREMENT B_lrare "Bedingung Reset LRA" UWORD B_TRUE 1 100 0 1 BIT_MASK 0x400 FORMAT "%13.11" ECU_ADDRESS 0xFD62 /end MEASUREMENT
/begin MEASUREMENT B_lrare2 "Bedingung Reset LRA Bank 2" UWORD B_TRUE 1 100 0 1 BIT_MASK 0x800 FORMAT "%13.11" ECU_ADDRESS 0xFD62 /end MEASUREMENT
/begin MEASUREMENT B_lrareb "Bedingung Resetbereitschaft LRA" UWORD B_TRUE 1 100 0 1 BIT_MASK 0x1000 FORMAT "%13.11" ECU_ADDRESS 0xFD62 /end MEASUREMENT
/begin MEASUREMENT B_lreb100 "Sammelbit der im 100 ms-Raster gebildeten Sperrbedingungen" UWORD B_TRUE 1 100 0 1 BIT_MASK 0x80 FORMAT "%13.11" ECU_ADDRESS 0xFDD6 /end MEASUREMENT
/begin MEASUREMENT B_lreble "Bedingung LR inaktiv bei Abmagerung und Sonde zeigt""fett""" UWORD B_TRUE 1 100 0 1 BIT_MASK 0x100 FORMAT "%13.11" ECU_ADDRESS 0xFDD6 /end MEASUREMENT
/begin MEASUREMENT B_lreble2 "Bedingung LR inaktiv bei Abmagerung und Sonde zeigt""fett"", Bank 2" UWORD B_TRUE 1 100 0 1 BIT_MASK 0x200 FORMAT "%13.11" ECU_ADDRESS 0xFDD6 /end MEASUREMENT
/begin MEASUREMENT B_lrebpr "Bedingung LR inaktiv bei Anfettung, Sonde ""mager"" oder Abmagerung, Sonde ""fett""" UWORD B_TRUE 1 100 0 1 BIT_MASK 0x400 FORMAT "%13.11" ECU_ADDRESS 0xFDD6 /end MEASUREMENT
/begin MEASUREMENT B_lrebpr2 "Bedingung LR inaktiv bei Anfett. Sonde ""mager"" oder Abmager. Sonde ""fett"", Bank2" UWORD B_TRUE 1 100 0 1 BIT_MASK 0x800 FORMAT "%13.11" ECU_ADDRESS 0xFDD6 /end MEASUREMENT
/begin MEASUREMENT B_lrebri "Bedingung LR inaktiv bei Anfettung: lamsons_w < 1, B_vl, B_vag oder B_bag" UWORD B_TRUE 1 100 0 1 BIT_MASK 0x1000 FORMAT "%13.11" ECU_ADDRESS 0xFDD6 /end MEASUREMENT
/begin MEASUREMENT B_lrebri2 "Bedingung LR inaktiv bei Anfettung: lamsons_w < 1, B_vl, B_vag oder B_bag, Bank2" UWORD B_TRUE 1 100 0 1 BIT_MASK 0x2000 FORMAT "%13.11" ECU_ADDRESS 0xFDD6 /end MEASUREMENT
/begin MEASUREMENT B_lrhk "Bedingung Lambdaregelung hinter Kat" UWORD B_TRUE 1 100 0 1 BIT_MASK 0x40 FORMAT "%13.11" ECU_ADDRESS 0xFD5E /end MEASUREMENT
/begin MEASUREMENT B_lrhk2 "Bedingung Lambdaregelung hinter Kat (Bank 2)" UWORD B_TRUE 1 100 0 1 BIT_MASK 0x80 FORMAT "%13.11" ECU_ADDRESS 0xFD5E /end MEASUREMENT
/begin MEASUREMENT B_lrhkb "Bedingung Lambdaregelung h. Kat, bankspez. Parameter Bank 1" UBYTE B_TRUE 1 100 0 1 BIT_MASK 0x4 FORMAT "%13.11" ECU_ADDRESS 0x380D8C /end MEASUREMENT
/begin MEASUREMENT B_lrhkb2 "LRHK: Bedingung Lambdaregelung h. Kat, bankspez. Parameter Bank 2" UBYTE B_TRUE 1 100 0 1 BIT_MASK 0x8 FORMAT "%13.11" ECU_ADDRESS 0x380D8C /end MEASUREMENT
/begin MEASUREMENT B_lrhkg "bankunabhängige Bedingung Lambdaregelung hinter Kat" UBYTE B_TRUE 1 100 0 1 BIT_MASK 0x10 FORMAT "%13.11" ECU_ADDRESS 0x380D8C /end MEASUREMENT
/begin MEASUREMENT B_lrhkgi "bankunabhängige Bedingung I-Anteil Lambdaregelung hinter Kat" UBYTE B_TRUE 1 100 0 1 BIT_MASK 0x20 FORMAT "%13.11" ECU_ADDRESS 0x380D8C /end MEASUREMENT
/begin MEASUREMENT B_lrhkp "LRHK: Freigabebedingung P-Anteil Lambdaregelung hinter Kat" UBYTE B_TRUE 1 100 0 1 BIT_MASK 0x40 FORMAT "%13.11" ECU_ADDRESS 0x380D8C /end MEASUREMENT
/begin MEASUREMENT B_lrhkp2 "LRHK Bank2: Freigabebedingung P-Anteil Lambdaregelung hinter Kat" UBYTE B_TRUE 1 100 0 1 BIT_MASK 0x80 FORMAT "%13.11" ECU_ADDRESS 0x380D8C /end MEASUREMENT
/begin MEASUREMENT B_lrka "Bedingung Katalysator-Ausräumen" UWORD B_TRUE 1 100 0 1 BIT_MASK 0x20 FORMAT "%13.11" ECU_ADDRESS 0xFD30 /end MEASUREMENT
/begin MEASUREMENT B_lrka2 "Bedingung Katalysator-Ausräumen für Stereo-LR Bank 2" UWORD B_TRUE 1 100 0 1 BIT_MASK 0x40 FORMAT "%13.11" ECU_ADDRESS 0xFD30 /end MEASUREMENT
/begin MEASUREMENT B_lrkaa "Bedingung Katalysator-Ausräumen auf-/abregeln" UWORD B_TRUE 1 100 0 1 BIT_MASK 0x80 FORMAT "%13.11" ECU_ADDRESS 0xFD30 /end MEASUREMENT
/begin MEASUREMENT B_lrkaa2 "Bedingung Katalysator-Ausräumen auf-/abregeln, Bank 2" UWORD B_TRUE 1 100 0 1 BIT_MASK 0x100 FORMAT "%13.11" ECU_ADDRESS 0xFD30 /end MEASUREMENT
/begin MEASUREMENT B_lrkae "Bedingung gesteuertes Katalysator-Ausräumen möglich" UWORD B_TRUE 1 100 0 1 BIT_MASK 0x200 FORMAT "%13.11" ECU_ADDRESS 0xFD30 /end MEASUREMENT
/begin MEASUREMENT B_lrkae2 "Bedingung gesteuertes Katalysator-Ausräumen möglich, Bank 2" UWORD B_TRUE 1 100 0 1 BIT_MASK 0x400 FORMAT "%13.11" ECU_ADDRESS 0xFD30 /end MEASUREMENT
/begin MEASUREMENT B_lrkaei "Bedingung gesteuertes Katalysator-Ausräumen möglich (ALRKAGST)" UWORD B_TRUE 1 100 0 1 BIT_MASK 0x800 FORMAT "%13.11" ECU_ADDRESS 0xFD30 /end MEASUREMENT
/begin MEASUREMENT B_lrkaei2 "Bedingung gesteuertes Katalysator-Ausräumen möglich (ALRKAGST2), Bank 2" UWORD B_TRUE 1 100 0 1 BIT_MASK 0x1000 FORMAT "%13.11" ECU_ADDRESS 0xFD30 /end MEASUREMENT
/begin MEASUREMENT B_lrkaon "Status aktives Ausräumen wird durch erneute Ausräumbedingung unterbrochen" UWORD B_TRUE 1 100 0 1 BIT_MASK 0x2000 FORMAT "%13.11" ECU_ADDRESS 0xFD30 /end MEASUREMENT
/begin MEASUREMENT B_lrkaon2 "Bank 2 Status aktives Ausräumen wird durch erneute Ausräumbedingung unterbrochen" UWORD B_TRUE 1 100 0 1 BIT_MASK 0x4000 FORMAT "%13.11" ECU_ADDRESS 0xFD30 /end MEASUREMENT
/begin MEASUREMENT B_lrkarg "Bedingung Katalysator-Ausräumen, geregelt" UWORD B_TRUE 1 100 0 1 BIT_MASK 0x8000 FORMAT "%13.11" ECU_ADDRESS 0xFD30 /end MEASUREMENT
/begin MEASUREMENT B_lrkarg2 "Bedingung Katalysator-Ausräumen, geregelt, Bank 2" UWORD B_TRUE 1 100 0 1 BIT_MASK 0x1 FORMAT "%13.11" ECU_ADDRESS 0xFD32 /end MEASUREMENT
/begin MEASUREMENT B_lrkast "Bedingung Katalysator-Ausräumen, gesteuert" UWORD B_TRUE 1 100 0 1 BIT_MASK 0x2 FORMAT "%13.11" ECU_ADDRESS 0xFD32 /end MEASUREMENT
/begin MEASUREMENT B_lrkast2 "Bedingung Katalysator-Ausräumen, gesteuert, Bank 2" UWORD B_TRUE 1 100 0 1 BIT_MASK 0x4 FORMAT "%13.11" ECU_ADDRESS 0xFD32 /end MEASUREMENT
/begin MEASUREMENT B_lrnd "Steuerbit LR aktiv setzen; Anforderung ""NORMAL-"" oder ""DIAGNOSE-Betrieb""" UWORD B_TRUE 1 100 0 1 BIT_MASK 0x800 FORMAT "%13.11" ECU_ADDRESS 0xFD2E /end MEASUREMENT
/begin MEASUREMENT B_lrnd2 "Steuerbit LR aktiv setzen; Anforderung ""NORMAL-"" oder ""DIAGNOSE"" z.B. bei SLS" UWORD B_TRUE 1 100 0 1 BIT_MASK 0x1000 FORMAT "%13.11" ECU_ADDRESS 0xFD2E /end MEASUREMENT
/begin MEASUREMENT B_lrnda "LR Bank1 aktiv, eventuell eingeschränkt" UWORD B_TRUE 1 100 0 1 BIT_MASK 0x4000 FORMAT "%13.11" ECU_ADDRESS 0xFDD6 /end MEASUREMENT
/begin MEASUREMENT B_lrnda2 "LR Bank2 aktiv, eventuell eingeschränkt" UWORD B_TRUE 1 100 0 1 BIT_MASK 0x8000 FORMAT "%13.11" ECU_ADDRESS 0xFDD6 /end MEASUREMENT
/begin MEASUREMENT B_lrpspa "LREB: Projektspezifische Ausschaltbedingung Lambdaregelung (vor Kat)" UWORD B_TRUE 1 100 0 1 BIT_MASK 0x1 FORMAT "%13.11" ECU_ADDRESS 0xFDD8 /end MEASUREMENT
/begin MEASUREMENT B_lrrl "LREB: Von Last abhängige Bedingung Lambdaregelung (vor Kat)" UWORD B_TRUE 1 100 0 1 BIT_MASK 0x2 FORMAT "%13.11" ECU_ADDRESS 0xFDD8 /end MEASUREMENT
/begin MEASUREMENT B_lrsp "Bedingung Sondensprung" UWORD B_TRUE 1 100 0 1 BIT_MASK 0x80 FORMAT "%13.11" ECU_ADDRESS 0xFD34 /end MEASUREMENT
/begin MEASUREMENT B_lrsp2 "Bedingung Sondensprung Zylinderbank 2" UWORD B_TRUE 1 100 0 1 BIT_MASK 0x100 FORMAT "%13.11" ECU_ADDRESS 0xFD34 /end MEASUREMENT
/begin MEASUREMENT B_lrstat "Bedingung Lambdaregler arbeitet stationär" UWORD B_TRUE 1 100 0 1 BIT_MASK 0x200 FORMAT "%13.11" ECU_ADDRESS 0xFD34 /end MEASUREMENT
/begin MEASUREMENT B_lrstat2 "Bedingung Lambdaregler arbeitet stationär, Bank2" UWORD B_TRUE 1 100 0 1 BIT_MASK 0x400 FORMAT "%13.11" ECU_ADDRESS 0xFD34 /end MEASUREMENT
/begin MEASUREMENT B_lrstta "Bedingung Lambdaregler arbeitet stationär, Zeit und Amplitudenbedingung" UWORD B_TRUE 1 100 0 1 BIT_MASK 0x800 FORMAT "%13.11" ECU_ADDRESS 0xFD34 /end MEASUREMENT
/begin MEASUREMENT B_lrstta2 "Bedingung Lambdaregler arbeitet stationär, Zeit und Amplitudenbedingung Bank 2" UWORD B_TRUE 1 100 0 1 BIT_MASK 0x1000 FORMAT "%13.11" ECU_ADDRESS 0xFD34 /end MEASUREMENT
/begin MEASUREMENT B_lrtpp "Periodendauer gültig, Bed. LR arbeitet stationär (Amplitude/Periode) erfüllt" UWORD B_TRUE 1 100 0 1 BIT_MASK 0x2000 FORMAT "%13.11" ECU_ADDRESS 0xFD34 /end MEASUREMENT
/begin MEASUREMENT B_lrtpp2 "Bedingung Lambdaregler arbeitet stationär (Amplitude/Periode) Bank2" UWORD B_TRUE 1 100 0 1 BIT_MASK 0x4000 FORMAT "%13.11" ECU_ADDRESS 0xFD34 /end MEASUREMENT
/begin MEASUREMENT B_lrvk "CARB FREEZE FRAME, Bank1 Bit 4, LR: Regelung nur mit einer Sonde (vor KAT)" UBYTE B_TRUE 1 100 0 1 BIT_MASK 0x10 FORMAT "%13.11" ECU_ADDRESS 0x380D83 /end MEASUREMENT
/begin MEASUREMENT B_lrvk2 "CARB FREEZE FRAME, Bank2 Bit 4, LR: Regelung nur mit einer Sonde (vor KAT)" UBYTE B_TRUE 1 100 0 1 BIT_MASK 0x10 FORMAT "%13.11" ECU_ADDRESS 0x380D84 /end MEASUREMENT
/begin MEASUREMENT B_lrwla "LR aktiv bei Bedingungen : B_lrrl & B_tmlr & B_pspwl & Bstend" UWORD B_TRUE 1 100 0 1 BIT_MASK 0x4 FORMAT "%13.11" ECU_ADDRESS 0xFDD8 /end MEASUREMENT
/begin MEASUREMENT B_mlrsa "LRSEB: Ausschaltbed. für Lambdareg. auf bei und nach Schub über Luftmassenschw." UWORD B_TRUE 1 100 0 1 BIT_MASK 0x8 FORMAT "%13.11" ECU_ADDRESS 0xFDD8 /end MEASUREMENT
/begin MEASUREMENT B_msfslr "Bed. LR aktiv/inaktiv bei Fett/Magerschutz" UWORD B_TRUE 1 100 0 1 BIT_MASK 0x10 FORMAT "%13.11" ECU_ADDRESS 0xFDD8 /end MEASUREMENT
/begin MEASUREMENT B_msfslr2 "Bed. LR aktiv/inaktiv während Fett-/Magerschutz, Bank 2" UWORD B_TRUE 1 100 0 1 BIT_MASK 0x20 FORMAT "%13.11" ECU_ADDRESS 0xFDD8 /end MEASUREMENT
/begin MEASUREMENT B_mslr "Bed. LR aktiv/inaktiv bei Fett/Magerschutz" UWORD B_TRUE 1 100 0 1 BIT_MASK 0x40 FORMAT "%13.11" ECU_ADDRESS 0xFDD8 /end MEASUREMENT
/begin MEASUREMENT B_mslr2 "Bed. LR aktiv/inaktiv während Fett-/Magerschutz" UWORD B_TRUE 1 100 0 1 BIT_MASK 0x80 FORMAT "%13.11" ECU_ADDRESS 0xFDD8 /end MEASUREMENT
/begin MEASUREMENT B_nftev "Bedingung Drehzahlanhebung für erhöhte TE-Spülrate" UWORD B_TRUE 1 100 0 1 BIT_MASK 0x4000 FORMAT "%13.11" ECU_ADDRESS 0xFD9A /end MEASUREMENT
/begin MEASUREMENT B_nivns "Bedingung niedrige Solldrehzahl" UWORD B_TRUE 1 100 0 1 BIT_MASK 0x8000 FORMAT "%13.11" ECU_ADDRESS 0xFD9A /end MEASUREMENT
/begin MEASUREMENT B_nofra "Bedingung Sperren der multiplikativen Gemischkorrektur" UWORD B_TRUE 1 100 0 1 BIT_MASK 0x2000 FORMAT "%13.11" ECU_ADDRESS 0xFD62 /end MEASUREMENT
/begin MEASUREMENT B_nolrb "CARB FREEZE FRAME, Bank1 Bit 2, LR: Steuerbetrieb durch Betriebsbedingungen" UBYTE B_TRUE 1 100 0 1 BIT_MASK 0x4 FORMAT "%13.11" ECU_ADDRESS 0x380D83 /end MEASUREMENT
/begin MEASUREMENT B_nolrb2 "CARB FREEZE FRAME, Bank2 Bit 2, LR: Steuerung durch Betriebsbedingung" UBYTE B_TRUE 1 100 0 1 BIT_MASK 0x4 FORMAT "%13.11" ECU_ADDRESS 0x380D84 /end MEASUREMENT
/begin MEASUREMENT B_nolre "CARB FREEZE FRAME, Bank1 Bit 3, LR: Steuerung nach Systemfehler" UBYTE B_TRUE 1 100 0 1 BIT_MASK 0x8 FORMAT "%13.11" ECU_ADDRESS 0x380D83 /end MEASUREMENT
/begin MEASUREMENT B_nolre2 "CARB FREEZE FRAME, Bank2 Bit 3, LR: Steuerung nach Systemfehler" UBYTE B_TRUE 1 100 0 1 BIT_MASK 0x8 FORMAT "%13.11" ECU_ADDRESS 0x380D84 /end MEASUREMENT
/begin MEASUREMENT B_nolrw "CARB FREEZE FRAME, Bank1 Bit 0, LR: Steuerbetrieb, Startbed. noch nicht erfüllt" UBYTE B_TRUE 1 100 0 1 BIT_MASK 0x1 FORMAT "%13.11" ECU_ADDRESS 0x380D83 /end MEASUREMENT
/begin MEASUREMENT B_nolrw2 "CARB FREEZE FRAME, Bank2 Bit 0, LR: Steuerbetrieb, Startbed. noch nicht erfüllt" UBYTE B_TRUE 1 100 0 1 BIT_MASK 0x1 FORMAT "%13.11" ECU_ADDRESS 0x380D84 /end MEASUREMENT
/begin MEASUREMENT B_norkat "Bedingung additive Korrektur der Gemischadaption pro Zeit abgeschaltet" UWORD B_TRUE 1 100 0 1 BIT_MASK 0x4000 FORMAT "%13.11" ECU_ADDRESS 0xFD62 /end MEASUREMENT
/begin MEASUREMENT B_norkaz "Bedingung additive Korrektur der Gemischadaption pro Zündung abgeschaltet" UWORD B_TRUE 1 100 0 1 BIT_MASK 0x8000 FORMAT "%13.11" ECU_ADDRESS 0xFD62 /end MEASUREMENT
/begin MEASUREMENT B_nsabg "Bedingung Abgleich Solldrehzahl" UWORD B_TRUE 1 100 0 1 BIT_MASK 0x100 FORMAT "%13.11" ECU_ADDRESS 0xFD9A /end MEASUREMENT
/begin MEASUREMENT B_pspaus "Bedingung LR inaktiv bei projektspez. AUS-Bedingungen" UWORD B_TRUE 1 100 0 1 BIT_MASK 0x100 FORMAT "%13.11" ECU_ADDRESS 0xFDD8 /end MEASUREMENT
/begin MEASUREMENT B_pspwl "Bedingung LR inaktiv bei projektspez. Warmlauf-Bedingungen" UWORD B_TRUE 1 100 0 1 BIT_MASK 0x200 FORMAT "%13.11" ECU_ADDRESS 0xFDD8 /end MEASUREMENT
/begin MEASUREMENT B_rkat "Bedingung Lernbereich additive Korrektur pro Zeit aktiv" UWORD B_TRUE 1 100 0 1 BIT_MASK 0x1 FORMAT "%13.11" ECU_ADDRESS 0xFD64 /end MEASUREMENT
/begin MEASUREMENT B_rkatr "Bedingung rkat-Integrator außerhalb reduzierten Bereich" UWORD B_TRUE 1 100 0 1 BIT_MASK 0x2 FORMAT "%13.11" ECU_ADDRESS 0xFD64 /end MEASUREMENT
/begin MEASUREMENT B_rkatr2 "Bedingung rkat2-Integrator außerhalb reduzierten Bereich" UWORD B_TRUE 1 100 0 1 BIT_MASK 0x4 FORMAT "%13.11" ECU_ADDRESS 0xFD64 /end MEASUREMENT
/begin MEASUREMENT B_rkaz "Bedingung Lernbereich additive Korrektur pro Zündung aktiv" UWORD B_TRUE 1 100 0 1 BIT_MASK 0x8 FORMAT "%13.11" ECU_ADDRESS 0xFD64 /end MEASUREMENT
/begin MEASUREMENT B_rkazr "Bedingung rkaz-Integrator außerhalb reduzierten Bereich" UWORD B_TRUE 1 100 0 1 BIT_MASK 0x10 FORMAT "%13.11" ECU_ADDRESS 0xFD64 /end MEASUREMENT
/begin MEASUREMENT B_rkazr2 "Bedingung rkaz2-Integrator außerhalb reduzierten Bereich" UWORD B_TRUE 1 100 0 1 BIT_MASK 0x20 FORMAT "%13.11" ECU_ADDRESS 0xFD64 /end MEASUREMENT
/begin MEASUREMENT B_sgnalt "Vorzeichen für Gemisch vor Kat (Bool), 1 Rechenraster verzögert" UWORD B_TRUE 1 100 0 1 BIT_MASK 0x8000 FORMAT "%13.11" ECU_ADDRESS 0xFD34 /end MEASUREMENT
/begin MEASUREMENT B_sgnalt2 "Vorzeichen für Gemisch vor Kat (Bool), 1 Rechenraster verzögert" UWORD B_TRUE 1 100 0 1 BIT_MASK 0x1 FORMAT "%13.11" ECU_ADDRESS 0xFD36 /end MEASUREMENT
/begin MEASUREMENT B_sgnlr "Vorzeichen für Gemisch vor Kat (Bool)" UWORD B_TRUE 1 100 0 1 BIT_MASK 0x2 FORMAT "%13.11" ECU_ADDRESS 0xFD36 /end MEASUREMENT
/begin MEASUREMENT B_sgnlr2 "Vorzeichen für Gemisch vor Kat (Bool), Bank 2" UWORD B_TRUE 1 100 0 1 BIT_MASK 0x4 FORMAT "%13.11" ECU_ADDRESS 0xFD36 /end MEASUREMENT
/begin MEASUREMENT B_sgnra "Vorzeichen für Gemisch vor Kat gem. Sperrzeitsteuerung (Bool)" UWORD B_TRUE 1 100 0 1 BIT_MASK 0x8 FORMAT "%13.11" ECU_ADDRESS 0xFD36 /end MEASUREMENT
/begin MEASUREMENT B_sgnra2 "Vorzeichen für Gemisch vor Kat gem. Sperrzeitsteuerung (Bool), Bank 2" UWORD B_TRUE 1 100 0 1 BIT_MASK 0x10 FORMAT "%13.11" ECU_ADDRESS 0xFD36 /end MEASUREMENT
/begin MEASUREMENT B_tarau "LREB: Bedingung Start bei niedrigen Ansauglufttemperaturen" UWORD B_TRUE 1 100 0 1 BIT_MASK 0x400 FORMAT "%13.11" ECU_ADDRESS 0xFDD8 /end MEASUREMENT
/begin MEASUREMENT B_tmkr "Bedingung Temperatur (tmot) fuer KR aktiv erreicht" UWORD B_TRUE 1 100 0 1 BIT_MASK 0x20 FORMAT "%13.11" ECU_ADDRESS 0xFD4C /end MEASUREMENT
/begin MEASUREMENT B_tmlr "LREB: Von Motortemp. abhängige Bedingungen Lambdaregelung (vor Kat)" UWORD B_TRUE 1 100 0 1 BIT_MASK 0x800 FORMAT "%13.11" ECU_ADDRESS 0xFDD8 /end MEASUREMENT
/begin MEASUREMENT B_tsper "LR: Bedingung Starten der Sperrzeit" UWORD B_TRUE 1 100 0 1 BIT_MASK 0x20 FORMAT "%13.11" ECU_ADDRESS 0xFD36 /end MEASUREMENT
/begin MEASUREMENT B_tsper2 "LR Bank2 : Bedingung Starten der Sperrzeit" UWORD B_TRUE 1 100 0 1 BIT_MASK 0x40 FORMAT "%13.11" ECU_ADDRESS 0xFD36 /end MEASUREMENT
/begin MEASUREMENT B_tspon "Bedingung Entstörsperrzeit in der Lambdaregelung starten" UWORD B_TRUE 1 100 0 1 BIT_MASK 0x80 FORMAT "%13.11" ECU_ADDRESS 0xFD36 /end MEASUREMENT
/begin MEASUREMENT B_tspon2 "Bedingung Entstörsperrzeit in der Lambdaregelung starten, Bank 2" UWORD B_TRUE 1 100 0 1 BIT_MASK 0x100 FORMAT "%13.11" ECU_ADDRESS 0xFD36 /end MEASUREMENT
/begin MEASUREMENT B_vla "Bedingung Vollastanreicherung > 1.0" UWORD B_TRUE 1 100 0 1 BIT_MASK 0x4000 FORMAT "%13.11" ECU_ADDRESS 0xFD96 /end MEASUREMENT
/begin MEASUREMENT B_vllr "Bedingung Fahrzeug rollt mit eingelegtem Gang" UWORD B_TRUE 1 100 0 1 BIT_MASK 0x1000 FORMAT "%13.11" ECU_ADDRESS 0xFD9A /end MEASUREMENT
/begin MEASUREMENT B_wkral "Bedingung wkr aus KR-Adaptionskennfeld einlesen" UWORD B_TRUE 1 100 0 1 BIT_MASK 0x40 FORMAT "%13.11" ECU_ADDRESS 0xFD4C /end MEASUREMENT
/begin MEASUREMENT B_zwkraa "Bedingung Zündwinkel der KR wird ausgegeben" UWORD B_TRUE 1 100 0 1 BIT_MASK 0x80 FORMAT "%13.11" ECU_ADDRESS 0xFD4C /end MEASUREMENT
/begin MEASUREMENT B_zwkrum "Flag: schnelle Frühverstellung" UWORD B_TRUE 1 100 0 1 BIT_MASK 0x100 FORMAT "%13.11" ECU_ADDRESS 0xFD4C /end MEASUREMENT
/begin MEASUREMENT dfrm2_w "Abweichung schneller Mittelwert des Lambdareglers von 1.0 (Word)" SWORD fak_sw_b1 1 100 -1 0.999969 FORMAT "%8.6" ECU_ADDRESS 0x380E4A /end MEASUREMENT
/begin MEASUREMENT dfrm_w "Abweichung schneller Mittelwert des Lambdareglers von 1.0 (Word)" SWORD fak_sw_b1 1 100 -1 0.999969 FORMAT "%8.6" ECU_ADDRESS 0x380E4C /end MEASUREMENT
/begin MEASUREMENT dfrsp2_w "delta Spitzenwert Lambdaregelfaktor frsp Bank 2" SWORD fak_sw_b1 1 100 -1 0.999969 FORMAT "%8.6" ECU_ADDRESS 0x38124A /end MEASUREMENT
/begin MEASUREMENT dfrsp_w "delta Spitzenwert Lambdaregelfaktor frsp" SWORD fak_sw_b1 1 100 -1 0.999969 FORMAT "%8.6" ECU_ADDRESS 0x38124C /end MEASUREMENT
/begin MEASUREMENT dfrst2_w "fr-Regelhub im Stationärzustand (Zylinderbank 2)" SWORD fak_sw_b1 1 100 -1 0.999969 FORMAT "%8.6" ECU_ADDRESS 0x38124E /end MEASUREMENT
/begin MEASUREMENT dfrstga2_w "Regelhub im Stationärbetrieb (Grundadaptions-Phase), Bank 2" SWORD fak_sw_b1 1 100 -1 0.999969 FORMAT "%8.6" ECU_ADDRESS 0x382FE6 /end MEASUREMENT
/begin MEASUREMENT dfrstga_w "Regelhub im Stationärbetrieb (Grundadaptions-Phase)" SWORD fak_sw_b1 1 100 -1 0.999969 FORMAT "%8.6" ECU_ADDRESS 0x382FE8 /end MEASUREMENT
/begin MEASUREMENT dfrstte2_w "Regelhub im Stationärbetrieb (Tankentlüftung-Spülphase), Bank 2" SWORD fak_sw_b1 1 100 -1 0.999969 FORMAT "%8.6" ECU_ADDRESS 0x382FEA /end MEASUREMENT
/begin MEASUREMENT dfrstte_w "Regelhub im Stationärbetrieb (Tankentlüftung-Spülphase)" SWORD fak_sw_b1 1 100 -1 0.999969 FORMAT "%8.6" ECU_ADDRESS 0x382FEC /end MEASUREMENT
/begin MEASUREMENT dfrst_w "fr-Regelhub im Stationärzustand" SWORD fak_sw_b1 1 100 -1 0.999969 FORMAT "%8.6" ECU_ADDRESS 0x381250 /end MEASUREMENT
/begin MEASUREMENT dlahkab2_w "Dynamische Überhöhung des Pseudo Lambda-Sollwertes hinter Kat, Bank2" SWORD fak_sw_b1 1 100 -1 0.999969 FORMAT "%8.6" ECU_ADDRESS 0x382776 /end MEASUREMENT
/begin MEASUREMENT dlahkab_w "Dynamische Überhöhung des Pseudo Lambda-Sollwertes hinter Kat" SWORD fak_sw_b1 1 100 -1 0.999969 FORMAT "%8.6" ECU_ADDRESS 0x382778 /end MEASUREMENT
/begin MEASUREMENT dlashki2_w "Delta-Lambda gewichtet für I-Anteil LRSHK, Bank2" SWORD fak_sw_b1 1 100 -1 0.999969 FORMAT "%8.6" ECU_ADDRESS 0x38277A /end MEASUREMENT
/begin MEASUREMENT dlashki_w "Delta-Lambda gewichtet für I-Anteil LRSHK" SWORD fak_sw_b1 1 100 -1 0.999969 FORMAT "%8.6" ECU_ADDRESS 0x38277C /end MEASUREMENT
/begin MEASUREMENT dlashkm2_w "Delta-Lambda aus Lambdaregelung hinter Kat (Ist-Wert fr-synchron gemittelt), Ba2" SWORD fak_sw_b1 1 100 -1 0.999969 FORMAT "%8.6" ECU_ADDRESS 0x38277E /end MEASUREMENT
/begin MEASUREMENT dlashkm_w "Delta-Lambda aus Lambdaregelung hinter Kat (Ist-Wert fr-synchron gemittelt)" SWORD fak_sw_b1 1 100 -1 0.999969 FORMAT "%8.6" ECU_ADDRESS 0x382780 /end MEASUREMENT
/begin MEASUREMENT dlashkp2_w "Delta-Lambda gewichtet für P-Anteil LRSHK5.30, Bank2" SWORD fak_sw_b1 1 100 -1 0.999969 FORMAT "%8.6" ECU_ADDRESS 0x382782 /end MEASUREMENT
/begin MEASUREMENT dlashkp_w "Delta-Lambda gewichtet für P-Anteil LRSHK5.30" SWORD fak_sw_b1 1 100 -1 0.999969 FORMAT "%8.6" ECU_ADDRESS 0x382784 /end MEASUREMENT
/begin MEASUREMENT dmdresdtev "Delta-Momentenreserve für TEV Drehzahlcheck" SBYTE rel_sb_q0p0976 1 100 -12.4988 12.4012 FORMAT "%5.2" ECU_ADDRESS 0x380CDE /end MEASUREMENT
/begin MEASUREMENT dmdresfs "dyn. Delta-Moment nach eingelegter Fahrstufe" UBYTE rel_ub_b24p9 1 100 0 24.9 FORMAT "%5.2" ECU_ADDRESS 0x380CDF /end MEASUREMENT
/begin MEASUREMENT dmlllmn_w "Reservemomentschwelle für Lufteingriffe" SWORD rel_sw_b100 1 100 -100 99.9969 FORMAT "%8.4" ECU_ADDRESS 0x381416 /end MEASUREMENT
/begin MEASUREMENT dmllrdz_w "geforderte Drehmomentänderung von der LLR (D-Zündungsanteil)" SWORD rel_sw_b100 1 100 -100 99.9969 FORMAT "%8.4" ECU_ADDRESS 0x382352 /end MEASUREMENT
/begin MEASUREMENT dmllrd_w "geforderte Drehmomentänderung von der LLR (D-Anteil)" SWORD rel_sw_b100 1 100 -100 99.9969 FORMAT "%8.4" ECU_ADDRESS 0x382354 /end MEASUREMENT
/begin MEASUREMENT dmllri_w "geforderte Drehmomentänderung von der LLR (I-Anteil)" SWORD rel_sw_b100 1 100 -100 99.9969 FORMAT "%8.4" ECU_ADDRESS 0x382356 /end MEASUREMENT
/begin MEASUREMENT dmllrpz_w "geforderte Drehmomentänderung von der LLR (P-Zündungsanteil)" SWORD rel_sw_b100 1 100 -100 99.9969 FORMAT "%8.4" ECU_ADDRESS 0x382358 /end MEASUREMENT
/begin MEASUREMENT dmllrp_w "geforderte Drehmomentänderung von der LLR (P-Anteil)" SWORD rel_sw_b100 1 100 -100 99.9969 FORMAT "%8.4" ECU_ADDRESS 0x38235A /end MEASUREMENT
/begin MEASUREMENT dmllrz_w "geforderte MD-Änderung von der LLR (PD-Zündungsanteil)" SWORD rel_sw_b100 1 100 -100 99.9969 FORMAT "%8.4" ECU_ADDRESS 0x381086 /end MEASUREMENT
/begin MEASUREMENT dmllr_w "geforderte Drehmomentänderung von der LLR (PD-Anteil)" SWORD rel_sw_b100 1 100 -100 99.9969 FORMAT "%8.4" ECU_ADDRESS 0x381088 /end MEASUREMENT
/begin MEASUREMENT dmrllr_w "Momenten-Reserve für Leerlaufregelung" UWORD rel_q0p09726 1 100 0 6399.3 FORMAT "%8.3" ECU_ADDRESS 0x381418 /end MEASUREMENT
/begin MEASUREMENT dn "Drehzahlabweichung bei Leerlaufregelung" SBYTE nmotd_sb_q10 1 100 -1280 1270 FORMAT "%5.0" ECU_ADDRESS 0x380CEB /end MEASUREMENT
/begin MEASUREMENT dnfsacmv "LLRNS: Delta-Solldrehzahl von DS2-Kommunikator, AC mit FS" SBYTE nmotd_sb_q10 1 100 -1280 1270 FORMAT "%5.0" ECU_ADDRESS 0x380CD9 /end MEASUREMENT
/begin MEASUREMENT dnfsmv "LLRNS: Delta-Solldrehzahl von DS2-Kommunikator, mit FS" SBYTE nmotd_sb_q10 1 100 -1280 1270 FORMAT "%5.0" ECU_ADDRESS 0x380CDA /end MEASUREMENT
/begin MEASUREMENT dnllmv "LLRNS: Delta-Solldrehzahl von DS2-Kommunikator" SBYTE nmotd_sb_q10 1 100 -1280 1270 FORMAT "%5.0" ECU_ADDRESS 0x380CDB /end MEASUREMENT
/begin MEASUREMENT dns "LLR: Drehzahlabweichung zur stationären Solldrehzahl" SBYTE nmotd_sb_q10 1 100 -1280 1270 FORMAT "%5.0" ECU_ADDRESS 0x380CE4 /end MEASUREMENT
/begin MEASUREMENT dnsacmv "LLRNS: Delta-Solldrehzahl von DS2-Kommunikator, AC ohne FS" SBYTE nmotd_sb_q10 1 100 -1280 1270 FORMAT "%5.0" ECU_ADDRESS 0x380CDC /end MEASUREMENT
/begin MEASUREMENT dnslbv "LLRNS: Delta-Solldrehzahl von DS2-Kommunikator, aus LLRUB" SBYTE nmotd_sb_q10 1 100 -1280 1270 FORMAT "%5.0" ECU_ADDRESS 0x380CDD /end MEASUREMENT
/begin MEASUREMENT dn_w "Drehzahlabweichung bei Leerlaufregelung" SWORD nmotd_sw_q0p25 1 100 -8192 8191.75 FORMAT "%8.3" ECU_ADDRESS 0x38235C /end MEASUREMENT
/begin MEASUREMENT drlkrdy "Lastgradient für Auslösung KR-Lastdynamik" SWORD rel_sw_q0p0234 1 100 -768 767.977 FORMAT "%8.4" ECU_ADDRESS 0x38119A /end MEASUREMENT
/begin MEASUREMENT dtvka "Delta-tv für Katalysator-Ausräumen" SBYTE t100msxs_sb_q0p01 1 100 -1.28 1.27 FORMAT "%5.3" ECU_ADDRESS 0x3809B6 /end MEASUREMENT
/begin MEASUREMENT dtvka2 "Delta-tv für Katalysator-Ausräumen für Stereo-LR Bank 2" SBYTE t100msxs_sb_q0p01 1 100 -1.28 1.27 FORMAT "%5.3" ECU_ADDRESS 0x3809B7 /end MEASUREMENT
/begin MEASUREMENT dtvkai "Delta-tv für Katalysator-Ausräumen, lokale Verwendung" SBYTE t100msxs_sb_q0p01 1 100 -1.28 1.27 FORMAT "%5.3" ECU_ADDRESS 0x380D94 /end MEASUREMENT
/begin MEASUREMENT dtvkai2 "Delta-tv für Katalysator-Ausräumen, lokale Verwendung, Bank 2" SBYTE t100msxs_sb_q0p01 1 100 -1.28 1.27 FORMAT "%5.3" ECU_ADDRESS 0x380D95 /end MEASUREMENT
/begin MEASUREMENT dwkr "zylinderindividuelle Zündwinkelspätverstellung KR" SBYTE zw_sb_q0p75 1 100 -96 95.25 FORMAT "%5.2" ECU_ADDRESS 0x380B06 /end MEASUREMENT
/begin MEASUREMENT dwkrmsw "aktueller Wert für Mittelwertbegrenzung der Spätverstellung" UBYTE zw_ub_qn0p75 1 100 -191.25 0 FORMAT "%5.1" ECU_ADDRESS 0x380B07 /end MEASUREMENT
/begin MEASUREMENT dwkrz "zyl.ind. ZW-Spätverstellung inkl. Dyn.vorhalt" SBYTE zw_sb_q0p75 1 100 -96 95.25 FORMAT "%5.2" ARRAY_SIZE 8 ECU_ADDRESS 0x380B08 /end MEASUREMENT
/begin MEASUREMENT dyesofv "aktueller Wert Offset für Lastdynamikerkennungsschwelle" SWORD rel_sw_q0p0234 1 100 -768 767.977 FORMAT "%8.4" ECU_ADDRESS 0x380DE4 /end MEASUREMENT
/begin MEASUREMENT dyesv "aktueller Wert Lastdynamikerkennungsschwelle" SWORD rel_sw_q0p0234 1 100 -768 767.977 FORMAT "%8.4" ECU_ADDRESS 0x38119C /end MEASUREMENT
/begin MEASUREMENT dyesvs "" SWORD rel_sw_q0p0234 1 100 -768 767.977 FORMAT "%8.4" ECU_ADDRESS 0x38119E /end MEASUREMENT
/begin MEASUREMENT dzwb "Differenz BasisZW optimaler Zündwinkel" SBYTE zw_sb_q0p75 1 100 -96 95.25 FORMAT "%5.2" ECU_ADDRESS 0x380912 /end MEASUREMENT
/begin MEASUREMENT dzwoag "abgasrückführratenabh. Zündwinkelkorrektur des optimalen ZW" SBYTE zw_sb_q0p75 1 100 -96 95.25 FORMAT "%5.2" ECU_ADDRESS 0x380913 /end MEASUREMENT
/begin MEASUREMENT dzwol "lambdaabh. Zündwinkelkorrektur des optimalen ZW" SBYTE zw_sb_q0p75 1 100 -96 95.25 FORMAT "%5.2" ECU_ADDRESS 0x380914 /end MEASUREMENT
/begin MEASUREMENT dzwotm "temperaturabhängige Zündwinkelkorrektur des optimalen ZW" SBYTE zw_sb_q0p75 1 100 -96 95.25 FORMAT "%5.2" ECU_ADDRESS 0x380915 /end MEASUREMENT
/begin MEASUREMENT dzw_kge "Eingang Delta-Zündwinkel für mehrfach verwendete Kenngrößen" SBYTE zw_sb_q0p75 1 100 -96 95.25 FORMAT "%5.2" ECU_ADDRESS 0x380916 /end MEASUREMENT
/begin MEASUREMENT esst_sdn08llsw "" UWORD dez 1 100 0 65535 FORMAT "%8.2" ECU_ADDRESS 0x38235E /end MEASUREMENT
/begin MEASUREMENT esst_sns06llsb "" UWORD dez 1 100 0 65535 FORMAT "%8.2" ECU_ADDRESS 0x382344 /end MEASUREMENT
/begin MEASUREMENT esst_srl11opuw "" UWORD dez 1 100 0 65535 FORMAT "%8.2" ECU_ADDRESS 0x38106C /end MEASUREMENT
/begin MEASUREMENT etalab "Lambda-Wirkungsgrad ohne Eingriff bezogen auf optimales Moment bei Lambda=1" UBYTE rel_ub_b127p5 1 100 0 127.5 FORMAT "%5.1" ECU_ADDRESS 0x380917 /end MEASUREMENT
/begin MEASUREMENT etatrmn "minimaler Wert in der Wirkungsgradtrommel" UBYTE rel_ub_b127p5 1 100 0 127.5 FORMAT "%5.1" ECU_ADDRESS 0x380918 /end MEASUREMENT
/begin MEASUREMENT etazwb "Zündwinkelwirkungsgrad des Basiszündwinkels" UBYTE rel_ub_b127p5 1 100 0 127.5 FORMAT "%5.1" ECU_ADDRESS 0x380919 /end MEASUREMENT
/begin MEASUREMENT etazwbm "gemittelter Zündwinkelwirkungsgrad des Basiszündwinkels" UBYTE rel_ub_b127p5 1 100 0 127.5 FORMAT "%5.1" ECU_ADDRESS 0x38091A /end MEASUREMENT
/begin MEASUREMENT favkatmx "Gewichtungsfaktor Sauerstoffspeicher über avkatf" UBYTE fak_ub_b1 1 100 0 0.996094 ECU_ADDRESS 0x380D93 /end MEASUREMENT
/begin MEASUREMENT ffri "LR mit Integratorstop : Gewichtungsfaktor I-Steigung bei langsamer Sonde" UBYTE fak_ub_b4 1 100 0 3.98438 FORMAT "%5.3" ECU_ADDRESS 0x3809C2 /end MEASUREMENT
/begin MEASUREMENT ffri2 "LR mit Integratorstop : Gewichtungsfaktor I-Steigung bei langsamer Sonde Bank 2" UBYTE fak_ub_b4 1 100 0 3.98438 FORMAT "%5.3" ECU_ADDRESS 0x3809C3 /end MEASUREMENT
/begin MEASUREMENT flaskh "Faktor Übergang zu Lambda-Abgas bei Sekundärluft" UBYTE fak_ub_b1 1 100 0 0.996094 ECU_ADDRESS 0x380CCE /end MEASUREMENT
/begin MEASUREMENT flglrs "CARB FREEZE FRAME Byte, Bank 1, für LR" UBYTE dez 1 100 0 255 FORMAT "%5.1" ECU_ADDRESS 0x380D83 /end MEASUREMENT
/begin MEASUREMENT flglrs2 "CARB FREEZE FRAME Byte, Bank 2, für LR" UBYTE dez 1 100 0 255 FORMAT "%5.1" ECU_ADDRESS 0x380D84 /end MEASUREMENT
/begin MEASUREMENT flmsslkh "Faktor Lambda-Motor-Soll-Sekundärluftanteil, resultierend" UBYTE fak_ub_b1 1 100 0 0.996094 ECU_ADDRESS 0x380CCF /end MEASUREMENT
/begin MEASUREMENT fr2_w "Lambda-Regler-Ausgang; Bank2 (Word)" UWORD fak_uw_b2 1 100 0 1.99997 FORMAT "%8.6" ECU_ADDRESS 0xFA42 /end MEASUREMENT
/begin MEASUREMENT fra2_w "multiplikative Gemischkorrektur der Gemischadaption (Word)" UWORD fak_uw_b2 1 100 0 1.99997 FORMAT "%8.6" ECU_ADDRESS 0x3812AE /end MEASUREMENT
/begin MEASUREMENT frao2_w "multipl. Gemischadaptionsfaktor oberer Lastbereich Bank 2 (Word)" UWORD fak_uw_b2 1 100 0 1.99997 FORMAT "%8.6" ECU_ADDRESS 0x382FFE /end MEASUREMENT
/begin MEASUREMENT frao_w "multiplikativer Gemischadaptionsfaktor oberer Lastbereich (Word)" UWORD fak_uw_b2 1 100 0 1.99997 FORMAT "%8.6" ECU_ADDRESS 0x383000 /end MEASUREMENT
/begin MEASUREMENT frau2_w "multipl. Gemischadaptionsfaktor unterer mult. Bereich der Bank 2 (Word)" UWORD fak_uw_b2 1 100 0 1.99997 FORMAT "%8.6" ECU_ADDRESS 0x383002 /end MEASUREMENT
/begin MEASUREMENT frau_w "multiplikativer Gemischadaptionsfaktor unterer mult. Bereich (Word)" UWORD fak_uw_b2 1 100 0 1.99997 FORMAT "%8.6" ECU_ADDRESS 0x383004 /end MEASUREMENT
/begin MEASUREMENT fra_w "multiplikative Gemischkorrektur der Gemischadaption (Word)" UWORD fak_uw_b2 1 100 0 1.99997 FORMAT "%8.6" ECU_ADDRESS 0x3812B0 /end MEASUREMENT
/begin MEASUREMENT frband2_w "Lambdaregelung (Zwei-Punkt) frm-Bildung, lokale Var. im Zustandsautomat, Bank 2" SWORD fak_sw_b1 1 100 -1 0.999969 FORMAT "%8.6" ECU_ADDRESS 0x381252 /end MEASUREMENT
/begin MEASUREMENT frband_w "Lambdaregelung (Zwei-Punkt) frm-Bildung,  lokale Variable im Zustandsautomat" SWORD fak_sw_b1 1 100 -1 0.999969 FORMAT "%8.6" ECU_ADDRESS 0x381254 /end MEASUREMENT
/begin MEASUREMENT fri "LR mit Integratorstop : I-Steigung aus KFRI(n,tL) oder gemäß DSLS" UBYTE fak_ub_b77p81 1 100 0 77.8198 FORMAT "%5.2" ECU_ADDRESS 0x3809C4 /end MEASUREMENT
/begin MEASUREMENT fri2 "Bank2: LR mit Integratorst. : I-Steigung aus KFRI(n,tL) oder gem. DSLS" UBYTE fak_ub_b77p81 1 100 0 77.8198 FORMAT "%5.2" ECU_ADDRESS 0x3809C5 /end MEASUREMENT
/begin MEASUREMENT friband2_w "Lambdaregelung (Zwei-Punkt) frm-Bildung, lokale Var. im Zustandsautomat, Bank 2" SWORD fak_sw_b1 1 100 -1 0.999969 FORMAT "%8.6" ECU_ADDRESS 0x381256 /end MEASUREMENT
/begin MEASUREMENT friband_w "Lambdaregelung (Zwei-Punkt) frm-Bildung,  lokale Variable im Zustandsautomat" SWORD fak_sw_b1 1 100 -1 0.999969 FORMAT "%8.6" ECU_ADDRESS 0x381258 /end MEASUREMENT
/begin MEASUREMENT friint "I-Steigung aus KFRI(nmot,rL) oder gemäß DSLS, lokale Hilfsgröße" UBYTE fak_ub_b77p81 1 100 0 77.8198 FORMAT "%5.2" ECU_ADDRESS 0x3809C6 /end MEASUREMENT
/begin MEASUREMENT friint2 "I-Steigung aus KFRI(nmot,rL) oder gemäß DSLS, lokale Hilfsgröße, Bank 2" UBYTE fak_ub_b77p81 1 100 0 77.8198 FORMAT "%5.2" ECU_ADDRESS 0x3809C7 /end MEASUREMENT
/begin MEASUREMENT frini2_w "Initialisierungswert für Regelfaktor Lambdaregelung, Bank 2" UWORD fak_uw_b2 1 100 0 1.99997 FORMAT "%8.6" ECU_ADDRESS 0x3811EE /end MEASUREMENT
/begin MEASUREMENT frini_w "Initialisierungswert für Regelfaktor Lambdaregelung" UWORD fak_uw_b2 1 100 0 1.99997 FORMAT "%8.6" ECU_ADDRESS 0x3811F0 /end MEASUREMENT
/begin MEASUREMENT frint2_w "Regelfaktor Lambdaregelung Bank 2, Integratorausgang" UWORD fak_uw_b2 1 100 0 1.99997 FORMAT "%8.6" ECU_ADDRESS 0x38125A /end MEASUREMENT
/begin MEASUREMENT frint_w "Regelfaktor Lambdaregelung, Integratorausgang" UWORD fak_uw_b2 1 100 0 1.99997 FORMAT "%8.6" ECU_ADDRESS 0x38125C /end MEASUREMENT
/begin MEASUREMENT frm2_w "schneller Mittelwert des Lambdaregelfaktors Bank 2(Word)" UWORD fak_uw_b2 1 100 0 1.99997 FORMAT "%8.6" ECU_ADDRESS 0xFA44 /end MEASUREMENT
/begin MEASUREMENT frmn2_w "Lambda-Regler-Ausgang Minimalwert, Bank 2" UWORD fak_uw_b2 1 100 0 1.99997 FORMAT "%8.6" ECU_ADDRESS 0x38125E /end MEASUREMENT
/begin MEASUREMENT frmn_w "Lambda-Regler-Ausgang Minimalwert" UWORD fak_uw_b2 1 100 0 1.99997 FORMAT "%8.6" ECU_ADDRESS 0x381260 /end MEASUREMENT
/begin MEASUREMENT frmx2_w "LR Bank 2: Max. Begrenzung Integrator fr,; FRMAX / angehoben d.DSLS" UWORD fak_uw_b2 1 100 0 1.99997 FORMAT "%8.6" ECU_ADDRESS 0x381262 /end MEASUREMENT
/begin MEASUREMENT frmx_w "LR mit Integratorstop : Max. Begrenzung Integrator fr,; FRMAX / angehoben d.DSLS" UWORD fak_uw_b2 1 100 0 1.99997 FORMAT "%8.6" ECU_ADDRESS 0x381264 /end MEASUREMENT
/begin MEASUREMENT frm_w "schneller Mittelwert des Lambdaregelfaktors (Word)" UWORD fak_uw_b2 1 100 0 1.99997 FORMAT "%8.6" ECU_ADDRESS 0xFA46 /end MEASUREMENT
/begin MEASUREMENT frp "LR mit Integratorstop : P-Sprung aus KFRP(n,tL) oder 0 bei DSLS aktiv" UBYTE fak_ub_b12p45 1 100 0 12.4512 FORMAT "%5.2" ECU_ADDRESS 0x3809C8 /end MEASUREMENT
/begin MEASUREMENT frp2 "Bank2: LR mit Integratorstop : Kennfeldwert aus KFRP(n,tL) oder 0 bei DSLS aktiv" UBYTE fak_ub_b12p45 1 100 0 12.4512 FORMAT "%5.2" ECU_ADDRESS 0x3809C9 /end MEASUREMENT
/begin MEASUREMENT frpint "P-Sprung aus KFRP(nmot,rL) oder gemäß DSLS, lokale Hilfsgröße" UBYTE fak_ub_b12p45 1 100 0 12.4512 FORMAT "%5.2" ECU_ADDRESS 0x3809CA /end MEASUREMENT
/begin MEASUREMENT frpint2 "P-Sprung aus KFRP(nmot,rL) oder gemäß DSLS, lokale Hilfsgröße, Bank 2" UBYTE fak_ub_b12p45 1 100 0 12.4512 FORMAT "%5.2" ECU_ADDRESS 0x3809CB /end MEASUREMENT
/begin MEASUREMENT frsp2_w "Zweipunktregelung: Regelfaktor fr vor Sprung (Max-/Min-Wert) Bank 2" UWORD fak_uw_b2 1 100 0 1.99997 FORMAT "%8.6" ECU_ADDRESS 0x381266 /end MEASUREMENT
/begin MEASUREMENT frsp_w "Zweipunktregelung: Regelfaktor fr vor Sprung (Max-/Min-Wert)" UWORD fak_uw_b2 1 100 0 1.99997 FORMAT "%8.6" ECU_ADDRESS 0x381268 /end MEASUREMENT
/begin MEASUREMENT frtv "tv-Zeit aus KFRTV(nmot,rL) oder gemäß DSLS" SBYTE t10msxs_sb_q0p01 1 100 -1.28 1.27 FORMAT "%5.3" ECU_ADDRESS 0x3809CC /end MEASUREMENT
/begin MEASUREMENT frtv2 "tv-Zeit aus KFRTV(nmot,rL) oder gemäß DSLS, Bank 2" SBYTE t10msxs_sb_q0p01 1 100 -1.28 1.27 FORMAT "%5.3" ECU_ADDRESS 0x3809CD /end MEASUREMENT
/begin MEASUREMENT fr_w "Lambda-Regler-Ausgang (Word)" UWORD fak_uw_b2 1 100 0 1.99997 FORMAT "%8.6" ECU_ADDRESS 0xFA48 /end MEASUREMENT
/begin MEASUREMENT fslsdyn "Faktor Dynamikbeschreibung Sekundärluftsystem" UBYTE fak_ub_b1 1 100 0 0.996094 ECU_ADDRESS 0x380CD0 /end MEASUREMENT
/begin MEASUREMENT ftv "Faktor Bewertung tv-Korrektur Regelung hinter Kat" UBYTE fak_ub_b2 1 100 0 1.99219 FORMAT "%5.3" ECU_ADDRESS 0x380D87 /end MEASUREMENT
/begin MEASUREMENT ftv2 "Faktor Bewertung tv-Korrektur Regelung hinter Kat, Bank 2" UBYTE fak_ub_b2 1 100 0 1.99219 FORMAT "%5.3" ECU_ADDRESS 0x380D88 /end MEASUREMENT
/begin MEASUREMENT iavkatf "Kl-Source: gef. Amplitudenverhältnis hinter/vor Katalysator" UBYTE fak_ub_b1 1 100 0 0.996094 ECU_ADDRESS 0x380D89 /end MEASUREMENT
/begin MEASUREMENT idlashkm_w "KL-Source: Delta-Lambda aus Lambdareg. h. Kat (Ist-Wert fr-synchron gemittelt)" SWORD fak_sw_b1 1 100 -1 0.999969 FORMAT "%8.6" ECU_ADDRESS 0x382786 /end MEASUREMENT
/begin MEASUREMENT ilmlka2_w "Integrator Fettfläche für Katalysator-Ausräumen, Bank 2" UWORD m_uw_b4660 1 100 0 4660.27 FORMAT "%8.3" ECU_ADDRESS 0x38141A /end MEASUREMENT
/begin MEASUREMENT ilmlkah2_w "Gewichteter Integrator Fettfläche für Ausräumen Haupt-kat, Bank 2" UWORD m_uw_b4660 1 100 0 4660.27 FORMAT "%8.3" ECU_ADDRESS 0x38141C /end MEASUREMENT
/begin MEASUREMENT ilmlkah_w "Gewichteter Integrator Fettfläche für Ausräumen Haupt-kat" UWORD m_uw_b4660 1 100 0 4660.27 FORMAT "%8.3" ECU_ADDRESS 0x38141E /end MEASUREMENT
/begin MEASUREMENT ilmlkam2_w "Gewichteter Integrator Sauerstoffeintrag in den Hauptkat, Bank 2" UWORD m_uw_b4660 1 100 0 4660.27 FORMAT "%8.3" ECU_ADDRESS 0x381420 /end MEASUREMENT
/begin MEASUREMENT ilmlkam_w "Gewichteter Integrator Sauerstoffeintrag in den Hauptkat" UWORD m_uw_b4660 1 100 0 4660.27 FORMAT "%8.3" ECU_ADDRESS 0x381422 /end MEASUREMENT
/begin MEASUREMENT ilmlkat2_w "Gültig gemessener Wert des Sauerstoffspeichers, Bank 2" UWORD m_uw_b4660 1 100 0 4660.27 FORMAT "%8.3" ECU_ADDRESS 0x381424 /end MEASUREMENT
/begin MEASUREMENT ilmlkat_w "Gültig gemessener Wert des Sauerstoffspeichers" UWORD m_uw_b4660 1 100 0 4660.27 FORMAT "%8.3" ECU_ADDRESS 0x381426 /end MEASUREMENT
/begin MEASUREMENT ilmlkav2_w "Gewichteter Integrator Fettfläche nach Ende Ausräumen Vorkat, Bank 2" UWORD m_uw_b4660 1 100 0 4660.27 FORMAT "%8.3" ECU_ADDRESS 0x381428 /end MEASUREMENT
/begin MEASUREMENT ilmlkav_w "Gewichteter Integrator Fettfläche nach Ende Ausräumen Vorkat" UWORD m_uw_b4660 1 100 0 4660.27 FORMAT "%8.3" ECU_ADDRESS 0x38142A /end MEASUREMENT
/begin MEASUREMENT ilmlkax2_w "Fettflächenschwelle gesteuertes Kat-Ausräumen f(tkatm2), Bank 2" UWORD m_uw_b4660 1 100 0 4660.27 FORMAT "%8.3" ECU_ADDRESS 0x38142C /end MEASUREMENT
/begin MEASUREMENT ilmlkax_w "Fettflächenschwelle gesteuertes Kat-Ausräumen f(tkatm), Bank 1" UWORD m_uw_b4660 1 100 0 4660.27 FORMAT "%8.3" ECU_ADDRESS 0x38142E /end MEASUREMENT
/begin MEASUREMENT ilmlka_w "Integrator Fettfläche für Katalysator-Ausräumen" UWORD m_uw_b4660 1 100 0 4660.27 FORMAT "%8.3" ECU_ADDRESS 0x381430 /end MEASUREMENT
/begin MEASUREMENT imlka2_w "Integrator Luftmasse für Katalysator-Ausräumen für Stereo-LR Bank 2" UWORD m_uw_b4660 1 100 0 4660.27 FORMAT "%8.3" ECU_ADDRESS 0x381432 /end MEASUREMENT
/begin MEASUREMENT imlkav2_w "Gewichteter Integrator Luftmasse bei Ende Ausräumen Vorkat, Bank 2" UWORD m_uw_b4660 1 100 0 4660.27 FORMAT "%8.3" ECU_ADDRESS 0x381434 /end MEASUREMENT
/begin MEASUREMENT imlkav_w "Gewichteter Integrator Luftmasse bei Ende Ausräumen Vorkat" UWORD m_uw_b4660 1 100 0 4660.27 FORMAT "%8.3" ECU_ADDRESS 0x381436 /end MEASUREMENT
/begin MEASUREMENT imlkax2_w "Luftmassenschwelle geregeltes Kat-Ausräumen f(tkatm2), Bank 2" UWORD m_uw_b4660 1 100 0 4660.27 FORMAT "%8.3" ECU_ADDRESS 0x381438 /end MEASUREMENT
/begin MEASUREMENT imlkax_w "Luftmassenschwelle geregeltes Kat-Ausräumen f(tkatm), Bank 1" UWORD m_uw_b4660 1 100 0 4660.27 FORMAT "%8.3" ECU_ADDRESS 0x38143A /end MEASUREMENT
/begin MEASUREMENT imlka_w "Integrator Luftmasse für Katalysator-Ausräumen" UWORD m_uw_b4660 1 100 0 4660.27 FORMAT "%8.3" ECU_ADDRESS 0x38143C /end MEASUREMENT
/begin MEASUREMENT imlrsa_w "Luftmasse nach SA für stetige Lambdaregelung" UWORD m_uw_b4660 1 100 0 4660.27 FORMAT "%8.3" ECU_ADDRESS 0x382760 /end MEASUREMENT
/begin MEASUREMENT ke "Klopferkennungsschwelle aus Kennfeld" UBYTE fak_ub_b16 1 100 0 15.9375 FORMAT "%5.2" ARRAY_SIZE 8 ECU_ADDRESS 0x380970 /end MEASUREMENT
/begin MEASUREMENT kek "Klopferkennungsschwelle korrigiert" UBYTE fak_ub_b16 1 100 0 15.9375 FORMAT "%5.2" ARRAY_SIZE 8 ECU_ADDRESS 0x380978 /end MEASUREMENT
/begin MEASUREMENT kek_tst "Klopferkennungsschwelle korrigiert rollierend mit Zyl.zähler" UBYTE fak_ub_b16 1 100 0 15.9375 FORMAT "%5.2" ECU_ADDRESS 0x380980 /end MEASUREMENT
/begin MEASUREMENT kral1w "aktueller Wert Last-Adaptionsbereich 1" UBYTE rel_ub_q0p75 1 100 0 191.25 FORMAT "%5.1" ECU_ADDRESS 0x380B10 /end MEASUREMENT
/begin MEASUREMENT kral2w "aktueller Wert Last-Adaptionsbereich 2" UBYTE rel_ub_q0p75 1 100 0 191.25 FORMAT "%5.1" ECU_ADDRESS 0x380B11 /end MEASUREMENT
/begin MEASUREMENT krdwsw "aktueller KL-Wert der Sicherheitsspätverstellung" UBYTE zw_ub_qn0p75 1 100 -191.25 0 FORMAT "%5.1" ECU_ADDRESS 0x380B12 /end MEASUREMENT
/begin MEASUREMENT krfkw "Aktueller Wert aus KRFKN" UBYTE zw_ub_qn0p75 1 100 -191.25 0 FORMAT "%5.1" ECU_ADDRESS 0x380B13 /end MEASUREMENT
/begin MEASUREMENT krmxw "aktueller Wert für Spätbegrenzung der Spätverstellung" UBYTE zw_ub_qn0p75 1 100 -191.25 0 FORMAT "%5.1" ECU_ADDRESS 0x380B14 /end MEASUREMENT
/begin MEASUREMENT krvfakt "Initwert für normale bzw. schnelle Frühverstellung" UBYTE dez 1 100 0 255 FORMAT "%5.1" ECU_ADDRESS 0x380B15 /end MEASUREMENT
/begin MEASUREMENT krvfsw "Initwert für schnelle Frühverstellung" UBYTE dez 1 100 0 255 FORMAT "%5.1" ECU_ADDRESS 0x380B16 /end MEASUREMENT
/begin MEASUREMENT krvfw "Initwert für normale Frühverstellung" UBYTE dez 1 100 0 255 FORMAT "%5.1" ECU_ADDRESS 0x380B17 /end MEASUREMENT
/begin MEASUREMENT kvarest "KVA-Rest" UWORD fuel_uw_b1 1 100 0 0.999985 FORMAT "%9.7" ECU_ADDRESS 0x380E60 /end MEASUREMENT
/begin MEASUREMENT kvaverbr "Verbrauchte Kraftstoffmenge über CAN; normiert in u-Liter" UWORD fuel_uw_b65535 1 100 0 65535 FORMAT "%8.2" ECU_ADDRESS 0x380E62 /end MEASUREMENT
/begin MEASUREMENT lahkmz "Zustandsbyte des Automaten: fr-synchrone Mittelung Pseodo-Lambda hinter Kat" UBYTE dez 1 100 0 255 FORMAT "%5.1" ECU_ADDRESS 0x380D8A /end MEASUREMENT
/begin MEASUREMENT lahkmz2 "Zustandsbyte des Automaten: fr-synchrone Mittelung Pseodo-Lambda h. Kat, Bank 2" UBYTE dez 1 100 0 255 FORMAT "%5.1" ECU_ADDRESS 0x380D8B /end MEASUREMENT
/begin MEASUREMENT lambas "Basis-Lambda" UBYTE fak_ub_b2 1 100 0 1.99219 FORMAT "%5.3" ECU_ADDRESS 0x380B00 /end MEASUREMENT
/begin MEASUREMENT lamfa_w "Lambdasoll Fahrerwunsch (word)" UWORD fak_uw_b16 1 100 0 15.9998 FORMAT "%8.5" ECU_ADDRESS 0x382258 /end MEASUREMENT
/begin MEASUREMENT lamhf2_w "Pseudolinearisietes Lambda hinter Kat, PT1-gefiltert,Bank2, Word" UWORD fak_uw_b16 1 100 0 15.9998 FORMAT "%8.5" ECU_ADDRESS 0x382788 /end MEASUREMENT
/begin MEASUREMENT lamhf_w "Pseudolinearisietes Lambda hinter Kat, PT1-gefiltert, Word" UWORD fak_uw_b16 1 100 0 15.9998 FORMAT "%8.5" ECU_ADDRESS 0x38278A /end MEASUREMENT
/begin MEASUREMENT lamhm2_w "fr-synchron gemittelter Pseudo Lambda-Istwert gem. mit Nernst-Sonde h.Kat,Bank2" UWORD fak_uw_b16 1 100 0 15.9998 FORMAT "%8.5" ECU_ADDRESS 0x38278C /end MEASUREMENT
/begin MEASUREMENT lamhm_w "fr-synchron gemittelter Pseudo Lambda-Istwert gem. mit Nernst-Sonde h.Kat, Word" UWORD fak_uw_b16 1 100 0 15.9998 FORMAT "%8.5" ECU_ADDRESS 0x38278E /end MEASUREMENT
/begin MEASUREMENT lamka2_w "Lambdasollwert Katausräumen, Bank2" UWORD fak_uw_b16 1 100 0 15.9998 FORMAT "%8.5" ECU_ADDRESS 0x38143E /end MEASUREMENT
/begin MEASUREMENT lamkai2_w "Lambdasollwert Katausräumen, Kennfeldwert, Bank 2" UWORD fak_uw_b16 1 100 0 15.9998 FORMAT "%8.5" ECU_ADDRESS 0x381440 /end MEASUREMENT
/begin MEASUREMENT lamkaii2_w "Lambdasollwert Katausräumen, lokaler Zwischenwert, Bank 2" UWORD fak_uw_b16 1 100 0 15.9998 FORMAT "%8.5" ECU_ADDRESS 0x381442 /end MEASUREMENT
/begin MEASUREMENT lamkaii_w "Lambdasollwert Katausräumen, lokaler Zwischenwert" UWORD fak_uw_b16 1 100 0 15.9998 FORMAT "%8.5" ECU_ADDRESS 0x381444 /end MEASUREMENT
/begin MEASUREMENT lamkai_w "Lambdasollwert Katausräumen, Kennfeldwert" UWORD fak_uw_b16 1 100 0 15.9998 FORMAT "%8.5" ECU_ADDRESS 0x381446 /end MEASUREMENT
/begin MEASUREMENT lamka_w "Lambdasollwert Katausräumen" UWORD fak_uw_b16 1 100 0 15.9998 FORMAT "%8.5" ECU_ADDRESS 0x381448 /end MEASUREMENT
/begin MEASUREMENT lamkh2_w "Lambda-Motor-Soll bei Katheizen, Bank 2 (word)" UWORD fak_uw_b16 1 100 0 15.9998 FORMAT "%8.5" ECU_ADDRESS 0x3822F8 /end MEASUREMENT
/begin MEASUREMENT lamkhe2_w "Lambda-Motor-Soll bei Katheizen, effektiv, Bank 2" UWORD fak_uw_b16 1 100 0 15.9998 FORMAT "%8.5" ECU_ADDRESS 0x38225C /end MEASUREMENT
/begin MEASUREMENT lamkhe_w "Lambda-Motor-Soll bei Katheizen, effektiv" UWORD fak_uw_b16 1 100 0 15.9998 FORMAT "%8.5" ECU_ADDRESS 0x38225E /end MEASUREMENT
/begin MEASUREMENT lamkhr2_w "Lambda-Motor-Soll resultierend bei Katheizen, Bank 2 (word)" UWORD fak_uw_b4 1 100 0 3.99994 FORMAT "%8.6" ECU_ADDRESS 0x3822FA /end MEASUREMENT
/begin MEASUREMENT lamkhr_w "Lambda-Motor-Soll resultierend bei Katheizen (word)" UWORD fak_uw_b4 1 100 0 3.99994 FORMAT "%8.6" ECU_ADDRESS 0x3822FC /end MEASUREMENT
/begin MEASUREMENT lamkh_w "Lambda-Motor-Soll bei Katheizen (word)" UWORD fak_uw_b16 1 100 0 15.9998 FORMAT "%8.5" ECU_ADDRESS 0x3822FE /end MEASUREMENT
/begin MEASUREMENT lamlgm "Laufgrenze ""Lambda mager""" UBYTE fak_ub_b2 1 100 0 1.99219 FORMAT "%5.3" ECU_ADDRESS 0x380CB6 /end MEASUREMENT
/begin MEASUREMENT lams2_w "Lambda-Sollwert, Bank 2" UWORD fak_uw_b16 1 100 0 15.9998 FORMAT "%8.5" ECU_ADDRESS 0x382260 /end MEASUREMENT
/begin MEASUREMENT lamsbg2_w "Lambdasoll Begrenzung (word) Bank2" UWORD fak_uw_b16 1 100 0 15.9998 FORMAT "%8.5" ECU_ADDRESS 0x3811CA /end MEASUREMENT
/begin MEASUREMENT lamsbg_w "Lambdasoll Begrenzung (word)" UWORD fak_uw_b16 1 100 0 15.9998 FORMAT "%8.5" ECU_ADDRESS 0x3811CC /end MEASUREMENT
/begin MEASUREMENT lamsnka2_w "Lambda-Sollwert interne Auswertung in LRKA, bank 2" UWORD fak_uw_b16 1 100 0 15.9998 FORMAT "%8.5" ECU_ADDRESS 0x38144A /end MEASUREMENT
/begin MEASUREMENT lamsnka_w "Lambda-Sollwert interne Auswertung in LRKA" UWORD fak_uw_b16 1 100 0 15.9998 FORMAT "%8.5" ECU_ADDRESS 0x38144C /end MEASUREMENT
/begin MEASUREMENT lamsolh2_w "Pseudo Lambda-Sollwert hinter Kat, Bank2" UWORD fak_uw_b16 1 100 0 15.9998 FORMAT "%8.5" ECU_ADDRESS 0x382790 /end MEASUREMENT
/begin MEASUREMENT lamsolh_w "Pseudo Lambda-Sollwert hinter Kat" UWORD fak_uw_b16 1 100 0 15.9998 FORMAT "%8.5" ECU_ADDRESS 0x382792 /end MEASUREMENT
/begin MEASUREMENT lamsonh2_w "Pseudo Lambda-Istwert gemessen mit Nernst-Sonde hinter Kat (word), Bank2" UWORD fak_uw_b16 1 100 0 15.9998 FORMAT "%8.5" ECU_ADDRESS 0x382794 /end MEASUREMENT
/begin MEASUREMENT lamsonh_w "Pseudo Lambda-Istwert gemessen mit Nernst-Sonde hinter Kat (word)" UWORD fak_uw_b16 1 100 0 15.9998 FORMAT "%8.5" ECU_ADDRESS 0x382796 /end MEASUREMENT
/begin MEASUREMENT lamsons2_w "Lambda-Sollwert bezogen auf Einbauort Lambda-Sensor Bank2" UWORD fak_uw_b16 1 100 0 15.9998 FORMAT "%8.5" ECU_ADDRESS 0x3811CE /end MEASUREMENT
/begin MEASUREMENT lamsons_w "Lambda-Sollwert bezogen auf Einbauort Lambda-Sensor" UWORD fak_uw_b16 1 100 0 15.9998 FORMAT "%8.5" ECU_ADDRESS 0x3811D0 /end MEASUREMENT
/begin MEASUREMENT lamsos2_w "Lambda-Sollwert bezogen auf Einbauort Lambda-Sensor Bank2" UWORD fak_uw_b16 1 100 0 15.9998 FORMAT "%8.5" ECU_ADDRESS 0x382262 /end MEASUREMENT
/begin MEASUREMENT lamsos_w "Lambda-Sollwert bezogen auf Einbauort Lambda-Sensor" UWORD fak_uw_b16 1 100 0 15.9998 FORMAT "%8.5" ECU_ADDRESS 0x382264 /end MEASUREMENT
/begin MEASUREMENT lamsubg2_w "Lambdasoll unbegrenzt (word)" UWORD fak_uw_b16 1 100 0 15.9998 FORMAT "%8.5" ECU_ADDRESS 0x382266 /end MEASUREMENT
/begin MEASUREMENT lamsubg_w "Lambdasoll unbegrenzt (word)" UWORD fak_uw_b16 1 100 0 15.9998 FORMAT "%8.5" ECU_ADDRESS 0x382268 /end MEASUREMENT
/begin MEASUREMENT lams_w "Lambda-Sollwert" UWORD fak_uw_b16 1 100 0 15.9998 FORMAT "%8.5" ECU_ADDRESS 0x38226A /end MEASUREMENT
/begin MEASUREMENT lamvoa2_w "Lambdavorsteuerung ohne additive Anteile" UWORD fak_uw_b16 1 100 0 15.9998 FORMAT "%8.5" ECU_ADDRESS 0x38226C /end MEASUREMENT
/begin MEASUREMENT lamvoa_w "Lambdavorsteuerung ohne additive Anteile" UWORD fak_uw_b16 1 100 0 15.9998 FORMAT "%8.5" ECU_ADDRESS 0x38226E /end MEASUREMENT
/begin MEASUREMENT lanskh_w "Lambda-Motor-Soll im Nachstart bei Katheizen" UWORD fak_uw_b16 1 100 0 15.9998 FORMAT "%8.5" ECU_ADDRESS 0x382300 /end MEASUREMENT
/begin MEASUREMENT lasdsl_w "Lambda-Abgas-Soll für Sekundärluftdiagnose" UWORD fak_uw_b4 1 100 0 3.99994 FORMAT "%8.6" ECU_ADDRESS 0x382302 /end MEASUREMENT
/begin MEASUREMENT laskh_w "Lambda-Abgas-Soll bei Katheizen (word)" UWORD fak_uw_b4 1 100 0 3.99994 FORMAT "%8.6" ECU_ADDRESS 0x382304 /end MEASUREMENT
/begin MEASUREMENT limax_w "LLR-Integrator-Maximalwert" SWORD rel_sw_b100 1 100 -100 99.9969 FORMAT "%8.4" ECU_ADDRESS 0x382360 /end MEASUREMENT
/begin MEASUREMENT limin_w "LLR-Integrator-Minimalwert" SWORD rel_sw_b100 1 100 -100 99.9969 FORMAT "%8.4" ECU_ADDRESS 0x382362 /end MEASUREMENT
/begin MEASUREMENT limnst "LLR-Integrator-Minimalwert während Nachstart" UBYTE rel_ub_b24p9 1 100 0 24.9 FORMAT "%5.2" ECU_ADDRESS 0x380CEC /end MEASUREMENT
/begin MEASUREMENT lkrnew "Lastwert Zeitpunkt t" SWORD rel_sw_q0p0234 1 100 -768 767.977 FORMAT "%8.4" ECU_ADDRESS 0x3811A0 /end MEASUREMENT
/begin MEASUREMENT lkrold "Lastwert Zeitpunkt t-dt" SWORD rel_sw_q0p0234 1 100 -768 767.977 FORMAT "%8.4" ECU_ADDRESS 0x3811A2 /end MEASUREMENT
/begin MEASUREMENT lkrw "aktueller Wert der Lastschwelle Klopfregelung" UBYTE rel_ub_q0p75 1 100 0 191.25 FORMAT "%5.1" ECU_ADDRESS 0x380B18 /end MEASUREMENT
/begin MEASUREMENT llsstat "Funktionsstatus LLRNS bei Anforderung Systemcheck" UBYTE dez 1 100 0 255 FORMAT "%5.1" ECU_ADDRESS 0x380CE0 /end MEASUREMENT
/begin MEASUREMENT lmskh_w "Lambda-Motor-Soll bei katheizen (word)" UWORD fak_uw_b4 1 100 0 3.99994 FORMAT "%8.6" ECU_ADDRESS 0x382306 /end MEASUREMENT
/begin MEASUREMENT lmssl2_w "Lambda-Motor-Soll wegen Sekundärluft bei Kathezen, Bank 2" UWORD fak_uw_b4 1 100 0 3.99994 FORMAT "%8.6" ECU_ADDRESS 0x382308 /end MEASUREMENT
/begin MEASUREMENT lmssl_w "Lambda-Motor-Soll wegen Sekundärluft bei Katheizen (word)" UWORD fak_uw_b4 1 100 0 3.99994 FORMAT "%8.6" ECU_ADDRESS 0x38230A /end MEASUREMENT
/begin MEASUREMENT lrfrmz "Zustandsbyte des Automaten Bildung des fr-Mittelwert frm_w" UBYTE dez 1 100 0 255 FORMAT "%5.1" ECU_ADDRESS 0x3809CE /end MEASUREMENT
/begin MEASUREMENT lrfrmz2 "Zustandsbyte des Automaten Bildung des fr-Mittelwert frm_w, Bank 2" UBYTE dez 1 100 0 255 FORMAT "%5.1" ECU_ADDRESS 0x3809CF /end MEASUREMENT
/begin MEASUREMENT lrfrz "Zustandsbyte des LR-Automaten" UBYTE dez 1 100 0 255 FORMAT "%5.1" ECU_ADDRESS 0x3809D0 /end MEASUREMENT
/begin MEASUREMENT lrfrz2 "Zustandsbyte des LR-Automaten, Bank 2" UBYTE dez 1 100 0 255 FORMAT "%5.1" ECU_ADDRESS 0x3809D1 /end MEASUREMENT
/begin MEASUREMENT LRHKlokbits "" UBYTE dez 1 100 0 255 FORMAT "%5.1" ECU_ADDRESS 0x380D8C /end MEASUREMENT
/begin MEASUREMENT lrkaz "Zustandsbyte des Automaten Kat-Ausräumen" UBYTE dez 1 100 0 255 FORMAT "%5.1" ECU_ADDRESS 0x3809B8 /end MEASUREMENT
/begin MEASUREMENT lrkaz2 "Zustandsbyte des Automaten Kat-Ausräumen für Stereo-LR Bank 2" UBYTE dez 1 100 0 255 FORMAT "%5.1" ECU_ADDRESS 0x3809B9 /end MEASUREMENT
/begin MEASUREMENT mibas_w "indiziertes Basis-Moment" UWORD rel_uw_b100 1 100 0 99.9985 FORMAT "%8.5" ECU_ADDRESS 0xFA26 /end MEASUREMENT
/begin MEASUREMENT mioptl1_w "optimales indiziertes Motormoment bei Lambda = 1" UWORD rel_uw_b100 1 100 0 99.9985 FORMAT "%8.5" ECU_ADDRESS 0x38106E /end MEASUREMENT
/begin MEASUREMENT miopt_w "optimales indiziertes Moment" UWORD rel_uw_b100 1 100 0 99.9985 FORMAT "%8.5" ECU_ADDRESS 0xFA28 /end MEASUREMENT
/begin MEASUREMENT mlnka2_w "Luftmasse nach Kat-Ausräumen, Bank 2" UWORD m_uw_b7281 1 100 0 7281.67 FORMAT "%8.3" ECU_ADDRESS 0x382798 /end MEASUREMENT
/begin MEASUREMENT mlnka_w "Luftmasse nach Kat-Ausräumen" UWORD m_uw_b7281 1 100 0 7281.67 FORMAT "%8.3" ECU_ADDRESS 0x38279A /end MEASUREMENT
/begin MEASUREMENT ngkrf_w "gefilterter Drehzahlgradient KRKE" SWORD nmotg_sw_q0p39 1 100 -12800.2 12799.8 FORMAT "%8.2" ECU_ADDRESS 0x3811A4 /end MEASUREMENT
/begin MEASUREMENT ngkrv_w "aktueller Wert Drehzahldynamikschwelle" SWORD nmotg_sw_q0p39 1 100 -12800.2 12799.8 FORMAT "%8.2" ECU_ADDRESS 0x3811A6 /end MEASUREMENT
/begin MEASUREMENT nsfsm "LLR: Motortemperaturabhängige Solldrehzahl im LL bei S_fs=1" UBYTE nmot_ub_q10 1 100 0 2550 FORMAT "%5.0" ECU_ADDRESS 0x380CE1 /end MEASUREMENT
/begin MEASUREMENT nsfsmn "LLR: Minimale Solldrehzahl bei eingelegter Fahrstufe" UBYTE nmot_ub_q10 1 100 0 2550 FORMAT "%5.0" ECU_ADDRESS 0x380CE5 /end MEASUREMENT
/begin MEASUREMENT nslbz "Solldrehtahl abhängig von lbz" UBYTE nmot_ub_q10 1 100 0 2550 FORMAT "%5.0" ECU_ADDRESS 0x380CE2 /end MEASUREMENT
/begin MEASUREMENT nsllm "LLR: Motortemperaturabhängige Solldrehzahl im LL" UBYTE nmot_ub_q10 1 100 0 2550 FORMAT "%5.0" ECU_ADDRESS 0x380CE3 /end MEASUREMENT
/begin MEASUREMENT nsllmn "LLR: Minimale Solldrehzahl im LL" UBYTE nmot_ub_q10 1 100 0 2550 FORMAT "%5.0" ECU_ADDRESS 0x380CE6 /end MEASUREMENT
/begin MEASUREMENT nsnf "LLR: Nachgeführte Solldrehzahl" UBYTE nmot_ub_q10 1 100 0 2550 FORMAT "%5.0" ECU_ADDRESS 0x380CE7 /end MEASUREMENT
/begin MEASUREMENT nsol "Leerlaufsolldrehzahl" UBYTE nmot_ub_q10 1 100 0 2550 FORMAT "%5.0" ECU_ADDRESS 0x380CE8 /end MEASUREMENT
/begin MEASUREMENT nsst "Initialisierungswert der Solldrehzahl im Start" UBYTE nmot_ub_q10 1 100 0 2550 FORMAT "%5.0" ECU_ADDRESS 0x380CE9 /end MEASUREMENT
/begin MEASUREMENT nstat "Solldrehzahl stationär" UBYTE nmot_ub_q10 1 100 0 2550 FORMAT "%5.0" ECU_ADDRESS 0x380CEA /end MEASUREMENT
/begin MEASUREMENT percnt2_w "Zähler 10-ms-Schritte für fr-synchrone lamsolh-Mittelung, Bank 2" UWORD dez 1 100 0 65535 FORMAT "%8.2" ECU_ADDRESS 0x38279C /end MEASUREMENT
/begin MEASUREMENT percnt_w "Zähler 10-ms-Schritte für fr-synchrone lamsolh-Mittelung" UWORD dez 1 100 0 65535 FORMAT "%8.2" ECU_ADDRESS 0x38279E /end MEASUREMENT
/begin MEASUREMENT ptv "LRHK: P-Anteil für verzögerte Reglerumschaltung tv, ungewichtet" SBYTE t100msxs_sb_q0p01 1 100 -1.28 1.27 FORMAT "%5.3" ECU_ADDRESS 0x380D8D /end MEASUREMENT
/begin MEASUREMENT ptv2 "Bank2: P-Anteil für verzögerte Reglerumschaltung tv, ungewichtet" SBYTE t100msxs_sb_q0p01 1 100 -1.28 1.27 FORMAT "%5.3" ECU_ADDRESS 0x380D8E /end MEASUREMENT
/begin MEASUREMENT rka2_w "Additive adaptive Korrektur der relativen Kraftstoffmasse" SWORD rel_sw_b1536 1 100 -1536 1535.95 FORMAT "%8.3" ECU_ADDRESS 0x3812B2 /end MEASUREMENT
/begin MEASUREMENT rkat2_w "additive Gemischkorrektur (pro Zeit) der Gemischadaption Bank 2 (Word)" SWORD rel_sw_b1536 1 100 -1536 1535.95 FORMAT "%8.3" ECU_ADDRESS 0x383006 /end MEASUREMENT
/begin MEASUREMENT rkat_w "additive Gemischkorrektur (pro Zeit) der Gemischdaption (Word)" SWORD rel_sw_b1536 1 100 -1536 1535.95 FORMAT "%8.3" ECU_ADDRESS 0x383008 /end MEASUREMENT
/begin MEASUREMENT rkaz2_w "additive Gemischkorrektur (pro Zündung) der Gemischadaption Bank2 (Word)" SWORD rel_sw_b1536 1 100 -1536 1535.95 FORMAT "%8.3" ECU_ADDRESS 0x38300A /end MEASUREMENT
/begin MEASUREMENT rkaz_w "additive Gemischkorrektur (pro Zündung) der Gemischadaption" SWORD rel_sw_b1536 1 100 -1536 1535.95 FORMAT "%8.3" ECU_ADDRESS 0x38300C /end MEASUREMENT
/begin MEASUREMENT rka_w "Additive adaptive Korrektur der relativen Kraftstoffmasse" SWORD rel_sw_b1536 1 100 -1536 1535.95 FORMAT "%8.3" ECU_ADDRESS 0x3812B4 /end MEASUREMENT
/begin MEASUREMENT rkr "Referenzpegel Klopfregelung" UBYTE spg_ub_b5 1 100 0 4.98047 FORMAT "%5.3" ARRAY_SIZE 8 ECU_ADDRESS 0x380981 /end MEASUREMENT
/begin MEASUREMENT rkrmx "nach oben begrenzter Referenzpegel" UBYTE spg_ub_b5 1 100 0 4.98047 FORMAT "%5.3" ECU_ADDRESS 0xF8F0 /end MEASUREMENT
/begin MEASUREMENT rkrmx1w "aktueller Wert der KL RKRMX1N" UBYTE spg_ub_b320 1 100 0 318.75 ECU_ADDRESS 0x380989 /end MEASUREMENT
/begin MEASUREMENT rkrmx2w "aktueller Wert der KL RKRMX2N" UBYTE spg_ub_b320 1 100 0 318.75 ECU_ADDRESS 0x38098A /end MEASUREMENT
/begin MEASUREMENT rkr_tst "Referenzpegel Klopfregelung rollierend mit Zyl.zähler" UBYTE spg_ub_b5 1 100 0 4.98047 FORMAT "%5.3" ECU_ADDRESS 0x38098B /end MEASUREMENT
/begin MEASUREMENT rl_w_kge "Eingang relative Füllung (Word) für mehrfach verwendete Kenngr." UWORD rel_uw_q0p0234 1 100 0 1535.98 FORMAT "%8.3" ECU_ADDRESS 0x381070 /end MEASUREMENT
/begin MEASUREMENT stkrlx "Laststützstelle für die KR-Adaption" UBYTE dez 1 100 0 255 FORMAT "%5.1" ECU_ADDRESS 0x380B19 /end MEASUREMENT
/begin MEASUREMENT stkrnx "Drehzahlstützstelle für die KR-Adaption" UBYTE dez 1 100 0 255 FORMAT "%5.1" ECU_ADDRESS 0x380B1A /end MEASUREMENT
/begin MEASUREMENT tansst "Ansaugluft-Temperatur bei Start" UBYTE temp_ub_q0p75_o48 1 100 -48 143.25 FORMAT "%5.1" ECU_ADDRESS 0x380D82 /end MEASUREMENT
/begin MEASUREMENT te_ges "" UWORD t3p2usxms_uw_b209p7 1 100 0 209.748 FORMAT "%8.4" ECU_ADDRESS 0x381484 /end MEASUREMENT
/begin MEASUREMENT tfrn2_w "Zeitdauer Lambdaregler I-Anteil negative Steigung, Bank 2" UWORD t10msxs_uw_b655p35 1 100 0 655.35 FORMAT "%8.4" ECU_ADDRESS 0x38126A /end MEASUREMENT
/begin MEASUREMENT tfrnint2_w "Zähler zum Ausmessen Zeitdauer Lambdaregler I-Anteil negative Steigung, Bank 2" UWORD t10msxs_uw_b655p35 1 100 0 655.35 FORMAT "%8.4" ECU_ADDRESS 0x38126C /end MEASUREMENT
/begin MEASUREMENT tfrnint_w "Zähler zum Ausmessen Zeitdauer Lambdaregler I-Anteil negative Steigung" UWORD t10msxs_uw_b655p35 1 100 0 655.35 FORMAT "%8.4" ECU_ADDRESS 0x38126E /end MEASUREMENT
/begin MEASUREMENT tfrn_w "Zeitdauer Lambdaregler I-Anteil negative Steigung" UWORD t10msxs_uw_b655p35 1 100 0 655.35 FORMAT "%8.4" ECU_ADDRESS 0x381270 /end MEASUREMENT
/begin MEASUREMENT tfrp2_w "Zeitdauer Lambdaregler I-Anteil positive Steigung, Bank2" UWORD t10msxs_uw_b655p35 1 100 0 655.35 FORMAT "%8.4" ECU_ADDRESS 0x381272 /end MEASUREMENT
/begin MEASUREMENT tfrpint2_w "Zähler zur Messung der Zeitdauer Lambdaregler I-Anteil positive Steigung, Bank 2" UWORD t10msxs_uw_b655p35 1 100 0 655.35 FORMAT "%8.4" ECU_ADDRESS 0x381274 /end MEASUREMENT
/begin MEASUREMENT tfrpint_w "Zähler zur Messung der Zeitdauer Lambdaregler I-Anteil positive Steigung" UWORD t10msxs_uw_b655p35 1 100 0 655.35 FORMAT "%8.4" ECU_ADDRESS 0x381276 /end MEASUREMENT
/begin MEASUREMENT tfrp_w "Zeitdauer Lambdaregler I-Anteil positive Steigung" UWORD t10msxs_uw_b655p35 1 100 0 655.35 FORMAT "%8.4" ECU_ADDRESS 0x381278 /end MEASUREMENT
/begin MEASUREMENT tplrvk2_w "Periodendauerwert Rohwert der Sonde vor Kat, ermittelt in %LR, Bank 2" UWORD t10msxs_uw_b655p35 1 100 0 655.35 FORMAT "%8.4" ECU_ADDRESS 0x38127A /end MEASUREMENT
/begin MEASUREMENT tplrvk_w "Periodendauerwert Rohwert der Sonde vor Kat, ermittelt in %LR" UWORD t10msxs_uw_b655p35 1 100 0 655.35 FORMAT "%8.4" ECU_ADDRESS 0x38127C /end MEASUREMENT
/begin MEASUREMENT tsaka "Timer Schubdauer für Katalysator-Ausräumen" UBYTE t20msxs_ub_b5p1 1 100 0 5.1 FORMAT "%5.3" ECU_ADDRESS 0x3809BA /end MEASUREMENT
/begin MEASUREMENT tsaka2 "Timer Schubdauer für Katalysator-Ausräumen für Stereo_LR Bank 2" UBYTE t20msxs_ub_b5p1 1 100 0 5.1 FORMAT "%5.3" ECU_ADDRESS 0x3809BB /end MEASUREMENT
/begin MEASUREMENT tsperr "Sperrzeit für Lambdaregelung" UBYTE t10msxs_ub_b2p55 1 100 0 2.55 FORMAT "%5.3" ECU_ADDRESS 0x3809D2 /end MEASUREMENT
/begin MEASUREMENT tsperr2 "Sperrzeit für Lambdaregelung, Bank 2" UBYTE t10msxs_ub_b2p55 1 100 0 2.55 FORMAT "%5.3" ECU_ADDRESS 0x3809D3 /end MEASUREMENT
/begin MEASUREMENT tv "LR: Integratorstopzeit-Zähler / ES: Bereitstellung Spannungskorrektur" SBYTE t10msxs_sb_q0p01 1 100 -1.28 1.27 FORMAT "%5.3" ECU_ADDRESS 0x3809D4 /end MEASUREMENT
/begin MEASUREMENT tv2 "LR Bank 2: Integratorstopzeit-Zähler / ES: Bereitstellung Spannungskorrektur" SBYTE t10msxs_sb_q0p01 1 100 -1.28 1.27 FORMAT "%5.3" ECU_ADDRESS 0x3809D5 /end MEASUREMENT
/begin MEASUREMENT tvlr "LR: Summenwert für verzögerte Reglerumschaltung tv" SBYTE t10msxs_sb_q0p01 1 100 -1.28 1.27 FORMAT "%5.3" ECU_ADDRESS 0x3809D6 /end MEASUREMENT
/begin MEASUREMENT tvlr2 "LR: Summenwert für verzögerte Reglerumschaltung tv 2" SBYTE t10msxs_sb_q0p01 1 100 -1.28 1.27 FORMAT "%5.3" ECU_ADDRESS 0x3809D7 /end MEASUREMENT
/begin MEASUREMENT tvlrh "LRHK: Korrekturwert für verzögerte Reglerumschaltung tv" SBYTE t100msxs_sb_q0p01 1 100 -1.28 1.27 FORMAT "%5.3" ECU_ADDRESS 0x3809BC /end MEASUREMENT
/begin MEASUREMENT tvlrh2 "LRHK: Korrekturwert für verzögerte Reglerumschaltung tv 2" SBYTE t100msxs_sb_q0p01 1 100 -1.28 1.27 FORMAT "%5.3" ECU_ADDRESS 0x3809BD /end MEASUREMENT
/begin MEASUREMENT tvlrhi "I-Anteil für verzögerte Reglerumschaltung tv, gewichtet" SBYTE t100msxs_sb_q0p01 1 100 -1.28 1.27 FORMAT "%5.3" ECU_ADDRESS 0x3809BE /end MEASUREMENT
/begin MEASUREMENT tvlrhi2 "Bank2: I-Anteil für verzögerte Reglerumschaltung tv, gewichtet" SBYTE t100msxs_sb_q0p01 1 100 -1.28 1.27 FORMAT "%5.3" ECU_ADDRESS 0x3809BF /end MEASUREMENT
/begin MEASUREMENT tvlrhp "P-Anteil für verzögerte Reglerumschaltung tv, gewichtet" SBYTE t100msxs_sb_q0p01 1 100 -1.28 1.27 FORMAT "%5.3" ECU_ADDRESS 0x380D8F /end MEASUREMENT
/begin MEASUREMENT tvlrhp2 "Bank2: P-Anteil für verzögerte Reglerumschaltung tv, gewichtet" SBYTE t100msxs_sb_q0p01 1 100 -1.28 1.27 FORMAT "%5.3" ECU_ADDRESS 0x380D90 /end MEASUREMENT
/begin MEASUREMENT usrhk "aktuelle Regelschwelle Lambdasignal h.K." UBYTE spg_ub_q0p0052_o0p2 1 100 -0.2 1.13 FORMAT "%5.3" ECU_ADDRESS 0x3809C0 /end MEASUREMENT
/begin MEASUREMENT usrhk2 "aktuelle Regelschwelle Lambdasignal h.K., Bank 2" UBYTE spg_ub_q0p0052_o0p2 1 100 -0.2 1.13 FORMAT "%5.3" ECU_ADDRESS 0x3809C1 /end MEASUREMENT
/begin MEASUREMENT virkr "Verhältnis Integrator / Referenzpegel Klopfregelung" UBYTE fak_ub_b16 1 100 0 15.9375 FORMAT "%5.2" ECU_ADDRESS 0xF8F1 /end MEASUREMENT
/begin MEASUREMENT vkr "Verstärkungsstufe für Eingangsverstärkung Klopf-IC" UBYTE dez 1 100 0 255 FORMAT "%5.1" ARRAY_SIZE 8 ECU_ADDRESS 0x38098C /end MEASUREMENT
/begin MEASUREMENT vkr_tst "Verstärkungsstufe für Eingangsverstärkung Klopf-IC rollierend mit Zyl.zähler" UBYTE dez 1 100 0 255 FORMAT "%5.1" ECU_ADDRESS 0x380994 /end MEASUREMENT
/begin MEASUREMENT vszwm "Mittelwert der ZW-Verstellung über VS2x" SBYTE zw_sb_q0p75 1 100 -96 95.25 FORMAT "%5.2" ECU_ADDRESS 0x380B1B /end MEASUREMENT
/begin MEASUREMENT wkr "zylinderindividuelle Zündwinkelspätverstellung KR" UBYTE zw_ub_qn0p75 1 100 -191.25 0 FORMAT "%5.1" ARRAY_SIZE 8 ECU_ADDRESS 0xF878 /end MEASUREMENT
/begin MEASUREMENT wkra "last und drehzahlabh. Adaptionskennfeld f. wkr" UBYTE zw_ub_qn0p75 1 100 -191.25 0 FORMAT "%5.1" ARRAY_SIZE 160 ECU_ADDRESS 0x382F36 /end MEASUREMENT
/begin MEASUREMENT wkratst "wkra mit Synchro-Raster rollierend" UBYTE zw_ub_qn0p75 1 100 -191.25 0 FORMAT "%5.1" ECU_ADDRESS 0x380B1C /end MEASUREMENT
/begin MEASUREMENT wkrdy "Zündwinkelspätverstellung bei KR-Dynamik" UBYTE zw_ub_qn0p75 1 100 -191.25 0 FORMAT "%5.1" ECU_ADDRESS 0xF882 /end MEASUREMENT
/begin MEASUREMENT wkrdya "adaptierter Zündwinkel bei KR-Dynamik" UBYTE zw_ub_qn0p75 1 100 -191.25 0 FORMAT "%5.1" ARRAY_SIZE 5 ECU_ADDRESS 0x382FD6 /end MEASUREMENT
/begin MEASUREMENT wkrm "Mittelwert der zylinderindividuellen ZW-Spätverstellungen durch KR" UBYTE zw_ub_qn0p75 1 100 -191.25 0 FORMAT "%5.1" ECU_ADDRESS 0xF880 /end MEASUREMENT
/begin MEASUREMENT wkrma "Mittelwert der ZW-Spätverstellungen KR, allgemein (im Notlauf mit Sicherheit)" UBYTE zw_ub_qn0p75 1 100 -191.25 0 FORMAT "%5.1" ECU_ADDRESS 0xF881 /end MEASUREMENT
/begin MEASUREMENT wkr_tst "zyl.ind. ZW-Spätverstellung, rollierend" UBYTE zw_ub_qn0p75 1 100 -191.25 0 FORMAT "%5.1" ECU_ADDRESS 0x380B1D /end MEASUREMENT
/begin MEASUREMENT zaldy "Zündungszähler für Abregelung Lastdynamik" UBYTE dez 1 100 0 255 FORMAT "%5.1" ECU_ADDRESS 0x38099F /end MEASUREMENT
/begin MEASUREMENT zatv "Integrationsgeschindigkeit I-Anteil  Regelung hinter Kat" UBYTE tgrad_ub_q0p039 1 100 0 9.96094 FORMAT "%5.3" ECU_ADDRESS 0x380D91 /end MEASUREMENT
/begin MEASUREMENT zatv2 "Integrationsgeschindigkeit I-Anteil  Regelung hinter Kat, Bank 2" UBYTE tgrad_ub_q0p039 1 100 0 9.96094 FORMAT "%5.3" ECU_ADDRESS 0x380D92 /end MEASUREMENT
/begin MEASUREMENT zkrvf "Zähler, bestimmt die Frequenz der zyl.-individuellen Zündwinkelfrühverstellung" UBYTE dez 1 100 0 255 FORMAT "%5.1" ARRAY_SIZE 8 ECU_ADDRESS 0x380B1E /end MEASUREMENT
/begin MEASUREMENT zldy "Zündungszähler für Lastdynamik" UBYTE dez 1 100 0 255 FORMAT "%5.1" ECU_ADDRESS 0xF883 /end MEASUREMENT
/begin MEASUREMENT zndy "Zündungszähler für Drehzahldynamik" UBYTE dez 1 100 0 255 FORMAT "%5.1" ECU_ADDRESS 0xF884 /end MEASUREMENT
/begin MEASUREMENT zwopt "optimaler Zündwinkel" SBYTE zw_sb_q0p75 1 100 -96 95.25 FORMAT "%5.2" ECU_ADDRESS 0xFA2A /end MEASUREMENT
/begin MEASUREMENT zwoptl1 "optimaler Zündwinkel bei Lambda=1" SBYTE zw_sb_q0p75 1 100 -96 95.25 FORMAT "%5.2" ECU_ADDRESS 0x38091B /end MEASUREMENT
/begin MEASUREMENT zzwdykr "Zündungszähler bei gesetztem Bit B_zwkra=1 während der KR-Dynamik" UWORD dez 1 100 0 65535 FORMAT "%8.2" ECU_ADDRESS 0xF888 /end MEASUREMENT
/begin MEASUREMENT zzwdymd "Zündungszähler bei nicht gesetztem Bit B_zwkra=0 während der KR-Dynamik" UWORD dez 1 100 0 65535 FORMAT "%8.2" ECU_ADDRESS 0xF88A /end MEASUREMENT
/begin FUNCTION KRDY "Klopfregelung Dynamik"
 /begin DEF_CHARACTERISTIC AZKRLDYN AZKRNDYN CWKR DYADMX DYADS DYAMNV DYAVF FKELDYA KFDYES KFDYESOF NGKRWN NKRUM PZWKRA TMDYNA ZNGKR /end DEF_CHARACTERISTIC
 /begin REF_CHARACTERISTIC SNM08KRUW SNM16KRUB SWD06KRSW /end REF_CHARACTERISTIC
 /begin IN_MEASUREMENT B_kl B_ll B_pwf B_tmkr B_zwkraa drlp_w drl_w esst_snm08kruw esst_snm16krub esst_swd06krsw kek ngas_w nmot nmot_w rlp_w rl_w stkrnx tmot virkr wdkba_w zzylkr /end IN_MEASUREMENT
 /begin OUT_MEASUREMENT B_krldy B_krldya B_krldyf B_krndy drlkrdy dyesofv dyesv dyesvs lkrnew lkrold ngkrf_w ngkrv_w wkrdy zaldy zldy zndy zzwdykr zzwdymd /end OUT_MEASUREMENT
 /begin LOC_MEASUREMENT B_drlkrdy B_kldynrm B_kldystk wkrdya /end LOC_MEASUREMENT
 /begin SUB_FUNCTION /end SUB_FUNCTION
/end FUNCTION
/begin FUNCTION KRKE "Klopferkennung"
 /begin DEF_CHARACTERISTIC FKELDY FKENDY KE1N KE2N KE3N KE4N KE5N KE6N KE7N KE8N KRFTP1 KRFTP2 KRFTP3 KRKFKS KRVST KSZA REFINI RKRMX1N RKRMX2N ZYRKR /end DEF_CHARACTERISTIC
 /begin REF_CHARACTERISTIC SNM16KRUB /end REF_CHARACTERISTIC
 /begin IN_MEASUREMENT B_c95ks3 B_dnt B_dntb B_dtp B_dtpb B_kr B_krldy B_krndy B_st B_synph esst_snm16krub ikr ikrma ikrme nmot vske zzylkr /end IN_MEASUREMENT
 /begin OUT_MEASUREMENT B_c95_g0 B_c95_g1 B_c95_g2 B_kl ke kek kek_tst rkr rkrmx rkrmx1w rkrmx2w rkr_tst virkr vkr vkr_tst /end OUT_MEASUREMENT
 /begin LOC_MEASUREMENT /end LOC_MEASUREMENT
 /begin SUB_FUNCTION /end SUB_FUNCTION
/end FUNCTION
/begin FUNCTION KRRA "Klopfregelung mit Adaption der zylinderindividuellen Spätverstellung"
 /begin DEF_CHARACTERISTIC DWKRMSN KFKRMX KRAL1N KRAL2N KRALH KRAN1 KRAN2 KRAN3 KRAN4 KRANH KRDWA KRDWSN KRFKN KRLMDY KRNMDY KRVFN KRVFSN KRWKRUM LKRN NKRF NKRFA STKRLDY STKRNDY TMKR TMKRAN /end DEF_CHARACTERISTIC
 /begin REF_CHARACTERISTIC SNM16KRUB _ZYLZA /end REF_CHARACTERISTIC
 /begin IN_MEASUREMENT B_kl B_krdws B_krldy B_krldya B_krndy B_pwf B_stend B_vl esst_snm16krub nmot rl tmot vszwkr wkrdy zwkrafld zzylkr /end IN_MEASUREMENT
 /begin OUT_MEASUREMENT B_kr B_krlmdy B_krnmdy B_tmkr dwkr dwkrz krvfakt lkrw stkrlx stkrnx vszwm wkr wkra wkratst wkrm wkrma wkr_tst /end OUT_MEASUREMENT
 /begin LOC_MEASUREMENT B_kra B_wkral B_zwkraa B_zwkrum dwkrmsw kral1w kral2w krdwsw krfkw krmxw krvfsw krvfw zkrvf /end LOC_MEASUREMENT
 /begin SUB_FUNCTION /end SUB_FUNCTION
/end FUNCTION
/begin FUNCTION kstda111 "" /begin DEF_CHARACTERISTIC /end DEF_CHARACTERISTIC /begin REF_CHARACTERISTIC /end REF_CHARACTERISTIC /begin IN_MEASUREMENT fcmEnd FCMTab ffzdfp kmstand kmstmil_w /end IN_MEASUREMENT /begin OUT_MEASUREMENT /end OUT_MEASUREMENT /begin LOC_MEASUREMENT /end LOC_MEASUREMENT /begin SUB_FUNCTION /end SUB_FUNCTION /end FUNCTION
/begin FUNCTION KVA "Ausgangssignal: Kraftstoff-Verbrauchs-Anzeige" /begin DEF_CHARACTERISTIC FKVAUM /end DEF_CHARACTERISTIC /begin REF_CHARACTERISTIC _ZYLZA /end REF_CHARACTERISTIC /begin IN_MEASUREMENT anzti frkte rk2_w rkte_w rk_w /end IN_MEASUREMENT /begin OUT_MEASUREMENT kvarest kvaverbr te_ges /end OUT_MEASUREMENT /begin LOC_MEASUREMENT /end LOC_MEASUREMENT /begin SUB_FUNCTION /end SUB_FUNCTION /end FUNCTION
/begin FUNCTION KWP111 "" /begin DEF_CHARACTERISTIC /end DEF_CHARACTERISTIC /begin REF_CHARACTERISTIC /end REF_CHARACTERISTIC /begin IN_MEASUREMENT B_bt B_fa /end IN_MEASUREMENT /begin OUT_MEASUREMENT /end OUT_MEASUREMENT /begin LOC_MEASUREMENT /end LOC_MEASUREMENT /begin SUB_FUNCTION /end SUB_FUNCTION /end FUNCTION
/begin FUNCTION KWP2000F "" /begin DEF_CHARACTERISTIC /end DEF_CHARACTERISTIC /begin REF_CHARACTERISTIC /end REF_CHARACTERISTIC /begin IN_MEASUREMENT nmot /end IN_MEASUREMENT /begin OUT_MEASUREMENT /end OUT_MEASUREMENT /begin LOC_MEASUREMENT /end LOC_MEASUREMENT /begin SUB_FUNCTION /end SUB_FUNCTION /end FUNCTION
/begin FUNCTION LAKH "Lambda-Koordination bei Katheizen"
 /begin DEF_CHARACTERISTIC IMLLASKH KFLANSKH KFLASKH KFLMSKH KFLMSKH2 LASDSLA LASTMOT LMSTMOT LMSTMOT2 ZFLASKH /end DEF_CHARACTERISTIC
 /begin REF_CHARACTERISTIC /end REF_CHARACTERISTIC
 /begin IN_MEASUREMENT anztib_w B_dsla B_fasla B_kh B_nokatfz B_slsfz flakh flamsl2_w flamsl_w flmssl fmsldyn fslpdyn imlpr ml nmot rl tmot tmst /end IN_MEASUREMENT
 /begin OUT_MEASUREMENT lamkh2_w lamkh_w /end OUT_MEASUREMENT
 /begin LOC_MEASUREMENT flaskh flmsslkh fslsdyn lamkhr2_w lamkhr_w lanskh_w lasdsl_w laskh_w lmskh_w lmssl2_w lmssl_w /end LOC_MEASUREMENT
 /begin SUB_FUNCTION /end SUB_FUNCTION
/end FUNCTION
/begin FUNCTION LAMFAW "Lambda Fahrerwunsch" /begin DEF_CHARACTERISTIC KFLAMFA LAMFAVL TLAFA TMVL /end DEF_CHARACTERISTIC /begin REF_CHARACTERISTIC /end REF_CHARACTERISTIC /begin IN_MEASUREMENT B_vl nmot rl tmot /end IN_MEASUREMENT /begin OUT_MEASUREMENT B_vla lamfa_w /end OUT_MEASUREMENT /begin LOC_MEASUREMENT /end LOC_MEASUREMENT /begin SUB_FUNCTION /end SUB_FUNCTION /end FUNCTION
/begin FUNCTION LAMKO "Lambdakoordination" /begin DEF_CHARACTERISTIC LAMLGF LAMLGMTM LAMSOSOF LAMSOSUF LASOAB /end DEF_CHARACTERISTIC /begin REF_CHARACTERISTIC STM12ESUB /end REF_CHARACTERISTIC
 /begin IN_MEASUREMENT B_bevab B_bevab2 B_dsla B_falsh B_falsh2 B_fasla B_kh B_lamlash B_lamlash2 B_lamnse B_slsfz esst_stm12esub flamkh flamsl2_w flamsl_w lambts_w lamelsh2_w lamelsh_w lamfa_w lamka2_w lamka_w lamkh2_w lamkh_w lamlash2_w lamlash_w lamnswl_w tmot /end IN_MEASUREMENT
 /begin OUT_MEASUREMENT B_lalgf B_lalgf2 B_lamsdef lambas lamsbg2_w lamsbg_w lamsons2_w lamsons_w lamvoa2_w lamvoa_w /end OUT_MEASUREMENT
 /begin LOC_MEASUREMENT B_lambts B_lambts2 B_lamka B_lamka2 B_lamnswl B_ldef B_ldef2 lamkhe2_w lamkhe_w lamlgm lams2_w lamsos2_w lamsos_w lamsubg2_w lamsubg_w lams_w /end LOC_MEASUREMENT
 /begin SUB_FUNCTION /end SUB_FUNCTION
/end FUNCTION
/begin FUNCTION LLRABG "Leerlaufregelung-Solldrehzahl Korrektur mit Tester"
 /begin DEF_CHARACTERISTIC NFSACVMN NFSACVMX NFSMVMN NFSMVMX NLLMVMN NLLMVMX NSACMVMN NSACMVMX NSLBVMN NSLBVMX TMLLRNS TMNV TMNVFS /end DEF_CHARACTERISTIC
 /begin REF_CHARACTERISTIC /end REF_CHARACTERISTIC
 /begin IN_MEASUREMENT B_eepdif B_ll B_ndsav tmot /end IN_MEASUREMENT
 /begin OUT_MEASUREMENT B_nsabg dnfsacmv dnfsmv dnllmv dnsacmv dnslbv /end OUT_MEASUREMENT
 /begin LOC_MEASUREMENT /end LOC_MEASUREMENT
 /begin SUB_FUNCTION /end SUB_FUNCTION
/end FUNCTION
/begin FUNCTION LLRBB "Leerlaufregelung Betriebsbedingungen" /begin DEF_CHARACTERISTIC CNFKUPPL DNLLR TVDK TVKUPPL VLLR /end DEF_CHARACTERISTIC /begin REF_CHARACTERISTIC /end REF_CHARACTERISTIC
 /begin IN_MEASUREMENT B_dash B_fil B_fs B_kuppl B_ll B_mdein B_nmot B_sa B_sab B_stend dmllri_w dn gangi mill_w mistt nmot nmotll nstat vfzg /end IN_MEASUREMENT
 /begin OUT_MEASUREMENT B_llr B_llrein B_llri B_llrpd B_vllr /end OUT_MEASUREMENT
 /begin LOC_MEASUREMENT /end LOC_MEASUREMENT
 /begin SUB_FUNCTION /end SUB_FUNCTION
/end FUNCTION
/begin FUNCTION LLRMR "Momentenreserve Leerlaufregelung"
 /begin DEF_CHARACTERISTIC CWLLRMR DMRESFS DMRESLL DMRESLW DNLLRES KFMRES KFMRESFS MRESFSM MRESLLM MRESTEV TDMRESLL TVLLRMRTEV TVRESFS TVRESLL /end DEF_CHARACTERISTIC
 /begin REF_CHARACTERISTIC SNS06LLSB STM04SAUB /end REF_CHARACTERISTIC
 /begin IN_MEASUREMENT B_dtebn B_fs B_ll B_nswo1 B_stend dmrac dns esst_sns06llsb esst_stm04saub lws_w tmot /end IN_MEASUREMENT
 /begin OUT_MEASUREMENT dmdresdtev dmdresfs dmlllmn_w dmrllr_w /end OUT_MEASUREMENT
 /begin LOC_MEASUREMENT /end LOC_MEASUREMENT
 /begin SUB_FUNCTION /end SUB_FUNCTION
/end FUNCTION
/begin FUNCTION LLRNS "Leerlaufregelung-Solldrehzahl"
 /begin DEF_CHARACTERISTIC DNSNFX FNSNF FNSSTM KNSNF NFHZ NFHZFS NFSLRM NFSM NGNSNF NLLM NSAC NSACFS NSLPP NSLPPFS NSLRM NSMNEGS NSNOT NSNOT1 NSNOT1FS NSNOTFS NTEB NTEBFS SNS06LLSB ZKNS ZNSM ZNSUB /end DEF_CHARACTERISTIC
 /begin REF_CHARACTERISTIC FTEDS STM06LLUB /end REF_CHARACTERISTIC
 /begin IN_MEASUREMENT B_autget B_dknolu B_dkpu B_egscok B_falls B_fhz B_fs B_kuppl B_ll B_llrein B_lowra B_nac B_nnot B_nsub B_nswo1 B_pn B_stend dnfsacmv dnfsmv dnllmv dnsacmv dnslbv esst_stm06llub ftead_w nfskh ngfil nllkh nmotll nslb nsolfa psl tmot vsns /end IN_MEASUREMENT
 /begin OUT_MEASUREMENT B_fallsa B_nftev B_nivns dns esst_sns06llsb llsstat nsfsm nsllm nsol nsst nstat /end OUT_MEASUREMENT
 /begin LOC_MEASUREMENT nsfsmn nslbz nsllmn nsnf /end LOC_MEASUREMENT
 /begin SUB_FUNCTION /end SUB_FUNCTION
/end FUNCTION
/begin FUNCTION LLRRM "Leerlaufregelung Reglereingriff Drehmoment"
 /begin DEF_CHARACTERISTIC DMLLRIMXN DMLLRMN DMLLRMXN DMLLRZMN DMLLRZMXN DNMNI DVNG DVNGV DVZNG DVZNGV FDDN FDDZN IVDN IVDNV LIMN LIMNDLLR LIMNDTES LIMNV LIMX LIMXV LISTM LLRICNF NDSU PVDN PVDNV PVDNVZ PVDNZ SDN08LLSW TVLISTUM ZKLLRD ZKLLRDZ ZLIBG /end DEF_CHARACTERISTIC
 /begin REF_CHARACTERISTIC SNG06LLSB SNM06LLUB SNS06LLSB STM06LLUB /end REF_CHARACTERISTIC
 /begin IN_MEASUREMENT B_dllr B_dtes B_llr B_llrein B_llri B_llrpd B_mdmin B_nswo1 B_st B_stend B_vllr dns esst_sng06llsb esst_snm06llub esst_sns06llsb esst_stm06llub ngfil nmot nmot_w nsol tmot /end IN_MEASUREMENT
 /begin OUT_MEASUREMENT dmllri_w dmllrz_w dmllr_w esst_sdn08llsw /end OUT_MEASUREMENT
 /begin LOC_MEASUREMENT B_llrimx dmllrdz_w dmllrd_w dmllrpz_w dmllrp_w dn dn_w limax_w limin_w limnst /end LOC_MEASUREMENT
 /begin SUB_FUNCTION /end SUB_FUNCTION
/end FUNCTION
/begin FUNCTION LR "Lambdaregelung"
 /begin DEF_CHARACTERISTIC CFRA DFRMN DFRSPS FFRITMS FLRFKATE FLRM FRIPTES FRMAX FRMIN FRTEMX KFRI KFRI2 KFRP KFRP2 KFRTV KFRTV2 QUFRMN QUFRMX TLRSIGN TSPERN TSPERN2 ULRRND USRDUMMY ZDFR ZLRFRI /end DEF_CHARACTERISTIC
 /begin REF_CHARACTERISTIC CWDLSV SNM07LRUB SRL06LRUB _STERSY _STERVK /end REF_CHARACTERISTIC
 /begin IN_MEASUREMENT B_atmtpa B_atmtpa2 B_dktlp B_frini B_frini2 B_lr B_lr2 B_lrnd B_lrnd2 B_pwf B_te B_tehbx B_vsigf B_vsigf2 dtvka dtvka2 esst_snm07lrub esst_srl06lrub falrdkt fkatei flr_ap frini2_w frini_w nmot rl tmot tmst tvlrh tvlrh2 tvlrhi tvlrhi2 usrvk usrvk2 usvk usvk2 vstlr /end IN_MEASUREMENT
 /begin OUT_MEASUREMENT B_dfrf B_dfrf2 B_dfrm B_dfrm2 B_frab B_frab2 B_frmax B_frmax2 B_frmin B_frmin2 B_lrsp B_lrsp2 B_lrstat B_lrstat2 B_lrstta B_lrstta2 B_lrtpp B_lrtpp2 B_sgnlr B_sgnlr2 dfrsp2_w dfrsp_w dfrst2_w dfrst_w fr2_w frm2_w frmn2_w frmn_w frmx2_w frmx_w frm_w fr_w tplrvk2_w tplrvk_w /end OUT_MEASUREMENT
 /begin LOC_MEASUREMENT B_frmini B_frmini2 B_frsp B_frsp2 B_inifrm B_inifrm2 B_int B_int2 B_sgnalt B_sgnalt2 B_sgnra B_sgnra2 B_tsper B_tsper2 B_tspon B_tspon2 dfrstga2_w dfrstga_w dfrstte2_w dfrstte_w ffri ffri2 frband2_w frband_w fri fri2 friband2_w friband_w friint friint2 frint2_w frint_w frp frp2 frpint frpint2 frsp2_w frsp_w frtv frtv2 lrfrmz lrfrmz2 lrfrz lrfrz2 tfrn2_w tfrnint2_w tfrnint_w tfrn_w tfrp2_w tfrpint2_w tfrpint_w tfrp_w tsperr tsperr2 tv tv2 tvlr tvlr2 /end LOC_MEASUREMENT
 /begin SUB_FUNCTION /end SUB_FUNCTION
/end FUNCTION
/begin FUNCTION LRA "Adaptive Vorsteuerung für Lambdaregelung"
 /begin DEF_CHARACTERISTIC FRAOMN FRAOMX FRAORN FRAORX FRAUMN FRAUMX FRAURN FRAURX MLO1 MLO2 MLO3 MLU2 MLU4 N0 NO1 NOLRA NRKAB NU3 RKATMN RKATMX RKATRN RKATRX RKAZMN RKAZMX RKAZRN RKAZRX RLO2 RLO3 RLU2 RLU3 RLU4 ZKFRAOA ZKFRAUA ZKRKATA ZKRKAZ /end DEF_CHARACTERISTIC
 /begin REF_CHARACTERISTIC _STERVK /end REF_CHARACTERISTIC
 /begin IN_MEASUREMENT abo B_abor B_edkvs B_edkvs2 B_fa B_fakvs B_lra B_lra2 B_lrar B_lsvvsp B_pwf frm2_w frm_w ml_w nmot rl /end IN_MEASUREMENT
 /begin OUT_MEASUREMENT B_frao B_fraor B_fraor2 B_frau B_fraur B_fraur2 B_lrare B_lrare2 B_nofra B_norkat B_norkaz B_rkat B_rkatr B_rkatr2 B_rkaz B_rkazr B_rkazr2 fra2_w frao2_w frao_w frau2_w frau_w fra_w rka2_w rkat2_w rkat_w rkaz2_w rkaz_w rka_w /end OUT_MEASUREMENT
 /begin LOC_MEASUREMENT B_lrareb dfrm2_w dfrm_w /end LOC_MEASUREMENT
 /begin SUB_FUNCTION /end SUB_FUNCTION
/end FUNCTION
/begin FUNCTION LRAEB "Einschaltbedingungen Gemischadaption" /begin DEF_CHARACTERISTIC TARA TMRAA TVLRA WDKARN /end DEF_CHARACTERISTIC /begin REF_CHARACTERISTIC /end REF_CHARACTERISTIC
 /begin IN_MEASUREMENT B_auakt B_dsls B_dtest B_esnws B_fa B_fakvs B_falra B_gap B_lr B_lr2 B_mdarv B_sls B_te B_ukg B_vl nmot tans tmot wdkba /end IN_MEASUREMENT
 /begin OUT_MEASUREMENT B_gasp B_lra B_lra2 /end OUT_MEASUREMENT
 /begin LOC_MEASUREMENT /end LOC_MEASUREMENT
 /begin SUB_FUNCTION /end SUB_FUNCTION
/end FUNCTION
/begin FUNCTION LREB "Lambdaregelung Einschaltbedingungen"
 /begin DEF_CHARACTERISTIC CLRZWTMS DTMR DTMTMRW IMLSALR NLRSHB RLLRSHB RLLRUN RLRAN RLRVAO TARAU TASHS TLRBAM TLRHS TLRTMS TLRVAM TLRZWTMS TMRA1 TMRA2 TMRAK TMSHS TRAB TRAU TSBBVTMS /end DEF_CHARACTERISTIC
 /begin REF_CHARACTERISTIC CLRKA CWDLSV STM08LEUB /end REF_CHARACTERISTIC
 /begin IN_MEASUREMENT B_bag B_blkmd B_craus B_dsl B_dsls B_dslsk B_eev B_esls B_evloc B_falr B_kse B_ll B_lrka B_lrka2 B_lrkast B_lrkast2 B_lsvvsp B_sa B_sbbvk B_sbbvk2 B_sls B_slsfz B_slsoff B_st B_stend B_temin B_temin2 B_vag B_vsigf B_vsigf2 esst_stm08leub fr2_w fr_w lamsons2_w lamsons_w ml_w nmot rl tans tmot tmotlin tmrw tmst usrvk usrvk2 usvk usvk2 /end IN_MEASUREMENT
 /begin OUT_MEASUREMENT B_lr B_lr2 B_lr2s B_lr2s2 B_lreb100 B_lrnd B_lrnd2 B_lrnda B_lrnda2 B_lrvk B_lrvk2 B_nolrb B_nolrb2 B_nolre B_nolre2 B_nolrw B_nolrw2 B_tmlr flglrs flglrs2 /end OUT_MEASUREMENT
 /begin LOC_MEASUREMENT B_bvdel B_eobdlr B_eobdlr2 B_fslr B_fslr2 B_lreble B_lreble2 B_lrebpr B_lrebpr2 B_lrebri B_lrebri2 B_lrpspa B_lrrl B_lrwla B_mlrsa B_msfslr B_msfslr2 B_mslr B_mslr2 B_pspaus B_pspwl B_tarau imlrsa_w tansst /end LOC_MEASUREMENT
 /begin SUB_FUNCTION /end SUB_FUNCTION
/end FUNCTION
/begin FUNCTION LRHK "Führungsregelung mit Sonde hinter KAT (OBDII)"
 /begin DEF_CHARACTERISTIC ATVINI ATVINI2 ATVMN ATVMX CLRHK CLRHKC KDLASHKI KDLASHKI2 KDLASHKP KDLASHKP2 KFFTV KFFTV2 KFUSHK KFUSHK2 LALIUSH LALIUSH2 LALIUSRH LALIUSRH2 LASHKAB MLNKAX NLRHO NLRHU PLRHAV PLRHAV2 PLRHML PLRHML2 RLLRHON RLLRHUN TBLRH TBLRH2 TKATMLRH TKATMLRH2 ZLASHKAB ZLASOHML ZLASOHML2 ZLRHML ZLRHML2 /end DEF_CHARACTERISTIC
 /begin REF_CHARACTERISTIC SML08LHUB SNM06LHUB SNM08LHUB SRL06LHUB /end REF_CHARACTERISTIC
 /begin IN_MEASUREMENT avkatf avkatf2 B_dsls B_edkvs B_edkvs2 B_falsh B_falsh2 B_lr B_lr2 B_lrka B_lrka2 B_lrsp B_lrsp2 B_mdarv B_pwf B_sbbhk B_sbbhk2 B_st B_tehb B_vsigf B_vsigf2 esst_sml08lhub esst_snm06lhub esst_snm08lhub esst_srl06lhub E_hsh E_hsh2 E_hsv E_hsv2 E_kat E_kat2 E_lash E_lash2 E_lm E_sls E_sls2 E_tes E_teve ml ml_w nmot rl tkatm tkatm2 ushk2_w ushk_w /end IN_MEASUREMENT
 /begin OUT_MEASUREMENT atv atv2 B_lrhk B_lrhk2 B_lrhkp B_lrhkp2 dlashkm_w lamsolh2_w lamsolh_w lamsonh2_w lamsonh_w tvlrh tvlrh2 tvlrhi tvlrhi2 usrhk usrhk2 /end OUT_MEASUREMENT
 /begin LOC_MEASUREMENT atvinii atvinii2 B_atvini B_atvini2 B_lrhkb B_lrhkb2 B_lrhkg B_lrhkgi dlahkab2_w dlahkab_w dlashki2_w dlashki_w dlashkm2_w dlashkp2_w dlashkp_w ftv ftv2 iavkatf idlashkm_w lahkmz lahkmz2 lamhf2_w lamhf_w lamhm2_w lamhm_w LRHKlokbits mlnka2_w mlnka_w percnt2_w percnt_w ptv ptv2 tvlrhp tvlrhp2 zatv zatv2 /end LOC_MEASUREMENT
 /begin SUB_FUNCTION /end SUB_FUNCTION
/end FUNCTION
/begin FUNCTION LRINI "Lambdaregelung, Koordination der Initialisierung" /begin DEF_CHARACTERISTIC /end DEF_CHARACTERISTIC /begin REF_CHARACTERISTIC /end REF_CHARACTERISTIC
 /begin IN_MEASUREMENT B_dtefrr B_frdlsv B_frdlsv2 B_lrnd B_lrnd2 frdlsv2_w frdlsv_w frdter_w /end IN_MEASUREMENT
 /begin OUT_MEASUREMENT B_frini B_frini2 frini2_w frini_w /end OUT_MEASUREMENT
 /begin LOC_MEASUREMENT /end LOC_MEASUREMENT
 /begin SUB_FUNCTION /end SUB_FUNCTION
/end FUNCTION
/begin FUNCTION LRKA "Zweipunkt-Lambdaregelung mit tv : Funkt. KAT-Ausräumen von Sauerstoff"
 /begin DEF_CHARACTERISTIC CLRKA DTVKAML DTVKAML2 FFWEKA FKAXAVKAT FLMLKAMA FLMLKAMA2 FLMLKAPR FLMLKAPR2 FMLKAMA FMLKAMA2 ILMLKAXTK ILMLKAXTK2 IMLAKMN IMLAKMN2 IMLKAXTK IMLKAXTK2 LAMKAML LAMKAML2 NLRKA TDFRKAD TDFRKAU TSAKAMN TSAKAMN2 USHKAMN USHKAMN2 USHKAMX USHKAMX2 USVKAMX USVKAMX2 /end DEF_CHARACTERISTIC
 /begin REF_CHARACTERISTIC SML05LKUB /end REF_CHARACTERISTIC
 /begin IN_MEASUREMENT avkatf B_bevab B_bevab2 B_sa B_sbbhk B_sbbhk2 B_sls B_vsigf B_vsigf2 esst_sml05lkub fwe lamsons2_w lamsons_w ml ml_w nmot tkatm2 tkatm2_w tkatm_w ushk ushk2 usvk usvk2 /end IN_MEASUREMENT
 /begin OUT_MEASUREMENT B_ilmlkat B_ilmlkat2 B_lrka B_lrka2 dtvka dtvka2 ilmlkat2_w ilmlkat_w lamka2_w lamka_w /end OUT_MEASUREMENT
 /begin LOC_MEASUREMENT B_blrka B_blrka2 B_kawe B_kawe2 B_lrkaa B_lrkaa2 B_lrkae B_lrkae2 B_lrkaei B_lrkaei2 B_lrkaon B_lrkaon2 B_lrkarg B_lrkarg2 B_lrkast B_lrkast2 dtvkai dtvkai2 favkatmx ilmlka2_w ilmlkah2_w ilmlkah_w ilmlkam2_w ilmlkam_w ilmlkav2_w ilmlkav_w ilmlkax2_w ilmlkax_w ilmlka_w imlka2_w imlkav2_w imlkav_w imlkax2_w imlkax_w imlka_w lamkai2_w lamkaii2_w lamkaii_w lamkai_w lamsnka2_w lamsnka_w lrkaz lrkaz2 tsaka tsaka2 /end LOC_MEASUREMENT
 /begin SUB_FUNCTION /end SUB_FUNCTION
/end FUNCTION
/begin FUNCTION _MCMESS "" /begin DEF_CHARACTERISTIC /end DEF_CHARACTERISTIC /begin REF_CHARACTERISTIC /end REF_CHARACTERISTIC /begin IN_MEASUREMENT /end IN_MEASUREMENT /begin OUT_MEASUREMENT /end OUT_MEASUREMENT /begin LOC_MEASUREMENT /end LOC_MEASUREMENT /begin SUB_FUNCTION /end SUB_FUNCTION /end FUNCTION
/begin FUNCTION MDBAS "Berechnung der Basisgrößen für Momentenschnittstelle"
 /begin DEF_CHARACTERISTIC DZWOAGR DZWOLA DZWOM ETADZW ETALAM KFMIOP KFZWOP KFZWOP2 SRL11OPUW /end DEF_CHARACTERISTIC
 /begin REF_CHARACTERISTIC SNM16OPUW _NWS _ZYLZA /end REF_CHARACTERISTIC
 /begin IN_MEASUREMENT agrr dzwnwsu esst_snm16opuw fnwue lambas nmot nmot_w rl_w tmot zwbas /end IN_MEASUREMENT
 /begin OUT_MEASUREMENT dzwoag dzwol dzw_kge esst_srl11opuw etalab etatrmn etazwb etazwbm mibas_w miopt_w rl_w_kge zwopt zwoptl1 /end OUT_MEASUREMENT
 /begin LOC_MEASUREMENT dzwb dzwotm mioptl1_w /end LOC_MEASUREMENT
 /begin SUB_FUNCTION /end SUB_FUNCTION
/end FUNCTION
/begin COMPU_METHOD B_TRUE "boolsche Zustände, positive Logik" TAB_VERB "%6.3" "" COMPU_TAB_REF B_TRUE /end COMPU_METHOD
/begin COMPU_VTAB B_TRUE "boolsche Zustände, positive Logik" TAB_VERB 2 0 "----" 1 "TRUE" /end COMPU_VTAB
/begin COMPU_METHOD dez "1 : 1 Umrechnug (dez/hex)" RAT_FUNC "%6.2" "" COEFFS 0 1 0 0 0 1 /end COMPU_METHOD
/begin COMPU_METHOD fak_sb_b1 "" RAT_FUNC "%6.4" "-" COEFFS 0 256 0 0 0 2 /end COMPU_METHOD
/begin COMPU_METHOD fak_sw_b1 "" RAT_FUNC "%7.6" "-" COEFFS 0 65536 0 0 0 2 /end COMPU_METHOD
/begin COMPU_METHOD fak_ub_b1 "" RAT_FUNC "%6.4" "-" COEFFS 0 256 0 0 0 1 /end COMPU_METHOD
/begin COMPU_METHOD fak_ub_b12p45 "" RAT_FUNC "%6.4" "%" COEFFS 0 2048 0 0 0 100 /end COMPU_METHOD
/begin COMPU_METHOD fak_ub_b16 "" RAT_FUNC "%6.4" "-" COEFFS 0 256 0 0 0 16 /end COMPU_METHOD
/begin COMPU_METHOD fak_ub_b2 "" RAT_FUNC "%6.4" "-" COEFFS 0 256 0 0 0 2 /end COMPU_METHOD
/begin COMPU_METHOD fak_ub_b4 "" RAT_FUNC "%6.4" "-" COEFFS 0 256 0 0 0 4 /end COMPU_METHOD
/begin COMPU_METHOD fak_ub_b77p81 "" RAT_FUNC "%6.3" "%/s" COEFFS 0 327.68 0 0 0 100 /end COMPU_METHOD
/begin COMPU_METHOD fak_ub_b8 "" RAT_FUNC "%6.4" "-" COEFFS 0 256 0 0 0 8 /end COMPU_METHOD
/begin COMPU_METHOD fak_uw_b1 "" RAT_FUNC "%7.6" "-" COEFFS 0 65536 0 0 0 1 /end COMPU_METHOD
/begin COMPU_METHOD fak_uw_b16 "" RAT_FUNC "%6.5" "-" COEFFS 0 65536 0 0 0 16 /end COMPU_METHOD
/begin COMPU_METHOD fak_uw_b2 "" RAT_FUNC "%7.6" "-" COEFFS 0 65536 0 0 0 2 /end COMPU_METHOD
/begin COMPU_METHOD fak_uw_b4 "" RAT_FUNC "%7.6" "-" COEFFS 0 65536 0 0 0 4 /end COMPU_METHOD
/begin COMPU_METHOD fuel_uw_b1 "" RAT_FUNC "%7.6" "ul" COEFFS 0 65536 0 0 0 1 /end COMPU_METHOD
/begin COMPU_METHOD fuel_uw_b65535 "" RAT_FUNC "%6.2" "ul" COEFFS 0 1 0 0 0 1 /end COMPU_METHOD
/begin COMPU_METHOD lws_q0p04375 "" RAT_FUNC "%6.4" "°" COEFFS 0 1 0 0 0 0.04375 /end COMPU_METHOD
/begin COMPU_METHOD m_ub_b1020 "" RAT_FUNC "%6.2" "kg/h" COEFFS 0 1 0 0 0 4 /end COMPU_METHOD
/begin COMPU_METHOD m_uw_b4660 "" RAT_FUNC "%6.4" "g" COEFFS 0 3600 0 0 0 256 /end COMPU_METHOD
/begin COMPU_METHOD m_uw_b6553p5 "" RAT_FUNC "%6.3" "kg/h" COEFFS 0 1 0 0 0 0.1 /end COMPU_METHOD
/begin COMPU_METHOD m_uw_b7281 "" RAT_FUNC "%6.3" "g" COEFFS 0 9 0 0 0 1 /end COMPU_METHOD
/begin COMPU_METHOD nmotd_sb_q10 "" RAT_FUNC "%6.1" "U/min" COEFFS 0 1 0 0 0 10 /end COMPU_METHOD
/begin COMPU_METHOD nmotd_sw_q0p25 "" RAT_FUNC "%6.3" "U/min" COEFFS 0 1 0 0 0 0.25 /end COMPU_METHOD
/begin COMPU_METHOD nmotg_sb_q100 "" RAT_FUNC "%6.0" "U/min/s" COEFFS 0 1 0 0 0 100 /end COMPU_METHOD
/begin COMPU_METHOD nmotg_sw_q0p39 "" RAT_FUNC "%6.3" "U/min/s" COEFFS 0 1 0 0 0 0.39063 /end COMPU_METHOD
/begin COMPU_METHOD nmotg_ub_q100 "" RAT_FUNC "%6.0" "U/min/s" COEFFS 0 1 0 0 0 100 /end COMPU_METHOD
/begin COMPU_METHOD nmot_ub_q10 "" RAT_FUNC "%6.1" "U/min" COEFFS 0 1 0 0 0 10 /end COMPU_METHOD
/begin COMPU_METHOD nmot_ub_q40 "" RAT_FUNC "%6.1" "Upm" COEFFS 0 1 0 0 0 40 /end COMPU_METHOD
/begin COMPU_METHOD nmot_uw_q0p25 "" RAT_FUNC "%6.3" "U/min" COEFFS 0 1 0 0 0 0.25 /end COMPU_METHOD
/begin COMPU_METHOD relDK_q0p02441 "" RAT_FUNC "%6.4" "% DK" COEFFS 0 65536 0 0 0 1600 /end COMPU_METHOD
/begin COMPU_METHOD relgrad_20ms_qn0p019 "" RAT_FUNC "%6.5" "%/s" COEFFS 0 -1 0 0 0 0.019 /end COMPU_METHOD
/begin COMPU_METHOD rel_q0p09726 "" RAT_FUNC "%6.3" "%" COEFFS 0 255 0 0 0 24.9 /end COMPU_METHOD
/begin COMPU_METHOD rel_sb_q0p0976 "" RAT_FUNC "%6.3" "%" COEFFS 0 1 0 0 0 0.097647 /end COMPU_METHOD
/begin COMPU_METHOD rel_sw_b100 "" RAT_FUNC "%6.4" "%" COEFFS 0 32768 0 0 0 100 /end COMPU_METHOD
/begin COMPU_METHOD rel_sw_b1536 "" RAT_FUNC "%6.4" "%" COEFFS 0 65536 0 0 0 3072 /end COMPU_METHOD
/begin COMPU_METHOD rel_sw_q0p0234 "" RAT_FUNC "%6.4" "%/seg" COEFFS 0 32 0 0 0 0.75 /end COMPU_METHOD
/begin COMPU_METHOD rel_ub_b0p78 "" RAT_FUNC "%6.4" "%" COEFFS 0 256 0 0 0 0.78125 /end COMPU_METHOD
/begin COMPU_METHOD rel_ub_b127p5 "" RAT_FUNC "%6.3" "%" COEFFS 0 2 0 0 0 1 /end COMPU_METHOD
/begin COMPU_METHOD rel_ub_b1p0 "" RAT_FUNC "%6.4" "%" COEFFS 0 256 0 0 0 1 /end COMPU_METHOD
/begin COMPU_METHOD rel_ub_b24p9 "" RAT_FUNC "%6.3" "%" COEFFS 0 255 0 0 0 24.9 /end COMPU_METHOD
/begin COMPU_METHOD rel_ub_b99p6 "" RAT_FUNC "%6.3" "%" COEFFS 0 256 0 0 0 100 /end COMPU_METHOD
/begin COMPU_METHOD rel_ub_bn0p125 "" RAT_FUNC "%8.7" "%" COEFFS 0 -256 0 0 0 0.125 /end COMPU_METHOD
/begin COMPU_METHOD rel_ub_bn24p9 "" RAT_FUNC "%6.5" "%" COEFFS 0 -255 0 0 0 24.9 /end COMPU_METHOD
/begin COMPU_METHOD rel_ub_q0p75 "" RAT_FUNC "%6.3" "%" COEFFS 0 1 0 0 0 0.75 /end COMPU_METHOD
/begin COMPU_METHOD rel_uw_b100 "" RAT_FUNC "%6.4" "%" COEFFS 0 65536 0 0 0 100 /end COMPU_METHOD
/begin COMPU_METHOD rel_uw_q0p0234 "" RAT_FUNC "%6.4" "%" COEFFS 0 32 0 0 0 0.75 /end COMPU_METHOD
/begin COMPU_METHOD spg_q20p374Em6 "" RAT_FUNC "%7.6" "V" COEFFS 0 65280 0 0 0 1.33 /end COMPU_METHOD
/begin COMPU_METHOD spg_ub_b320 "" RAT_FUNC "%7.3" "V" COEFFS 0 1 0 0 0 1.25 /end COMPU_METHOD
/begin COMPU_METHOD spg_ub_b5 "" RAT_FUNC "%6.4" "V" COEFFS 0 256 0 0 0 5 /end COMPU_METHOD
/begin COMPU_METHOD spg_ub_q0p0052_o0p2 "" RAT_FUNC "%6.3" "V" COEFFS 0 255 51 0 0 1.33 /end COMPU_METHOD
/begin COMPU_METHOD spg_uw_q0p00488_o1 "" RAT_FUNC "%6.3" "V" COEFFS 0 1024 1024 0 0 5 /end COMPU_METHOD
/begin COMPU_METHOD t100msxs_sb_q0p01 "" RAT_FUNC "%6.4" "s" COEFFS 0 1 0 0 0 0.01 /end COMPU_METHOD
/begin COMPU_METHOD t100msxs_ub_b25p5 "" RAT_FUNC "%6.3" "s" COEFFS 0 1 0 0 0 0.1 /end COMPU_METHOD
/begin COMPU_METHOD t100msxs_uw_b6553p5 "" RAT_FUNC "%6.3" "s" COEFFS 0 1 0 0 0 0.1 /end COMPU_METHOD
/begin COMPU_METHOD t10msxs_sb_q0p01 "" RAT_FUNC "%6.4" "s" COEFFS 0 1 0 0 0 0.01 /end COMPU_METHOD
/begin COMPU_METHOD t10msxs_ub_b2p55 "" RAT_FUNC "%6.4" "s" COEFFS 0 1 0 0 0 0.01 /end COMPU_METHOD
/begin COMPU_METHOD t10msxs_uw_b655p35 "" RAT_FUNC "%6.4" "s" COEFFS 0 1 0 0 0 0.01 /end COMPU_METHOD
/begin COMPU_METHOD t200msxs_ub_b51 "" RAT_FUNC "%6.3" "s" COEFFS 0 1 0 0 0 0.2 /end COMPU_METHOD
/begin COMPU_METHOD t20msxs_ub_b5p1 "" RAT_FUNC "%6.4" "s" COEFFS 0 1 0 0 0 0.02 /end COMPU_METHOD
/begin COMPU_METHOD t3p2usxms_uw_b209p7 "" RAT_FUNC "%6.4" "ms" COEFFS 0 65536 0 0 0 209.751 /end COMPU_METHOD
/begin COMPU_METHOD tefuel_uw_b312p5 "" RAT_FUNC "%6.4" "ul/ms" COEFFS 0 65535 0 0 0 312.5 /end COMPU_METHOD
/begin COMPU_METHOD temp_sb_q0p75 "" RAT_FUNC "%6.3" "Grad C" COEFFS 0 1 0 0 0 0.75 /end COMPU_METHOD
/begin COMPU_METHOD temp_ub_b191p25 "" RAT_FUNC "%6.3" "Grad C" COEFFS 0 1 0 0 0 0.75 /end COMPU_METHOD
/begin COMPU_METHOD temp_ub_q0p75_o48 "" RAT_FUNC "%6.2" "Grad C" COEFFS 0 1 48 0 0 0.75 /end COMPU_METHOD
/begin COMPU_METHOD temp_ub_q5_o50 "" RAT_FUNC "%6.2" "Grad C" COEFFS 0 1 50 0 0 5 /end COMPU_METHOD
/begin COMPU_METHOD temp_uw_q0p0195_o50 "" RAT_FUNC "%6.2" "Grad C" COEFFS 0 256 12800 0 0 5 /end COMPU_METHOD
/begin COMPU_METHOD tgrad_ub_q0p039 "" RAT_FUNC "%6.4" "ms/s" COEFFS 0 256 0 0 0 10 /end COMPU_METHOD
/begin COMPU_METHOD vfzg_ub_q1p25 "" RAT_FUNC "%6.2" "km/h" COEFFS 0 1 0 0 0 1.25 /end COMPU_METHOD
/begin COMPU_METHOD zk100msxs_ub_b25p5 "" RAT_FUNC "%6.3" "s" COEFFS 0 0 256 0 10 0 /end COMPU_METHOD
/begin COMPU_METHOD zk100msxs_uw_b655 "" RAT_FUNC "%6.1" "s" COEFFS 0 0 65536 0 10 0 /end COMPU_METHOD
/begin COMPU_METHOD zk10msxs_ub_b2p56 "" RAT_FUNC "%6.4" "s" COEFFS 0 0 256 0 100 0 /end COMPU_METHOD
/begin COMPU_METHOD zk10msxs_uw_b655 "" RAT_FUNC "%10.4" "s" COEFFS 0 0 65536 0 100 0 /end COMPU_METHOD
/begin COMPU_METHOD zk200msxs_ub_b51p2 "" RAT_FUNC "%6.3" "s" COEFFS 0 0 51.2 0 1 0 /end COMPU_METHOD
/begin COMPU_METHOD zk200msxs_uw_b5 "" RAT_FUNC "%7.6" "1/s" COEFFS 0 65536 0 0 0 5 /end COMPU_METHOD
/begin COMPU_METHOD zk200msxs_uw_b960 "" RAT_FUNC "%6.4" "%/s" COEFFS 0 65536 0 0 0 960 /end COMPU_METHOD
/begin COMPU_METHOD zk20msxs_ub_b5p1 "" RAT_FUNC "%6.4" "s" COEFFS 0 0 5.1 0 1 0 /end COMPU_METHOD
/begin COMPU_METHOD zk20msxs_uw_b1310 "" RAT_FUNC "%10.3" "s" COEFFS 0 0 1310 0 1 0 /end COMPU_METHOD
/begin COMPU_METHOD zw_sb_q0p75 "" RAT_FUNC "%6.3" "grad KW" COEFFS 0 255 0 0 0 191.25 /end COMPU_METHOD
/begin COMPU_METHOD zw_ub_q0p75 "" RAT_FUNC "%6.3" "Grad KW" COEFFS 0 255 0 0 0 191.25 /end COMPU_METHOD
/begin COMPU_METHOD zw_ub_qn0p75 "" RAT_FUNC "%6.4" "grad KW" COEFFS 0 1 0 0 0 -0.75 /end COMPU_METHOD
/begin RECORD_LAYOUT FklWUb FNC_VALUES 1 UBYTE COLUMN_DIR DIRECT /end RECORD_LAYOUT
/begin RECORD_LAYOUT GkfWSb FNC_VALUES 1 SBYTE COLUMN_DIR DIRECT /end RECORD_LAYOUT
/begin RECORD_LAYOUT GkfWUb FNC_VALUES 1 UBYTE COLUMN_DIR DIRECT /end RECORD_LAYOUT
/begin RECORD_LAYOUT GkfWUw FNC_VALUES 1 UWORD COLUMN_DIR DIRECT /end RECORD_LAYOUT
/begin RECORD_LAYOUT GklWSb FNC_VALUES 1 SBYTE COLUMN_DIR DIRECT /end RECORD_LAYOUT
/begin RECORD_LAYOUT GklWSw FNC_VALUES 1 SWORD COLUMN_DIR DIRECT /end RECORD_LAYOUT
/begin RECORD_LAYOUT GklWUb FNC_VALUES 1 UBYTE COLUMN_DIR DIRECT /end RECORD_LAYOUT
/begin RECORD_LAYOUT GklWUw FNC_VALUES 1 UWORD COLUMN_DIR DIRECT /end RECORD_LAYOUT
/begin RECORD_LAYOUT KfAxUbAyUbSstxUbSstyUbWUb NO_AXIS_PTS_X 1 UBYTE NO_AXIS_PTS_Y 2 UBYTE AXIS_PTS_X 3 UBYTE INDEX_INCR DIRECT AXIS_PTS_Y 4 UBYTE INDEX_INCR DIRECT FNC_VALUES 5 UBYTE COLUMN_DIR DIRECT /end RECORD_LAYOUT
/begin RECORD_LAYOUT KfAxUbAyUbSstxUbSstyUwWUw NO_AXIS_PTS_X 1 UBYTE NO_AXIS_PTS_Y 2 UBYTE AXIS_PTS_X 3 UBYTE INDEX_INCR DIRECT AXIS_PTS_Y 4 UWORD INDEX_INCR DIRECT FNC_VALUES 5 UWORD COLUMN_DIR DIRECT /end RECORD_LAYOUT
/begin RECORD_LAYOUT KlASwSstSwWSw NO_AXIS_PTS_X 1 SWORD AXIS_PTS_X 2 SWORD INDEX_INCR DIRECT FNC_VALUES 3 SWORD COLUMN_DIR DIRECT /end RECORD_LAYOUT
/begin RECORD_LAYOUT KlAUbSstSbWUb NO_AXIS_PTS_X 1 UBYTE AXIS_PTS_X 2 SBYTE INDEX_INCR DIRECT FNC_VALUES 3 UBYTE COLUMN_DIR DIRECT /end RECORD_LAYOUT
/begin RECORD_LAYOUT KlAUbSstUbWSb NO_AXIS_PTS_X 1 UBYTE AXIS_PTS_X 2 UBYTE INDEX_INCR DIRECT FNC_VALUES 3 SBYTE COLUMN_DIR DIRECT /end RECORD_LAYOUT
/begin RECORD_LAYOUT KlAUbSstUbWUb NO_AXIS_PTS_X 1 UBYTE AXIS_PTS_X 2 UBYTE INDEX_INCR DIRECT FNC_VALUES 3 UBYTE COLUMN_DIR DIRECT /end RECORD_LAYOUT
/begin RECORD_LAYOUT KlAUbSstUbWUw NO_AXIS_PTS_X 1 UBYTE AXIS_PTS_X 2 UBYTE INDEX_INCR DIRECT FNC_VALUES 3 UWORD COLUMN_DIR DIRECT /end RECORD_LAYOUT
/begin RECORD_LAYOUT KlAUwSstSwWUw NO_AXIS_PTS_X 1 UWORD AXIS_PTS_X 2 SWORD INDEX_INCR DIRECT FNC_VALUES 3 UWORD COLUMN_DIR DIRECT /end RECORD_LAYOUT
/begin RECORD_LAYOUT KlAUwSstUwWUw NO_AXIS_PTS_X 1 UWORD AXIS_PTS_X 2 UWORD INDEX_INCR DIRECT FNC_VALUES 3 UWORD COLUMN_DIR DIRECT /end RECORD_LAYOUT
/begin RECORD_LAYOUT KwSb FNC_VALUES 1 SBYTE COLUMN_DIR DIRECT /end RECORD_LAYOUT
/begin RECORD_LAYOUT KwSw FNC_VALUES 1 SWORD COLUMN_DIR DIRECT /end RECORD_LAYOUT
/begin RECORD_LAYOUT KwUb FNC_VALUES 1 UBYTE COLUMN_DIR DIRECT /end RECORD_LAYOUT
/begin RECORD_LAYOUT KwUw FNC_VALUES 1 UWORD COLUMN_DIR DIRECT /end RECORD_LAYOUT
/begin RECORD_LAYOUT SstASwSstSw NO_AXIS_PTS_X 1 SWORD AXIS_PTS_X 2 SWORD INDEX_INCR DIRECT /end RECORD_LAYOUT
/begin RECORD_LAYOUT SstAUbSstSb NO_AXIS_PTS_X 1 UBYTE AXIS_PTS_X 2 SBYTE INDEX_INCR DIRECT /end RECORD_LAYOUT
/begin RECORD_LAYOUT SstAUbSstUb NO_AXIS_PTS_X 1 UBYTE AXIS_PTS_X 2 UBYTE INDEX_INCR DIRECT /end RECORD_LAYOUT
/begin RECORD_LAYOUT SstAUwSstUw NO_AXIS_PTS_X 1 UWORD AXIS_PTS_X 2 UWORD INDEX_INCR DIRECT /end RECORD_LAYOUT
/end MODULE
/end PROJECT
