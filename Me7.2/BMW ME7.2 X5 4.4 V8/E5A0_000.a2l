ASAP2_VERSION 1 3
/begin PROJECT BMW_ME72 "72111"
/begin HEADER "" VERSION "_721115A0" PROJECT_NO BMW_ME72 /end HEADER
/begin MODULE DIM ""
/begin MOD_COMMON "" BYTE_ORDER MSB_LAST ALIGNMENT_BYTE 1 ALIGNMENT_WORD 2 ALIGNMENT_LONG 2 /end MOD_COMMON
/begin CHARACTERISTIC ABGMSIGH "Abgastemperaturschwelle für Signalunterbrechung mit Ri-Diagnose hinter KAT" VALUE 0x819A5A KwUb 1275. temp_ub_q5_o50 -50.00 1225. FORMAT "%5.0" /end CHARACTERISTIC
/begin CHARACTERISTIC ADKATNF "Normierungsfaktor für Signalamplitude der Sonde bzw. Katbelastung" VALUE 0x811A69 KwUb 23.87 spg_ub_b24 0.00 23.87 FORMAT "%5.2" /end CHARACTERISTIC
/begin CHARACTERISTIC AGANGW "Anzahl Gangwechsel für Diagnose Kupplungsschalter" VALUE 0x819A70 KwUb 255.0 dez 0.00 255.0 FORMAT "%5.1" /end CHARACTERISTIC
/begin CHARACTERISTIC AHKATKM "Schwellwertkorrektur DKAT Abhängig vom kmstand" CURVE 0x81ACE4 KlAUwSstUwWUw 1.999969 fak_uw_b2 0.00 1.999969 FORMAT "%8.6"
 /begin AXIS_DESCR STD_AXIS kmstand km_uw_q10 2 0.00 655350.0 FORMAT "%8.1" DEPOSIT ABSOLUTE /end AXIS_DESCR
/end CHARACTERISTIC
/begin CHARACTERISTIC AHKATMN "Schwellwert Katalysator gut,  AHKAT < AHKATMN" VALUE 0x811A6A KwUb 0.9961 fak_ub_b1 0.00 0.9961 /end CHARACTERISTIC
/begin CHARACTERISTIC AHKATMX "Schwellwert Katalysator defekt,  AHKAT > AHKATMX" VALUE 0x811A6B KwUb 0.9961 fak_ub_b1 0.00 0.9961 /end CHARACTERISTIC
/begin CHARACTERISTIC AHKATS "Schwellwert für Summe AHKAT,AHKAT2 (Stereo )" VALUE 0x811A6C KwUb 1.992 fak_ub_b2 0.00 1.992 FORMAT "%5.3" /end CHARACTERISTIC
/begin CHARACTERISTIC AHKATSB "Schwellwert für Summenbereichfehler (Stereo)" VALUE 0x811A6D KwUb 0.9961 fak_ub_b1 0.00 0.9961 /end CHARACTERISTIC
/begin CHARACTERISTIC AHKTTSW "Setztwert für Zeitgeber in Signalauswertung" VALUE 0x8156B2 KwUw 3276.750 t50msxs_uw_b3276p75 0.00 3276.750 FORMAT "%8.3" /end CHARACTERISTIC
/begin CHARACTERISTIC AKUPPLB "Anzahl Kupplung betätigt für Diagnose Kupplungsschalter" VALUE 0x819A71 KwUb 255.0 dez 0.00 255.0 FORMAT "%5.1" /end CHARACTERISTIC
/begin CHARACTERISTIC ANSWPUK "Anzahl pukor Speicherwerte für pu-Gradientenberechnung" VALUE 0x8123EE KwUb 4.000 dez 1.000 5.000 FORMAT "%5.3" /end CHARACTERISTIC
/begin CHARACTERISTIC ANZDPVK "Anzahl der Perioden für Ready-Flag der Usvk-Periodenüberwachung" VALUE 0x810162 KwUb 255.0 dez 0.00 255.0 FORMAT "%5.1" /end CHARACTERISTIC
/begin CHARACTERISTIC ANZDYNSH "Anzahl der Dynamikmessungen für Schwingungsprüfung Sonde hinter KAT" VALUE 0x819A4C KwUb 255.0 dez 0.00 255.0 FORMAT "%5.1" /end CHARACTERISTIC
/begin CHARACTERISTIC ANZTP "Anzahl auszublendender Perioden für Periodendauerüberwachung" VALUE 0x810163 KwUb 255.0 dez 0.00 255.0 FORMAT "%5.1" /end CHARACTERISTIC
/begin CHARACTERISTIC APEKTDX "max. Anzahl Fehlerprüfungen bei Kat-Diagnose" VALUE 0x811A6E KwUb 255.0 dez 0.00 255.0 FORMAT "%5.1" /end CHARACTERISTIC
/begin CHARACTERISTIC ATVFETTO "obere Grenze für atvfett, CARB-Tester, DLSSA" VALUE 0x819BAC KwUb 10.20 t40msxs_ub_q0p04 0.00 10.20 FORMAT "%5.2" /end CHARACTERISTIC
/begin CHARACTERISTIC ATVFETTU "untere Grenze für atvfett, CARB-Tester, DLSSA" VALUE 0x819BAD KwUb 10.20 t40msxs_ub_q0p04 0.00 10.20 FORMAT "%5.2" /end CHARACTERISTIC
/begin CHARACTERISTIC ATVMAGO "obere Grenze für atvmager, CARB-Tester, DLSSA" VALUE 0x819BAE KwUb 10.20 t40msxs_ub_q0p04 0.00 10.20 FORMAT "%5.2" /end CHARACTERISTIC
/begin CHARACTERISTIC ATVMAGU "untere Grenze für atvmager, CARB-Tester, DLSSA" VALUE 0x819BAF KwUb 10.20 t40msxs_ub_q0p04 0.00 10.20 FORMAT "%5.2" /end CHARACTERISTIC
/begin CHARACTERISTIC AVKATFS "Setztwert für AVKATF wenn Powerfail" VALUE 0x811A6F KwUb 0.9961 fak_ub_b1 0.00 0.9961 /end CHARACTERISTIC
/begin CHARACTERISTIC CDCAAV "Codewort CARB: Absperrventil Aktivkohlefilter (Funktion)" VAL_BLK 0x814F5A KwbUw 65535.00 dez 0.00 65535.00 FORMAT "%8.2" NUMBER 4 /end CHARACTERISTIC
/begin CHARACTERISTIC CDCAGRE "Codewort CARB:	Überwachung AGR-Endstufe" VAL_BLK 0x814F6A KwbUw 65535.00 dez 0.00 65535.00 FORMAT "%8.2" NUMBER 4 /end CHARACTERISTIC
/begin CHARACTERISTIC CDCAGRF "Codewort CARB: Überwachung AGR-FLOW" VAL_BLK 0x814F72 KwbUw 65535.00 dez 0.00 65535.00 FORMAT "%8.2" NUMBER 4 /end CHARACTERISTIC
/begin CHARACTERISTIC CDCDSS "Codewort CARB: Saugrohr-Drucksensor" VAL_BLK 0x815012 KwbUw 65535.00 dez 0.00 65535.00 FORMAT "%8.2" NUMBER 4 /end CHARACTERISTIC
/begin CHARACTERISTIC CDCMDB "Codewort CARB: Momentbegrenzung Sollmoment" VAL_BLK 0x81526A KwbUw 65535.00 dez 0.00 65535.00 FORMAT "%8.2" NUMBER 4 /end CHARACTERISTIC
/begin CHARACTERISTIC CDCTESF "Codewort CARB: Tankentlüftungssystem Feinleck" VAL_BLK 0x815342 KwbUw 65535.00 dez 0.00 65535.00 FORMAT "%8.2" NUMBER 4 /end CHARACTERISTIC
/begin CHARACTERISTIC CDCTEVE2 "Codewort CARB:	Tankentlüftungsventil Endstufe  Bank2" VAL_BLK 0x81535A KwbUw 65535.00 dez 0.00 65535.00 FORMAT "%8.2" NUMBER 4 /end CHARACTERISTIC
/begin CHARACTERISTIC CDKAAV "Codewort Kunde: Absperrventil Aktivkohlefilter (Funktion)" VALUE 0x8153DC KwUw 65535.00 dez 0.00 65535.00 FORMAT "%8.2" /end CHARACTERISTIC
/begin CHARACTERISTIC CDKAGRE "Codewort Kunde: Überwachung AGR-Endstufe" VALUE 0x8153E0 KwUw 65535.00 dez 0.00 65535.00 FORMAT "%8.2" /end CHARACTERISTIC
/begin CHARACTERISTIC CDKAGRF "Codewort Kunde: Überwachung AGR-FLOW" VALUE 0x8153E2 KwUw 65535.00 dez 0.00 65535.00 FORMAT "%8.2" /end CHARACTERISTIC
/begin CHARACTERISTIC CDKATLK "Codewort für B_lrka aktiv" VALUE 0x811A70 KwUb 255.0 dez 0.00 255.0 FORMAT "%5.1" /end CHARACTERISTIC
/begin CHARACTERISTIC CDKDSS "Codewort Kunde: Saugrohr-Drucksensor" VALUE 0x81540A KwUw 65535.00 dez 0.00 65535.00 FORMAT "%8.2" /end CHARACTERISTIC
/begin CHARACTERISTIC CDKMDB "Codewort Kunde: Momentbegrenzung Sollmoment" VALUE 0x8154A0 KwUw 65535.00 dez 0.00 65535.00 FORMAT "%8.2" /end CHARACTERISTIC
/begin CHARACTERISTIC CDKTESF "Codewort Kunde: Tankentlüftungssystem Feinleck" VALUE 0x8154D6 KwUw 65535.00 dez 0.00 65535.00 FORMAT "%8.2" /end CHARACTERISTIC
/begin CHARACTERISTIC CDKTEVE2 "Codewort Kunde: Tankentlüftungsventil Endstufe Bank 2" VALUE 0x8154DC KwUw 65535.00 dez 0.00 65535.00 FORMAT "%8.2" /end CHARACTERISTIC
/begin CHARACTERISTIC CDTAAV "Codewort Tester: Absperrventil Aktivkohlefilter (Fkt)" VALUE 0x8154FE KwUw 65535.00 dez 0.00 65535.00 FORMAT "%8.2" /end CHARACTERISTIC
/begin CHARACTERISTIC CDTAGRE "Codewort Tester: Überwachung AGR-Endstufe" VALUE 0x815502 KwUw 65535.00 dez 0.00 65535.00 FORMAT "%8.2" /end CHARACTERISTIC
/begin CHARACTERISTIC CDTAGRF "Codewort Tester: Überwachung AGR-FLOW" VALUE 0x815504 KwUw 65535.00 dez 0.00 65535.00 FORMAT "%8.2" /end CHARACTERISTIC
/begin CHARACTERISTIC CDTDSS "Codewort Tester: Saugrohrdrucksensor" VALUE 0x81552C KwUw 65535.00 dez 0.00 65535.00 FORMAT "%8.2" /end CHARACTERISTIC
/begin CHARACTERISTIC CDTMDB "Codewort Tester: Momentbegrenzung Sollmoment" VALUE 0x8155C2 KwUw 65535.00 dez 0.00 65535.00 FORMAT "%8.2" /end CHARACTERISTIC
/begin CHARACTERISTIC CDTTESF "Codewort Tester: Tankentlüftungssystem Feinleck" VALUE 0x8155F8 KwUw 65535.00 dez 0.00 65535.00 FORMAT "%8.2" /end CHARACTERISTIC
/begin CHARACTERISTIC CDTTEVE2 "Codewort Tester: Tankentlüftungsventil Endstufe Bank 2" VALUE 0x8155FE KwUw 65535.00 dez 0.00 65535.00 FORMAT "%8.2" /end CHARACTERISTIC
/begin CHARACTERISTIC CLAAAV "Fehlerklasse: Tankdiagnose, AAV verstopft" VALUE 0x811592 KwUb 255.0 dez 0.00 255.0 FORMAT "%5.1" /end CHARACTERISTIC
/begin CHARACTERISTIC CLAAGRE "Fehlerklasse: AGR-Ventil Endstufe" VALUE 0x811594 KwUb 255.0 dez 0.00 255.0 FORMAT "%5.1" /end CHARACTERISTIC
/begin CHARACTERISTIC CLAAGRF "Fehlerklasse: Überwachung AGR-Flow" VALUE 0x811595 KwUb 255.0 dez 0.00 255.0 FORMAT "%5.1" /end CHARACTERISTIC
/begin CHARACTERISTIC CLADSS "Fehlerklasse: Saugrohrdrucksensor" VALUE 0x8115A9 KwUb 255.0 dez 0.00 255.0 FORMAT "%5.1" /end CHARACTERISTIC
/begin CHARACTERISTIC CLAMDB "Fehlerklasse: Momentbgrenzung Sollmoment" VALUE 0x8115F4 KwUb 255.0 dez 0.00 255.0 FORMAT "%5.1" /end CHARACTERISTIC
/begin CHARACTERISTIC CLATESF "Fehlerklasse: Tankdiagnose, Feinleck" VALUE 0x81160F KwUb 255.0 dez 0.00 255.0 FORMAT "%5.1" /end CHARACTERISTIC
/begin CHARACTERISTIC CLATEVE2 "Fehlerklasse: Tankentlüftungsventil Endstufe Bank 2" VALUE 0x811612 KwUb 255.0 dez 0.00 255.0 FORMAT "%5.1" /end CHARACTERISTIC
/begin CHARACTERISTIC CPLRA "Codewort für Umschaltung DKVS von HFM- auf P-System" VALUE 0x819BD9 KwUb 255.0 dez 0.00 255.0 FORMAT "%5.1" /end CHARACTERISTIC
/begin CHARACTERISTIC CWDKRNT "Codewort: KR-Diagnose Integratorsteigung" VALUE 0x810182 KwUb 255.0 dez 0.00 255.0 FORMAT "%5.1" /end CHARACTERISTIC
/begin CHARACTERISTIC CWDKROF "Codewort: KR-Diagnose Resetwert" VALUE 0x810183 KwUb 255.0 dez 0.00 255.0 FORMAT "%5.1" /end CHARACTERISTIC
/begin CHARACTERISTIC CWDKRTP "Codewort: KR-Diagnose Testimpuls" VALUE 0x810066 KwUb 255.0 dez 0.00 255.0 FORMAT "%5.1" /end CHARACTERISTIC
/begin CHARACTERISTIC CWDKS1 "Codewort: Klopfsensordiagnose Sensor1" VALUE 0x81A322 KwUb 255.0 dez 0.00 255.0 FORMAT "%5.1" /end CHARACTERISTIC
/begin CHARACTERISTIC CWDKS2 "Codewort: Klopfsensordiagnose Sensor 2" VALUE 0x81A323 KwUb 255.0 dez 0.00 255.0 FORMAT "%5.1" /end CHARACTERISTIC
/begin CHARACTERISTIC CWDKS3 "Codewort: Klopfsensordiagnose Sensor 3" VALUE 0x81A324 KwUb 255.0 dez 0.00 255.0 FORMAT "%5.1" /end CHARACTERISTIC
/begin CHARACTERISTIC CWDKS4 "Codewort: Klopfsensordiagnose Sensor 4" VALUE 0x81A325 KwUb 255.0 dez 0.00 255.0 FORMAT "%5.1" /end CHARACTERISTIC
/begin CHARACTERISTIC CWDLSA "Codewort für Einmalprüfung Alterung Sonde vor KAT für Applikationszwecke" VALUE 0x8199FD KwUb 255.0 dez 0.00 255.0 FORMAT "%5.1" /end CHARACTERISTIC
/begin CHARACTERISTIC CWDLSAHK "Codewort CWDLSAHK für Alterung Sonde hinter KAT" VALUE 0x819A4D KwUb 255.0 dez 0.00 255.0 FORMAT "%5.1" /end CHARACTERISTIC
/begin CHARACTERISTIC CWDTLECK "Codewort Abschaltung der DLDP" VALUE 0x8123EF KwUb 255.0 dez 0.00 255.0 FORMAT "%5.1" /end CHARACTERISTIC
/begin CHARACTERISTIC CWFSTD "Codewort Tankfuellstandsdiagnose" VALUE 0x81A4DD KwUb 255.0 dez 0.00 255.0 FORMAT "%5.1" /end CHARACTERISTIC
/begin CHARACTERISTIC DASA "Anzahl der SAS-Phasen zur Erkennung LLS Fehler" VALUE 0x81A328 KwUb 255.0 dez 0.00 255.0 FORMAT "%5.1" /end CHARACTERISTIC
/begin CHARACTERISTIC DFRMST "Delta frm-schwelle für Erkennung der eingeschwungenen Grundadaption" VALUE 0x819BDA KwUb 1.992 fak_ub_b2 0.00 1.992 FORMAT "%5.3" /end CHARACTERISTIC
/begin CHARACTERISTIC DFSKVO "Obere Toleranzgrenze fuer Fuellstandsgeberdiagnose" VALUE 0x81B8BE KwSw 127.9961 vol_q3p90625Em3_l 0.00 127.9961 FORMAT "%8.4" /end CHARACTERISTIC
/begin CHARACTERISTIC DFSKVU "Untere Toleranzgrenze fuer Fuellstandsgeberdiagnose" VALUE 0x81B8C0 KwSw 128.0000 vol_q3p90625Em3_l -128.0000 0.00 FORMAT "%8.4" /end CHARACTERISTIC
/begin CHARACTERISTIC DHAKTIV "Codewort Down-Hill Erkennung dauernd aktiv" VALUE 0x81A4F5 KwUb 1.000 dez 0.00 1.000 FORMAT "%5.3" /end CHARACTERISTIC
/begin CHARACTERISTIC DKATCW "einmaliger Lauf bzw. Initialisierung der DKAT-Funktion" VALUE 0x811A71 KwUb 255.0 dez 0.00 255.0 FORMAT "%5.1" /end CHARACTERISTIC
/begin CHARACTERISTIC DKROFN "Grenzwert der Integratorsteigung für Nulltest" CURVE 0x813CF4 KlAUwSstUwWUw 6103.425 spgg_sw_b3052 0.00 6103.425 FORMAT "%8.3"
 /begin AXIS_DESCR STD_AXIS tmfln_w tknockcon_sy 6 0.00 0.2097120 FORMAT "%9.7" DEPOSIT ABSOLUTE /end AXIS_DESCR
/end CHARACTERISTIC
/begin CHARACTERISTIC DKROKU "Untere Drehzahlschwelle für Ermittlung Offsetkompensationswert" VALUE 0x810184 KwUb 10200. nmot_ub_q40 0.00 10200. FORMAT "%5.0" /end CHARACTERISTIC
/begin CHARACTERISTIC DKVBD "Schwelle verbrauchter Kraftstoff für Diagnosefreigabe" VALUE 0x81B8C2 KwUw 255.9961 vol_q3p90625Em3_l 0.00 255.9961 FORMAT "%8.4" /end CHARACTERISTIC
/begin CHARACTERISTIC DLAMELSH "Delta-Lambda-Sollwert für elektrische Sonendiagnose hinter KAT (Kurztrip)" VALUE 0x81AD0E KwUw 15.99976 fak_uw_b16 0.00 15.99976 FORMAT "%8.5" /end CHARACTERISTIC
/begin CHARACTERISTIC DLAMLASHF "Delta-Lambda-Sollwert (Fett) für Test Schwingungsprüfung hinter KAT" VALUE 0x81ACF0 KwUw 15.99976 fak_uw_b16 0.00 15.99976 FORMAT "%8.5" /end CHARACTERISTIC
/begin CHARACTERISTIC DLAMLASHM "Delta-Lambda-Sollwert (Mager) für Test Schwingungsprüfung hinter KAT" VALUE 0x81ACF2 KwUw 15.99976 fak_uw_b16 0.00 15.99976 FORMAT "%8.5" /end CHARACTERISTIC
/begin CHARACTERISTIC DMLLRIDO "Maximale Integratorabweichung (Unterdrehzahl) für Diagnose LLR" VALUE 0x81A329 KwUb 24.90 rel_ub_b50 0.00 24.90 FORMAT "%5.2" /end CHARACTERISTIC
/begin CHARACTERISTIC DMLLRIDU "Maximale Integratorabweichung (Überdrehzahl) für Diagnose LLR" VALUE 0x81A32A KwSb 25.10 rel_ub_b50 -25.10 0.00 FORMAT "%5.2" /end CHARACTERISTIC
/begin CHARACTERISTIC DMLLRIDU2 "Maximale Integratorabweichung (Überdrehzahl) für Diagnose LLR (2.Schwelle)" VALUE 0x81A32B KwSb 25.10 rel_ub_b50 -25.10 0.00 FORMAT "%5.2" /end CHARACTERISTIC
/begin CHARACTERISTIC DMRKTD "Momentenreserve für Katalysator-Diagnose" VALUE 0x813FFA KwUw 99.99847 rel_uw_b100 0.00 99.99847 FORMAT "%8.5" /end CHARACTERISTIC
/begin CHARACTERISTIC DMRLASH "Momentenreserve für Diagnose Lambdasonden-Alterungsüberwachung hinter KAT" VALUE 0x81ACF4 KwUw 99.99847 rel_uw_b100 0.00 99.99847 FORMAT "%8.5" /end CHARACTERISTIC
/begin CHARACTERISTIC DMRLSH "Momentenreserve für Diagnose Lambdasonden hinter KAT" VALUE 0x81AD10 KwUw 99.99847 rel_uw_b100 0.00 99.99847 FORMAT "%8.5" /end CHARACTERISTIC
/begin CHARACTERISTIC DNDLLRO "Maximale Drehzahlabweichung (Unterdrehzahl) für Diagnose LLR" VALUE 0x81A32C KwUb 1270. nmot_ub_q10 0.00 1270. FORMAT "%5.0" /end CHARACTERISTIC
/begin CHARACTERISTIC DNDLLRU "Maximale Drehzahlabweichung (Überdrehzahl) für Diagnose LLR" VALUE 0x81A32D KwSb 1280. nmot_ub_q10 -1280. 0.00 FORMAT "%5.0" /end CHARACTERISTIC
/begin CHARACTERISTIC DPUBABMX "Maximale Schwelle Delta Umgebungsdruck für Bergaberkennung" VALUE 0x817468 KwUw 2559.961 p_uw_q0p039 0.00 2559.961 FORMAT "%8.3" /end CHARACTERISTIC
/begin CHARACTERISTIC DPUKORDH "Schwellwert für Delta Umgebungsdruck für Bergaberkennung" VALUE 0x81746A KwUw 2559.961 p_uw_q0p039 0.00 2559.961 FORMAT "%8.3" /end CHARACTERISTIC
/begin CHARACTERISTIC DRISIGH "Diagnoseschwelle Ri-Sonde für Signalunterbrechung hinter KAT" VALUE 0x81AD12 KwUw 131070.0 r_uw_q2 0.00 131070.0 FORMAT "%8.1" /end CHARACTERISTIC
/begin CHARACTERISTIC DRLKTDP "Schwelle für Laständerung in Kat-Diagnose" VALUE 0x811A72 KwSb 191.3 rel_sb_q0p75 -96.00 95.25 FORMAT "%5.2" /end CHARACTERISTIC
/begin CHARACTERISTIC DTMLDP "Differenz Motorabstelltemperatur - TMOT bei Start" VALUE 0x8123F0 KwUb 191.3 temp_ub_b191p25 0.00 191.3 FORMAT "%5.1" /end CHARACTERISTIC
/begin CHARACTERISTIC FALRKTD "Verstärkungsfaktor für Amplitude des Lambdareglers" VALUE 0x811A73 KwUb 7.969 fak_ub_b8 0.00 7.969 FORMAT "%5.3" /end CHARACTERISTIC
/begin CHARACTERISTIC FALRKTT "Verstärkungsfaktor für Amplitude des Lambdareglers bei Testerbetrieb" VALUE 0x811A74 KwUb 7.969 fak_ub_b8 0.00 7.969 FORMAT "%5.3" /end CHARACTERISTIC
/begin CHARACTERISTIC FDKHLDP "Minimaler Höhenfaktor für DLDP" VALUE 0x81746C KwUw 3.999939 fak_uw_b4 0.00 3.999939 FORMAT "%8.6" /end CHARACTERISTIC
/begin CHARACTERISTIC FFTAAV "Freeze Frame Tabelle: Tankdiagnose, AAV verstopft" VAL_BLK 0x811626 KwbUb 255.0 dez 0.00 255.0 FORMAT "%5.1" NUMBER 4 /end CHARACTERISTIC
/begin CHARACTERISTIC FFTAGRE "Freeze Frame Tabelle: AGR-Ventil Endstufe" VAL_BLK 0x81162E KwbUb 255.0 dez 0.00 255.0 FORMAT "%5.1" NUMBER 4 /end CHARACTERISTIC
/begin CHARACTERISTIC FFTAGRF "Freeze Frame Tabelle: Überwachung AGR-Flow" VAL_BLK 0x811632 KwbUb 255.0 dez 0.00 255.0 FORMAT "%5.1" NUMBER 4 /end CHARACTERISTIC
/begin CHARACTERISTIC FFTDSS "Freeze Frame Tabelle: Saugrohrdrucksensor" VAL_BLK 0x811682 KwbUb 255.0 dez 0.00 255.0 FORMAT "%5.1" NUMBER 4 /end CHARACTERISTIC
/begin CHARACTERISTIC FFTMDB "Freeze Frame Tabelle: Momentbegrenzung Sollmoment" VAL_BLK 0x8117AE KwbUb 255.0 dez 0.00 255.0 FORMAT "%5.1" NUMBER 4 /end CHARACTERISTIC
/begin CHARACTERISTIC FFTTESF "Freeze Frame Tabelle: Tankdiagnose, Feinleck" VAL_BLK 0x81181A KwbUb 255.0 dez 0.00 255.0 FORMAT "%5.1" NUMBER 4 /end CHARACTERISTIC
/begin CHARACTERISTIC FFTTEVE2 "Freeze Frame Tabelle: Tankentlüftungsventil" VAL_BLK 0x811826 KwbUb 255.0 dez 0.00 255.0 FORMAT "%5.1" NUMBER 4 /end CHARACTERISTIC
/begin CHARACTERISTIC FHDLLR "Höhenschwelle für Durchführung Diagnose Leerlaufsteller" VALUE 0x81A32E KwUb 3.984 fak_ub_b4 0.00 3.984 FORMAT "%5.3" /end CHARACTERISTIC
/begin CHARACTERISTIC FRAE "Delta-fra-Schwelle für Erkennung der eingeschwungenen Grundadaption" VALUE 0x81B100 KwUw 1.999969 fak_uw_b2 0.00 1.999969 FORMAT "%8.6" /end CHARACTERISTIC
/begin CHARACTERISTIC FRAODN "untere Diagnoseschwelle des Korrekturfaktors frao" VALUE 0x81B102 KwUw 1.999969 fak_uw_b2 0.00 1.999969 FORMAT "%8.6" /end CHARACTERISTIC
/begin CHARACTERISTIC FRAODX "obere Diagnoseschwelle des Korrekturfaktors frao" VALUE 0x81B104 KwUw 1.999969 fak_uw_b2 0.00 1.999969 FORMAT "%8.6" /end CHARACTERISTIC
/begin CHARACTERISTIC FRAUDN "untere Diagnoseschwelle des Korrekturfaktors frau" VALUE 0x81B106 KwUw 1.999969 fak_uw_b2 0.00 1.999969 FORMAT "%8.6" /end CHARACTERISTIC
/begin CHARACTERISTIC FRAUDX "obere Diagnoseschwelle des Korrekturfaktors frau" VALUE 0x81B108 KwUw 1.999969 fak_uw_b2 0.00 1.999969 FORMAT "%8.6" /end CHARACTERISTIC
/begin CHARACTERISTIC FRINH1 "Multiplikativer Faktor für RIN Sollwert hinter Kat" CURVE 0x81999A KlAUbSstUbWUb 63.75 fak_ub_b64 0.00 63.75 FORMAT "%5.2"
 /begin AXIS_DESCR STD_AXIS tkatmf temp_ub_q5_o50 5 -50.00 1225. FORMAT "%5.0" DEPOSIT ABSOLUTE /end AXIS_DESCR
/end CHARACTERISTIC
/begin CHARACTERISTIC FRINH2 "Multiplikativer Faktor für RIN Sollwert hinter Kat" CURVE 0x8199A5 KlAUbSstUbWUb 63.75 fak_ub_b64 0.00 63.75 FORMAT "%5.2"
 /begin AXIS_DESCR STD_AXIS tkatmf2 temp_ub_q5_o50 5 -50.00 1225. FORMAT "%5.0" DEPOSIT ABSOLUTE /end AXIS_DESCR
/end CHARACTERISTIC
/begin CHARACTERISTIC FRINV1 "Multiplikativer Faktor für RIN Sollwert vor Kat" CURVE 0x8199B0 KlAUbSstUbWUb 63.75 fak_ub_b64 0.00 63.75 FORMAT "%5.2"
 /begin AXIS_DESCR STD_AXIS tabgmf temp_ub_q5_o50 5 -50.00 1225. FORMAT "%5.0" DEPOSIT ABSOLUTE /end AXIS_DESCR
/end CHARACTERISTIC
/begin CHARACTERISTIC FRINV2 "Multiplikativer Faktor für RIN Sollwert vor Kat" CURVE 0x8199BB KlAUbSstUbWUb 63.75 fak_ub_b64 0.00 63.75 FORMAT "%5.2"
 /begin AXIS_DESCR STD_AXIS tabgmf2 temp_ub_q5_o50 5 -50.00 1225. FORMAT "%5.0" DEPOSIT ABSOLUTE /end AXIS_DESCR
/end CHARACTERISTIC
/begin CHARACTERISTIC FRMLASHO "obere Schwelle für Mittelwert des Lambdareglerfaktors" VALUE 0x81ACF6 KwUw 1.999969 fak_uw_b2 0.00 1.999969 FORMAT "%8.6" /end CHARACTERISTIC
/begin CHARACTERISTIC FRMLASHU "untere Schwelle für Mittelwert des Lambdareglerfaktors" VALUE 0x81ACF8 KwUw 1.999969 fak_uw_b2 0.00 1.999969 FORMAT "%8.6" /end CHARACTERISTIC
/begin CHARACTERISTIC FRMSTDN "untere Diagnoseschwelle (short test)" VALUE 0x819BDB KwUb 1.992 fak_ub_b2 0.00 1.992 FORMAT "%5.3" /end CHARACTERISTIC
/begin CHARACTERISTIC FRMSTDX "obere Diagnoseschwelle (short test)" VALUE 0x819BDC KwUb 1.992 fak_ub_b2 0.00 1.992 FORMAT "%5.3" /end CHARACTERISTIC
/begin CHARACTERISTIC FSALULDP "Fahrzeugbeschleunigungsschwelle für vorläufigen Abbruch DLDP" VALUE 0x81746E KwUw 55.55471 acc_uw_b55p55 0.00 55.55471 FORMAT "%8.5" /end CHARACTERISTIC
/begin CHARACTERISTIC FTEADLDP "Schwelle Beladungsgrad AKF zur Wiederholfreigabe AKF" VALUE 0x817470 KwSw 127.9980 fak_sw_b64 -64.00000 63.99805 FORMAT "%8.5" /end CHARACTERISTIC
/begin CHARACTERISTIC IMLKVSMX "Maximale Integrationsschwelle für Fehlerfreigabe in DKVS (Tank leer)" VALUE 0x81B10A KwUw 233.0133 m_q0p00355 0.00 233.0133 FORMAT "%8.4" /end CHARACTERISTIC
/begin CHARACTERISTIC KATBFML "Filterzeitkonstante für Signaldämpfung in Katbelastung" CURVE 0x811A75 GklWUb 12.7498 zk50msxs_ub_b12p8 0.0501961 12.8000 FORMAT "%7.4" /begin AXIS_DESCR COM_AXIS ml m_ub_b1020 5 0.00 1020. AXIS_PTS_REF SML05DKUB /end AXIS_DESCR /end CHARACTERISTIC
/begin CHARACTERISTIC KATBFMN "Schwellwert für kleine Katalysatorbelastung" VALUE 0x811A7A KwUb 0.9961 fak_ub_b1 0.00 0.9961 /end CHARACTERISTIC
/begin CHARACTERISTIC KATBFN "normierter Mittelwert der Sondenamplitude" VALUE 0x811A7B KwUb 0.9961 fak_ub_b1 0.00 0.9961 /end CHARACTERISTIC
/begin CHARACTERISTIC KATBFNM "Normierungsfaktor multiplikativ für Katbelastung" VALUE 0x811A7C KwUb 1.330 spg_ub_b1p33 0.00 1.330 FORMAT "%5.3" /end CHARACTERISTIC
/begin CHARACTERISTIC KATBFNP "Normierungsfaktor additiv für Katbelastung" VALUE 0x811A7D KwUb 1.330 spg_ub_b1p33 0.00 1.330 FORMAT "%5.3" /end CHARACTERISTIC
/begin CHARACTERISTIC KATBFSX "Max. Integrationsschwelle für Stoppbedingung" VALUE 0x811A7E KwSb 1.992 fak_sb_b1 -1.000 0.9922 FORMAT "%5.3" /end CHARACTERISTIC
/begin CHARACTERISTIC KATBFXM "Maximale Katbelastungsschwelle für Stoppbedingung" CURVE 0x8156B4 GklWSw 1023.984 freq_sw_b512 -512.0000 511.9844 FORMAT "%8.4" /begin AXIS_DESCR COM_AXIS ml m_ub_b1020 5 0.00 1020. AXIS_PTS_REF SML05DKUB /end AXIS_DESCR /end CHARACTERISTIC
/begin CHARACTERISTIC KATBSG "Katalysatorspeichergröße für Katbelastung" VALUE 0x8156BE KwUw 56887.15 m_uw_b58888 0.8680556 56888.02 FORMAT "%8.2" /end CHARACTERISTIC
/begin CHARACTERISTIC KATBSH "Offset für Lambdaregelung leicht im fetten Bereich" VALUE 0x811A7F KwUb 221.4 mgrad_ub_b221p35 0.00 221.4 FORMAT "%5.1" /end CHARACTERISTIC
/begin CHARACTERISTIC KATBSHF "Verstärkungsfaktor für Regellagendifferenz" VALUE 0x8156C0 KwUw 9996.308 mgrad_uw_q10p402 0.00 9996.308 FORMAT "%8.3" /end CHARACTERISTIC
/begin CHARACTERISTIC KATBSHG "Begrenzungsfaktor der Regellagenkorrektur" VALUE 0x811A80 KwUb 0.9961 fak_ub_b1 0.00 0.9961 /end CHARACTERISTIC
/begin CHARACTERISTIC KFMLDMN "ML-Schwelle für B_minflr-Diagnose HFM/HLM" MAP 0x81AF12 GkfWSw 6553.500 m_sw_q0p1 -3276.800 3276.700 FORMAT "%8.3"
 /begin AXIS_DESCR COM_AXIS wdkbad_w relDK_q0p02441 8 -800.0000 799.9756 AXIS_PTS_REF SDK08FEUW /end AXIS_DESCR
 /begin AXIS_DESCR COM_AXIS nmot_w nmot_uw_q0p25 8 0.00 16383.75 AXIS_PTS_REF SNM08FEUW /end AXIS_DESCR
/end CHARACTERISTIC
/begin CHARACTERISTIC KFMLDMX "ML-Schwelle für B_maxflr-Diagnose HFM/HLM" MAP 0x81AF92 GkfWUw 6553.500 m_uw_b6553p5 0.00 6553.500 FORMAT "%8.3"
 /begin AXIS_DESCR COM_AXIS wdkbad_w relDK_q0p02441 8 -800.0000 799.9756 AXIS_PTS_REF SDK08FEUW /end AXIS_DESCR
 /begin AXIS_DESCR COM_AXIS nmot_w nmot_uw_q0p25 8 0.00 16383.75 AXIS_PTS_REF SNM08FEUW /end AXIS_DESCR
/end CHARACTERISTIC
/begin CHARACTERISTIC KFRINH "Kennfeld für Nernst-Innenwiderstand hinter Kat" MAP 0x8199C6 KfAxUbAyUbSstxUbSstyUbWUb 2040. r_q8 0.00 2040. FORMAT "%5.0"
 /begin AXIS_DESCR STD_AXIS tkatmf temp_ub_q5_o50 5 -50.00 1225. FORMAT "%5.0" DEPOSIT ABSOLUTE /end AXIS_DESCR
 /begin AXIS_DESCR STD_AXIS phlsnhf fak_ub_q0p01 3 0.00 2.550 FORMAT "%5.3" DEPOSIT ABSOLUTE /end AXIS_DESCR
/end CHARACTERISTIC
/begin CHARACTERISTIC KFRINH2 "Kennfeld für Nernst-Innenwiderstand hinter Kat Bank2" MAP 0x8199DF KfAxUbAyUbSstxUbSstyUbWUb 2040. r_q8 0.00 2040. FORMAT "%5.0"
 /begin AXIS_DESCR STD_AXIS tkatmf2 temp_ub_q5_o50 5 -50.00 1225. FORMAT "%5.0" DEPOSIT ABSOLUTE /end AXIS_DESCR
 /begin AXIS_DESCR STD_AXIS phlsnhf2 fak_ub_q0p01 3 0.00 2.550 FORMAT "%5.3" DEPOSIT ABSOLUTE /end AXIS_DESCR
/end CHARACTERISTIC
/begin CHARACTERISTIC KFRINV "Kennfeld für Nernst-Innenwiderstand vor Kat" MAP 0x81ACAA KfAxUbAyUbSstxUbSstyUbWUb 2040. r_q8 0.00 2040. FORMAT "%5.0"
 /begin AXIS_DESCR STD_AXIS tabgmf temp_ub_q5_o50 5 -50.00 1225. FORMAT "%5.0" DEPOSIT ABSOLUTE /end AXIS_DESCR
 /begin AXIS_DESCR STD_AXIS phlsnvf fak_ub_q0p01 3 0.00 2.550 FORMAT "%5.3" DEPOSIT ABSOLUTE /end AXIS_DESCR
/end CHARACTERISTIC
/begin CHARACTERISTIC KFRINV2 "Kennfeld für Nernst-Innenwiderstand vor Kat Bank2" MAP 0x81ACC3 KfAxUbAyUbSstxUbSstyUbWUb 2040. r_q8 0.00 2040. FORMAT "%5.0"
 /begin AXIS_DESCR STD_AXIS tabgmf2 temp_ub_q5_o50 5 -50.00 1225. FORMAT "%5.0" DEPOSIT ABSOLUTE /end AXIS_DESCR
 /begin AXIS_DESCR STD_AXIS phlsnvf2 fak_ub_q0p01 3 0.00 2.550 FORMAT "%5.3" DEPOSIT ABSOLUTE /end AXIS_DESCR
/end CHARACTERISTIC
/begin CHARACTERISTIC KFTPKOR "Korrekturkennfeld für gemessene Periodendauer TP (tpsvkof)" MAP 0x8199FE KfAxUbAyUbSstxUbSstyUbWUb 1.992 fak_ub_b2 0.00 1.992 FORMAT "%5.3"
 /begin AXIS_DESCR STD_AXIS nmot nmot_ub_q40 8 0.00 10200. FORMAT "%5.0" DEPOSIT ABSOLUTE /end AXIS_DESCR
 /begin AXIS_DESCR STD_AXIS rl rel_ub_q0p75 7 0.00 191.3 FORMAT "%5.1" DEPOSIT ABSOLUTE /end AXIS_DESCR
/end CHARACTERISTIC
/begin CHARACTERISTIC KLDTPLDP "Dynamikfensterbreite Stabilitätskriterium" CURVE 0x817472 KlAUwSstUwWUw 1310.70 t20msxs_uw_b1310 0.00 1310.70 FORMAT "%7.2"
 /begin AXIS_DESCR STD_AXIS timtp t10msxs_uw_b655p35 30 0.00 655.3500 FORMAT "%8.4" DEPOSIT ABSOLUTE /end AXIS_DESCR
/end CHARACTERISTIC
/begin CHARACTERISTIC KLWZTLDP "Anzahl Meßwerte für Stabilitätskriterium" CURVE 0x8174EC KlAUwSstUwWUw 65535.00 dez 0.00 65535.00 FORMAT "%8.2"
 /begin AXIS_DESCR STD_AXIS timtp t10msxs_uw_b655p35 30 0.00 655.3500 FORMAT "%8.4" DEPOSIT ABSOLUTE /end AXIS_DESCR
/end CHARACTERISTIC
/begin CHARACTERISTIC KMXSTG "Filterkonstante für Filter max. Steigung für Sonde hinter KAT" VALUE 0x81ACFA KwUw 0.9999847 fak_uw_b1 0.00 0.9999847 FORMAT "%9.7" /end CHARACTERISTIC
/begin CHARACTERISTIC KRFHKS "Fehlerhäufigkeit Klopfsensoren" VALUE 0x81A326 KwUb 255.0 dez 0.00 255.0 FORMAT "%5.1" /end CHARACTERISTIC
/begin CHARACTERISTIC KRFHT "Fehlerhäufigkeit Testimpuls" VALUE 0x810185 KwUb 254.0 dez 1.000 255.0 FORMAT "%5.1" /end CHARACTERISTIC
/begin CHARACTERISTIC MLDKVSF "Luftmassenschwelle für Fehlerfreigabe im DKVS (Tank leer)" VALUE 0x81B10C KwUw 233.0133 m_q0p00355 0.00 233.0133 FORMAT "%8.4" /end CHARACTERISTIC
/begin CHARACTERISTIC MLDKVSG "Luftmassenschwelle für Fehlerfreigabe Tank leer" VALUE 0x81B10E KwUw 233.0133 m_q0p00355 0.00 233.0133 FORMAT "%8.4" /end CHARACTERISTIC
/begin CHARACTERISTIC MLDPKD "Minimaler Integratorwert Spülluft damit Tank drucklos" VALUE 0x817566 KwUw 2.330133 dldp_uw_b2p33 0.00 2.330133 FORMAT "%8.6" /end CHARACTERISTIC
/begin CHARACTERISTIC MLLASH "Luftmassenschwelle für Schwingungsprüfung hinter KAT" VALUE 0x81ACFC KwUw 6553.500 m_q0p1 0.00 6553.500 FORMAT "%8.3" /end CHARACTERISTIC
/begin CHARACTERISTIC MLOSTEST "obere Luftmassenschwelle für Testbeginn Schwingungsprüfung hinter KAT" VALUE 0x81ACFE KwUw 6553.500 m_q0p1 0.00 6553.500 FORMAT "%8.3" /end CHARACTERISTIC
/begin CHARACTERISTIC MLUSSTG "Luftmassenschwelle für Dynamikprüfung hinter KAT" VALUE 0x81AD00 KwUw 6553.500 m_q0p1 0.00 6553.500 FORMAT "%8.3" /end CHARACTERISTIC
/begin CHARACTERISTIC MLUSTEST "untere Luftmassenschwelle für Testbeginn Schwingungsprüfung hinter KAT" VALUE 0x81AD02 KwUw 6553.500 m_q0p1 0.00 6553.500 FORMAT "%8.3" /end CHARACTERISTIC
/begin CHARACTERISTIC NDKS "Drehzahlschwelle für Dia KS" VALUE 0x81A327 KwUb 10200. nmot_ub_q40 0.00 10200. FORMAT "%5.0" /end CHARACTERISTIC
/begin CHARACTERISTIC NDKTSO "Obere Drehzahlgrenze für DKAT-aktiv" VALUE 0x811A81 KwUb 10200. nmot_ub_q40 0.00 10200. FORMAT "%5.0" /end CHARACTERISTIC
/begin CHARACTERISTIC NDKTSOT "Obere Drehzahlgrenze für Funktionsanforderung" VALUE 0x811A82 KwUb 10200. nmot_ub_q40 0.00 10200. FORMAT "%5.0" /end CHARACTERISTIC
/begin CHARACTERISTIC NDKTSU "untere Drehzahlgrenze für DKAT-aktiv" VALUE 0x811A83 KwUb 10200. nmot_ub_q40 0.00 10200. FORMAT "%5.0" /end CHARACTERISTIC
/begin CHARACTERISTIC NDKTSUT "Untere Drehzahlgrenze für Funktionsanforderung" VALUE 0x811A84 KwUb 10200. nmot_ub_q40 0.00 10200. FORMAT "%5.0" /end CHARACTERISTIC
/begin CHARACTERISTIC NKTDX "Maximale Drehzahlgrenze DKAT für Berechnung" VALUE 0x811A85 KwUb 10200. nmot_ub_q40 0.00 10200. FORMAT "%5.0" /end CHARACTERISTIC
/begin CHARACTERISTIC NTPKTO "obere Drehzahlschwelle für Periodendauer-Kurztest" VALUE 0x811A9C KwUb 10200. nmot_ub_q40 0.00 10200. FORMAT "%5.0" /end CHARACTERISTIC
/begin CHARACTERISTIC NTPKTU "untere Drehzahlschwelle für Periodendauer-Kurztest" VALUE 0x811A9D KwUb 10200. nmot_ub_q40 0.00 10200. FORMAT "%5.0" /end CHARACTERISTIC
/begin CHARACTERISTIC NTPVKO "obere Drehzahlschwelle für Periodendauerüberwachung vor Kat" VALUE 0x811A9E KwUb 10200. nmot_ub_q40 0.00 10200. FORMAT "%5.0" /end CHARACTERISTIC
/begin CHARACTERISTIC NTPVKU "untere Drehzahlschwelle für Periodendauerüberwachung vor Kat" VALUE 0x811A9F KwUb 10200. nmot_ub_q40 0.00 10200. FORMAT "%5.0" /end CHARACTERISTIC
/begin CHARACTERISTIC PHLSNHMN "Heizleistung für ausreichende Sondenheizung" VALUE 0x819A5B KwUb 2.550 fak_ub_q0p01 0.00 2.550 FORMAT "%5.3" /end CHARACTERISTIC
/begin CHARACTERISTIC PSLDPMX "Maximaler Saugrohrdruck bei Leckdiagnose" VALUE 0x817568 KwUw 1.999969 fak_uw_b2 0.00 1.999969 FORMAT "%8.6" /end CHARACTERISTIC
/begin CHARACTERISTIC RISIGRESH "Schwelle für Reset Signalunterbrechung mit Ri-Diagnose hinter KAT" VALUE 0x81AD14 KwUw 131070.0 r_uw_q2 0.00 131070.0 FORMAT "%8.1" /end CHARACTERISTIC
/begin CHARACTERISTIC RKAE "Delta rkat- bzw. rkaz-Schwelle für Erkennung der eingeschwungenen Grundadaption" VALUE 0x81B110 KwSw 3071.953 rel_sw_b1536 -1536.000 1535.953 FORMAT "%8.3" /end CHARACTERISTIC
/begin CHARACTERISTIC RKATDN "untere Diagnoseschwelle additive Korrektur pro Zeit" VALUE 0x81B112 KwSw 3071.953 rel_sw_b1536 -1536.000 1535.953 FORMAT "%8.3" /end CHARACTERISTIC
/begin CHARACTERISTIC RKATDX "obere Diagnoseschwelle additive Korrektur pro Zeit" VALUE 0x81B114 KwSw 3071.953 rel_sw_b1536 -1536.000 1535.953 FORMAT "%8.3" /end CHARACTERISTIC
/begin CHARACTERISTIC RKAZDN "untere Diagnoseschwelle additive Korrektur pro Zündung" VALUE 0x81B116 KwSw 3071.953 rel_sw_b1536 -1536.000 1535.953 FORMAT "%8.3" /end CHARACTERISTIC
/begin CHARACTERISTIC RKAZDX "obere Diagnoseschwelle additive Korrektur pro Zündung" VALUE 0x81B118 KwSw 3071.953 rel_sw_b1536 -1536.000 1535.953 FORMAT "%8.3" /end CHARACTERISTIC
/begin CHARACTERISTIC RLDKTOT "Obere Lastgrenze für Funktionsanforderung" VALUE 0x811A86 KwUb 191.3 rel_ub_q0p75 0.00 191.3 FORMAT "%5.1" /end CHARACTERISTIC
/begin CHARACTERISTIC RLDKTSO "Obere Lastkennlinie für DKAT-aktiv" CURVE 0x811A87 GklWUb 191.3 rel_ub_q0p75 0.00 191.3 FORMAT "%5.1"
 /begin AXIS_DESCR COM_AXIS nmot nmot_ub_q40 5 0.00 10200. AXIS_PTS_REF SNM05DKUB /end AXIS_DESCR
/end CHARACTERISTIC
/begin CHARACTERISTIC RLDKTSU "Untere Lastkennlinie für DKAT-aktiv" CURVE 0x811A8C GklWUb 191.3 rel_ub_q0p75 0.00 191.3 FORMAT "%5.1"
 /begin AXIS_DESCR COM_AXIS nmot nmot_ub_q40 5 0.00 10200. AXIS_PTS_REF SNM05DKUB /end AXIS_DESCR
/end CHARACTERISTIC
/begin CHARACTERISTIC RLDKTUT "Untere Lastgrenze für Funktionsanforderung" VALUE 0x811A91 KwUb 191.3 rel_ub_q0p75 0.00 191.3 FORMAT "%5.1" /end CHARACTERISTIC
/begin CHARACTERISTIC RLDLLR "Füllungsschwelle für Diagnose LLR" VALUE 0x81A32F KwUb 99.75 rel_ub_q0p75 0.00 99.75 FORMAT "%5.2" /end CHARACTERISTIC
/begin CHARACTERISTIC RLLDPRU "Lastschwelle zur Freigabe TANS-Monitor in DLDP-Funktion" VALUE 0x8123F1 KwUb 191.3 rel_ub_q0p75 0.00 191.3 FORMAT "%5.1" /end CHARACTERISTIC
/begin CHARACTERISTIC RLTPKTO "obere Lastschwelle für Periodendauer-Kurztest" VALUE 0x811AA0 KwUb 191.3 rel_ub_q0p75 0.00 191.3 FORMAT "%5.1" /end CHARACTERISTIC
/begin CHARACTERISTIC RLTPKTU "untere Lastschwelle für Periodendauer-Kurztest" VALUE 0x811AA1 KwUb 191.3 rel_ub_q0p75 0.00 191.3 FORMAT "%5.1" /end CHARACTERISTIC
/begin CHARACTERISTIC RLTPVKO "obere Lastschwelle für Periodendauerüberwachung vor Kat" VALUE 0x811AA2 KwUb 191.3 rel_ub_q0p75 0.00 191.3 FORMAT "%5.1" /end CHARACTERISTIC
/begin CHARACTERISTIC RLTPVKU "untere Lastschwelle für Periodendauerüberwachung vor Kat" VALUE 0x811AA3 KwUb 191.3 rel_ub_q0p75 0.00 191.3 FORMAT "%5.1" /end CHARACTERISTIC
/begin CHARACTERISTIC SAFK1 "Filterkonstante 1 für Lambdasonden-Signalausgabe" VALUE 0x81B066 KwUw 0.9999847 fak_uw_b1 0.00 0.9999847 FORMAT "%9.7" /end CHARACTERISTIC
/begin CHARACTERISTIC SAFK2 "Filterkonstante 2 für Lambdasonden-Signalausgabe" VALUE 0x819BB0 KwUb 0.9961 fak_ub_b1 0.00 0.9961 /end CHARACTERISTIC
/begin AXIS_PTS SDK08FEUW "SST-Verteilung für Drosselklappenwinkel" 0x81B012 wdkbad_w SstASwSstSw 1599.976 relDK_q0p02441 8 -800.0000 799.9756 FORMAT "%8.4" DEPOSIT ABSOLUTE /end AXIS_PTS
/begin CHARACTERISTIC SLOWRMX "Maximale STrecke seit low range aktive" VALUE 0x81B8C4 KwUw 1820.417 s_q0p02777_m 0.00 1820.417 FORMAT "%8.3" /end CHARACTERISTIC
/begin AXIS_PTS SML05DKUB "Stützstellenvert. Luftmasse" 0x811921 ml SstAUbSstUb 1020. m_ub_b1020 5 0.00 1020. FORMAT "%5.0" DEPOSIT ABSOLUTE /end AXIS_PTS
/begin CHARACTERISTIC SMLDYN "Luftmassenschwelle für Sondendynamik hinter KAT" VALUE 0x81AD04 KwUw 182.0417 m_q0p00277 0.00 182.0417 FORMAT "%8.4" /end CHARACTERISTIC
/begin AXIS_PTS SNM05DKUB "Stützstellenvert. nmot" 0x811934 nmot SstAUbSstUb 10200. nmot_ub_q40 5 0.00 10200. FORMAT "%5.0" DEPOSIT ABSOLUTE /end AXIS_PTS
/begin AXIS_PTS SNM08FEUW "SST-Verteilung für Drehzahl" 0x81B024 nmot_w SstAUwSstUw 16383.75 nmot_uw_q0p25 8 0.00 16383.75 FORMAT "%8.2" DEPOSIT ABSOLUTE /end AXIS_PTS
/begin AXIS_PTS SNM16KRUB "Stützstellenverteilung Drehzahl, 16 Sst." 0x8196F2 nmot SstAUbSstUb 10200. nmot_ub_q40 16 0.00 10200. FORMAT "%5.0" DEPOSIT ABSOLUTE /end AXIS_PTS
/begin CHARACTERISTIC SRYAGR "Schwelle für Readiness-Bildung Abgasrückführungs-Diagnose" VALUE 0x8118F7 KwUb 255.0 dez 0.00 255.0 FORMAT "%5.1" /end CHARACTERISTIC
/begin CHARACTERISTIC SRYHS "Schwelle für Readiness-Bildung Sondenheizungs-Diagnose" VALUE 0x8118F8 KwUb 255.0 dez 0.00 255.0 FORMAT "%5.1" /end CHARACTERISTIC
/begin CHARACTERISTIC SRYKAT "Schwelle für Readiness-Bildung Katalysator-Diagnose" VALUE 0x8118F9 KwUb 255.0 dez 0.00 255.0 FORMAT "%5.1" /end CHARACTERISTIC
/begin CHARACTERISTIC SRYLS "Schwelle für Readiness-Bildung Lambdasonden-Diagnose" VALUE 0x8118FA KwUb 255.0 dez 0.00 255.0 FORMAT "%5.1" /end CHARACTERISTIC
/begin CHARACTERISTIC SRYSLS "Schwelle für Readiness-Bildung Sekundärluft-Diagnose" VALUE 0x8118FB KwUb 255.0 dez 0.00 255.0 FORMAT "%5.1" /end CHARACTERISTIC
/begin CHARACTERISTIC SRYTES "Schwelle für Readiness-Bildung Tankentlüftungs-Diagnose" VALUE 0x8118FC KwUb 255.0 dez 0.00 255.0 FORMAT "%5.1" /end CHARACTERISTIC
/begin CHARACTERISTIC TABGMCSD "Abgastemperaturschwelle für CSD-Messung" VALUE 0x811AA6 KwUb 1275. temp_ub_q5_o50 -50.00 1225. FORMAT "%5.0" /end CHARACTERISTIC
/begin CHARACTERISTIC TABGSTG "Abgastemperaturschwelle für Dynamik-Messung" VALUE 0x819A4E KwUb 1275. temp_ub_q5_o50 -50.00 1225. FORMAT "%5.0" /end CHARACTERISTIC
/begin CHARACTERISTIC TADHMN "untere Temperaturschwelle für die Heizerdiagnose" VALUE 0x810045 KwUb 1275. temp_ub_q5_o50 -50.00 1225. FORMAT "%5.0" /end CHARACTERISTIC
/begin CHARACTERISTIC TADHMX "obere Temperaturschwelle für die Heizerdiagnose" VALUE 0x8199F8 KwUb 1275. temp_ub_q5_o50 -50.00 1225. FORMAT "%5.0" /end CHARACTERISTIC
/begin CHARACTERISTIC TADLLR "Ansauglufttemperaturschwelle für Diagnose Leerlaufsteller" VALUE 0x81A330 KwUb 191.3 temp_ub_q0p75_o48 -48.00 143.3 FORMAT "%5.1" /end CHARACTERISTIC
/begin CHARACTERISTIC TALDPMX "Startwert TANS-Monitor" VALUE 0x8123F2 KwUb 191.3 temp_ub_q0p75_o48 -48.00 143.3 FORMAT "%5.1" /end CHARACTERISTIC
/begin CHARACTERISTIC TALDPO "Obere Ansaugtemperaturschwelle für Leckdiagnosemodul" VALUE 0x8123F3 KwUb 191.3 temp_ub_q0p75_o48 -48.00 143.3 FORMAT "%5.1" /end CHARACTERISTIC
/begin CHARACTERISTIC TALDPRO "Oberer Schwellwert TANS-Monitor zur Freigabe der DLDP" VALUE 0x8123F4 KwUb 191.3 temp_ub_q0p75_o48 -48.00 143.3 FORMAT "%5.1" /end CHARACTERISTIC
/begin CHARACTERISTIC TALDPRU "Unterer Schwellwert TANS-Monitor zur Freigabe der DLDP" VALUE 0x8123F5 KwUb 191.3 temp_ub_q0p75_o48 -48.00 143.3 FORMAT "%5.1" /end CHARACTERISTIC
/begin CHARACTERISTIC TALDPU "Untere Ansaugtemperaturschwelle für Leckdiagnosemodul" VALUE 0x8123F6 KwUb 191.3 temp_ub_q0p75_o48 -48.00 143.3 FORMAT "%5.1" /end CHARACTERISTIC
/begin CHARACTERISTIC TANKABN "minimale Fuellstandsabnahme fuer Tankerkennung" VALUE 0x81B8C6 KwSw 3276.800 vol_q0p1_l -3276.800 0.00 FORMAT "%8.3" /end CHARACTERISTIC
/begin CHARACTERISTIC TANKMN "minimale Tankmenge fuer Tankerkennung" VALUE 0x81B8C8 KwSw 3276.700 vol_q0p1_l 0.00 3276.700 FORMAT "%8.3" /end CHARACTERISTIC
/begin CHARACTERISTIC TASIG "Zeit für Ausblendung von Störspitzen außerhalb Band für Erk. Signalunterbrechung" VALUE 0x811AA7 KwUb 5.100 t20msxs_ub_b5p1 0.00 5.100 FORMAT "%5.3" /end CHARACTERISTIC
/begin CHARACTERISTIC TDHAKT "Zeit für Down-Hill Erkennung aktiv (Apllikation)" VALUE 0x81A4F6 KwUb 255.0 t1sxs_ub_b255 0.00 255.0 FORMAT "%5.1" /end CHARACTERISTIC
/begin CHARACTERISTIC TDKATAKT "Schwellwert Zyklus fertig wenn aktive Überwachungszeit > TDKATAKT" VALUE 0x8156C2 KwUw 3276.750 t50msxs_uw_b3276p75 0.00 3276.750 FORMAT "%8.3" /end CHARACTERISTIC
/begin CHARACTERISTIC TDKATATT "Schwellwert Zyklus fertig für Funktionsanforderung" VALUE 0x8156C4 KwUw 3276.750 t50msxs_uw_b3276p75 0.00 3276.750 FORMAT "%8.3" /end CHARACTERISTIC
/begin CHARACTERISTIC TDKUPNOG "Verzögerungszeit nach Gangwechsel bis erneute Gangwechselerk. möglich" VALUE 0x819A72 KwUb 255.0 t1sxs_ub_b255 0.00 255.0 FORMAT "%5.1" /end CHARACTERISTIC
/begin CHARACTERISTIC TDLLR "Wartezeit bis setzen der Bedingung Diagnose Leerlaufsteller" VALUE 0x81B572 KwUw 255.0000 t200msxs_ub_b51 0.00 255.0000 FORMAT "%8.4" /end CHARACTERISTIC
/begin CHARACTERISTIC TDLLRMN "Wartezeit bis Fehlereintrag Steller geschlossen" VALUE 0x81B574 KwUw 255.0000 t200msxs_ub_b51 0.00 255.0000 FORMAT "%8.4" /end CHARACTERISTIC
/begin CHARACTERISTIC TDLLRMX "Wartezeit bis Fehlereintrag Steller offen" VALUE 0x81B576 KwUw 255.0000 t200msxs_ub_b51 0.00 255.0000 FORMAT "%8.4" /end CHARACTERISTIC
/begin CHARACTERISTIC TDLLRNF "Wartezeit bis Meldung kein Fehler bei Leerlaufsteller" VALUE 0x81B578 KwUw 255.0000 t200msxs_ub_b51 0.00 255.0000 FORMAT "%8.4" /end CHARACTERISTIC
/begin CHARACTERISTIC TDMLMN "Entprellzeit HFM-(Hauptlastgeber-)Fehlererkennung Minimalwert" VALUE 0x819B8C KwUb 25.50 t100msxs_ub_b25p5 0.00 25.50 FORMAT "%5.2" /end CHARACTERISTIC
/begin CHARACTERISTIC TDMLMX "Entprellzeit HFM-(Hauptlastgeber-)Fehlererkennung Maximalwert" VALUE 0x819B8D KwUb 25.50 t100msxs_ub_b25p5 0.00 25.50 FORMAT "%5.2" /end CHARACTERISTIC
/begin CHARACTERISTIC TDMLNF "Entprellzeit HFM-(Hauptlastgeber-)Diagnose mit i.O.-Meldung" VALUE 0x819B8E KwUb 25.50 t100msxs_ub_b25p5 0.00 25.50 FORMAT "%5.2" /end CHARACTERISTIC
/begin CHARACTERISTIC TDMLST "Entprellzeit HFM-(Hauptlastgeber-)Fehlererkennung im Start" VALUE 0x819B8F KwUb 25.50 t100msxs_ub_b25p5 0.00 25.50 FORMAT "%5.2" /end CHARACTERISTIC
/begin CHARACTERISTIC TDUBHFM "Zeit für HFM-Diagnose mit u < UBHFM" VALUE 0x819B90 KwUb 25.50 t100msxs_ub_b25p5 0.00 25.50 FORMAT "%5.2" /end CHARACTERISTIC
/begin CHARACTERISTIC TERISA "Entprellzeit für Schubabschneidung" VALUE 0x8199F9 KwUb 255.0 t_q1 0.00 255.0 FORMAT "%5.1" /end CHARACTERISTIC
/begin CHARACTERISTIC TFDLLRO "Obere Schwelle für Zeitfenster für DLLR" VALUE 0x81B57A KwUw 6553.500 t100msxs_uw_b6553p5 0.00 6553.500 FORMAT "%8.3" /end CHARACTERISTIC
/begin CHARACTERISTIC TFDLLRU "Untere Schwelle für Zeitfenster für DLLR" VALUE 0x81B57C KwUw 6553.500 t100msxs_uw_b6553p5 0.00 6553.500 FORMAT "%8.3" /end CHARACTERISTIC
/begin CHARACTERISTIC TFRA "Erkennungszeit für eingeschwungene Grundadaption von fra" VALUE 0x819BDD KwUb 51.00 t200msxs_ub_b51 0.00 51.00 FORMAT "%5.2" /end CHARACTERISTIC
/begin CHARACTERISTIC TFRAOZ "Verweilzeit in FRAO für Zyklusflag bei nicht eingeschw. Adaption" VALUE 0x819BDE KwUb 51.00 t200msxs_ub_b51 0.00 51.00 FORMAT "%5.2" /end CHARACTERISTIC
/begin CHARACTERISTIC TFRAUZ "Verweilzeit in FRAU für Zyklusflag bei nicht eingeschw. Adaption" VALUE 0x819BDF KwUb 51.00 t200msxs_ub_b51 0.00 51.00 FORMAT "%5.2" /end CHARACTERISTIC
/begin CHARACTERISTIC TFRMB "Verzög.zeit für Erkennung Mittelwert des Lambdareglers innerhalb Schwellen" VALUE 0x819A4F KwUb 25.50 t100msxs_ub_b25p5 0.00 25.50 FORMAT "%5.2" /end CHARACTERISTIC
/begin CHARACTERISTIC TFRMST "Erkennungszeit für eingeschwungene Grundadaption von frm" VALUE 0x819BE0 KwUb 51.00 t200msxs_ub_b51 0.00 51.00 FORMAT "%5.2" /end CHARACTERISTIC
/begin CHARACTERISTIC TFRMZST "Verweilzeit für unplausibles frm-Signal (Kurztest)" VALUE 0x819BE1 KwUb 51.00 t200msxs_ub_b51 0.00 51.00 FORMAT "%5.2" /end CHARACTERISTIC
/begin CHARACTERISTIC TFSTNP "Schwelle Tankfuellstandssignal nicht Plausibel" VALUE 0x81A4DE KwUb 127.0 vol_q1_l 0.00 127.0 FORMAT "%5.1" /end CHARACTERISTIC
/begin CHARACTERISTIC TKATMSHU "Kat-Temperatur für ausreichende Sondenheizung" VALUE 0x819A5C KwUb 1275. temp_ub_q5_o50 -50.00 1225. FORMAT "%5.0" /end CHARACTERISTIC
/begin CHARACTERISTIC TKTPVK "Abgastemperatur Kat (aus ATM) für TP-Überwachung Sonde vor Kat" VALUE 0x811AA4 KwUb 1275. temp_ub_q5_o50 -50.00 1225. FORMAT "%5.0" /end CHARACTERISTIC
/begin CHARACTERISTIC TKTVHK "Kat-Modelltemperatur für Schwingungsprüfung SHK" VALUE 0x811AA5 KwUb 1275. temp_ub_q5_o50 -50.00 1225. FORMAT "%5.0" /end CHARACTERISTIC
/begin CHARACTERISTIC TLDPEIN "Ansteuerdauer Magnetventil der LDP" VALUE 0x81756A KwUw 655.3500 t10msxs_uw_b655p35 0.00 655.3500 FORMAT "%8.4" /end CHARACTERISTIC
/begin CHARACTERISTIC TLDPFL "Zeitschwelle für Erkennung Feinleck bei Leckdiagnosemodul" VALUE 0x81756C KwUw 655.3500 t10msxs_uw_b655p35 0.00 655.3500 FORMAT "%8.4" /end CHARACTERISTIC
/begin CHARACTERISTIC TLDPFP "Zeitdauer fast pulse-Phase bei Leckdiagnosemodul" VALUE 0x81756E KwUw 655.3500 t10msxs_uw_b655p35 0.00 655.3500 FORMAT "%8.4" /end CHARACTERISTIC
/begin CHARACTERISTIC TLDPFTE "Zeit nach FTEAD=-4 bis zur Überprüfung FTEAD-Schwelle" VALUE 0x817570 KwUw 655.3500 t10msxs_uw_b655p35 0.00 655.3500 FORMAT "%8.4" /end CHARACTERISTIC
/begin CHARACTERISTIC TLDPLRMX "Zeitschwelle für Reed-Switch Closed-Check" VALUE 0x817572 KwUw 655.3500 t10msxs_uw_b655p35 0.00 655.3500 FORMAT "%8.4" /end CHARACTERISTIC
/begin CHARACTERISTIC TLDPMN "Wartezeit nach Start für Freigabe Leckdiagnose" VALUE 0x817574 KwUw 655.3500 t10msxs_uw_b655p35 0.00 655.3500 FORMAT "%8.4" /end CHARACTERISTIC
/begin CHARACTERISTIC TLDPNF "Dauer NF-Phase" VALUE 0x817576 KwUw 655.3500 t10msxs_uw_b655p35 0.00 655.3500 FORMAT "%8.4" /end CHARACTERISTIC
/begin CHARACTERISTIC TLDPONMX "Maximale Aktivierungsdauer DLDP nach Funktionsstart" VALUE 0x817578 KwUw 655.3500 t10msxs_uw_b655p35 0.00 655.3500 FORMAT "%8.4" /end CHARACTERISTIC
/begin CHARACTERISTIC TLDPREF "Stabilisierungszeit TANS-Monitor nach VFZ und TL-Freigabe" VALUE 0x81757A KwUw 655.3500 t10msxs_uw_b655p35 0.00 655.3500 FORMAT "%8.4" /end CHARACTERISTIC
/begin CHARACTERISTIC TLDPRKL "Zeit für 'Reed-Kontakt zu'-Erkennung Closed Check" VALUE 0x81757C KwUw 655.3500 t10msxs_uw_b655p35 0.00 655.3500 FORMAT "%8.4" /end CHARACTERISTIC
/begin CHARACTERISTIC TLDPRKO "Zeit für ""Reed-Kontankt offen""-Erkennung bei Leckdiagnosemodul" VALUE 0x81757E KwUw 655.3500 t10msxs_uw_b655p35 0.00 655.3500 FORMAT "%8.4" /end CHARACTERISTIC
/begin CHARACTERISTIC TLDPRKZ "Zeit für ""Reed-Kontankt zu""-Erkennung bei Leckdiagnosemodul" VALUE 0x817580 KwUw 655.3500 t10msxs_uw_b655p35 0.00 655.3500 FORMAT "%8.4" /end CHARACTERISTIC
/begin CHARACTERISTIC TLDPSD "Zeitschwelle für Erkennung System dicht bei Leckdiagnosemodul" VALUE 0x817582 KwUw 655.3500 t10msxs_uw_b655p35 0.00 655.3500 FORMAT "%8.4" /end CHARACTERISTIC
/begin CHARACTERISTIC TLDPST1 "Maximale Zeitdauer CTO-Check (S1) bei Lastüberschreitung" VALUE 0x817584 KwUw 655.3500 t10msxs_uw_b655p35 0.00 655.3500 FORMAT "%8.4" /end CHARACTERISTIC
/begin CHARACTERISTIC TLDPTD "Zeitschwelle für Erkennung offener Tankdeckel bei Leckdiagnosemodul" VALUE 0x817586 KwUw 655.3500 t10msxs_uw_b655p35 0.00 655.3500 FORMAT "%8.4" /end CHARACTERISTIC
/begin CHARACTERISTIC TLDPVL "Zeitschwelle für Erkennung ""verstopfte Leitung"" bei Leckdiagnosemodul" VALUE 0x817588 KwUw 655.3500 t10msxs_uw_b655p35 0.00 655.3500 FORMAT "%8.4" /end CHARACTERISTIC
/begin CHARACTERISTIC TLDPWAB "Zeit bis zur Wiederholung DLDP nach vorläufigen Abbruch" VALUE 0x81758A KwUw 1310.70 t20msxs_uw_b1310 0.00 1310.70 FORMAT "%7.2" /end CHARACTERISTIC
/begin CHARACTERISTIC TLLASH "Verzög.zeit um lamlash_w zu sperren wenn lamsons_w ungleich lamlash_w ist" VALUE 0x819A50 KwUb 25.50 t100msxs_ub_b25p5 0.00 25.50 FORMAT "%5.2" /end CHARACTERISTIC
/begin CHARACTERISTIC TMDLLR "Motortemperaturschwelle für Diagnose Leerlaufsteller" VALUE 0x81A331 KwUb 191.3 temp_ub_q0p75_o48 -48.00 143.3 FORMAT "%5.1" /end CHARACTERISTIC
/begin CHARACTERISTIC TMINKAT "Minimale Kat-Temperatur für Überwachung" VALUE 0x811A92 KwUb 1275. temp_ub_q5_o50 -50.00 1225. FORMAT "%5.0" /end CHARACTERISTIC
/begin CHARACTERISTIC TMLDPO "Obere Motortemperaturschwelle für Leckdiagnosemodul" VALUE 0x8123F7 KwUb 191.3 temp_ub_q0p75_o48 -48.00 143.3 FORMAT "%5.1" /end CHARACTERISTIC
/begin CHARACTERISTIC TMLDPU "Untere Motortemperaturschwelle für Leckdiagnosemodul" VALUE 0x8123F8 KwUb 191.3 temp_ub_q0p75_o48 -48.00 143.3 FORMAT "%5.1" /end CHARACTERISTIC
/begin CHARACTERISTIC TMNKATT "Minimale Kat-Temperatur für Überwachung bei Testerbetrieb" VALUE 0x811A93 KwUb 1275. temp_ub_q5_o50 -50.00 1225. FORMAT "%5.0" /end CHARACTERISTIC
/begin CHARACTERISTIC TPSVKMN "minimale Periodendauer der Lambdasonde vor Kat, DLSSA" VALUE 0x819BB1 KwUb 10.20 t40msxs_ub_q0p04 0.00 10.20 FORMAT "%5.2" /end CHARACTERISTIC
/begin CHARACTERISTIC TPSVKMX "maximale Periodendauer der Lambdasonde vor Kat, DLSSA" VALUE 0x819BB2 KwUb 10.20 t40msxs_ub_q0p04 0.00 10.20 FORMAT "%5.2" /end CHARACTERISTIC
/begin CHARACTERISTIC TRIPFASH "Kurztrip: Mindest Zeitdauer für aktive Lamda Regelung vor KAT" VALUE 0x81AD06 KwUw 6553.500 t100msxs_uw_b6553p5 0.00 6553.500 FORMAT "%8.3" /end CHARACTERISTIC
/begin CHARACTERISTIC TRKA "Erkennungszeit für eingeschwungene Grundadaption von rkat bzw. rkaz" VALUE 0x819BE2 KwUb 51.00 t200msxs_ub_b51 0.00 51.00 FORMAT "%5.2" /end CHARACTERISTIC
/begin CHARACTERISTIC TRKATZ "Aktivierungszeit von rkat bis Setzen Zyklusflag, wenn B_gae = FALSE" VALUE 0x819BE3 KwUb 51.00 t200msxs_ub_b51 0.00 51.00 FORMAT "%5.2" /end CHARACTERISTIC
/begin CHARACTERISTIC TRKAZZ "Aktivierungszeit von rkaz bis Setzen Zyklusflag, wenn B_gae = FALSE" VALUE 0x819BE4 KwUb 51.00 t200msxs_ub_b51 0.00 51.00 FORMAT "%5.2" /end CHARACTERISTIC
/begin CHARACTERISTIC TRSAFA "Überwachungszeit Kabelbruch hinter KAT: Funktions Anforderung für Kurz-Trip-Test" VALUE 0x81AD16 KwUw 6553.500 t100msxs_uw_q100 0.00 6553.500 FORMAT "%8.3" /end CHARACTERISTIC
/begin CHARACTERISTIC TRSAH "Überwachungszeit für Kabelbruch (Spg. im Band) für Sonde hinter KAT" VALUE 0x81AD18 KwUw 6553.500 t100msxs_uw_q100 0.00 6553.500 FORMAT "%8.3" /end CHARACTERISTIC
/begin CHARACTERISTIC TRSE "Überwachungszeit -> Regelung ein" VALUE 0x819A5D KwUb 25.50 t100msxs_ub_b25p5 0.00 25.50 FORMAT "%5.2" /end CHARACTERISTIC
/begin CHARACTERISTIC TSALASH "Zeit nach Schub für Überprüfung Sonde hinter KAT" VALUE 0x819A51 KwUb 25.50 t100msxs_ub_b25p5 0.00 25.50 FORMAT "%5.2" /end CHARACTERISTIC
/begin CHARACTERISTIC TSFAAV "Fehlersummenzeit: Absperrventil Aktivkohlefilter (Funktion)" VALUE 0x811867 KwUb 255.0 dez 0.00 255.0 FORMAT "%5.1" /end CHARACTERISTIC
/begin CHARACTERISTIC TSFAGRE "Fehlersummenzeit: Überwachung AGR-Endstufe" VALUE 0x811869 KwUb 255.0 dez 0.00 255.0 FORMAT "%5.1" /end CHARACTERISTIC
/begin CHARACTERISTIC TSFAGRF "Fehlersummenzeit: Überwachung AGR-FLOW" VALUE 0x81186A KwUb 255.0 dez 0.00 255.0 FORMAT "%5.1" /end CHARACTERISTIC
/begin CHARACTERISTIC TSFDSS "Fehlersummenzeit: Saugrohr-Drucksensor" VALUE 0x81187E KwUb 255.0 dez 0.00 255.0 FORMAT "%5.1" /end CHARACTERISTIC
/begin CHARACTERISTIC TSFMDB "Fehlersummenzeit: Momentbegrenzung Sollmoment" VALUE 0x8118C9 KwUb 255.0 dez 0.00 255.0 FORMAT "%5.1" /end CHARACTERISTIC
/begin CHARACTERISTIC TSFTESF "Fehlersummenzeit: Tankentlüftungssytem Feinleck" VALUE 0x8118E4 KwUb 255.0 dez 0.00 255.0 FORMAT "%5.1" /end CHARACTERISTIC
/begin CHARACTERISTIC TSFTEVE2 "Fehlersummenzeit: Tankentlüftungsventil Endstufe  Bank2" VALUE 0x8118E7 KwUb 255.0 dez 0.00 255.0 FORMAT "%5.1" /end CHARACTERISTIC
/begin CHARACTERISTIC TSTEAA "Sperrzeit nach B_te (TEA aktiv)" VALUE 0x819A47 KwUb 25.50 t100msxs_ub_b25p5 0.00 25.50 FORMAT "%5.2" /end CHARACTERISTIC
/begin CHARACTERISTIC TSVKKTO "obere Periodendauergrenze für SVK, Kurztest" VALUE 0x8156C8 KwUw 655.3500 t10msxs_uw_b655p35 0.00 655.3500 FORMAT "%8.4" /end CHARACTERISTIC
/begin CHARACTERISTIC TSVKKTU "untere Periodendauergrenze für SVK, Kurztest" VALUE 0x8156CA KwUw 655.3500 t10msxs_uw_b655p35 0.00 655.3500 FORMAT "%8.4" /end CHARACTERISTIC
/begin CHARACTERISTIC TSVKO "obere Periodendauergrenze für die Lambda-Sonde vor Katalysator" VALUE 0x8156CC KwUw 655.3500 t10msxs_uw_b655p35 0.00 655.3500 FORMAT "%8.4" /end CHARACTERISTIC
/begin CHARACTERISTIC TSVKU "untere Periodengrenze für Lambda-Sonde vor Katalysator" VALUE 0x8156CE KwUw 655.3500 t10msxs_uw_b655p35 0.00 655.3500 FORMAT "%8.4" /end CHARACTERISTIC
/begin CHARACTERISTIC TTBMH "Zeit für theoretische Sondenbetriebsbereitschaft mit Heizung" VALUE 0x81AD1A KwUw 6553.500 t100msxs_uw_q100 0.00 6553.500 FORMAT "%8.3" /end CHARACTERISTIC
/begin CHARACTERISTIC TTLASH "Zeit für Verweildauer der Sonde hinter KAT unter/oberhalb des Sollwertes" VALUE 0x81AD08 KwUw 6553.500 t100msxs_uw_b6553p5 0.00 6553.500 FORMAT "%8.3" /end CHARACTERISTIC
/begin CHARACTERISTIC TULDPRO "Oberer Schwellwert Umgebungstemperatur zur Freigabe DLDP" VALUE 0x8123F9 KwUb 191.3 temp_ub_q0p75_o48 -48.00 143.3 FORMAT "%5.1" /end CHARACTERISTIC
/begin CHARACTERISTIC TULDPRU "Unterer Schwellwert Umgebungstemperatur zur Freigabe DLDP" VALUE 0x8123FA KwUb 191.3 temp_ub_q0p75_o48 -48.00 143.3 FORMAT "%5.1" /end CHARACTERISTIC
/begin CHARACTERISTIC TUSCHUB "Verzögerungszeit für Störspitzen bei Schubprüfung der Sonde hinter KAT" VALUE 0x819A52 KwUb 25.50 t100msxs_ub_b25p5 0.00 25.50 FORMAT "%5.2" /end CHARACTERISTIC
/begin CHARACTERISTIC TUSDUFA "Verzögerunszeit für Erk. Adernschl. Lamdasonde h.KAT (Funkt. Anford. Kurz-Trip)" VALUE 0x81AD1C KwUw 6553.500 t100msxs_uw_q100 0.00 6553.500 FORMAT "%8.3" /end CHARACTERISTIC
/begin CHARACTERISTIC TUSDUH "Verzögerungszeit für Erkennung Adernschluß Lambdasonde hinter KAT" VALUE 0x81AD1E KwUw 6553.500 t100msxs_uw_q100 0.00 6553.500 FORMAT "%8.3" /end CHARACTERISTIC
/begin CHARACTERISTIC TUSEINH "Verzögerungzeit für Einschalten der Sondenbetriebsbereitschaft hinter KAT" VALUE 0x819A5E KwUb 255.0 t1sxs_ub_b255 0.00 255.0 FORMAT "%5.1" /end CHARACTERISTIC
/begin CHARACTERISTIC TUSENLASH "Zeitdauer bis Sonden Mager/Fett Erkennung erlaubt hinter Kat" VALUE 0x81AD0A KwUw 6553.500 t100msxs_uw_b6553p5 0.00 6553.500 FORMAT "%8.3" /end CHARACTERISTIC
/begin CHARACTERISTIC TUSHSMIN "Mindestdauer für Steigungsmessung für enable Filter hinter Kat" VALUE 0x819A53 KwUb 25.50 t100msxs_ub_b25p5 0.00 25.50 FORMAT "%5.2" /end CHARACTERISTIC
/begin CHARACTERISTIC TUSKS "Entstörzeit für Abschalten einzelner Funktionen Sonde hinter KAT" VALUE 0x811AA8 KwUb 5.100 t20msxs_ub_b5p1 0.00 5.100 FORMAT "%5.3" /end CHARACTERISTIC
/begin CHARACTERISTIC TUSLASH "Testzeit füt Dauer Anfettung/Abmagerung hinter KAT" VALUE 0x81AD0C KwUw 6553.500 t100msxs_uw_b6553p5 0.00 6553.500 FORMAT "%8.3" /end CHARACTERISTIC
/begin CHARACTERISTIC TUSMAX "Überwachungszeit für Usmax" VALUE 0x819A5F KwUb 25.50 t100msxs_ub_b25p5 0.00 25.50 FORMAT "%5.2" /end CHARACTERISTIC
/begin CHARACTERISTIC TUSPNMN "min. Zeit der Sondenspannung zwischen pos. und neg. Flanke" VALUE 0x819BB3 KwUb 10.20 t40msxs_ub_q0p04 0.00 10.20 FORMAT "%5.2" /end CHARACTERISTIC
/begin CHARACTERISTIC TUSPNMX "max. Zeit der Sondenspannung zwischen pos. und neg. Flanke" VALUE 0x819BB4 KwUb 10.20 t40msxs_ub_q0p04 0.00 10.20 FORMAT "%5.2" /end CHARACTERISTIC
/begin CHARACTERISTIC TUSSA "Verzögerungszeit nach Über/Unterschreiten der Regelschwelle hinter KAT" VALUE 0x819A54 KwUb 25.50 t100msxs_ub_b25p5 0.00 25.50 FORMAT "%5.2" /end CHARACTERISTIC
/begin CHARACTERISTIC TUSTAL "Verzög.zeit für Erkennung Adernschluß nach ""Tank leer"" fahren für Sonde h. KAT" VALUE 0x81AD20 KwUw 6553.500 t100msxs_uw_q100 0.00 6553.500 FORMAT "%8.3" /end CHARACTERISTIC
/begin CHARACTERISTIC TVDKAT "Verzögerungszeit zur Freigabe der DKAT" VALUE 0x8156C6 KwUw 6553.500 t100msxs_uw_b6553p5 0.00 6553.500 FORMAT "%8.3" /end CHARACTERISTIC
/begin CHARACTERISTIC TVFHS "Entprellzeit für Heizerendstufe" VALUE 0x810098 KwUb 2.550 t10msxs_ub_b2p55 0.00 2.550 FORMAT "%5.3" /end CHARACTERISTIC
/begin CHARACTERISTIC TVFSTD "Entprellzeit elektrische Fuellstandsgeberdiagnose" VALUE 0x81A4DF KwUb 254.0 t1sxs_ub_b255 1.000 255.0 FORMAT "%5.1" /end CHARACTERISTIC
/begin CHARACTERISTIC TVHATA "Verzoegerungszeit Halt vor Tankvorgang" VALUE 0x81A4E0 KwUb 254.0 t1sxs_ub_b255 1.000 255.0 FORMAT "%5.1" /end CHARACTERISTIC
/begin CHARACTERISTIC TVHSEE "Entprellzeit für Heizerendstufenfehler" VALUE 0x8199FA KwUb 12.75 t50msxs_q0p05 0.00 12.75 FORMAT "%5.2" /end CHARACTERISTIC
/begin CHARACTERISTIC TVLRHMN "untere Grenze für tv-Korrektur" VALUE 0x819A48 KwSb 2.550 t100msxs_sb_q0p01 -1.280 1.270 FORMAT "%5.3" /end CHARACTERISTIC
/begin CHARACTERISTIC TVLRHMN2 "untere Grenze für tv-Korrektur ungleiche Parameter Bank2" VALUE 0x819A49 KwSb 2.550 t100msxs_sb_q0p01 -1.280 1.270 FORMAT "%5.3" /end CHARACTERISTIC
/begin CHARACTERISTIC TVLRHMX "obere Grenze für tv-Korrektur" VALUE 0x819A4A KwSb 2.550 t100msxs_sb_q0p01 -1.280 1.270 FORMAT "%5.3" /end CHARACTERISTIC
/begin CHARACTERISTIC TVLRHMX2 "obere Grenze für tv-Korrektur ungleiche Parameter Bank2" VALUE 0x819A4B KwSb 2.550 t100msxs_sb_q0p01 -1.280 1.270 FORMAT "%5.3" /end CHARACTERISTIC
/begin CHARACTERISTIC TVRIF "Verzögerungszeit für Ri-Fehler" VALUE 0x8199FB KwUb 255.0 t1sxs_ub_b255 0.00 255.0 FORMAT "%5.1" /end CHARACTERISTIC
/begin CHARACTERISTIC TVRISA "Verzögerungszeit für Ri-Diagnose nach Schub" VALUE 0x8199FC KwUb 255.0 t_q1 0.00 255.0 FORMAT "%5.1" /end CHARACTERISTIC
/begin CHARACTERISTIC TWDDTV "Wartezeit für Ready-Flag der Delta-TV Diagnose (DLSA)" VALUE 0x81ACEE KwUw 65525.00 t1sxs_uw_b65535 10.00000 65535.00 FORMAT "%8.2" /end CHARACTERISTIC
/begin CHARACTERISTIC TWDKATST "Wartezeit nach Stoppbedingung für Filter und Integrator" VALUE 0x811A94 KwUb 12.75 t50msxs_ub_b12p75 0.00 12.75 FORMAT "%5.2" /end CHARACTERISTIC
/begin CHARACTERISTIC TWDLSSA "Mindestprüfzeit für DLSSA-Extremwertbestimmung" VALUE 0x81B068 KwUw 3276.750 t50msxs_uw_b3276p75 0.00 3276.750 FORMAT "%8.3" /end CHARACTERISTIC
/begin CHARACTERISTIC TWKTDLP "Wartezeit nach Parameterumschaltung in Lambdaregelung" VALUE 0x811A95 KwUb 12.75 t50msxs_ub_b12p75 0.00 12.75 FORMAT "%5.2" /end CHARACTERISTIC
/begin CHARACTERISTIC UBDLS "Batteriespannungsschwelle zur Freigabe der Sonden-Diagnose" VALUE 0x810096 KwUb 24.02 spg_ubatt 0.00 24.02 FORMAT "%5.2" /end CHARACTERISTIC
/begin CHARACTERISTIC UBDLSMX "obere Batteriespannungsschwelle für die  Sonden-Diagnose" VALUE 0x810099 KwUb 24.02 spg_ub 0.00 24.02 FORMAT "%5.2" /end CHARACTERISTIC
/begin CHARACTERISTIC UBHFM "Batteriespannungsschwelle zur Umschaltung auf Ersatzlastsignal" VALUE 0x819B91 KwUb 24.02 spg_ubatt 0.00 24.02 FORMAT "%5.2" /end CHARACTERISTIC
/begin CHARACTERISTIC UBLDPMX "Maximale UBATT für DLDP" VALUE 0x8123FB KwUb 24.02 spg_ubatt 0.00 24.02 FORMAT "%5.2" /end CHARACTERISTIC
/begin CHARACTERISTIC UDKRGOFS "Spannungsschwelle für DIA/KR Grundoffset Verstärker" VALUE 0x810186 KwUb 4.980 spg_ub_b5 0.00 4.980 FORMAT "%5.3" /end CHARACTERISTIC
/begin CHARACTERISTIC UDKRTP "Integratorspannungsschwelle für Dia KS - Auswerteschaltung Testimpuls" VALUE 0x810067 KwUb 4.980 spg_ub_b5 0.00 4.980 FORMAT "%5.3" /end CHARACTERISTIC
/begin CHARACTERISTIC UDKSNO "Obere Referenzspannungsschwelle DIA KS" CURVE 0x81B532 GklWUw 319.976 spg_uw_b1280 0.00 319.976 FORMAT "%7.3"
 /begin AXIS_DESCR COM_AXIS nmot nmot_ub_q40 16 0.00 10200. AXIS_PTS_REF SNM16KRUB /end AXIS_DESCR
/end CHARACTERISTIC
/begin CHARACTERISTIC UDKSNU "untere Referenzspannungsschwelle DIA KS" CURVE 0x81B552 GklWUw 319.976 spg_uw_b1280 0.00 319.976 FORMAT "%7.3"
 /begin AXIS_DESCR COM_AXIS nmot nmot_ub_q40 16 0.00 10200. AXIS_PTS_REF SNM16KRUB /end AXIS_DESCR
/end CHARACTERISTIC
/begin CHARACTERISTIC UHDMN "Schwellwert für bestromte Heizerendstufe" VALUE 0x81009A KwUb 4.980 spg_ub_b5 0.00 4.980 FORMAT "%5.3" /end CHARACTERISTIC
/begin CHARACTERISTIC UHDMX "Schwellwert für stromlose Heizerendstufe" VALUE 0x81009B KwUb 4.980 spg_ub_b5 0.00 4.980 FORMAT "%5.3" /end CHARACTERISTIC
/begin CHARACTERISTIC USHLEAN "Schwelle für Magerspannung für Reset Dynamikmessung der Sonde hinter KAT" VALUE 0x819A55 KwUb 1.330 spg_ub_q0p0052_o0p2 -0.2000 1.130 FORMAT "%5.3" /end CHARACTERISTIC
/begin CHARACTERISTIC USHRICH "Schwelle für Fettspannung für gültige Dynamikmessung der Sonde hinter KAT" VALUE 0x819A56 KwUb 1.330 spg_ub_q0p0052_o0p2 -0.2000 1.130 FORMAT "%5.3" /end CHARACTERISTIC
/begin CHARACTERISTIC USHSTGMX "Wert für maximale Steigung für Startwert Filter" VALUE 0x819A57 KwUb 132.6 spgg_q0p52 0.00 132.6 FORMAT "%5.1" /end CHARACTERISTIC
/begin CHARACTERISTIC USHSTSOLL "Schwelle für zulässige Steigung der Sondenspannung hinter KAT" VALUE 0x819A58 KwUb 132.6 spgg_q0p52 0.00 132.6 FORMAT "%5.1" /end CHARACTERISTIC
/begin CHARACTERISTIC USIVMAXH "Init value für max.Sondenspg. hinter Kat nach Powerfail u. Fehlersp. löschen" VALUE 0x819BB5 KwUb 1.330 spg_ub_b1p33 0.00 1.330 FORMAT "%5.3" /end CHARACTERISTIC
/begin CHARACTERISTIC USIVMAXV "Init value für max. Sondenspg. vor Kat nach Powerfail u. Fehlersp. löschen" VALUE 0x819BB6 KwUb 1.330 spg_ub_b1p33 0.00 1.330 FORMAT "%5.3" /end CHARACTERISTIC
/begin CHARACTERISTIC USIVMINH "Init value für min.Sondenspg. hinter Kat nach Powerfail u. Fehlersp. löschen" VALUE 0x819BB7 KwUb 1.330 spg_ub_b1p33 0.00 1.330 FORMAT "%5.3" /end CHARACTERISTIC
/begin CHARACTERISTIC USIVMINV "Init value für min. Sondenspg. vor Kat nach Powerfail u. Fehlersp. löschen" VALUE 0x819BB8 KwUb 1.330 spg_ub_b1p33 0.00 1.330 FORMAT "%5.3" /end CHARACTERISTIC
/begin CHARACTERISTIC USMAX "Schwelle für Sondenkurzschluß nach Ubat" VALUE 0x8156D0 KwUw 319.9951 spg_uw_q0p00488_o1 -1.000000 318.9951 FORMAT "%8.4" /end CHARACTERISTIC
/begin CHARACTERISTIC USMIN "Schwelle für Sondenkurzschluß nach Masse" VALUE 0x8156D2 KwUw 319.9951 spg_uw_q0p00488_o1 -1.000000 318.9951 FORMAT "%8.4" /end CHARACTERISTIC
/begin CHARACTERISTIC USMNSAMN "min. erkannte Sondenspannung für Signalausgabe (min. plaus. Wert)" VALUE 0x819BB9 KwUb 1.330 spg_ub_b1p33 0.00 1.330 FORMAT "%5.3" /end CHARACTERISTIC
/begin CHARACTERISTIC USMNSAMX "min. erkannte Sondenspannung für Signalausgabe (max. plaus. Wert)" VALUE 0x819BBA KwUb 1.330 spg_ub_b1p33 0.00 1.330 FORMAT "%5.3" /end CHARACTERISTIC
/begin CHARACTERISTIC USMNSHMN "min. erkannte Sondenspannung hinter Kat für Signalausgabe (min. plaus. Wert)" VALUE 0x819BBB KwUb 1.330 spg_ub_b1p33 0.00 1.330 FORMAT "%5.3" /end CHARACTERISTIC
/begin CHARACTERISTIC USMNSHMX "min. erkannte Sondenspannung hinter Kat für Signalausgabe (max. plaus. Wert)" VALUE 0x819BBC KwUb 1.330 spg_ub_b1p33 0.00 1.330 FORMAT "%5.3" /end CHARACTERISTIC
/begin CHARACTERISTIC USMXSAMN "max. erkannte Sondenspannung für Signalausgabe (min. plaus. Wert)" VALUE 0x819BBD KwUb 1.330 spg_ub_b1p33 0.00 1.330 FORMAT "%5.3" /end CHARACTERISTIC
/begin CHARACTERISTIC USMXSAMX "max. erkannte Sondenspannung für Signalausgabe (max. plaus. Wert)" VALUE 0x819BBE KwUb 1.330 spg_ub_b1p33 0.00 1.330 FORMAT "%5.3" /end CHARACTERISTIC
/begin CHARACTERISTIC USMXSHMN "max. erkannte Sondenspannung hinter Kat für Signalausgabe (min. plaus. Wert)" VALUE 0x819BBF KwUb 1.330 spg_ub_b1p33 0.00 1.330 FORMAT "%5.3" /end CHARACTERISTIC
/begin CHARACTERISTIC USMXSHMX "max. erkannte Sondenspannung hinter Kat für Signalausgabe (max. plaus. Wert)" VALUE 0x819BC0 KwUb 1.330 spg_ub_b1p33 0.00 1.330 FORMAT "%5.3" /end CHARACTERISTIC
/begin CHARACTERISTIC USREFH "Schwelle für Sondenbetriebsbereitschaft hinter KAT bei fettem Gemisch" VALUE 0x8156D4 KwUw 319.9951 spg_uw_q0p00488_o1 -1.000000 318.9951 FORMAT "%8.4" /end CHARACTERISTIC
/begin CHARACTERISTIC USREMH "Schwelle für Sondenbetriebsbereitschaft hinter KAT bei magerem Gemisch" VALUE 0x8156D6 KwUw 319.9951 spg_uw_q0p00488_o1 -1.000000 318.9951 FORMAT "%8.4" /end CHARACTERISTIC
/begin CHARACTERISTIC USRHKSHJ "Regelschwelle für Regelung hinter Kat, DLSSA-Ausgabe umgerechn. Wert" VALUE 0x819BC1 KwUb 1.330 spg_ub_b1p33 0.00 1.330 FORMAT "%5.3" /end CHARACTERISTIC
/begin CHARACTERISTIC USRJ "" VALUE 0x819BC2 KwUb 1.330 spg_ub_b1p33 0.00 1.330 FORMAT "%5.3" /end CHARACTERISTIC
/begin CHARACTERISTIC USSCHUB "Schwelle für Sondenspannung hinter KAT nach Schub" VALUE 0x819A59 KwUb 1.330 spg_ub_q0p0052_o0p2 -0.2000 1.130 FORMAT "%5.3" /end CHARACTERISTIC
/begin CHARACTERISTIC VDKUPPLMN "min. vfzg-Schwelle für Diagnose Kupplungsschalter" VALUE 0x819A73 KwUb 318.8 vfzg_ub_q1p25 0.00 318.8 FORMAT "%5.1" /end CHARACTERISTIC
/begin CHARACTERISTIC VLDPMX "Max. Fahrzeuggeschwindigkeit bei Erkennung 'verstopfte Leitung'" VALUE 0x8123FC KwUb 318.8 vfzg_ub_q1p25 0.00 318.8 FORMAT "%5.1" /end CHARACTERISTIC
/begin CHARACTERISTIC VLDPRU "Minimale Fahrzeuggeschwindigkeit zur Freigabe TANS-Monitor" VALUE 0x8123FD KwUb 318.8 vfzg_ub_q1p25 0.00 318.8 FORMAT "%5.1" /end CHARACTERISTIC
/begin CHARACTERISTIC VMAXLDP "Maximale Fahrzeuggeschwindigkeit DLDP aktiv" VALUE 0x8123FE KwUb 318.8 vfzg_ub_q1p25 0.00 318.8 FORMAT "%5.1" /end CHARACTERISTIC
/begin CHARACTERISTIC WLDPAB "Anzahl Wiederholungen Leckprüfung bis zum endgültigen Abbruch" VALUE 0x8123FF KwUb 255.0 dez 0.00 255.0 FORMAT "%5.1" /end CHARACTERISTIC
/begin CHARACTERISTIC WZCTCMX "Max. Anzahl Wiederholversuche Clamped Tube Check" VALUE 0x812400 KwUb 255.0 dez 0.00 255.0 FORMAT "%5.1" /end CHARACTERISTIC
/begin CHARACTERISTIC WZLDPRO "Max. Anzahl Wiederholversuche Reed-Switch Close to Open Check" VALUE 0x812401 KwUb 255.0 dez 0.00 255.0 FORMAT "%5.1" /end CHARACTERISTIC
/begin CHARACTERISTIC WZSTLMX "maximale Anzahl Pumphübe mit überschrittener Lastschwelle" VALUE 0x812402 KwUb 255.0 dez 0.00 255.0 FORMAT "%5.1" /end CHARACTERISTIC
/begin CHARACTERISTIC ZDKATAD "Filterzeitkonstante der Differenzierer für Signalamplitude" VALUE 0x811A96 KwUb 12.7498 zk50msxs_ub_b12p8 0.0501961 12.8000 FORMAT "%7.4" /end CHARACTERISTIC
/begin CHARACTERISTIC ZDKATAF "Zeitkonstante Betrags-Filter für Signalamplitude" VALUE 0x811A97 KwUb 12.7498 zk50msxs_ub_b12p8 0.0501961 12.8000 FORMAT "%7.4" /end CHARACTERISTIC
/begin CHARACTERISTIC ZDKATSH "Zeitkonstante Tiefpaß, Regellagendifferenz" VALUE 0x811A98 KwUb 12.7498 zk50msxs_ub_b12p8 0.0501961 12.8000 FORMAT "%7.4" /end CHARACTERISTIC
/begin CHARACTERISTIC ZDKTBD "Zeitkonstante der Differenzierer für FR-Wechselanteil" VALUE 0x811A99 KwUb 12.7498 zk50msxs_ub_b12p8 0.0501961 12.8000 FORMAT "%7.4" /end CHARACTERISTIC
/begin CHARACTERISTIC ZDKTBF "Zeitkonstante für Gasvermischungsvorgang vor Katalysator" VALUE 0x811A9A KwUb 12.7498 zk50msxs_ub_b12p8 0.0501961 12.8000 FORMAT "%7.4" /end CHARACTERISTIC
/begin CHARACTERISTIC ZFRMST "Zeitkonstante für frm-Filter (short test)" VALUE 0x819BE5 KwUb 50.9992 zk200msxs_ub_b51p2 0.200784 51.2000 FORMAT "%7.4" /end CHARACTERISTIC
/begin CHARACTERISTIC ZFTSVK "Zeitkonstante für Filter Periodendauer der Sonde vor Katalysator" VALUE 0x810164 KwUb 0.9961 fak_ub_b1 0.00 0.9961 /end CHARACTERISTIC
/begin CHARACTERISTIC ZKARIH "Filterzeitkonst.für Nachbildung Dynamik der Keramiktemp. aus Abgastemp. h.Kat" VALUE 0x81ACDC KwUw 6553.4999985 zk100msxs_uw_b6553 0.10000152590 6553.6000000 FORMAT "%12.7" /end CHARACTERISTIC
/begin CHARACTERISTIC ZKARIV "Filterzeitkonst.für Nachbildung Dynamik der Keramiktemp. aus Abgastemp. v.Kat" VALUE 0x81ACDE KwUw 6553.4999985 zk100msxs_uw_b6553 0.10000152590 6553.6000000 FORMAT "%12.7" /end CHARACTERISTIC
/begin CHARACTERISTIC ZKPRIH "Filter für Nachbildung Dynamik der Sondenkeramiktemp.aus el.Heizleistung h.Kat" VALUE 0x81ACE0 KwUw 6553.4999985 zk100msxs_uw_b6553 0.10000152590 6553.6000000 FORMAT "%12.7" /end CHARACTERISTIC
/begin CHARACTERISTIC ZKPRIV "Filter für Nachbildung Dynamik der Sondenkeramiktemp.aus el.Heizleistung v.Kat" VALUE 0x81ACE2 KwUw 6553.4999985 zk100msxs_uw_b6553 0.10000152590 6553.6000000 FORMAT "%12.7" /end CHARACTERISTIC
/begin CHARACTERISTIC ZKTDRL "Zeitkonstante Tiefpaß, rl-Filterung" VALUE 0x811A9B KwUb 12.7498 zk50msxs_ub_b12p8 0.0501961 12.8000 FORMAT "%7.4" /end CHARACTERISTIC
/begin CHARACTERISTIC ZMLRO "Zeitkonstante mlroh-Tiefpaß bei Diagnose HFM/HLM" VALUE 0x81008B KwUb 2.54000 zk10msxs_ub_b2p55 0.0100000 2.55000 FORMAT "%7.5" /end CHARACTERISTIC
/begin MEASUREMENT ahkat "Mittelwert der Amplitude Sondensignal hinter Kat. korrigiert mit KB" UBYTE fak_ub_b1 1 100 0 0.996094 ECU_ADDRESS 0x380C15 /end MEASUREMENT
/begin MEASUREMENT ahkat2 "Mittelwert der Amplitude Sondensignal hinter Kat. korrigiert mit KB (2.Bank)" UBYTE fak_ub_b1 1 100 0 0.996094 ECU_ADDRESS 0x380C16 /end MEASUREMENT
/begin MEASUREMENT ahkatn "Amplitude Sondensignal hinter Katalysator normiert" UBYTE fak_ub_b1 1 100 0 0.996094 ECU_ADDRESS 0x380C17 /end MEASUREMENT
/begin MEASUREMENT ahkatn2 "Amplitude Sondensignal hinter Katalysator normiert (Stereo 2.Bank)" UBYTE fak_ub_b1 1 100 0 0.996094 ECU_ADDRESS 0x380C18 /end MEASUREMENT
/begin MEASUREMENT ahktki2_w "Amplitude Sondensignal hinter Kat. korrigiert und integiert" UWORD t50msxs_uw_b819p2 1 100 0 819.188 FORMAT "%8.4" ECU_ADDRESS 0x381EE4 /end MEASUREMENT
/begin MEASUREMENT ahktki_w "Amplitude Sondensignal hinter Katalysator korrigiert und integiert" UWORD t50msxs_uw_b819p2 1 100 0 819.188 FORMAT "%8.4" ECU_ADDRESS 0x381EE6 /end MEASUREMENT
/begin MEASUREMENT ahktnk "Korrigierte Sondensignal-Amplitude normiert" UBYTE fak_ub_b1 1 100 0 0.996094 ECU_ADDRESS 0x380C19 /end MEASUREMENT
/begin MEASUREMENT ahktnk2 "korrigierte Sondensignal-Amplitude normiert (Stereo 2.Bank)" UBYTE fak_ub_b1 1 100 0 0.996094 ECU_ADDRESS 0x380C1A /end MEASUREMENT
/begin MEASUREMENT akatbn "Amplitude der Katalysatorbelastungssignal" UBYTE fak_ub_b1 1 100 0 0.996094 ECU_ADDRESS 0x380C1B /end MEASUREMENT
/begin MEASUREMENT akatbn2 "Amplitude des Katalysatorbelastungssignals (Stereo 2.Bank)" UBYTE fak_ub_b1 1 100 0 0.996094 ECU_ADDRESS 0x380C1C /end MEASUREMENT
/begin MEASUREMENT anzgangw "Anzahl erkannter Gangwechsel" UBYTE dez 1 100 0 255 FORMAT "%5.1" ECU_ADDRESS 0x380C67 /end MEASUREMENT
/begin MEASUREMENT anzkupplb "Anzahl erkannter Kupplungsbetätigungen" UBYTE dez 1 100 0 255 FORMAT "%5.1" ECU_ADDRESS 0x380C68 /end MEASUREMENT
/begin MEASUREMENT apedkt "Anzahl der Prüfungen mit Fehlerergebnis bei Katdiagnose" UBYTE dez 1 100 0 255 FORMAT "%5.1" ECU_ADDRESS 0x380C1D /end MEASUREMENT
/begin MEASUREMENT apedkt2 "Anzahl der Prüfungen mit Fehlerergebnis bei Katdiagnose (Bank2)" UBYTE dez 1 100 0 255 FORMAT "%5.1" ECU_ADDRESS 0x380C1E /end MEASUREMENT
/begin MEASUREMENT atvfett "atv-Verschiebung nach FETT, DLSSA" UBYTE t40msxs_ub_q0p04 1 100 0 10.2 FORMAT "%5.2" ECU_ADDRESS 0x380C99 /end MEASUREMENT
/begin MEASUREMENT atvfett2 "atv-Verschiebung nach FETT, DLSSA (Bank2)" UBYTE t40msxs_ub_q0p04 1 100 0 10.2 FORMAT "%5.2" ECU_ADDRESS 0x380C9A /end MEASUREMENT
/begin MEASUREMENT atvmager "atv-Verschiebung nach MAGER, DLSSA" UBYTE t40msxs_ub_q0p04 1 100 0 10.2 FORMAT "%5.2" ECU_ADDRESS 0x380C9B /end MEASUREMENT
/begin MEASUREMENT atvmager2 "atv-Verschiebung nach MAGER, DLSSA (Bank2)" UBYTE t40msxs_ub_q0p04 1 100 0 10.2 FORMAT "%5.2" ECU_ADDRESS 0x380C9C /end MEASUREMENT
/begin MEASUREMENT avkatf "AmplitudenVerhältnis laafh/laafv gefiltert" UBYTE fak_ub_b1 1 100 0 0.996094 ECU_ADDRESS 0x3830FC /end MEASUREMENT
/begin MEASUREMENT avkatf2 "Amplitudenverhältnis laafh/laafv gefiltert Bank2" UBYTE fak_ub_b1 1 100 0 0.996094 ECU_ADDRESS 0x3830FD /end MEASUREMENT
/begin MEASUREMENT B_abgstg "Bedingung Modelltemperatur (tkatm od. tanhkm_w) hinter KAT ist oberhalb Schwelle" UBYTE B_TRUE 1 100 0 1 BIT_MASK 0x2 FORMAT "%13.11" ECU_ADDRESS 0x380C2E /end MEASUREMENT
/begin MEASUREMENT B_abgstg2 "Bedingung Modelltemp. (tkatm od. tanhkm_w) liegt oberhalb Schwelle Bank2" UBYTE B_TRUE 1 100 0 1 BIT_MASK 0x4 FORMAT "%13.11" ECU_ADDRESS 0x380C2E /end MEASUREMENT
/begin MEASUREMENT B_acsdh "Bedingung für Prüfung Adernschluß und CSD hinter Kat" UWORD B_TRUE 1 100 0 1 BIT_MASK 0x100 FORMAT "%13.11" ECU_ADDRESS 0xFD82 /end MEASUREMENT
/begin MEASUREMENT B_acsdh2 "Bedingung für Prüfung Adernschluß und CSD hinter Kat" UWORD B_TRUE 1 100 0 1 BIT_MASK 0x200 FORMAT "%13.11" ECU_ADDRESS 0xFD82 /end MEASUREMENT
/begin MEASUREMENT B_adsh "Bedingung Adernschluß bei Lambdasonden hinter Kat" UBYTE B_TRUE 1 100 0 1 BIT_MASK 0x1 FORMAT "%13.11" ECU_ADDRESS 0x382FFD /end MEASUREMENT
/begin MEASUREMENT B_adsh2 "Bedingung Adernschluß bei Lambdasonden hinter Kat Bank2" UBYTE B_TRUE 1 100 0 1 BIT_MASK 0x2 FORMAT "%13.11" ECU_ADDRESS 0x382FFD /end MEASUREMENT
/begin MEASUREMENT B_adshs "Bedingung Adernschluß ""setzen"" bei Lambdasonden hinter Kat" UBYTE B_TRUE 1 100 0 1 BIT_MASK 0x40 FORMAT "%13.11" ECU_ADDRESS 0x380C34 /end MEASUREMENT
/begin MEASUREMENT B_adshs2 "Bedingung Adernschluß ""setzen"" bei Lambdasonden hinter Kat Bank2" UBYTE B_TRUE 1 100 0 1 BIT_MASK 0x80 FORMAT "%13.11" ECU_ADDRESS 0x380C34 /end MEASUREMENT
/begin MEASUREMENT B_agrrdy "Bedingung AGR geprüft für 'ready-Byte'" UBYTE B_TRUE 1 100 0 1 BIT_MASK 0x80 FORMAT "%13.11" ECU_ADDRESS 0x382FFC /end MEASUREMENT
/begin MEASUREMENT B_bemdb "Bedingung Bandende-Funktionsanforderung MDB" UWORD B_TRUE 1 100 0 1 BIT_MASK 0x20 FORMAT "%13.11" ECU_ADDRESS 0x38396E /end MEASUREMENT
/begin MEASUREMENT B_bergab "Bedingung Bergabfahrt erkannt" UWORD B_TRUE 1 100 0 1 BIT_MASK 0x4 FORMAT "%13.11" ECU_ADDRESS 0xFDCA /end MEASUREMENT
/begin MEASUREMENT B_bkmdb "Bedingung: Momentanüberwachung (bergrenzt dauerhaft) aktiv" UWORD B_TRUE 1 100 0 1 BIT_MASK 0x40 FORMAT "%13.11" ECU_ADDRESS 0x38396E /end MEASUREMENT
/begin MEASUREMENT B_clmdb "Flag für Löschung: Momentenbegrenzung begrenzt dauerhaft" UWORD B_TRUE 1 100 0 1 BIT_MASK 0x80 FORMAT "%13.11" ECU_ADDRESS 0x38396E /end MEASUREMENT
/begin MEASUREMENT B_ctccka "Flag Clamped-Tube-Check aktiv bei Leckdiagnose" UWORD B_TRUE 1 100 0 1 BIT_MASK 0x8 FORMAT "%13.11" ECU_ADDRESS 0xFDCA /end MEASUREMENT
/begin MEASUREMENT B_ctccke "Flag Clamped-Tube-Check beendet bei Leckdiagnose" UWORD B_TRUE 1 100 0 1 BIT_MASK 0x10 FORMAT "%13.11" ECU_ADDRESS 0xFDCA /end MEASUREMENT
/begin MEASUREMENT B_ctocka "Flag Close-To-Open-Check aktiv bei Leckdiagnose" UWORD B_TRUE 1 100 0 1 BIT_MASK 0x20 FORMAT "%13.11" ECU_ADDRESS 0xFDCA /end MEASUREMENT
/begin MEASUREMENT B_ctocke "Flag Close-To-Open-Check beendet bei Leckdiagnose" UWORD B_TRUE 1 100 0 1 BIT_MASK 0x40 FORMAT "%13.11" ECU_ADDRESS 0xFDCA /end MEASUREMENT
/begin MEASUREMENT B_ddylash "Bedingung Sonde hinter KAT dynamisch langsam" UWORD B_TRUE 1 100 0 1 BIT_MASK 0x8000 FORMAT "%13.11" ECU_ADDRESS 0xFD7C /end MEASUREMENT
/begin MEASUREMENT B_ddylash2 "Bedingung Sonde hinter KAT dynamisch langsam `dynamisch` Bank2" UWORD B_TRUE 1 100 0 1 BIT_MASK 0x1 FORMAT "%13.11" ECU_ADDRESS 0xFD7E /end MEASUREMENT
/begin MEASUREMENT B_dfskvo "Bedingung Fuellstands-Verbrauchsdiagnose obere Schwelle" UWORD B_TRUE 1 100 0 1 BIT_MASK 0x1 FORMAT "%13.11" ECU_ADDRESS 0x382628 /end MEASUREMENT
/begin MEASUREMENT B_dfskvu "Bedingung Fuellstands-Verbrauchsdiagnose untere Schwelle" UWORD B_TRUE 1 100 0 1 BIT_MASK 0x2 FORMAT "%13.11" ECU_ADDRESS 0x382628 /end MEASUREMENT
/begin MEASUREMENT B_dkini "Bedingung für DKAT-Funktion initialisieren" UWORD B_TRUE 1 100 0 1 BIT_MASK 0x10 FORMAT "%13.11" ECU_ADDRESS 0xFD78 /end MEASUREMENT
/begin MEASUREMENT B_dkini2 "Bedingung für DKAT-Funktion initialisieren (Stereo 2.Bank)" UWORD B_TRUE 1 100 0 1 BIT_MASK 0x20 FORMAT "%13.11" ECU_ADDRESS 0xFD78 /end MEASUREMENT
/begin MEASUREMENT B_dklpi "interne Umschaltung d. Lambdregelungsparameter angefordert" UWORD B_TRUE 1 100 0 1 BIT_MASK 0x40 FORMAT "%13.11" ECU_ADDRESS 0xFD78 /end MEASUREMENT
/begin MEASUREMENT B_dklpi2 "interne Umschaltung d. Lambdregelungsparameter angefordert, Bank2" UWORD B_TRUE 1 100 0 1 BIT_MASK 0x80 FORMAT "%13.11" ECU_ADDRESS 0xFD78 /end MEASUREMENT
/begin MEASUREMENT B_dkten "DKAT für diesen Trip nicht mehr aktiv" UWORD B_TRUE 1 100 0 1 BIT_MASK 0x100 FORMAT "%13.11" ECU_ADDRESS 0xFD78 /end MEASUREMENT
/begin MEASUREMENT B_dkten2 "DKAT für diesen Trip nicht mehr aktiv (Bank2)" UWORD B_TRUE 1 100 0 1 BIT_MASK 0x200 FORMAT "%13.11" ECU_ADDRESS 0xFD78 /end MEASUREMENT
/begin MEASUREMENT B_dktlp "Umschaltung der Lambdaregelungsparameter angefordert" UWORD B_TRUE 1 100 0 1 BIT_MASK 0x8000 FORMAT "%13.11" ECU_ADDRESS 0xFD3A /end MEASUREMENT
/begin MEASUREMENT B_dktnr "DKAT: n/rl-Bereich verlassen" UWORD B_TRUE 1 100 0 1 BIT_MASK 0x400 FORMAT "%13.11" ECU_ADDRESS 0xFD78 /end MEASUREMENT
/begin MEASUREMENT B_dktnr2 "DKAT: n/rl-Bereich verlassen, Bank2" UWORD B_TRUE 1 100 0 1 BIT_MASK 0x800 FORMAT "%13.11" ECU_ADDRESS 0xFD78 /end MEASUREMENT
/begin MEASUREMENT B_dktsb "Bankspezifische Stoppbedingung" UWORD B_TRUE 1 100 0 1 BIT_MASK 0x1000 FORMAT "%13.11" ECU_ADDRESS 0xFD78 /end MEASUREMENT
/begin MEASUREMENT B_dktsb2 "Bankspezifische Stoppbedingung (Stereo 2.Bank)" UWORD B_TRUE 1 100 0 1 BIT_MASK 0x2000 FORMAT "%13.11" ECU_ADDRESS 0xFD78 /end MEASUREMENT
/begin MEASUREMENT B_dktsp "physikalische Stoppbedingung" UWORD B_TRUE 1 100 0 1 BIT_MASK 0x4000 FORMAT "%13.11" ECU_ADDRESS 0xFD78 /end MEASUREMENT
/begin MEASUREMENT B_dktsp2 "physikalische Stoppbedingung (Stereo 2.Bank)" UWORD B_TRUE 1 100 0 1 BIT_MASK 0x8000 FORMAT "%13.11" ECU_ADDRESS 0xFD78 /end MEASUREMENT
/begin MEASUREMENT B_dktst "DKAT-Funktion ist gestoppt (B_dktst=FALSE)" UWORD B_TRUE 1 100 0 1 BIT_MASK 0x1 FORMAT "%13.11" ECU_ADDRESS 0xFD7A /end MEASUREMENT
/begin MEASUREMENT B_dktst2 "DKAT-Funktion ist gestoppt (B_dktst=FALSE, Stereo 2.Bank)" UWORD B_TRUE 1 100 0 1 BIT_MASK 0x2 FORMAT "%13.11" ECU_ADDRESS 0xFD7A /end MEASUREMENT
/begin MEASUREMENT B_dktt "DKAT-Aktiv-Zeit abgelaufen" UWORD B_TRUE 1 100 0 1 BIT_MASK 0x4 FORMAT "%13.11" ECU_ADDRESS 0xFD7A /end MEASUREMENT
/begin MEASUREMENT B_dktt2 "DKAT-Aktiv-Zeit abgelaufen, Bank2" UWORD B_TRUE 1 100 0 1 BIT_MASK 0x8 FORMAT "%13.11" ECU_ADDRESS 0xFD7A /end MEASUREMENT
/begin MEASUREMENT B_dkvsf "Bedingung: Freigabe des Fehlers" UWORD B_TRUE 1 100 0 1 BIT_MASK 0x1 FORMAT "%13.11" ECU_ADDRESS 0xFD94 /end MEASUREMENT
/begin MEASUREMENT B_dkvsfm "Bedingung: Freigabe des Fehlers (Flipflop Ausgang)" UBYTE B_TRUE 1 100 0 1 BIT_MASK 0x1 FORMAT "%13.11" ECU_ADDRESS 0x38311E /end MEASUREMENT
/begin MEASUREMENT B_dkvstr "Bedingung: Integrator bei Tankleer zurücksetzen" UWORD B_TRUE 1 100 0 1 BIT_MASK 0x2 FORMAT "%13.11" ECU_ADDRESS 0xFD94 /end MEASUREMENT
/begin MEASUREMENT B_dlaff "Anzahl der gültigen Tp-Messungen erreicht seit B_dlatp=1" UWORD B_TRUE 1 100 0 1 BIT_MASK 0x20 FORMAT "%13.11" ECU_ADDRESS 0xFD3C /end MEASUREMENT
/begin MEASUREMENT B_dlaff2 "Anzahl der gültigen Tp-Messungen erreicht seit B_dlatp2=1 Bank2" UWORD B_TRUE 1 100 0 1 BIT_MASK 0x40 FORMAT "%13.11" ECU_ADDRESS 0xFD3C /end MEASUREMENT
/begin MEASUREMENT B_dlash "Bedingung Freigabe Schwingungsprüfung hinter Kat." UWORD B_TRUE 1 100 0 1 BIT_MASK 0x2 FORMAT "%13.11" ECU_ADDRESS 0xFD7E /end MEASUREMENT
/begin MEASUREMENT B_dlash2 "Bedingung Freigabe Schwingungsprüfung  hinter Kat. (Bank 2)" UWORD B_TRUE 1 100 0 1 BIT_MASK 0x4 FORMAT "%13.11" ECU_ADDRESS 0xFD7E /end MEASUREMENT
/begin MEASUREMENT B_dlatp "Aktive Diagnose:Lambda-Sondenalterung TP" UWORD B_TRUE 1 100 0 1 BIT_MASK 0x80 FORMAT "%13.11" ECU_ADDRESS 0xFD3C /end MEASUREMENT
/begin MEASUREMENT B_dlatp2 "Aktive Diagnose:	Lambda-Sondenalterung TP (Bank 2)" UWORD B_TRUE 1 100 0 1 BIT_MASK 0x100 FORMAT "%13.11" ECU_ADDRESS 0xFD3C /end MEASUREMENT
/begin MEASUREMENT B_dlatv "Aktive Diagnose:	Lambda-Sondenalterung TV" UWORD B_TRUE 1 100 0 1 BIT_MASK 0x8 FORMAT "%13.11" ECU_ADDRESS 0xFD7C /end MEASUREMENT
/begin MEASUREMENT B_dlatv2 "Aktive Diagnose:	Lambda-Sondenalterung TV (Bank 2)" UWORD B_TRUE 1 100 0 1 BIT_MASK 0x10 FORMAT "%13.11" ECU_ADDRESS 0xFD7C /end MEASUREMENT
/begin MEASUREMENT B_dldp "Aktive Diagnose: Leckdiagnosemodul" UWORD B_TRUE 1 100 0 1 BIT_MASK 0x80 FORMAT "%13.11" ECU_ADDRESS 0xFDCA /end MEASUREMENT
/begin MEASUREMENT B_dldpte "Anforderung TEV schließen aus Tankentlüftungsdiagnose" UWORD B_TRUE 1 100 0 1 BIT_MASK 0x100 FORMAT "%13.11" ECU_ADDRESS 0xFDCA /end MEASUREMENT
/begin MEASUREMENT B_dldp_old "" UWORD B_TRUE 1 100 0 1 BIT_MASK 0x200 FORMAT "%13.11" ECU_ADDRESS 0xFDCA /end MEASUREMENT
/begin MEASUREMENT B_dllr "Aktive diagnose: Leerlaufstellerdiagnose" UWORD B_TRUE 1 100 0 1 BIT_MASK 0x10 FORMAT "%13.11" ECU_ADDRESS 0xFD9A /end MEASUREMENT
/begin MEASUREMENT B_dllra "Bedingung DLLR Anforderung" UWORD B_TRUE 1 100 0 1 BIT_MASK 0x20 FORMAT "%13.11" ECU_ADDRESS 0xFD9A /end MEASUREMENT
/begin MEASUREMENT B_dpuabb "Bedingung hoher Umgebungsdruckgradient bei Bergabfahrt erkannt" UWORD B_TRUE 1 100 0 1 BIT_MASK 0x400 FORMAT "%13.11" ECU_ADDRESS 0xFDCA /end MEASUREMENT
/begin MEASUREMENT B_druck "Bedingung Drucklosprüfung erfüllt, System drucklos" UBYTE B_TRUE 1 100 0 1 BIT_MASK 0x1 FORMAT "%13.11" ECU_ADDRESS 0x38314E /end MEASUREMENT
/begin MEASUREMENT B_dshen "Bedingung Freigabe Sondendiagnose hinter KAT" UWORD B_TRUE 1 100 0 1 BIT_MASK 0x400 FORMAT "%13.11" ECU_ADDRESS 0xFD82 /end MEASUREMENT
/begin MEASUREMENT B_dshen2 "Bedingung Freigabe Sondendiagnose hinter KAT Bank2" UWORD B_TRUE 1 100 0 1 BIT_MASK 0x800 FORMAT "%13.11" ECU_ADDRESS 0xFD82 /end MEASUREMENT
/begin MEASUREMENT B_dshk "Bedingung Diagnosefunktion in %DLSH und %DHLS mit i.O.-Meldung h. KAT" UWORD B_TRUE 1 100 0 1 BIT_MASK 0x8 FORMAT "%13.11" ECU_ADDRESS 0xFD7E /end MEASUREMENT
/begin MEASUREMENT B_dshk2 "Bed. Diagnosefunktion in %DLSH u.%DHLS mit i.O.-Meldung h. KAT  Bank2" UWORD B_TRUE 1 100 0 1 BIT_MASK 0x10 FORMAT "%13.11" ECU_ADDRESS 0xFD7E /end MEASUREMENT
/begin MEASUREMENT B_dtankm "Bedingung Diagnose Tankvorgang moeglich" UWORD B_TRUE 1 100 0 1 BIT_MASK 0x4 FORMAT "%13.11" ECU_ADDRESS 0x382628 /end MEASUREMENT
/begin MEASUREMENT B_dushsch "Bedingung Schwelle für Sonde hinter KAT im Schub nicht unterschritten" UWORD B_TRUE 1 100 0 1 BIT_MASK 0x20 FORMAT "%13.11" ECU_ADDRESS 0xFD7E /end MEASUREMENT
/begin MEASUREMENT B_dushsch2 "Bed. Schwelle für Sonde hinter KAT im Schub nicht unterschritten  Bank2" UWORD B_TRUE 1 100 0 1 BIT_MASK 0x40 FORMAT "%13.11" ECU_ADDRESS 0xFD7E /end MEASUREMENT
/begin MEASUREMENT B_dylash "Bedingung Sonde hinter KAT dynamisch langsam" UBYTE B_TRUE 1 100 0 1 BIT_MASK 0x1 FORMAT "%13.11" ECU_ADDRESS 0x383105 /end MEASUREMENT
/begin MEASUREMENT B_dylash2 "Bedingung Sonde hinter KAT dynamisch langsam Bank2" UBYTE B_TRUE 1 100 0 1 BIT_MASK 0x2 FORMAT "%13.11" ECU_ADDRESS 0x383105 /end MEASUREMENT
/begin MEASUREMENT B_edkvs "Bedingung Adaptionsfehlerschwellen aktuell überschritten" UWORD B_TRUE 1 100 0 1 BIT_MASK 0x8 FORMAT "%13.11" ECU_ADDRESS 0xFD42 /end MEASUREMENT
/begin MEASUREMENT B_edkvs2 "Bedingung Adaptionsfehlerschwellen Bank 2 aktuell überschritten" UWORD B_TRUE 1 100 0 1 BIT_MASK 0x10 FORMAT "%13.11" ECU_ADDRESS 0xFD42 /end MEASUREMENT
/begin MEASUREMENT B_efrao "Bedingung Diagnoseschwellen obere multipl. Korrektur aktuell überschritten" UWORD B_TRUE 1 100 0 1 BIT_MASK 0x4 FORMAT "%13.11" ECU_ADDRESS 0xFD94 /end MEASUREMENT
/begin MEASUREMENT B_efrao2 "Bedingung Diagnoseschwellen obere multipl. Korr. Bank 2 aktuell überschritten" UWORD B_TRUE 1 100 0 1 BIT_MASK 0x8 FORMAT "%13.11" ECU_ADDRESS 0xFD94 /end MEASUREMENT
/begin MEASUREMENT B_efrau "Bedingung Diagnoseschwellen untere multipl. Korrektur aktuell überschritten" UWORD B_TRUE 1 100 0 1 BIT_MASK 0x10 FORMAT "%13.11" ECU_ADDRESS 0xFD94 /end MEASUREMENT
/begin MEASUREMENT B_efrau2 "Bedingung Diagnoseschwellen untere multipl. Korr. Bank 2 aktuell überschritten" UWORD B_TRUE 1 100 0 1 BIT_MASK 0x20 FORMAT "%13.11" ECU_ADDRESS 0xFD94 /end MEASUREMENT
/begin MEASUREMENT B_eggldp "Bedingung Fehler in DLDP-Gebergrößen gesetzt" UWORD B_TRUE 1 100 0 1 BIT_MASK 0x800 FORMAT "%13.11" ECU_ADDRESS 0xFDCA /end MEASUREMENT
/begin MEASUREMENT B_ehfm "Bedingung Fehler HFM (ohne Entprellung)" UWORD B_TRUE 1 100 0 1 BIT_MASK 0x200 FORMAT "%13.11" ECU_ADDRESS 0xFD90 /end MEASUREMENT
/begin MEASUREMENT B_ekats "Summenfehler für MODE 6" UWORD B_TRUE 1 100 0 1 BIT_MASK 0x10 FORMAT "%13.11" ECU_ADDRESS 0xFD7A /end MEASUREMENT
/begin MEASUREMENT B_ekats2 "Summenfehler für MODE 6 (Stereo 2.Bank)" UWORD B_TRUE 1 100 0 1 BIT_MASK 0x20 FORMAT "%13.11" ECU_ADDRESS 0xFD7A /end MEASUREMENT
/begin MEASUREMENT B_enfmst "Bedingung Enable für Filter; Maximum der Steigung übernehmen hinter Kat" UWORD B_TRUE 1 100 0 1 BIT_MASK 0x80 FORMAT "%13.11" ECU_ADDRESS 0xFD7E /end MEASUREMENT
/begin MEASUREMENT B_enfmst2 "Bedingung Enable für Filter Maximum der Steigung übernehmen hinter Kat Bank2" UWORD B_TRUE 1 100 0 1 BIT_MASK 0x100 FORMAT "%13.11" ECU_ADDRESS 0xFD7E /end MEASUREMENT
/begin MEASUREMENT B_enlash "Bedingung Test für Schwingungsprüfung abgeschlossen hinteer Kat" UWORD B_TRUE 1 100 0 1 BIT_MASK 0x200 FORMAT "%13.11" ECU_ADDRESS 0xFD7E /end MEASUREMENT
/begin MEASUREMENT B_enlash2 "Bedingung Test für Schwingungsprüfung abgeschlossen hinter Kat Bank2" UWORD B_TRUE 1 100 0 1 BIT_MASK 0x400 FORMAT "%13.11" ECU_ADDRESS 0xFD7E /end MEASUREMENT
/begin MEASUREMENT B_entest "Bedingung Wartezeit abgeschlossen für Test-Überprüfung Sonde hinter KAT" UWORD B_TRUE 1 100 0 1 BIT_MASK 0x800 FORMAT "%13.11" ECU_ADDRESS 0xFD7E /end MEASUREMENT
/begin MEASUREMENT B_entest2 "Bedingung Wartezeit abgeschlossen für Test-Überprüfung Sonde hinter KAT Bank2" UWORD B_TRUE 1 100 0 1 BIT_MASK 0x1000 FORMAT "%13.11" ECU_ADDRESS 0xFD7E /end MEASUREMENT
/begin MEASUREMENT B_erdkt "Interner Fehler Kat-Überwachung" UWORD B_TRUE 1 100 0 1 BIT_MASK 0x40 FORMAT "%13.11" ECU_ADDRESS 0xFD7A /end MEASUREMENT
/begin MEASUREMENT B_erdkt2 "Interner Fehler Kat-Überwachung (Bank2)" UWORD B_TRUE 1 100 0 1 BIT_MASK 0x80 FORMAT "%13.11" ECU_ADDRESS 0xFD7A /end MEASUREMENT
/begin MEASUREMENT B_erkat "Bedingung Diagnoseschwellen additive Korr. pro Zeit aktuell überschritten" UWORD B_TRUE 1 100 0 1 BIT_MASK 0x40 FORMAT "%13.11" ECU_ADDRESS 0xFD94 /end MEASUREMENT
/begin MEASUREMENT B_erkat2 "Bedingung Diagnoseschwellen additive Korr. pro Zeit Bank 2 aktuell überschritten" UWORD B_TRUE 1 100 0 1 BIT_MASK 0x80 FORMAT "%13.11" ECU_ADDRESS 0xFD94 /end MEASUREMENT
/begin MEASUREMENT B_erkaz "Bedingung Diagnoseschwellen additive Korr. pro Einspr.  aktuell überschritten" UWORD B_TRUE 1 100 0 1 BIT_MASK 0x100 FORMAT "%13.11" ECU_ADDRESS 0xFD94 /end MEASUREMENT
/begin MEASUREMENT B_erkaz2 "Bedingung Diagnoseschw. additive Korr. pro Einspr. Bank 2 aktuell überschritten" UWORD B_TRUE 1 100 0 1 BIT_MASK 0x200 FORMAT "%13.11" ECU_ADDRESS 0xFD94 /end MEASUREMENT
/begin MEASUREMENT B_estldp "Fehlerbedingung in DLDP-Eingangsgrößen stoppt DLDP" UWORD B_TRUE 1 100 0 1 BIT_MASK 0x1000 FORMAT "%13.11" ECU_ADDRESS 0xFDCA /end MEASUREMENT
/begin MEASUREMENT B_fadldp_old "" UWORD B_TRUE 1 100 0 1 BIT_MASK 0x2000 FORMAT "%13.11" ECU_ADDRESS 0xFDCA /end MEASUREMENT
/begin MEASUREMENT B_fbdtevn "" UWORD B_TRUE 1 100 0 1 BIT_MASK 0x4000 FORMAT "%13.11" ECU_ADDRESS 0xFDCA /end MEASUREMENT
/begin MEASUREMENT B_fbldp "Freigabebedingungen DLDP erfüllt" UWORD B_TRUE 1 100 0 1 BIT_MASK 0x8000 FORMAT "%13.11" ECU_ADDRESS 0xFDCA /end MEASUREMENT
/begin MEASUREMENT B_fbldpw "Wiederholte Freigabe DLDP erfüllt" UWORD B_TRUE 1 100 0 1 BIT_MASK 0x1 FORMAT "%13.11" ECU_ADDRESS 0xFDCC /end MEASUREMENT
/begin MEASUREMENT B_fbldpw1 "" UWORD B_TRUE 1 100 0 1 BIT_MASK 0x2 FORMAT "%13.11" ECU_ADDRESS 0xFDCC /end MEASUREMENT
/begin MEASUREMENT B_fbldpw2 "" UWORD B_TRUE 1 100 0 1 BIT_MASK 0x4 FORMAT "%13.11" ECU_ADDRESS 0xFDCC /end MEASUREMENT
/begin MEASUREMENT B_fbldpwff "" UWORD B_TRUE 1 100 0 1 BIT_MASK 0x8 FORMAT "%13.11" ECU_ADDRESS 0xFDCC /end MEASUREMENT
/begin MEASUREMENT B_fbldpw_old "" UWORD B_TRUE 1 100 0 1 BIT_MASK 0x10 FORMAT "%13.11" ECU_ADDRESS 0xFDCC /end MEASUREMENT
/begin MEASUREMENT B_fbldp_old "" UWORD B_TRUE 1 100 0 1 BIT_MASK 0x20 FORMAT "%13.11" ECU_ADDRESS 0xFDCC /end MEASUREMENT
/begin MEASUREMENT B_fbsperr "" UWORD B_TRUE 1 100 0 1 BIT_MASK 0x40 FORMAT "%13.11" ECU_ADDRESS 0xFDCC /end MEASUREMENT
/begin MEASUREMENT B_flag0 "" UWORD B_TRUE 1 100 0 1 BIT_MASK 0x80 FORMAT "%13.11" ECU_ADDRESS 0xFDCC /end MEASUREMENT
/begin MEASUREMENT B_flag1 "" UWORD B_TRUE 1 100 0 1 BIT_MASK 0x100 FORMAT "%13.11" ECU_ADDRESS 0xFDCC /end MEASUREMENT
/begin MEASUREMENT B_flag2 "KR: Leitungsdiagnose im CC196 wurde durchgeführt" UWORD B_TRUE 1 100 0 1 BIT_MASK 0x200 FORMAT "%13.11" ECU_ADDRESS 0xFDCC /end MEASUREMENT
/begin MEASUREMENT B_fpuls "Flag Fast Pulse aktiv" UWORD B_TRUE 1 100 0 1 BIT_MASK 0x400 FORMAT "%13.11" ECU_ADDRESS 0xFDCC /end MEASUREMENT
/begin MEASUREMENT B_frmlash "Bedingung Mittelwert des Lambdaregelfaktors innerhalb den Schwellen" UWORD B_TRUE 1 100 0 1 BIT_MASK 0x2000 FORMAT "%13.11" ECU_ADDRESS 0xFD7E /end MEASUREMENT
/begin MEASUREMENT B_frmlash2 "Bedingung Mittelwert des Lambdaregelfaktors innerhalb den Schwellen Bank2" UWORD B_TRUE 1 100 0 1 BIT_MASK 0x4000 FORMAT "%13.11" ECU_ADDRESS 0xFD7E /end MEASUREMENT
/begin MEASUREMENT B_frste "Bedingung frm_w eingeschwungen (Kurztest)" UWORD B_TRUE 1 100 0 1 BIT_MASK 0x400 FORMAT "%13.11" ECU_ADDRESS 0xFD94 /end MEASUREMENT
/begin MEASUREMENT B_frste2 "Bedingung frm2_w eingeschwungen (Kurztest 2. Bank)" UWORD B_TRUE 1 100 0 1 BIT_MASK 0x800 FORMAT "%13.11" ECU_ADDRESS 0xFD94 /end MEASUREMENT
/begin MEASUREMENT B_frzdh "Bedingung Frezze Druckreferenz für Downhill-Erkennung" UWORD B_TRUE 1 100 0 1 BIT_MASK 0x800 FORMAT "%13.11" ECU_ADDRESS 0xFDCC /end MEASUREMENT
/begin MEASUREMENT B_fstclr "Bedingung Fuellstand Clearanforderung" UBYTE B_TRUE 1 100 0 1 BIT_MASK 0x1 FORMAT "%13.11" ECU_ADDRESS 0x380D5A /end MEASUREMENT
/begin MEASUREMENT B_fstdakt "Bedingung Fuellstandsgeber - Plausibilisierung aktiv" UWORD B_TRUE 1 100 0 1 BIT_MASK 0x8 FORMAT "%13.11" ECU_ADDRESS 0x382628 /end MEASUREMENT
/begin MEASUREMENT B_fstini "Bedingung Fuellstand fuer Auswertung initialisieren" UWORD B_TRUE 1 100 0 1 BIT_MASK 0x10 FORMAT "%13.11" ECU_ADDRESS 0x382628 /end MEASUREMENT
/begin MEASUREMENT B_fstlowr "Bedingung Fuellstandsgeberdiagnose-Unterbrechung durch low range" UBYTE B_TRUE 1 100 0 1 BIT_MASK 0x2 FORMAT "%13.11" ECU_ADDRESS 0x383131 /end MEASUREMENT
/begin MEASUREMENT B_fstsigf "Fuellstandssignalfehler" UWORD B_TRUE 1 100 0 1 BIT_MASK 0x20 FORMAT "%13.11" ECU_ADDRESS 0x382628 /end MEASUREMENT
/begin MEASUREMENT B_fsttab "Bedingung Fuellstand hat abgenommen waehrend Zuendung ein" UBYTE B_TRUE 1 100 0 1 BIT_MASK 0x8 FORMAT "%13.11" ECU_ADDRESS 0x380D5A /end MEASUREMENT
/begin MEASUREMENT B_fsttd "Bedingung Fuellstandsgeberdiagnose" UWORD B_TRUE 1 100 0 1 BIT_MASK 0x1000 FORMAT "%13.11" ECU_ADDRESS 0x382628 /end MEASUREMENT
/begin MEASUREMENT B_fsttden "Bedingung Diagnosefreigabe Fuellstand Tank" UWORD B_TRUE 1 100 0 1 BIT_MASK 0x40 FORMAT "%13.11" ECU_ADDRESS 0x382628 /end MEASUREMENT
/begin MEASUREMENT B_fsttin "Bedingung Fuellstand einlesen" UWORD B_TRUE 1 100 0 1 BIT_MASK 0x2000 FORMAT "%13.11" ECU_ADDRESS 0x382628 /end MEASUREMENT
/begin MEASUREMENT B_fsttzu "Bedingung Fuellstand hat zugenommen waehrend Zuendung ein" UBYTE B_TRUE 1 100 0 1 BIT_MASK 0x4 FORMAT "%13.11" ECU_ADDRESS 0x380D5A /end MEASUREMENT
/begin MEASUREMENT B_ftmdb "Bedingung: Fehlereintrag durch Tester für MDB" UWORD B_TRUE 1 100 0 1 BIT_MASK 0x10 FORMAT "%13.11" ECU_ADDRESS 0x38396E /end MEASUREMENT
/begin MEASUREMENT B_gae "Bedingung Grundadaption eingeschwungen" UWORD B_TRUE 1 100 0 1 BIT_MASK 0x1000 FORMAT "%13.11" ECU_ADDRESS 0xFD94 /end MEASUREMENT
/begin MEASUREMENT B_gaefra "Bedingung Grundadaption (fra-Integrator) eingeschwungen" UWORD B_TRUE 1 100 0 1 BIT_MASK 0x2000 FORMAT "%13.11" ECU_ADDRESS 0xFD94 /end MEASUREMENT
/begin MEASUREMENT B_gaefra2 "Bedingung Grundadaption (fra2-Integrator) eingeschwungen" UWORD B_TRUE 1 100 0 1 BIT_MASK 0x4000 FORMAT "%13.11" ECU_ADDRESS 0xFD94 /end MEASUREMENT
/begin MEASUREMENT B_gaeing "Bedingung Grundadaption Bank 1 eingeschwungen" UWORD B_TRUE 1 100 0 1 BIT_MASK 0x8000 FORMAT "%13.11" ECU_ADDRESS 0xFD94 /end MEASUREMENT
/begin MEASUREMENT B_gaeing2 "Bedingung Grundadaption Bank 2 eingeschwungenen" UWORD B_TRUE 1 100 0 1 BIT_MASK 0x1 FORMAT "%13.11" ECU_ADDRESS 0xFD96 /end MEASUREMENT
/begin MEASUREMENT B_gangok "Bedingung Gangwechselerkennung prinziell erlaubt" UWORD B_TRUE 1 100 0 1 BIT_MASK 0x40 FORMAT "%13.11" ECU_ADDRESS 0xFD88 /end MEASUREMENT
/begin MEASUREMENT B_hfm "Bedingung HFM messbereit" UWORD B_TRUE 1 100 0 1 BIT_MASK 0x40 FORMAT "%13.11" ECU_ADDRESS 0xFD26 /end MEASUREMENT
/begin MEASUREMENT B_hsrdy "Bedingung Sondenheizung geprüft für 'ready-Byte'" UBYTE B_TRUE 1 100 0 1 BIT_MASK 0x40 FORMAT "%13.11" ECU_ADDRESS 0x382FFC /end MEASUREMENT
/begin MEASUREMENT B_imlkvse "Bedingung Luftmassenintegral Rücksetzen" UBYTE B_TRUE 1 100 0 1 BIT_MASK 0x2 FORMAT "%13.11" ECU_ADDRESS 0x38311E /end MEASUREMENT
/begin MEASUREMENT B_kathrdy "Bedingung Katalysator-Heizungen geprüft für 'ready-Byte'" UBYTE B_TRUE 1 100 0 1 BIT_MASK 0x2 FORMAT "%13.11" ECU_ADDRESS 0x382FFC /end MEASUREMENT
/begin MEASUREMENT B_katrdy "Bedingung Katalysatoren geprüft für 'ready-Byte'" UBYTE B_TRUE 1 100 0 1 BIT_MASK 0x1 FORMAT "%13.11" ECU_ADDRESS 0x382FFC /end MEASUREMENT
/begin MEASUREMENT B_kkrdy "Bedingung Klimakühlmittel geprüft für 'ready-Byte'" UBYTE B_TRUE 1 100 0 1 BIT_MASK 0x10 FORMAT "%13.11" ECU_ADDRESS 0x382FFC /end MEASUREMENT
/begin MEASUREMENT B_krdws "Bedingung Klopfregelung Sicherheitsspätverstellung" UWORD B_TRUE 1 100 0 1 BIT_MASK 0x10 FORMAT "%13.11" ECU_ADDRESS 0xFD2E /end MEASUREMENT
/begin MEASUREMENT B_kvbd "Bedingung Freigabe Verbrauchsdiagnose" UWORD B_TRUE 1 100 0 1 BIT_MASK 0x80 FORMAT "%13.11" ECU_ADDRESS 0x382628 /end MEASUREMENT
/begin MEASUREMENT B_kvsffl "Bedingung: Freigabe des Fehlers trotz Tank leer" UWORD B_TRUE 1 100 0 1 BIT_MASK 0x2 FORMAT "%13.11" ECU_ADDRESS 0xFD96 /end MEASUREMENT
/begin MEASUREMENT B_lamend "Bedingung Ende der Lambdaverstellung in %LAMKO hinter Kat" UWORD B_TRUE 1 100 0 1 BIT_MASK 0x8000 FORMAT "%13.11" ECU_ADDRESS 0xFD7E /end MEASUREMENT
/begin MEASUREMENT B_lamend2 "Bedingung Ende der Lambdaverstellung in %LAMKO hinter Kat Bank2" UWORD B_TRUE 1 100 0 1 BIT_MASK 0x1 FORMAT "%13.11" ECU_ADDRESS 0xFD80 /end MEASUREMENT
/begin MEASUREMENT B_lamlash "Bedingung für Abmagern/Anfetten in %LAMKO" UWORD B_TRUE 1 100 0 1 BIT_MASK 0x2 FORMAT "%13.11" ECU_ADDRESS 0xFD80 /end MEASUREMENT
/begin MEASUREMENT B_lamlash2 "Bedingung für Abmagern in %LAMKO Bank2" UWORD B_TRUE 1 100 0 1 BIT_MASK 0x4 FORMAT "%13.11" ECU_ADDRESS 0xFD80 /end MEASUREMENT
/begin MEASUREMENT B_lamverg "Bedingung Vergleich Lambdasoll in %DLSAHK mit %LAMKO übereinstimmend" UWORD B_TRUE 1 100 0 1 BIT_MASK 0x8 FORMAT "%13.11" ECU_ADDRESS 0xFD80 /end MEASUREMENT
/begin MEASUREMENT B_lamverg2 "Bedingung Vergleich Lambdasoll in %DLSAHK mit %LAMKO übereinstimmend Bank2" UWORD B_TRUE 1 100 0 1 BIT_MASK 0x10 FORMAT "%13.11" ECU_ADDRESS 0xFD80 /end MEASUREMENT
/begin MEASUREMENT B_ldpein "Flag LDP eingeschaltet" UWORD B_TRUE 1 100 0 1 BIT_MASK 0x1000 FORMAT "%13.11" ECU_ADDRESS 0xFDCC /end MEASUREMENT
/begin MEASUREMENT B_ldpena "Flag ldp-Ansteuerung freigegeben" UWORD B_TRUE 1 100 0 1 BIT_MASK 0x2000 FORMAT "%13.11" ECU_ADDRESS 0xFDCC /end MEASUREMENT
/begin MEASUREMENT B_ldpf1 "Fehler fault_1" UWORD B_TRUE 1 100 0 1 BIT_MASK 0x4000 FORMAT "%13.11" ECU_ADDRESS 0xFDCC /end MEASUREMENT
/begin MEASUREMENT B_ldpf2 "Fehler fault_2" UWORD B_TRUE 1 100 0 1 BIT_MASK 0x8000 FORMAT "%13.11" ECU_ADDRESS 0xFDCC /end MEASUREMENT
/begin MEASUREMENT B_ldpf2h "" UWORD B_TRUE 1 100 0 1 BIT_MASK 0x1 FORMAT "%13.11" ECU_ADDRESS 0xFDCE /end MEASUREMENT
/begin MEASUREMENT B_ldpf3 "Fehler fault_3" UWORD B_TRUE 1 100 0 1 BIT_MASK 0x2 FORMAT "%13.11" ECU_ADDRESS 0xFDCE /end MEASUREMENT
/begin MEASUREMENT B_ldpf4 "Fehler fault_4" UWORD B_TRUE 1 100 0 1 BIT_MASK 0x4 FORMAT "%13.11" ECU_ADDRESS 0xFDCE /end MEASUREMENT
/begin MEASUREMENT B_ldpf4h "" UWORD B_TRUE 1 100 0 1 BIT_MASK 0x8 FORMAT "%13.11" ECU_ADDRESS 0xFDCE /end MEASUREMENT
/begin MEASUREMENT B_ldpf5 "Fehler fault_5" UWORD B_TRUE 1 100 0 1 BIT_MASK 0x10 FORMAT "%13.11" ECU_ADDRESS 0xFDCE /end MEASUREMENT
/begin MEASUREMENT B_ldpf6 "Fehler fault_6" UWORD B_TRUE 1 100 0 1 BIT_MASK 0x20 FORMAT "%13.11" ECU_ADDRESS 0xFDCE /end MEASUREMENT
/begin MEASUREMENT B_ldpstp "Flag DLDP unterbrochen" UWORD B_TRUE 1 100 0 1 BIT_MASK 0x40 FORMAT "%13.11" ECU_ADDRESS 0xFDCE /end MEASUREMENT
/begin MEASUREMENT B_lldia "Diagnose Leerlaufregelung freigegeben" UWORD B_TRUE 1 100 0 1 BIT_MASK 0x40 FORMAT "%13.11" ECU_ADDRESS 0xFD9A /end MEASUREMENT
/begin MEASUREMENT B_lowra1 "" UBYTE B_TRUE 1 100 0 1 BIT_MASK 0x1 FORMAT "%13.11" ECU_ADDRESS 0x383131 /end MEASUREMENT
/begin MEASUREMENT B_lsahksp "allgemeine Stop-Bedingungen für die DLSAHK" UWORD B_TRUE 1 100 0 1 BIT_MASK 0x20 FORMAT "%13.11" ECU_ADDRESS 0xFD80 /end MEASUREMENT
/begin MEASUREMENT B_lsahksp2 "allgemeine Stop-Bedingungen für die DLSAHK Bank2" UWORD B_TRUE 1 100 0 1 BIT_MASK 0x40 FORMAT "%13.11" ECU_ADDRESS 0xFD80 /end MEASUREMENT
/begin MEASUREMENT B_lsastp "allgemeine Stop-Bedingungen für die DLSA" UWORD B_TRUE 1 100 0 1 BIT_MASK 0x20 FORMAT "%13.11" ECU_ADDRESS 0xFD7C /end MEASUREMENT
/begin MEASUREMENT B_lsastp2 "allgemeine Stop-Bedingungen für die DLSA  Bank2" UWORD B_TRUE 1 100 0 1 BIT_MASK 0x40 FORMAT "%13.11" ECU_ADDRESS 0xFD7C /end MEASUREMENT
/begin MEASUREMENT B_lsrdy "Bedingung Lambda-Sonden geprüft für 'ready-Byte'" UBYTE B_TRUE 1 100 0 1 BIT_MASK 0x20 FORMAT "%13.11" ECU_ADDRESS 0x382FFC /end MEASUREMENT
/begin MEASUREMENT B_maxflsh "Kurzsschluß nach UBatt bei Sonde hinter KAT erkannt" UBYTE B_TRUE 1 100 0 1 BIT_MASK 0x1 FORMAT "%13.11" ECU_ADDRESS 0x380C33 /end MEASUREMENT
/begin MEASUREMENT B_maxflsh2 "Kurzsschluß nach UBatt bei Sonde hinter KAT erkannt, Bank 2" UBYTE B_TRUE 1 100 0 1 BIT_MASK 0x2 FORMAT "%13.11" ECU_ADDRESS 0x380C33 /end MEASUREMENT
/begin MEASUREMENT B_maxlash "Sonden-Fehler Maximalwert für Schwingungs-Prüfung hinter KAT nicht erkannt" UWORD B_TRUE 1 100 0 1 BIT_MASK 0x80 FORMAT "%13.11" ECU_ADDRESS 0xFD80 /end MEASUREMENT
/begin MEASUREMENT B_maxlash2 "Sonden-Fehler Maximalwert für Schwingungs-Prüfung hinter KAT nicht erkannt Bank2" UWORD B_TRUE 1 100 0 1 BIT_MASK 0x100 FORMAT "%13.11" ECU_ADDRESS 0xFD80 /end MEASUREMENT
/begin MEASUREMENT B_minflsh "Adernschluß oder KS nach Masse bei Sonde  hinter KAT erkannt" UBYTE B_TRUE 1 100 0 1 BIT_MASK 0x4 FORMAT "%13.11" ECU_ADDRESS 0x380C33 /end MEASUREMENT
/begin MEASUREMENT B_minflsh2 "Adernschluß oder KS nach Masse bei Sonde hinter KAT erkannt Bank2" UBYTE B_TRUE 1 100 0 1 BIT_MASK 0x8 FORMAT "%13.11" ECU_ADDRESS 0x380C33 /end MEASUREMENT
/begin MEASUREMENT B_minlash "Sonden Fehler Minimalwert für Schwingungsprüfung hinter KAT nicht erkannt" UWORD B_TRUE 1 100 0 1 BIT_MASK 0x200 FORMAT "%13.11" ECU_ADDRESS 0xFD80 /end MEASUREMENT
/begin MEASUREMENT B_minlash2 "Sonden-Fehler Minimalwert für Schwingungsprüfung hinter KAT nicht erkannt Bank2" UWORD B_TRUE 1 100 0 1 BIT_MASK 0x400 FORMAT "%13.11" ECU_ADDRESS 0xFD80 /end MEASUREMENT
/begin MEASUREMENT B_mldyn "Bedingung erforderliche Luftmasse im Schubbetrieb für Dynamikmessung erreicht" UWORD B_TRUE 1 100 0 1 BIT_MASK 0x800 FORMAT "%13.11" ECU_ADDRESS 0xFD80 /end MEASUREMENT
/begin MEASUREMENT B_mlustest "Bedingung ml ist innerhalb den Schwellen" UBYTE B_TRUE 1 100 0 1 BIT_MASK 0x1 FORMAT "%13.11" ECU_ADDRESS 0x380C2E /end MEASUREMENT
/begin MEASUREMENT B_mnfhsh "Kurzschluß Heizung Lambdasonde hinter Kat nach Masse" UWORD B_TRUE 1 100 0 1 BIT_MASK 0x10 FORMAT "%13.11" ECU_ADDRESS 0xFD76 /end MEASUREMENT
/begin MEASUREMENT B_mnfhsh2 "Kurzschluß Heizung Lambdasonde2 hinter Kat nach Masse" UWORD B_TRUE 1 100 0 1 BIT_MASK 0x20 FORMAT "%13.11" ECU_ADDRESS 0xFD76 /end MEASUREMENT
/begin MEASUREMENT B_mnfhsv "Kurzschluß Heizung Lambdasonde vor Kat nach Masse" UWORD B_TRUE 1 100 0 1 BIT_MASK 0x40 FORMAT "%13.11" ECU_ADDRESS 0xFD76 /end MEASUREMENT
/begin MEASUREMENT B_mnfhsv2 "Kurzschluß Heizung Lambdasonde2 vor Kat nach Masse" UWORD B_TRUE 1 100 0 1 BIT_MASK 0x80 FORMAT "%13.11" ECU_ADDRESS 0xFD76 /end MEASUREMENT
/begin MEASUREMENT B_mnmdb "Fehlertyp min.: Momentanüberwachung begrenzt dauerhaft" UWORD B_TRUE 1 100 0 1 BIT_MASK 0x200 FORMAT "%13.11" ECU_ADDRESS 0x38396E /end MEASUREMENT
/begin MEASUREMENT B_mxfhsh "Kurzschluß Heizung Lambdasonde hinter Kat nach UB" UWORD B_TRUE 1 100 0 1 BIT_MASK 0x100 FORMAT "%13.11" ECU_ADDRESS 0xFD76 /end MEASUREMENT
/begin MEASUREMENT B_mxfhsh2 "Kurzschluß Heizung Lambdasonde2 hinter Kat nach UB" UWORD B_TRUE 1 100 0 1 BIT_MASK 0x200 FORMAT "%13.11" ECU_ADDRESS 0xFD76 /end MEASUREMENT
/begin MEASUREMENT B_mxfhsv "Kurzschluß Heizung Lambdasonde vor Kat nach UB" UWORD B_TRUE 1 100 0 1 BIT_MASK 0x400 FORMAT "%13.11" ECU_ADDRESS 0xFD76 /end MEASUREMENT
/begin MEASUREMENT B_mxfhsv2 "Kurzschluß Heizung Lambdasonde2 vor Kat nach UB" UWORD B_TRUE 1 100 0 1 BIT_MASK 0x800 FORMAT "%13.11" ECU_ADDRESS 0xFD76 /end MEASUREMENT
/begin MEASUREMENT B_mxmdb "Fehlerart: Maximal zulässiges Sollmoment wird dauerhaft überschritten" UWORD B_TRUE 1 100 0 1 BIT_MASK 0x100 FORMAT "%13.11" ECU_ADDRESS 0x38396E /end MEASUREMENT
/begin MEASUREMENT B_nesch "Bedingung Sondenspannung keinen Fehler (no Error) im Schub" UBYTE B_TRUE 1 100 0 1 BIT_MASK 0x8 FORMAT "%13.11" ECU_ADDRESS 0x380C2E /end MEASUREMENT
/begin MEASUREMENT B_nesch2 "Bedingung Sondenspannung keinen Fehler (no Error) im Schub Bank2" UBYTE B_TRUE 1 100 0 1 BIT_MASK 0x10 FORMAT "%13.11" ECU_ADDRESS 0x380C2E /end MEASUREMENT
/begin MEASUREMENT B_nfldp "" UWORD B_TRUE 1 100 0 1 BIT_MASK 0x80 FORMAT "%13.11" ECU_ADDRESS 0xFDCE /end MEASUREMENT
/begin MEASUREMENT B_nolash "Bedingung Diagnosefunktion Schwingungs-Prüfung. i.O.-Meldung beendet." UWORD B_TRUE 1 100 0 1 BIT_MASK 0x1000 FORMAT "%13.11" ECU_ADDRESS 0xFD80 /end MEASUREMENT
/begin MEASUREMENT B_nolash2 "Bedingung Diagnosefunktion Schwingungs-Prüfung. i.O.-Meldung beendet. Bank2" UWORD B_TRUE 1 100 0 1 BIT_MASK 0x2000 FORMAT "%13.11" ECU_ADDRESS 0xFD80 /end MEASUREMENT
/begin MEASUREMENT B_nolatp "Bedingung Diagnosefunktion Perioden-Dauer mit i.O.-Meldung beendet." UWORD B_TRUE 1 100 0 1 BIT_MASK 0x80 FORMAT "%13.11" ECU_ADDRESS 0xFD7C /end MEASUREMENT
/begin MEASUREMENT B_nolatp2 "Bedingung Diagnosefunktion Perioden-Dauer mit i.O.-Meldung beendet. Bank2" UWORD B_TRUE 1 100 0 1 BIT_MASK 0x100 FORMAT "%13.11" ECU_ADDRESS 0xFD7C /end MEASUREMENT
/begin MEASUREMENT B_nolatv "Bedingung Diagnosefunktion ATV-Prüfung mit i.O.-Meldung beendet." UWORD B_TRUE 1 100 0 1 BIT_MASK 0x200 FORMAT "%13.11" ECU_ADDRESS 0xFD7C /end MEASUREMENT
/begin MEASUREMENT B_nolatv2 "Bedingung Diagnosefunktion ATV-Prüfung mit i.O.-Meldung beendet. Bank2" UWORD B_TRUE 1 100 0 1 BIT_MASK 0x400 FORMAT "%13.11" ECU_ADDRESS 0xFD7C /end MEASUREMENT
/begin MEASUREMENT B_nollrflr "Bedingung LLR-Diagnosefunktion mit i.O.-Meldung beendet." UWORD B_TRUE 1 100 0 1 BIT_MASK 0x80 FORMAT "%13.11" ECU_ADDRESS 0xFD9A /end MEASUREMENT
/begin MEASUREMENT B_nolsh "Bedingung Diagnosefunktion mit i.O.-Meldung hinter KAT beendet." UWORD B_TRUE 1 100 0 1 BIT_MASK 0x1000 FORMAT "%13.11" ECU_ADDRESS 0xFD82 /end MEASUREMENT
/begin MEASUREMENT B_nolsh2 "Bedingung Diagnosefunktion mit i.O.-Meldung hinter KAT beendet Bank2" UWORD B_TRUE 1 100 0 1 BIT_MASK 0x2000 FORMAT "%13.11" ECU_ADDRESS 0xFD82 /end MEASUREMENT
/begin MEASUREMENT B_norkam "Bedingung additive Korrektur der Adaption pro Zeit oder Zündung abgeschaltet" UWORD B_TRUE 1 100 0 1 BIT_MASK 0x4 FORMAT "%13.11" ECU_ADDRESS 0xFD96 /end MEASUREMENT
/begin MEASUREMENT B_npfhsh "Nernstwiderstand Sonde hinter Kat zu groß" UWORD B_TRUE 1 100 0 1 BIT_MASK 0x1000 FORMAT "%13.11" ECU_ADDRESS 0xFD76 /end MEASUREMENT
/begin MEASUREMENT B_npfhsh2 "Nernstwiderstand Sonde 2 hinter Kat zu groß" UWORD B_TRUE 1 100 0 1 BIT_MASK 0x2000 FORMAT "%13.11" ECU_ADDRESS 0xFD76 /end MEASUREMENT
/begin MEASUREMENT B_npfhsv "Nernstwiderstand Sonde vor Kat zu groß" UWORD B_TRUE 1 100 0 1 BIT_MASK 0x4000 FORMAT "%13.11" ECU_ADDRESS 0xFD76 /end MEASUREMENT
/begin MEASUREMENT B_npfhsv2 "Nernstwiderstand Sonde 2 vor Kat zu groß" UWORD B_TRUE 1 100 0 1 BIT_MASK 0x8000 FORMAT "%13.11" ECU_ADDRESS 0xFD76 /end MEASUREMENT
/begin MEASUREMENT B_nplflsh "Adernschluß bei Sonde hinter KAT erkannt" UBYTE B_TRUE 1 100 0 1 BIT_MASK 0x40 FORMAT "%13.11" ECU_ADDRESS 0x380C33 /end MEASUREMENT
/begin MEASUREMENT B_nplflsh2 "Adernschluß hinter KAT erkannt Bank2" UBYTE B_TRUE 1 100 0 1 BIT_MASK 0x80 FORMAT "%13.11" ECU_ADDRESS 0x380C33 /end MEASUREMENT
/begin MEASUREMENT B_npmdb "Nicht plausibler Fehler: Momentanüberwachung begrenzt dauerhaft" UWORD B_TRUE 1 100 0 1 BIT_MASK 0x800 FORMAT "%13.11" ECU_ADDRESS 0x38396E /end MEASUREMENT
/begin MEASUREMENT B_plra "Bedingung für Umschaltung DKVS von HFM- auf P-System" UWORD B_TRUE 1 100 0 1 BIT_MASK 0x8 FORMAT "%13.11" ECU_ADDRESS 0xFD96 /end MEASUREMENT
/begin MEASUREMENT B_reads "Bedingung Read-Switch geshlossen: Leckdiagnosepumpe" UWORD B_TRUE 1 100 0 1 BIT_MASK 0x100 FORMAT "%13.11" ECU_ADDRESS 0xFDCE /end MEASUREMENT
/begin MEASUREMENT B_reads_old "" UWORD B_TRUE 1 100 0 1 BIT_MASK 0x200 FORMAT "%13.11" ECU_ADDRESS 0xFDCE /end MEASUREMENT
/begin MEASUREMENT B_risigh "Bedingung Signalunterbrechung Sondenmasse mit Ri-Diagnose hinter KAT" UWORD B_TRUE 1 100 0 1 BIT_MASK 0x4000 FORMAT "%13.11" ECU_ADDRESS 0xFD82 /end MEASUREMENT
/begin MEASUREMENT B_risigh2 "Bedingung Signalunterbrechung Sondenmasse mit Ri-Diagnose hinter KAT Bank2" UWORD B_TRUE 1 100 0 1 BIT_MASK 0x8000 FORMAT "%13.11" ECU_ADDRESS 0xFD82 /end MEASUREMENT
/begin MEASUREMENT B_rkam "Bedingung einer der beiden additiven Bereiche aktiv" UWORD B_TRUE 1 100 0 1 BIT_MASK 0x10 FORMAT "%13.11" ECU_ADDRESS 0xFD96 /end MEASUREMENT
/begin MEASUREMENT B_rkamr "Bedingung rkat oder rkaz außerhalb reduzierter Schwellen" UWORD B_TRUE 1 100 0 1 BIT_MASK 0x20 FORMAT "%13.11" ECU_ADDRESS 0xFD96 /end MEASUREMENT
/begin MEASUREMENT B_rkamr2 "Bedingung rkat2 oder rkaz2 außerhalb reduzierter Schwellen" UWORD B_TRUE 1 100 0 1 BIT_MASK 0x40 FORMAT "%13.11" ECU_ADDRESS 0xFD96 /end MEASUREMENT
/begin MEASUREMENT B_s0w "" UWORD B_TRUE 1 100 0 1 BIT_MASK 0x400 FORMAT "%13.11" ECU_ADDRESS 0xFDCE /end MEASUREMENT
/begin MEASUREMENT B_s2w "" UWORD B_TRUE 1 100 0 1 BIT_MASK 0x800 FORMAT "%13.11" ECU_ADDRESS 0xFDCE /end MEASUREMENT
/begin MEASUREMENT B_sbbhk "Bedingung Sonde betriebsbereit hinter Kat" UWORD B_TRUE 1 100 0 1 BIT_MASK 0x1 FORMAT "%13.11" ECU_ADDRESS 0xFD5A /end MEASUREMENT
/begin MEASUREMENT B_sbbhk2 "Bedingung Sonde betriebsbereit hinter Kat Bank2" UWORD B_TRUE 1 100 0 1 BIT_MASK 0x2 FORMAT "%13.11" ECU_ADDRESS 0xFD5A /end MEASUREMENT
/begin MEASUREMENT B_sifhsh "Lastabfall Sondenheizung hinter Kat" UWORD B_TRUE 1 100 0 1 BIT_MASK 0x1 FORMAT "%13.11" ECU_ADDRESS 0xFD78 /end MEASUREMENT
/begin MEASUREMENT B_sifhsh2 "Lastabfall Sondenheizung2 hinter Kat" UWORD B_TRUE 1 100 0 1 BIT_MASK 0x2 FORMAT "%13.11" ECU_ADDRESS 0xFD78 /end MEASUREMENT
/begin MEASUREMENT B_sifhsv "Lastabfall Sondenheizung vor Kat" UWORD B_TRUE 1 100 0 1 BIT_MASK 0x4 FORMAT "%13.11" ECU_ADDRESS 0xFD78 /end MEASUREMENT
/begin MEASUREMENT B_sifhsv2 "Lastabfall Sondenheizung2 vor Kat" UWORD B_TRUE 1 100 0 1 BIT_MASK 0x8 FORMAT "%13.11" ECU_ADDRESS 0xFD78 /end MEASUREMENT
/begin MEASUREMENT B_sigflsh "Signalunterbrechung (Kabelbruch) Bei Sonde hinter KAT erkannt" UBYTE B_TRUE 1 100 0 1 BIT_MASK 0x10 FORMAT "%13.11" ECU_ADDRESS 0x380C33 /end MEASUREMENT
/begin MEASUREMENT B_sigflsh2 "Signalunterbrechung (Kabelbruch) bei Sonde hinter KAT erkannt Bank2" UBYTE B_TRUE 1 100 0 1 BIT_MASK 0x20 FORMAT "%13.11" ECU_ADDRESS 0x380C33 /end MEASUREMENT
/begin MEASUREMENT B_simdb "Fehlertyp: Momentanüberwachung begrenzt dauerhaft" UWORD B_TRUE 1 100 0 1 BIT_MASK 0x400 FORMAT "%13.11" ECU_ADDRESS 0x38396E /end MEASUREMENT
/begin MEASUREMENT B_slsrdy "Bedingung SLS geprüft für 'ready-Byte'" UBYTE B_TRUE 1 100 0 1 BIT_MASK 0x8 FORMAT "%13.11" ECU_ADDRESS 0x382FFC /end MEASUREMENT
/begin MEASUREMENT B_stage62 "" UWORD B_TRUE 1 100 0 1 BIT_MASK 0x1000 FORMAT "%13.11" ECU_ADDRESS 0xFDCE /end MEASUREMENT
/begin MEASUREMENT B_steigm "Bedingung Steigung des Sondensignals messen hinter KAT" UWORD B_TRUE 1 100 0 1 BIT_MASK 0x4000 FORMAT "%13.11" ECU_ADDRESS 0xFD80 /end MEASUREMENT
/begin MEASUREMENT B_steigm2 "Bedingung Steigung des Sondensignals messen Bank2" UWORD B_TRUE 1 100 0 1 BIT_MASK 0x8000 FORMAT "%13.11" ECU_ADDRESS 0xFD80 /end MEASUREMENT
/begin MEASUREMENT B_stend_old "" UWORD B_TRUE 1 100 0 1 BIT_MASK 0x2000 FORMAT "%13.11" ECU_ADDRESS 0xFDCE /end MEASUREMENT
/begin MEASUREMENT B_stldp "Abbruchbedingung für DLDP erfüllt" UWORD B_TRUE 1 100 0 1 BIT_MASK 0x4000 FORMAT "%13.11" ECU_ADDRESS 0xFDCE /end MEASUREMENT
/begin MEASUREMENT B_stldpv "Vorläufige Abbruchbedingung erfüllt" UWORD B_TRUE 1 100 0 1 BIT_MASK 0x8000 FORMAT "%13.11" ECU_ADDRESS 0xFDCE /end MEASUREMENT
/begin MEASUREMENT B_stldpv1 "" UWORD B_TRUE 1 100 0 1 BIT_MASK 0x1 FORMAT "%13.11" ECU_ADDRESS 0xFDD0 /end MEASUREMENT
/begin MEASUREMENT B_stldpv2 "" UWORD B_TRUE 1 100 0 1 BIT_MASK 0x2 FORMAT "%13.11" ECU_ADDRESS 0xFDD0 /end MEASUREMENT
/begin MEASUREMENT B_stldpv3 "" UWORD B_TRUE 1 100 0 1 BIT_MASK 0x4 FORMAT "%13.11" ECU_ADDRESS 0xFDD0 /end MEASUREMENT
/begin MEASUREMENT B_stldpvff "" UWORD B_TRUE 1 100 0 1 BIT_MASK 0x8 FORMAT "%13.11" ECU_ADDRESS 0xFDD0 /end MEASUREMENT
/begin MEASUREMENT B_szkat "Zykluszeit und Fehler in einer Bank abgelaufen" UWORD B_TRUE 1 100 0 1 BIT_MASK 0x100 FORMAT "%13.11" ECU_ADDRESS 0xFD7A /end MEASUREMENT
/begin MEASUREMENT B_szkat2 "Zykluszeit und Fehler in Bank2 abgelaufen" UWORD B_TRUE 1 100 0 1 BIT_MASK 0x200 FORMAT "%13.11" ECU_ADDRESS 0xFD7A /end MEASUREMENT
/begin MEASUREMENT B_taakt "Bedingung TANS-Monitor aktualisiert" UWORD B_TRUE 1 100 0 1 BIT_MASK 0x10 FORMAT "%13.11" ECU_ADDRESS 0xFDD0 /end MEASUREMENT
/begin MEASUREMENT B_tank "Bedingung Tankvorgang" UBYTE B_TRUE 1 100 0 1 BIT_MASK 0x2 FORMAT "%13.11" ECU_ADDRESS 0x380D5A /end MEASUREMENT
/begin MEASUREMENT B_tankab "Bedingung Tankinhalt hat abgenommen" UWORD B_TRUE 1 100 0 1 BIT_MASK 0x100 FORMAT "%13.11" ECU_ADDRESS 0x382628 /end MEASUREMENT
/begin MEASUREMENT B_tankdy "Bedingung Fuellstandsdynamik infolge Tankvorgang" UWORD B_TRUE 1 100 0 1 BIT_MASK 0x200 FORMAT "%13.11" ECU_ADDRESS 0x382628 /end MEASUREMENT
/begin MEASUREMENT B_tankend "Bedingung Tankvorgang beendet" UWORD B_TRUE 1 100 0 1 BIT_MASK 0x400 FORMAT "%13.11" ECU_ADDRESS 0x382628 /end MEASUREMENT
/begin MEASUREMENT B_tankg "Betankungsbit gueltig" UWORD B_TRUE 1 100 0 1 BIT_MASK 0x4000 FORMAT "%13.11" ECU_ADDRESS 0x382628 /end MEASUREMENT
/begin MEASUREMENT B_tankzu "Bedingung Tankinhalt hat zugenommen" UWORD B_TRUE 1 100 0 1 BIT_MASK 0x800 FORMAT "%13.11" ECU_ADDRESS 0x382628 /end MEASUREMENT
/begin MEASUREMENT B_taref "Bedingung TANS-Monitor innerhalb Grenzwerten" UWORD B_TRUE 1 100 0 1 BIT_MASK 0x20 FORMAT "%13.11" ECU_ADDRESS 0xFDD0 /end MEASUREMENT
/begin MEASUREMENT B_tatumgok "" UWORD B_TRUE 1 100 0 1 BIT_MASK 0x40 FORMAT "%13.11" ECU_ADDRESS 0xFDD0 /end MEASUREMENT
/begin MEASUREMENT B_teilerbit "" UWORD B_TRUE 1 100 0 1 BIT_MASK 0x80 FORMAT "%13.11" ECU_ADDRESS 0xFDD0 /end MEASUREMENT
/begin MEASUREMENT B_teslash "Bedingung Test ausführen für Überprüfung Sonde hinter KAT" UWORD B_TRUE 1 100 0 1 BIT_MASK 0x1 FORMAT "%13.11" ECU_ADDRESS 0xFD82 /end MEASUREMENT
/begin MEASUREMENT B_teslash2 "Bedingung Test ausführen für Überprüfung Sonde hinter KAT Bank2" UWORD B_TRUE 1 100 0 1 BIT_MASK 0x2 FORMAT "%13.11" ECU_ADDRESS 0xFD82 /end MEASUREMENT
/begin MEASUREMENT B_tesrdy "Bedingung TES geprüft für 'ready-Byte'" UBYTE B_TRUE 1 100 0 1 BIT_MASK 0x4 FORMAT "%13.11" ECU_ADDRESS 0x382FFC /end MEASUREMENT
/begin MEASUREMENT B_timrs "Flag Zeitstufe TIMRS läuft" UWORD B_TRUE 1 100 0 1 BIT_MASK 0x100 FORMAT "%13.11" ECU_ADDRESS 0xFDD0 /end MEASUREMENT
/begin MEASUREMENT B_tlablp "Abbruch DLDP bei Überschreitung tl-Schwelle möglich" UWORD B_TRUE 1 100 0 1 BIT_MASK 0x200 FORMAT "%13.11" ECU_ADDRESS 0xFDD0 /end MEASUREMENT
/begin MEASUREMENT B_tlxldp "Lastschwelle überschritten" UWORD B_TRUE 1 100 0 1 BIT_MASK 0x400 FORMAT "%13.11" ECU_ADDRESS 0xFDD0 /end MEASUREMENT
/begin MEASUREMENT B_tmabs "Differenz Motorabstelltemperatur - TMOT bei Start erkannt" UWORD B_TRUE 1 100 0 1 BIT_MASK 0x800 FORMAT "%13.11" ECU_ADDRESS 0xFDD0 /end MEASUREMENT
/begin MEASUREMENT B_tpldp "" UWORD B_TRUE 1 100 0 1 BIT_MASK 0x1000 FORMAT "%13.11" ECU_ADDRESS 0xFDD0 /end MEASUREMENT
/begin MEASUREMENT B_trfash "Bedingung Kurztrip einleiten für Schwingungsprüfung Sonde hinter KAT" UWORD B_TRUE 1 100 0 1 BIT_MASK 0x4 FORMAT "%13.11" ECU_ADDRESS 0xFD82 /end MEASUREMENT
/begin MEASUREMENT B_trfash2 "Bedingung Kurztrip einleiten für Schwingungsprüfung Sonde hinter KAT Bank2" UWORD B_TRUE 1 100 0 1 BIT_MASK 0x8 FORMAT "%13.11" ECU_ADDRESS 0xFD82 /end MEASUREMENT
/begin MEASUREMENT B_trig "Bedingung für Umschaltung der Verstärkerstufen und Skalierung des Referenzpegels" UWORD B_TRUE 1 100 0 1 BIT_MASK 0x400 FORMAT "%13.11" ECU_ADDRESS 0xFD7A /end MEASUREMENT
/begin MEASUREMENT B_trig2 "" UWORD B_TRUE 1 100 0 1 BIT_MASK 0x800 FORMAT "%13.11" ECU_ADDRESS 0xFD7A /end MEASUREMENT
/begin MEASUREMENT B_trsah "Bedingung Kabelbruch für Sonde hinter KAT" UBYTE B_TRUE 1 100 0 1 BIT_MASK 0x10 FORMAT "%13.11" ECU_ADDRESS 0x380C34 /end MEASUREMENT
/begin MEASUREMENT B_trsah2 "Bedingung Kabelbruch für Sonde hinter KAT, Bank 2" UBYTE B_TRUE 1 100 0 1 BIT_MASK 0x20 FORMAT "%13.11" ECU_ADDRESS 0x380C34 /end MEASUREMENT
/begin MEASUREMENT B_ttbmhh "Bedingung theoretische Sondenbetriebsbereitschaft hinter KAT mit Heizung" UWORD B_TRUE 1 100 0 1 BIT_MASK 0x1 FORMAT "%13.11" ECU_ADDRESS 0xFD84 /end MEASUREMENT
/begin MEASUREMENT B_ttbmhh2 "Bedingung theoretische Sondenbetriebsbereitschaft hinter KAT mit Heizung Bank2" UWORD B_TRUE 1 100 0 1 BIT_MASK 0x2 FORMAT "%13.11" ECU_ADDRESS 0xFD84 /end MEASUREMENT
/begin MEASUREMENT B_tuspn "Bedingung für Übernahme der Halbperiode (Zeit zw. pos. und neg. Flanke)" UBYTE B_TRUE 1 100 0 1 BIT_MASK 0x1 FORMAT "%13.11" ECU_ADDRESS 0x380CAA /end MEASUREMENT
/begin MEASUREMENT B_tuspn2 "Bedingung für Übernahme der Halbperiode (Zeit zw. pos. und neg. Flanke) Bank2" UBYTE B_TRUE 1 100 0 1 BIT_MASK 0x4 FORMAT "%13.11" ECU_ADDRESS 0x380CAA /end MEASUREMENT
/begin MEASUREMENT B_tusre "Bedingung Resultat für gefilterte Halbperiode für Sonde vor KAT" UBYTE B_TRUE 1 100 0 1 BIT_MASK 0x2 FORMAT "%13.11" ECU_ADDRESS 0x380CAA /end MEASUREMENT
/begin MEASUREMENT B_tusre2 "Bedingung Resultat für gefilterte Halbperiode für Sonde vor KAT Bank2" UBYTE B_TRUE 1 100 0 1 BIT_MASK 0x8 FORMAT "%13.11" ECU_ADDRESS 0x380CAA /end MEASUREMENT
/begin MEASUREMENT B_tvdkat "Bedingung Verzögerungszeit DKAT-Sperrung noch nicht abgelaufen" UWORD B_TRUE 1 100 0 1 BIT_MASK 0x1000 FORMAT "%13.11" ECU_ADDRESS 0xFD7A /end MEASUREMENT
/begin MEASUREMENT B_ueinh "Beding. Vorbereitung z. Einsch. d. Sondenbetriebsbereitschaft hinter KAT" UBYTE B_TRUE 1 100 0 1 BIT_MASK 0x1 FORMAT "%13.11" ECU_ADDRESS 0x380C34 /end MEASUREMENT
/begin MEASUREMENT B_ueinh2 "Beding. Vorbereitung z. Einsch. d. Sondenbetriebsbereitschaft hinter KAT Bank2" UBYTE B_TRUE 1 100 0 1 BIT_MASK 0x2 FORMAT "%13.11" ECU_ADDRESS 0x380C34 /end MEASUREMENT
/begin MEASUREMENT B_uhsig "Bedingung Sondenspannung hinter KAT im Spannungsband für Signalunterbrechung" UBYTE B_TRUE 1 100 0 1 BIT_MASK 0x4 FORMAT "%13.11" ECU_ADDRESS 0x380C34 /end MEASUREMENT
/begin MEASUREMENT B_uhsig2 "Bedingung Sondenspg. hinter KAT im Spannungsband für Signalunterbrechung Bank2" UBYTE B_TRUE 1 100 0 1 BIT_MASK 0x8 FORMAT "%13.11" ECU_ADDRESS 0x380C34 /end MEASUREMENT
/begin MEASUREMENT B_ushkf "Bedingung Sondenspannung hinter Kat ""Fett"" (Sollwert überschritten)" UWORD B_TRUE 1 100 0 1 BIT_MASK 0x10 FORMAT "%13.11" ECU_ADDRESS 0xFD82 /end MEASUREMENT
/begin MEASUREMENT B_ushkf2 "Bedingung Sondenspannung hinter KAT ""Fett"" (Sollwert überschritten) Bank2" UWORD B_TRUE 1 100 0 1 BIT_MASK 0x20 FORMAT "%13.11" ECU_ADDRESS 0xFD82 /end MEASUREMENT
/begin MEASUREMENT B_ushkm "Bedingung Sondenspannung hinter KAT ""Mager"" (Sollwert unterschritten)" UWORD B_TRUE 1 100 0 1 BIT_MASK 0x40 FORMAT "%13.11" ECU_ADDRESS 0xFD82 /end MEASUREMENT
/begin MEASUREMENT B_ushkm2 "Bedingung Sondenspannung hinter KAT ""Mager"" (Sollwert unterschritten) Bank2" UWORD B_TRUE 1 100 0 1 BIT_MASK 0x80 FORMAT "%13.11" ECU_ADDRESS 0xFD82 /end MEASUREMENT
/begin MEASUREMENT B_ushsch "Bed. Schwelle für Sonde h. KAT im Schub nicht unterschritten `statichisch`" UBYTE B_TRUE 1 100 0 1 BIT_MASK 0x4 FORMAT "%13.11" ECU_ADDRESS 0x383105 /end MEASUREMENT
/begin MEASUREMENT B_ushsch2 "Bed. Schwelle für Sonde h. KAT im Schub nicht unterschritten `statisch` Bank2" UBYTE B_TRUE 1 100 0 1 BIT_MASK 0x8 FORMAT "%13.11" ECU_ADDRESS 0x383105 /end MEASUREMENT
/begin MEASUREMENT B_zkatb "Bankspezifische Zykluszeit für MODE 6" UWORD B_TRUE 1 100 0 1 BIT_MASK 0x2000 FORMAT "%13.11" ECU_ADDRESS 0xFD7A /end MEASUREMENT
/begin MEASUREMENT B_zkatb2 "Bankspezifische Zykluszeit für MODE 6 (stereo 2.Bank)" UWORD B_TRUE 1 100 0 1 BIT_MASK 0x4000 FORMAT "%13.11" ECU_ADDRESS 0xFD7A /end MEASUREMENT
/begin MEASUREMENT B_zkats "Zykluszeit für eine Bank abgelaufen" UWORD B_TRUE 1 100 0 1 BIT_MASK 0x8000 FORMAT "%13.11" ECU_ADDRESS 0xFD7A /end MEASUREMENT
/begin MEASUREMENT B_zkats2 "Zykluszeit für 2. Bank abgelaufen" UWORD B_TRUE 1 100 0 1 BIT_MASK 0x1 FORMAT "%13.11" ECU_ADDRESS 0xFD7C /end MEASUREMENT
/begin MEASUREMENT B_zkatz "Bedinging für Summenfehler im MODE 6" UWORD B_TRUE 1 100 0 1 BIT_MASK 0x2 FORMAT "%13.11" ECU_ADDRESS 0xFD7C /end MEASUREMENT
/begin MEASUREMENT B_zkatz2 "Bedingung für Summenfehler im MODE 6 (Stereo 2.Bank)" UWORD B_TRUE 1 100 0 1 BIT_MASK 0x4 FORMAT "%13.11" ECU_ADDRESS 0xFD7C /end MEASUREMENT
/begin MEASUREMENT B_zldp "" UWORD B_TRUE 1 100 0 1 BIT_MASK 0x2000 FORMAT "%13.11" ECU_ADDRESS 0xFDD0 /end MEASUREMENT
/begin MEASUREMENT B_ztesb "" UWORD B_TRUE 1 100 0 1 BIT_MASK 0x4000 FORMAT "%13.11" ECU_ADDRESS 0xFDD0 /end MEASUREMENT
/begin MEASUREMENT B_ztesk "Interne Bedingung Prüfung auf Kleinstleck abgeschlossen" UWORD B_TRUE 1 100 0 1 BIT_MASK 0x8000 FORMAT "%13.11" ECU_ADDRESS 0xFDD0 /end MEASUREMENT
/begin MEASUREMENT cpukor_w "" UWORD p_uw_q0p039 1 100 0 2559.96 FORMAT "%8.3" ARRAY_SIZE 6 ECU_ADDRESS 0x3826B2 /end MEASUREMENT
/begin MEASUREMENT cryhs "Counter für Readinessbildung Sondenheizungs-Diagnose" UBYTE dez 1 100 0 255 FORMAT "%5.1" ECU_ADDRESS 0x382FF7 /end MEASUREMENT
/begin MEASUREMENT crykat "Counter für Readinessbildung Katalysator-Diagnose" UBYTE dez 1 100 0 255 FORMAT "%5.1" ECU_ADDRESS 0x382FF8 /end MEASUREMENT
/begin MEASUREMENT cryls "Counter für Readinessbildung Lambdasonden-Diagnose" UBYTE dez 1 100 0 255 FORMAT "%5.1" ECU_ADDRESS 0x382FF9 /end MEASUREMENT
/begin MEASUREMENT crysls "Counter für Readinessbildung Sekundärluft-Diagnose" UBYTE dez 1 100 0 255 FORMAT "%5.1" ECU_ADDRESS 0x382FFA /end MEASUREMENT
/begin MEASUREMENT crytes "Counter für Readinessbildung Tankentlüftungs-Diagnose" UBYTE dez 1 100 0 255 FORMAT "%5.1" ECU_ADDRESS 0x382FFB /end MEASUREMENT
/begin MEASUREMENT dfskv_w "Differenz verbrauchter Kraftstoff - Fuellstandsdifferenz" SWORD vol_q3p90625Em3_l 1 100 -128 127.996 FORMAT "%8.4" ECU_ADDRESS 0x382612 /end MEASUREMENT
/begin MEASUREMENT dfstigof_w "Differenz Fuellstand nach Start" SWORD vol_q0p1_l 1 100 -3276.8 3276.7 FORMAT "%8.3" ECU_ADDRESS 0x382614 /end MEASUREMENT
/begin MEASUREMENT dfstigo_w "Differenz Fuellstand bei Fahrzeughalt" SWORD vol_q0p1_l 1 100 -3276.8 3276.7 FORMAT "%8.3" ECU_ADDRESS 0x382616 /end MEASUREMENT
/begin MEASUREMENT DFSTTbits "" UWORD dez 1 100 0 65535 FORMAT "%8.2" ECU_ADDRESS 0x382628 /end MEASUREMENT
/begin MEASUREMENT DFSTTbits2 "" UBYTE dez 1 100 0 255 FORMAT "%5.1" ECU_ADDRESS 0x380D5A /end MEASUREMENT
/begin MEASUREMENT DFSTTBUFRAM "" UBYTE dez 1 100 0 255 FORMAT "%5.1" ECU_ADDRESS 0x383131 /end MEASUREMENT
/begin MEASUREMENT dfstt_w "Differenz Fuellstand Kraftstofftank" SWORD vol_q3p90625Em3_l 1 100 -128 127.996 FORMAT "%8.4" ECU_ADDRESS 0x382618 /end MEASUREMENT
/begin MEASUREMENT dkatakt2_w "aktive Überwachungszeit für DKAT (Steroe 2.Bank)" UWORD t50msxs_uw_b3276p75 1 100 0 3276.75 FORMAT "%8.3" ECU_ADDRESS 0x381EE8 /end MEASUREMENT
/begin MEASUREMENT dkatakt_w "aktive Überwachungszeit für DKAT" UWORD t50msxs_uw_b3276p75 1 100 0 3276.75 FORMAT "%8.3" ECU_ADDRESS 0x381EEA /end MEASUREMENT
/begin MEASUREMENT dkvbigo_w "Differenz Verbrauch bei Fahrzeughalt" UWORD vol_q3p90625Em3_l 1 100 0 255.996 FORMAT "%8.4" ECU_ADDRESS 0x38261A /end MEASUREMENT
/begin MEASUREMENT dkvb_w "Differenz verbrauchter Kraftstoff" UWORD vol_q3p90625Em3_l 1 100 0 255.996 FORMAT "%8.4" ECU_ADDRESS 0x38261C /end MEASUREMENT
/begin MEASUREMENT DKVSbits "" UBYTE dez 1 100 0 255 FORMAT "%5.1" ECU_ADDRESS 0x38311E /end MEASUREMENT
/begin MEASUREMENT DldpNvBits "" UBYTE dez 1 100 0 255 FORMAT "%5.1" ECU_ADDRESS 0x38314E /end MEASUREMENT
/begin MEASUREMENT DLSHbits "" UBYTE dez 1 100 0 255 FORMAT "%5.1" ECU_ADDRESS 0x382FFD /end MEASUREMENT
/begin MEASUREMENT DLSHerrors "" UBYTE dez 1 100 0 255 FORMAT "%5.1" ECU_ADDRESS 0x380C33 /end MEASUREMENT
/begin MEASUREMENT DLSHintbits "" UBYTE dez 1 100 0 255 FORMAT "%5.1" ECU_ADDRESS 0x380C34 /end MEASUREMENT
/begin MEASUREMENT dlssabits "" UBYTE dez 1 100 0 255 FORMAT "%5.1" ECU_ADDRESS 0x380CAA /end MEASUREMENT
/begin MEASUREMENT dmrdkt_w "Momenten-Reserve für Katalysatordiagnose" UWORD rel_uw_b100 1 100 0 99.9985 FORMAT "%8.5" ECU_ADDRESS 0x38116A /end MEASUREMENT
/begin MEASUREMENT dmrlash_w "Momenten-Reserve für Lambdasonden-Alterungsüberwachung hinter Kat" UWORD rel_uw_b100 1 100 0 99.9985 FORMAT "%8.5" ECU_ADDRESS 0x381F3A /end MEASUREMENT
/begin MEASUREMENT dmrlsh_w "Momenten-Reserve für Sondendiagnose hinter Kat" UWORD rel_uw_b100 1 100 0 99.9985 FORMAT "%8.5" ECU_ADDRESS 0x38117A /end MEASUREMENT
/begin MEASUREMENT dpubab_w "Umgebungsdruckgradient aus pukor_w berechnet" UWORD p_uw_q0p039 1 100 0 2559.96 FORMAT "%8.3" ECU_ADDRESS 0x3826BE /end MEASUREMENT
/begin MEASUREMENT dpukordh_w "" UWORD p_uw_q0p039 1 100 0 2559.96 FORMAT "%8.3" ECU_ADDRESS 0x3826C0 /end MEASUREMENT
/begin MEASUREMENT esst_sdk08feuw "" UWORD dez 1 100 0 65535 FORMAT "%8.2" ECU_ADDRESS 0x38216C /end MEASUREMENT
/begin MEASUREMENT esst_snm08feuw "" UWORD dez 1 100 0 65535 FORMAT "%8.2" ECU_ADDRESS 0x38216E /end MEASUREMENT
/begin MEASUREMENT evsup1 "Funktionskennungsbyte für Ausgabe SAE J1979 Mode2" UBYTE dez 1 100 0 255 FORMAT "%5.1" ECU_ADDRESS 0x380AD5 /end MEASUREMENT
/begin MEASUREMENT E_aav "Errorflag: Absperrventil Aktivkohlefilter (Funktion)" UWORD B_TRUE 1 100 0 1 BIT_MASK 0x1 FORMAT "%13.11" ECU_ADDRESS 0x3838AA /end MEASUREMENT
/begin MEASUREMENT E_agre "Errorflag: Überwachung AGR-Endstufe" UWORD B_TRUE 1 100 0 1 BIT_MASK 0x1 FORMAT "%13.11" ECU_ADDRESS 0x3838AE /end MEASUREMENT
/begin MEASUREMENT E_agrf "Errorflag: Überwachung AGR-FLOW" UWORD B_TRUE 1 100 0 1 BIT_MASK 0x1 FORMAT "%13.11" ECU_ADDRESS 0x3838B0 /end MEASUREMENT
/begin MEASUREMENT E_dss "Errorflag: Saugrohr-Drucksensor" UWORD B_TRUE 1 100 0 1 BIT_MASK 0x1 FORMAT "%13.11" ECU_ADDRESS 0x3838D8 /end MEASUREMENT
/begin MEASUREMENT E_mdb "Errorflag: Momentenüberwachung begrenzt dauerhaft" UWORD B_TRUE 1 100 0 1 BIT_MASK 0x1 FORMAT "%13.11" ECU_ADDRESS 0x38396E /end MEASUREMENT
/begin MEASUREMENT E_tesf "Errorflag: Tankentlüftungssystem Feinleck" UWORD B_TRUE 1 100 0 1 BIT_MASK 0x1 FORMAT "%13.11" ECU_ADDRESS 0x3839A4 /end MEASUREMENT
/begin MEASUREMENT E_teve2 "Errorflag: Tankentlüftungsventil Endstufe, Bank 2" UWORD B_TRUE 1 100 0 1 BIT_MASK 0x1 FORMAT "%13.11" ECU_ADDRESS 0x3839AA /end MEASUREMENT
/begin MEASUREMENT fahkatkm_w "Faktor Signalkorrektur Abhängig über kmstand" UWORD fak_uw_b2 1 100 0 1.99997 FORMAT "%8.6" ECU_ADDRESS 0x38116C /end MEASUREMENT
/begin MEASUREMENT falrdkt "Anforderung Katdiagnose: Modifikation der Lambdregelungsamplitude" UBYTE fak_ub_b8 1 100 0 7.96875 FORMAT "%5.3" ECU_ADDRESS 0x380A19 /end MEASUREMENT
/begin MEASUREMENT frauzs2_w "multipl. Gemischadaptionsfaktor unterer mult. Bereich (Stereo)" UWORD fak_uw_b2 1 100 0 1.99997 FORMAT "%8.6" ECU_ADDRESS 0x3821F4 /end MEASUREMENT
/begin MEASUREMENT frauzs_w "multiplikativer Gemischadaptionsfaktor unterer mult. Bereich (alter Wert)" UWORD fak_uw_b2 1 100 0 1.99997 FORMAT "%8.6" ECU_ADDRESS 0x3821F6 /end MEASUREMENT
/begin MEASUREMENT frmtrip2_w "Mittelwert des Lambdaregelfaktors für Kurztrip Schwingungsprüfung h. KAT Bank2" UWORD fak_uw_b2 1 100 0 1.99997 FORMAT "%8.6" ECU_ADDRESS 0x381F3C /end MEASUREMENT
/begin MEASUREMENT frmtrip_w "Mittelwert des Lambdaregelfaktors für Kurztrip Schwingungsprüfung hinter KAT" UWORD fak_uw_b2 1 100 0 1.99997 FORMAT "%8.6" ECU_ADDRESS 0x381F3E /end MEASUREMENT
/begin MEASUREMENT fstakt_w "aktueller Tankfuellstand" UWORD vol_q0p1_l 1 100 0 6553.5 FORMAT "%8.3" ECU_ADDRESS 0x38261E /end MEASUREMENT
/begin MEASUREMENT fstalt_w "Fuellstand bei Zuendung aus" UWORD vol_q0p1_l 1 100 0 6553.5 FORMAT "%8.3" ECU_ADDRESS 0x383E8A /end MEASUREMENT
/begin MEASUREMENT fsthin_w "Tankfuellstand bei Fahrzeug-Halt" UWORD vol_q0p1_l 1 100 0 6553.5 FORMAT "%8.3" ECU_ADDRESS 0x382620 /end MEASUREMENT
/begin MEASUREMENT fstneu_w "Fuellstand bei Start" UWORD vol_q0p1_l 1 100 0 6553.5 FORMAT "%8.3" ECU_ADDRESS 0x382622 /end MEASUREMENT
/begin MEASUREMENT fsttin_w "Fulelstandsinitialwert fuer Diagnosezyklus" UWORD vol_q0p1_l 1 100 0 6553.5 FORMAT "%8.3" ECU_ADDRESS 0x383E8C /end MEASUREMENT
/begin MEASUREMENT imlkvszs_w "Zwischenspeicher: Luftmasse nach Auftreten eines DKVS Fehles bei leerem Tank" UWORD m_q0p00355 1 100 0 233.013 FORMAT "%8.4" ECU_ADDRESS 0x3839FC /end MEASUREMENT
/begin MEASUREMENT imlkvs_w "Luftmasse nach Auftreten eines DKVS Fehles bei leerem Tank" UWORD m_q0p00355 1 100 0 233.013 FORMAT "%8.4" ECU_ADDRESS 0x3821F8 /end MEASUREMENT
/begin MEASUREMENT katbf "Signal nach Speicher normiert vergleichbar mit ushk" UBYTE spg_ub_q0p0052_o0p2 1 100 -0.2 1.13 FORMAT "%5.3" ECU_ADDRESS 0x380C1F /end MEASUREMENT
/begin MEASUREMENT katbf2 "Signal nach Speicher normiert vergleichbar mit ushk2 (stereo 2.Bank)" UBYTE spg_ub_q0p0052_o0p2 1 100 -0.2 1.13 FORMAT "%5.3" ECU_ADDRESS 0x380C20 /end MEASUREMENT
/begin MEASUREMENT katbfi2_w "Sauerstoff-Anteil vor dem Speicher (Kat-Modell Stereo 2.Bank)" SWORD freq_sw_b512 1 100 -512 511.984 FORMAT "%8.4" ECU_ADDRESS 0x381EEC /end MEASUREMENT
/begin MEASUREMENT katbfi_w "Sauerstoff-Anteil vor dem Speicher (Kat-Modell)" SWORD freq_sw_b512 1 100 -512 511.984 FORMAT "%8.4" ECU_ADDRESS 0x381EEE /end MEASUREMENT
/begin MEASUREMENT katbfs "Signal nach Speicher (Kat-Modell)" SBYTE fak_sb_b1 1 100 -1 0.992188 FORMAT "%5.3" ECU_ADDRESS 0x380C21 /end MEASUREMENT
/begin MEASUREMENT katbfs2 "Signal nach Speicher (Kat-Modell, Stereo 2.Bank)" SBYTE fak_sb_b1 1 100 -1 0.992188 FORMAT "%5.3" ECU_ADDRESS 0x380C22 /end MEASUREMENT
/begin MEASUREMENT katbftp "Signal nach Speicher normiert, tiefpaßgefiltert" UBYTE spg_ub_q0p0052 1 100 0 1.33 FORMAT "%5.3" ECU_ADDRESS 0x380C23 /end MEASUREMENT
/begin MEASUREMENT katbftp2 "Signal nach Speicher normiert, tiefpaßgefiltert (Bank2)" UBYTE spg_ub_q0p0052 1 100 0 1.33 FORMAT "%5.3" ECU_ADDRESS 0x380C24 /end MEASUREMENT
/begin MEASUREMENT katbshd2_w "Signal für Fett-Verschiebung des Modells (Bank2)" SWORD mgrad_sw_b28p44 1 100 -28.4444 28.4436 FORMAT "%8.5" ECU_ADDRESS 0x381EF0 /end MEASUREMENT
/begin MEASUREMENT katbshd_w "Signal für Fett-Verschiebung des Modells" SWORD mgrad_sw_b28p44 1 100 -28.4444 28.4436 FORMAT "%8.5" ECU_ADDRESS 0x381EF2 /end MEASUREMENT
/begin MEASUREMENT kbdkt2_w "Katbelastungssignal, Bank2" SWORD mgrad_sw_b28p44 1 100 -28.4444 28.4436 FORMAT "%8.5" ECU_ADDRESS 0x381EF4 /end MEASUREMENT
/begin MEASUREMENT kbdkt_w "Katbelastungssignal" SWORD mgrad_sw_b28p44 1 100 -28.4444 28.4436 FORMAT "%8.5" ECU_ADDRESS 0x381EF6 /end MEASUREMENT
/begin MEASUREMENT kvbadd_w "verbrauchter Kraftstoff im letzten Fahrzyklus" UWORD vol_q3p90625Em3_l 1 100 0 255.996 FORMAT "%8.4" ECU_ADDRESS 0x382624 /end MEASUREMENT
/begin MEASUREMENT kvbakt_w "aktueller verbrauchter Kraftstoff" UWORD vol_q3p90625Em3_l 1 100 0 255.996 FORMAT "%8.4" ECU_ADDRESS 0x383E8E /end MEASUREMENT
/begin MEASUREMENT kvbres_w "verbrauchter Kraftstoff für Diagnose-Reset" UWORD vol_q3p90625Em3_l 1 100 0 255.996 FORMAT "%8.4" ECU_ADDRESS 0x382626 /end MEASUREMENT
/begin MEASUREMENT lamelsh2_w "Lambdasoll für elektrische Sondendiagnose hinter KAT (Kurztrip), Bank 2" UWORD fak_uw_b16 1 100 0 15.9998 FORMAT "%8.5" ECU_ADDRESS 0x3811C2 /end MEASUREMENT
/begin MEASUREMENT lamelsh_w "Lambdasoll für elektrische Sondendiagnose hinter KAT (Kurztrip)" UWORD fak_uw_b16 1 100 0 15.9998 FORMAT "%8.5" ECU_ADDRESS 0x3811C4 /end MEASUREMENT
/begin MEASUREMENT lamfrm2_w "Lambdaabweichung aus Mittelwert Lambdaregelfaktor Bank2" UWORD fak_uw_b16 1 100 0 15.9998 FORMAT "%8.5" ECU_ADDRESS 0x381F40 /end MEASUREMENT
/begin MEASUREMENT lamfrm_w "Lambdaabweichung aus Mittelwert Lambdaregelfaktor" UWORD fak_uw_b16 1 100 0 15.9998 FORMAT "%8.5" ECU_ADDRESS 0x381F42 /end MEASUREMENT
/begin MEASUREMENT lamlash2_w "Lambdasoll für Test Schwingungsprüfung hinter KAT Bank2" UWORD fak_uw_b16 1 100 0 15.9998 FORMAT "%8.5" ECU_ADDRESS 0x381F44 /end MEASUREMENT
/begin MEASUREMENT lamlash_w "Lambdasoll für Test Schwingungsprüfung hinter KAT" UWORD fak_uw_b16 1 100 0 15.9998 FORMAT "%8.5" ECU_ADDRESS 0x381F46 /end MEASUREMENT
/begin MEASUREMENT LokBits1 "" UBYTE dez 1 100 0 255 FORMAT "%5.1" ECU_ADDRESS 0x380C2E /end MEASUREMENT
/begin MEASUREMENT mldmn_w "minimale Luftmasse aus Kennfeld KFMLDMN" SWORD m_q0p1 1 100 -3276.8 3276.7 FORMAT "%8.3" ECU_ADDRESS 0x382170 /end MEASUREMENT
/begin MEASUREMENT mldmx_w "maximale Luftmasse aus Kennfeld KFMLDMX" UWORD m_q0p1 1 100 0 6553.5 FORMAT "%8.3" ECU_ADDRESS 0x382172 /end MEASUREMENT
/begin MEASUREMENT mldpkd_h "" UWORD dldp_uw_b2p33 1 100 0 2.33013 FORMAT "%8.6" ECU_ADDRESS 0x3826C4 /end MEASUREMENT
/begin MEASUREMENT mldpkd_l "" UWORD dez 1 100 0 65535 FORMAT "%8.2" ECU_ADDRESS 0x3826C6 /end MEASUREMENT
/begin MEASUREMENT mldyn_w "Luftmassenintegral im Schubbetrieb für Sonde hinter Kat" UWORD m_q0p00277 1 100 0 182.042 FORMAT "%8.4" ECU_ADDRESS 0x381F48 /end MEASUREMENT
/begin MEASUREMENT mlhfmf_w "gefilterter Luftmassen HFM-Mittelwert 16Bit-Wert" UWORD m_q0p1 1 100 0 6553.5 FORMAT "%8.3" ECU_ADDRESS 0x382174 /end MEASUREMENT
/begin MEASUREMENT NovBits "" UBYTE dez 1 100 0 255 FORMAT "%5.1" ECU_ADDRESS 0x383105 /end MEASUREMENT
/begin MEASUREMENT phlsnhf "normierte Heizleistung der Lambdasonde hinter Kat, gefiltert" UBYTE fak_ub_q0p01 1 100 0 2.55 FORMAT "%5.3" ECU_ADDRESS 0x380C08 /end MEASUREMENT
/begin MEASUREMENT phlsnhf2 "normierte Heizleistung der Lambdasonde 2 hinter Kat, gefiltert" UBYTE fak_ub_q0p01 1 100 0 2.55 FORMAT "%5.3" ECU_ADDRESS 0x380C09 /end MEASUREMENT
/begin MEASUREMENT phlsnvf "normierte Heizleistung der Lambdasonde vor Kat, gefiltert" UBYTE fak_ub_q0p01 1 100 0 2.55 FORMAT "%5.3" ECU_ADDRESS 0x380C0A /end MEASUREMENT
/begin MEASUREMENT phlsnvf2 "normierte Heizleistung der Lambdasonde 2 vor Kat, gefiltert" UBYTE fak_ub_q0p01 1 100 0 2.55 FORMAT "%5.3" ECU_ADDRESS 0x380C0B /end MEASUREMENT
/begin MEASUREMENT pukorfrz "Referenz-Umgebungsdruckwert für Bergab-Erkennung" UWORD p_uw_q0p039 1 100 0 2559.96 FORMAT "%8.3" ECU_ADDRESS 0x3826C2 /end MEASUREMENT
/begin MEASUREMENT ready "readiness-Byte für Ausgabe SAE J1979 Mode2" UBYTE dez 1 100 0 255 FORMAT "%5.1" ECU_ADDRESS 0x382FFC /end MEASUREMENT
/begin MEASUREMENT rinkfh "Innenwiderstand Nernstzelle der Lambdasonde aus Kennfeld vor Kat" UBYTE r_q8 1 100 0 2040 FORMAT "%5.0" ECU_ADDRESS 0x380C0C /end MEASUREMENT
/begin MEASUREMENT rinkfh2 "Innenwiderstand Nernstzelle der Lambdasonde 2 aus Kennfeld vor Kat" UBYTE r_q8 1 100 0 2040 FORMAT "%5.0" ECU_ADDRESS 0x380C0D /end MEASUREMENT
/begin MEASUREMENT rinkfv "Innenwiderstand Nernstzelle der Lambdasonde aus Kennfeld vor Kat" UBYTE r_q8 1 100 0 2040 FORMAT "%5.0" ECU_ADDRESS 0x380C0E /end MEASUREMENT
/begin MEASUREMENT rinkfv2 "Innenwiderstand Nernstzelle der Lambdasonde 2 aus Kennfeld vor Kat" UBYTE r_q8 1 100 0 2040 FORMAT "%5.0" ECU_ADDRESS 0x380C0F /end MEASUREMENT
/begin MEASUREMENT rinsh2_w "Grenzwert Innenwiderstand Nernstzelle der Lambdasonde 2 hinter Kat" UWORD r_uw_q2 1 100 0 131070 FORMAT "%8.1" ECU_ADDRESS 0x381162 /end MEASUREMENT
/begin MEASUREMENT rinsh_w "Grenzwert Innenwiderstand Nernstzelle der Lambdasonde hinter Kat" UWORD r_uw_q2 1 100 0 131070 FORMAT "%8.1" ECU_ADDRESS 0x381164 /end MEASUREMENT
/begin MEASUREMENT rinsv2_w "Grenzwert Innenwiderstand Nernstzelle der Lambdasonde 2  vor Kat" UWORD r_uw_q2 1 100 0 131070 FORMAT "%8.1" ECU_ADDRESS 0x381166 /end MEASUREMENT
/begin MEASUREMENT rinsv_w "Grenzwert Innenwiderstand Nernstzelle der Lambdasonde vor Kat" UWORD r_uw_q2 1 100 0 131070 FORMAT "%8.1" ECU_ADDRESS 0x381168 /end MEASUREMENT
/begin MEASUREMENT rkam2_w "Auswahl additive Gemischkorrektur der Gemischadaption für Bestimmung B_gae2" SWORD rel_sw_b1536 1 100 -1536 1535.95 FORMAT "%8.3" ECU_ADDRESS 0x3821FA /end MEASUREMENT
/begin MEASUREMENT rkamzs2_w "additive Gemischkorrektur (pro Zeit oder Zündung) Bank 2 (alter Wert)" SWORD rel_sw_b1536 1 100 -1536 1535.95 FORMAT "%8.3" ECU_ADDRESS 0x3821FC /end MEASUREMENT
/begin MEASUREMENT rkamzs_w "additive Gemischkorrektur (pro Zeit oder Zündung); alter Wert" SWORD rel_sw_b1536 1 100 -1536 1535.95 FORMAT "%8.3" ECU_ADDRESS 0x3821FE /end MEASUREMENT
/begin MEASUREMENT rkam_w "Auswahl additive Gemischkorrektur der Gemischadaption für Bestimmung B_gae" SWORD rel_sw_b1536 1 100 -1536 1535.95 FORMAT "%8.3" ECU_ADDRESS 0x382200 /end MEASUREMENT
/begin MEASUREMENT rkrn_w "normierter Referenzpegel Klopfregelung" UWORD spg_uw_b1280 1 100 0 1279.96 FORMAT "%7.2" ARRAY_SIZE 8 ECU_ADDRESS 0x382312 /end MEASUREMENT
/begin MEASUREMENT rldkthp "Hochpaßgefiltertes rl-Signal" SBYTE rel_sb_q0p75 1 100 -96 95.25 FORMAT "%5.2" ECU_ADDRESS 0x380C25 /end MEASUREMENT
/begin MEASUREMENT rldkthp2 "Hochpaßgefiltertes rl-Signal, Bank2" SBYTE rel_sb_q0p75 1 100 -96 95.25 FORMAT "%5.2" ECU_ADDRESS 0x380C26 /end MEASUREMENT
/begin MEASUREMENT S6_1init "" UWORD B_TRUE 1 100 0 1 BIT_MASK 0x1 FORMAT "%13.11" ECU_ADDRESS 0xFDD2 /end MEASUREMENT
/begin MEASUREMENT sfpaav "Status Fehlerpfad: Tankdiagnose, AAV defekt geschlossen" UWORD dez 1 100 0 65535 FORMAT "%8.2" ECU_ADDRESS 0x3838AA /end MEASUREMENT
/begin MEASUREMENT sfpagre "Status Fehlerpfad: AGR-Ventil Endstufe" UWORD dez 1 100 0 65535 FORMAT "%8.2" ECU_ADDRESS 0x3838AE /end MEASUREMENT
/begin MEASUREMENT sfpagrf "Status Fehlerpfad: Überwachung AGR-Flow" UWORD dez 1 100 0 65535 FORMAT "%8.2" ECU_ADDRESS 0x3838B0 /end MEASUREMENT
/begin MEASUREMENT sfpdss "Status Fehlerpfad: DSS" UWORD dez 1 100 0 65535 FORMAT "%8.2" ECU_ADDRESS 0x3838D8 /end MEASUREMENT
/begin MEASUREMENT sfpmdb "Status Fehlerpfad: Momentanüberwachung begrenzt dauerhaft" UWORD dez 1 100 0 65535 FORMAT "%8.2" ECU_ADDRESS 0x38396E /end MEASUREMENT
/begin MEASUREMENT sfptesf "Status Fehlerpfad: Tankdiagnose, Feinleck" UWORD dez 1 100 0 65535 FORMAT "%8.2" ECU_ADDRESS 0x3839A4 /end MEASUREMENT
/begin MEASUREMENT sfpteve2 "Status Fehlerpfad: Tanklüftungsventil Endstufe Bank 2" UWORD dez 1 100 0 65535 FORMAT "%8.2" ECU_ADDRESS 0x3839AA /end MEASUREMENT
/begin MEASUREMENT slowr_w "Fahrstrecke seit low range ein" UWORD s_q0p02777_m 1 100 0 1820.42 FORMAT "%8.3" ECU_ADDRESS 0x383E90 /end MEASUREMENT
/begin MEASUREMENT SP_switchptr "" UWORD B_TRUE 1 100 0 1 BIT_MASK 0x2 FORMAT "%13.11" ECU_ADDRESS 0xFDD2 /end MEASUREMENT
/begin MEASUREMENT stptr "Zustandspointer der DLDP" UBYTE dez 1 100 0 255 FORMAT "%5.1" ECU_ADDRESS 0x380D69 /end MEASUREMENT
/begin MEASUREMENT stptrw "Beginn Zustandspointer im Wiederholfall" UBYTE dez 1 100 0 255 FORMAT "%5.1" ECU_ADDRESS 0x380D6A /end MEASUREMENT
/begin MEASUREMENT tabgmf "gefilterte Abgastemperatur aus Modell" UBYTE temp_ub_q5_o50 1 100 -50 1225 FORMAT "%5.0" ECU_ADDRESS 0x380C10 /end MEASUREMENT
/begin MEASUREMENT tabgmf2 "gefilterte Abgastemperatur aus Modell, Bank2" UBYTE temp_ub_q5_o50 1 100 -50 1225 FORMAT "%5.0" ECU_ADDRESS 0x380C11 /end MEASUREMENT
/begin MEASUREMENT taldpref "TANS-Referenztemperatur" UBYTE temp_ub_q0p75_o48 1 100 -48 143.25 FORMAT "%5.1" ECU_ADDRESS 0x380D6B /end MEASUREMENT
/begin MEASUREMENT tc6kata "Anzahl der Ausgabe-Codes SCAN-Tool Mode6 aus Kat-Diagnose" UBYTE dez 1 100 0 255 FORMAT "%5.1" ECU_ADDRESS 0x3830FE /end MEASUREMENT
/begin MEASUREMENT tc6katc "Ausgabe-Code SCAN-Tool Mode 6 aus KAT-Diagnose" UBYTE dez 1 100 0 255 FORMAT "%5.1" ECU_ADDRESS 0x3830FF /end MEASUREMENT
/begin MEASUREMENT tc6katc2 "Ausgabe-Code SCAN-Tool Mode 6 aus KAT-Diagnose, Bank2" UBYTE dez 1 100 0 255 FORMAT "%5.1" ECU_ADDRESS 0x383100 /end MEASUREMENT
/begin MEASUREMENT tc6kats "Ausgabe Schwellwert SCAN-Tool Mode 6 aus KAT-Diagnose" UBYTE dez 1 100 0 255 FORMAT "%5.1" ECU_ADDRESS 0x383101 /end MEASUREMENT
/begin MEASUREMENT tc6kats2 "Ausgabe Schwellwert SCAN-Tool Mode 6 aus KAT-Diagnose" UBYTE dez 1 100 0 255 FORMAT "%5.1" ECU_ADDRESS 0x383102 /end MEASUREMENT
/begin MEASUREMENT tc6katw "Ausgabe Prüfwert SCAN-Tool Mode 6 aus KAT-Diagnose" UBYTE dez 1 100 0 255 FORMAT "%5.1" ECU_ADDRESS 0x383103 /end MEASUREMENT
/begin MEASUREMENT tc6katw2 "Ausgabe Prüfwert SCAN-Tool Mode 6 aus KAT-Diagnose, Bank2" UBYTE dez 1 100 0 255 FORMAT "%5.1" ECU_ADDRESS 0x383104 /end MEASUREMENT
/begin MEASUREMENT tc6ldpc "Ausgabe Code SCAN-Tool Mode 6 aus LDP-Diagnose" UBYTE dez 1 100 0 255 FORMAT "%5.1" ECU_ADDRESS 0x38314F /end MEASUREMENT
/begin MEASUREMENT tc6ldps "Ausgabe Schwellwert SCAN-Tool Mode 6 aus LDP-Diagnose" UWORD dez 1 100 0 65535 FORMAT "%8.2" ECU_ADDRESS 0x383EF8 /end MEASUREMENT
/begin MEASUREMENT tc6ldpw "Ausgabe Prüfwert SCAN-Tool Mode 6 aus LDP-Diagnose" UWORD dez 1 100 0 65535 FORMAT "%8.2" ECU_ADDRESS 0x383EFA /end MEASUREMENT
/begin MEASUREMENT tdhakt_ctr "" UBYTE t1sxs_ub_b255 1 100 0 255 FORMAT "%5.1" ECU_ADDRESS 0x380D6C /end MEASUREMENT
/begin MEASUREMENT tildpabroc "" UWORD t20msxs_uw_b1310 1 100 0 1310.7 FORMAT "%7.2" ECU_ADDRESS 0x3826C8 /end MEASUREMENT
/begin MEASUREMENT timfp "Timer für Zeitdauer Fast Pulse" UWORD t10msxs_uw_b655p35 1 100 0 655.35 FORMAT "%8.4" ECU_ADDRESS 0x3826CA /end MEASUREMENT
/begin MEASUREMENT timnf "" UWORD t10msxs_uw_b655p35 1 100 0 655.35 FORMAT "%8.4" ECU_ADDRESS 0x3826CC /end MEASUREMENT
/begin MEASUREMENT timrs "Timer für Reed-Switch Closed Check" UWORD t10msxs_uw_b655p35 1 100 0 655.35 FORMAT "%8.4" ECU_ADDRESS 0x3826CE /end MEASUREMENT
/begin MEASUREMENT timrsl "" UWORD t10msxs_uw_b655p35 1 100 0 655.35 FORMAT "%8.4" ECU_ADDRESS 0x3826D0 /end MEASUREMENT
/begin MEASUREMENT timtp "Timer für Periodenmessung Leckdiagnose" UWORD t10msxs_uw_b655p35 1 100 0 655.35 FORMAT "%8.4" ECU_ADDRESS 0x3826D2 /end MEASUREMENT
/begin MEASUREMENT timvldp "Timer für Ansteuerung Magnetventil der LDP" UWORD t10msxs_uw_b655p35 1 100 0 655.35 FORMAT "%8.4" ECU_ADDRESS 0x3826D4 /end MEASUREMENT
/begin MEASUREMENT tkatmf "gefilterte Katalysatortemperatur aus Modell" UBYTE temp_ub_q5_o50 1 100 -50 1225 FORMAT "%5.0" ECU_ADDRESS 0x380C12 /end MEASUREMENT
/begin MEASUREMENT tkatmf2 "gefilterte Katalysatortemperatur aus Modell, Bank2" UBYTE temp_ub_q5_o50 1 100 -50 1225 FORMAT "%5.0" ECU_ADDRESS 0x380C13 /end MEASUREMENT
/begin MEASUREMENT tldpfpi "" UWORD t10msxs_uw_b655p35 1 100 0 655.35 FORMAT "%8.4" ECU_ADDRESS 0x3826D6 /end MEASUREMENT
/begin MEASUREMENT tldpfte_ctr "" UWORD t10msxs_uw_b655p35 1 100 0 655.35 FORMAT "%8.4" ECU_ADDRESS 0x3826D8 /end MEASUREMENT
/begin MEASUREMENT tldponmx_ctr "" UWORD t10msxs_uw_b655p35 1 100 0 655.35 FORMAT "%8.4" ECU_ADDRESS 0x3826DA /end MEASUREMENT
/begin MEASUREMENT tldprefctr "" UWORD t10msxs_uw_b655p35 1 100 0 655.35 FORMAT "%8.4" ECU_ADDRESS 0x3826DC /end MEASUREMENT
/begin MEASUREMENT tldpst1_ctr "" UWORD t10msxs_uw_b655p35 1 100 0 655.35 FORMAT "%8.4" ECU_ADDRESS 0x3826DE /end MEASUREMENT
/begin MEASUREMENT tldpswo "" UWORD t10msxs_uw_b655p35 1 100 0 655.35 FORMAT "%8.4" ECU_ADDRESS 0x3826E0 /end MEASUREMENT
/begin MEASUREMENT tldpswu "" UWORD t10msxs_uw_b655p35 1 100 0 655.35 FORMAT "%8.4" ECU_ADDRESS 0x3826E2 /end MEASUREMENT
/begin MEASUREMENT tmabsldp "Motorabstelltemperatur" UBYTE temp_ub_q0p75_o48 1 100 -48 143.25 FORMAT "%5.1" ECU_ADDRESS 0x380D6D /end MEASUREMENT
/begin MEASUREMENT tpfper "" UWORD t10msxs_uw_b655p35 1 100 0 655.35 FORMAT "%8.4" ECU_ADDRESS 0x3826E4 /end MEASUREMENT
/begin MEASUREMENT tpfpldp "" UWORD t10msxs_uw_b655p35 1 100 0 655.35 FORMAT "%8.4" ECU_ADDRESS 0x3826E6 /end MEASUREMENT
/begin MEASUREMENT tpldp "Gemessene Periodendauer" UWORD t10msxs_uw_b655p35 1 100 0 655.35 FORMAT "%8.4" ECU_ADDRESS 0x3826E8 /end MEASUREMENT
/begin MEASUREMENT tpldpe "Gemessene Periodendauer, Diagnoseergebnis" UWORD t10msxs_uw_b655p35 1 100 0 655.35 FORMAT "%8.4" ECU_ADDRESS 0x3826EA /end MEASUREMENT
/begin MEASUREMENT tpotv2_w "Periodendauerwert für Sonde vor KAT ohne TV-Wert Bank2" UWORD t10msxs_uw_b655p35 1 100 0 655.35 FORMAT "%8.4" ECU_ADDRESS 0x381172 /end MEASUREMENT
/begin MEASUREMENT tpotv_w "Periodendauerwert für Sonde vor KAT ohne TV-Wert" UWORD t10msxs_uw_b655p35 1 100 0 655.35 FORMAT "%8.4" ECU_ADDRESS 0x381174 /end MEASUREMENT
/begin MEASUREMENT tpsvkmf2_w "gefilterter Periodendauerwert des Sondensignals vor Kat, Bank2 (Word)" UWORD t10msxs_uw_b655p35 1 100 0 655.35 FORMAT "%8.4" ECU_ADDRESS 0x38300E /end MEASUREMENT
/begin MEASUREMENT tpsvkmf_w "gefilterter Periodendauerwert des Sondensignals vor Kat. (Word)" UWORD t10msxs_uw_b655p35 1 100 0 655.35 FORMAT "%8.4" ECU_ADDRESS 0x383010 /end MEASUREMENT
/begin MEASUREMENT tpsvkof2_w "gemessener Periodendauerwert der Sonde vor Kat., Bank2, ohne Filter" UWORD t10msxs_uw_b655p35 1 100 0 655.35 FORMAT "%8.4" ECU_ADDRESS 0x38138E /end MEASUREMENT
/begin MEASUREMENT tpsvkof_w "gemessener Periodendauerwert der Sonde vor Kat., ohne Filter" UWORD t10msxs_uw_b655p35 1 100 0 655.35 FORMAT "%8.4" ECU_ADDRESS 0x381390 /end MEASUREMENT
/begin MEASUREMENT tpsvlssa "Periodendauer (Sondensignal vor Kat) für DLSSA" UBYTE t40msxs_ub_q0p04 1 100 0 10.2 FORMAT "%5.2" ECU_ADDRESS 0x38310F /end MEASUREMENT
/begin MEASUREMENT tpsvlssa2 "Periodendauer (Sondensignal vor Kat) für DLSSA (Bank2)" UBYTE t40msxs_ub_q0p04 1 100 0 10.2 FORMAT "%5.2" ECU_ADDRESS 0x383110 /end MEASUREMENT
/begin MEASUREMENT tuspnf "gefilterte Zeit zw. pos. und neg. usvk-Flanke, DLSSA" UBYTE t40msxs_ub_q0p04 1 100 0 10.2 FORMAT "%5.2" ECU_ADDRESS 0x383111 /end MEASUREMENT
/begin MEASUREMENT tuspnf2 "gefilterte Zeit zw. pos. und neg. usvk-Flanke, DLSSA (Bank2)" UBYTE t40msxs_ub_q0p04 1 100 0 10.2 FORMAT "%5.2" ECU_ADDRESS 0x383112 /end MEASUREMENT
/begin MEASUREMENT twdlssa2_w "Timer für Mindestprüfzeit für DLSSA-Extremwertbestimmung Bank2" UWORD t50msxs_uw_b3276p75 1 100 0 3276.75 FORMAT "%8.3" ECU_ADDRESS 0x3821AC /end MEASUREMENT
/begin MEASUREMENT twdlssa_w "Timer für Mindestprüfzeit für DLSSA-Extremwertbestimmung" UWORD t50msxs_uw_b3276p75 1 100 0 3276.75 FORMAT "%8.3" ECU_ADDRESS 0x3821AE /end MEASUREMENT
/begin MEASUREMENT twdlssh2_w "Timer für Mindestprüfzeit für DLSSA-Extremwertbestimmung hinter KAT Bank2" UWORD t50msxs_uw_b3276p75 1 100 0 3276.75 FORMAT "%8.3" ECU_ADDRESS 0x3821B0 /end MEASUREMENT
/begin MEASUREMENT twdlssh_w "Timer für Mindestprüfzeit für DLSSA-Extremwertbestimmung hinter KAT" UWORD t50msxs_uw_b3276p75 1 100 0 3276.75 FORMAT "%8.3" ECU_ADDRESS 0x3821B2 /end MEASUREMENT
/begin MEASUREMENT TYP_mdb "Fehlertyp: Momentenbegrenzung (begrenzt dauerhaft) aktiv" UWORD B_TRUE 1 100 0 1 BIT_MASK 0xf00 FORMAT "%13.11" ECU_ADDRESS 0x38396E /end MEASUREMENT
/begin MEASUREMENT tzlsatv2_w "aktueller Zeitzählerstand für Ready-Flag der ATV-Überwachung, Bank 2" UWORD t1sxs_uw_b65535 1 100 0 65535 FORMAT "%8.2" ECU_ADDRESS 0x38116E /end MEASUREMENT
/begin MEASUREMENT tzlsatv_w "aktueller Zeitzählerstand für Ready-Flag der ATV-Überwachung" UWORD t1sxs_uw_b65535 1 100 0 65535 FORMAT "%8.2" ECU_ADDRESS 0x381170 /end MEASUREMENT
/begin MEASUREMENT t_tsteaa "Zeitzähler für Verzögerungszeit TSTEAA" UBYTE t100msxs_ub_b25p5 1 100 0 25.5 FORMAT "%5.2" ECU_ADDRESS 0x380C2B /end MEASUREMENT
/begin MEASUREMENT urddktp "Regelspannungsdifferenz, tiefpaßgefiltert" SBYTE spg_sb_q0p01043 1 100 -1.33522 1.32478 FORMAT "%5.3" ECU_ADDRESS 0x380C27 /end MEASUREMENT
/begin MEASUREMENT urddktp2 "Regelspannungsdifferenz, tiefpaßgefiltert, Bank2" SBYTE spg_sb_q0p01043 1 100 -1.33522 1.32478 FORMAT "%5.3" ECU_ADDRESS 0x380C28 /end MEASUREMENT
/begin MEASUREMENT ushdktp "Spannung Lambdsonde hinter KAt, tiefpassgefiltert" UBYTE spg_ub_q0p0052 1 100 0 1.33 FORMAT "%5.3" ECU_ADDRESS 0x380C29 /end MEASUREMENT
/begin MEASUREMENT ushdktp2 "Spannung Lambdsonde hinter KAt, tiefpassgefiltert" UBYTE spg_ub_q0p0052 1 100 0 1.33 FORMAT "%5.3" ECU_ADDRESS 0x380C2A /end MEASUREMENT
/begin MEASUREMENT ushfmxstg "Gefilterte maximale Steigung der Sondenspannung hinter KAT" UBYTE spgg_q0p52 1 100 0 132.6 FORMAT "%5.1" ECU_ADDRESS 0x383106 /end MEASUREMENT
/begin MEASUREMENT ushfmxstg2 "Gefilterte maximale Steigung der Sondenspannung hinter KAT Bank2" UBYTE spgg_q0p52 1 100 0 132.6 FORMAT "%5.1" ECU_ADDRESS 0x383107 /end MEASUREMENT
/begin MEASUREMENT ushkj "Spannung Lambdasonde hinter Kat, ohne Offset, DLSSA, Bank 1" UBYTE spg_ub_b1p33 1 100 0 1.33 FORMAT "%5.3" ECU_ADDRESS 0x380C9D /end MEASUREMENT
/begin MEASUREMENT ushkj2 "Spannung Lambdasonde hinter Kat, ohne Offset, DLSSA, Bank 2" UBYTE spg_ub_b1p33 1 100 0 1.33 FORMAT "%5.3" ECU_ADDRESS 0x380C9E /end MEASUREMENT
/begin MEASUREMENT ushkjf2_w "Gefilterte Spannung Lambdasonde hinter Kat, ohne Offset, DLSSA (Bank2)" UWORD spg_uw_b1p33 1 100 0 1.33 FORMAT "%8.6" ECU_ADDRESS 0x3821B4 /end MEASUREMENT
/begin MEASUREMENT ushkjf_w "Gefilterte Spannung Lambdasonde hinter Kat, ohne Offset, DLSSA" UWORD spg_uw_b1p33 1 100 0 1.33 FORMAT "%8.6" ECU_ADDRESS 0x3821B6 /end MEASUREMENT
/begin MEASUREMENT ushkmxstg "Maximale Steigung der Sondenspannung hinter KAT" UBYTE spgg_q0p52 1 100 0 132.6 FORMAT "%5.1" ECU_ADDRESS 0x380C2F /end MEASUREMENT
/begin MEASUREMENT ushkmxstg2 "Maximale Steigung der Sondenspannung hinter KAT Bank2" UBYTE spgg_q0p52 1 100 0 132.6 FORMAT "%5.1" ECU_ADDRESS 0x380C30 /end MEASUREMENT
/begin MEASUREMENT ushksteig "Steigung der Sondenspannung hinter KAT" UBYTE spgg_q0p52 1 100 0 132.6 FORMAT "%5.1" ECU_ADDRESS 0x380C31 /end MEASUREMENT
/begin MEASUREMENT ushksteig2 "Steigung der Sondenspannung hinter KAT Bank2" UBYTE spgg_q0p52 1 100 0 132.6 FORMAT "%5.1" ECU_ADDRESS 0x380C32 /end MEASUREMENT
/begin MEASUREMENT usmnsaa "minimal erkannter Sondenspannungswert v.K. (alt), DLSSA, Bank 1" UBYTE spg_ub_b1p33 1 100 0 1.33 FORMAT "%5.3" ECU_ADDRESS 0x380C9F /end MEASUREMENT
/begin MEASUREMENT usmnsaa2 "minimal erkannter Sondenspannungswert v.K. (alt), DLSSA, Bank 2" UBYTE spg_ub_b1p33 1 100 0 1.33 FORMAT "%5.3" ECU_ADDRESS 0x380CA0 /end MEASUREMENT
/begin MEASUREMENT usmnsan "minimal erkannter Sondenspannungswert v.K. (neu), DLSSA" UBYTE spg_ub_b1p33 1 100 0 1.33 FORMAT "%5.3" ECU_ADDRESS 0x383113 /end MEASUREMENT
/begin MEASUREMENT usmnsan2 "minimal erkannter Sondenspannungswert v.K. (neu), DLSSA (Bank2)" UBYTE spg_ub_b1p33 1 100 0 1.33 FORMAT "%5.3" ECU_ADDRESS 0x383114 /end MEASUREMENT
/begin MEASUREMENT usmnsha "minimal erkannter Sondenspannungswert h.K. (alt), DLSSA, Bank 1" UBYTE spg_ub_b1p33 1 100 0 1.33 FORMAT "%5.3" ECU_ADDRESS 0x380CA1 /end MEASUREMENT
/begin MEASUREMENT usmnsha2 "minimal erkannter Sondenspannungswert h.K. (alt), DLSSA, Bank 2" UBYTE spg_ub_b1p33 1 100 0 1.33 FORMAT "%5.3" ECU_ADDRESS 0x380CA2 /end MEASUREMENT
/begin MEASUREMENT usmnshn "minimal erkannter Sondenspannungswert h.K. (neu), DLSSA" UBYTE spg_ub_b1p33 1 100 0 1.33 FORMAT "%5.3" ECU_ADDRESS 0x383115 /end MEASUREMENT
/begin MEASUREMENT usmnshn2 "minimal erkannter Sondenspannungswert h.K. (neu), DLSSA (Bank2)" UBYTE spg_ub_b1p33 1 100 0 1.33 FORMAT "%5.3" ECU_ADDRESS 0x383116 /end MEASUREMENT
/begin MEASUREMENT usmxsaa "maximal erkannter Sondenspannungswert v.K. (alt), DLSSA, Bank1" UBYTE spg_ub_b1p33 1 100 0 1.33 FORMAT "%5.3" ECU_ADDRESS 0x380CA3 /end MEASUREMENT
/begin MEASUREMENT usmxsaa2 "maximal erkannter Sondenspannungswert v.K. (alt), DLSSA, Bank2" UBYTE spg_ub_b1p33 1 100 0 1.33 FORMAT "%5.3" ECU_ADDRESS 0x380CA4 /end MEASUREMENT
/begin MEASUREMENT usmxsan "maximal erkannter Sondenspannungswert v.K. (neu), DLSSA" UBYTE spg_ub_b1p33 1 100 0 1.33 FORMAT "%5.3" ECU_ADDRESS 0x383117 /end MEASUREMENT
/begin MEASUREMENT usmxsan2 "maximal erkannter Sondenspannungswert v.K. (neu), DLSSA (Bank2)" UBYTE spg_ub_b1p33 1 100 0 1.33 FORMAT "%5.3" ECU_ADDRESS 0x383118 /end MEASUREMENT
/begin MEASUREMENT usmxsha "maximal erkannter Sondenspannungswert h.K. (alt), DLSSA, Bank 1" UBYTE spg_ub_b1p33 1 100 0 1.33 FORMAT "%5.3" ECU_ADDRESS 0x380CA5 /end MEASUREMENT
/begin MEASUREMENT usmxsha2 "maximal erkannter Sondenspannungswert h.K. (alt), DLSSA, Bank 2" UBYTE spg_ub_b1p33 1 100 0 1.33 FORMAT "%5.3" ECU_ADDRESS 0x380CA6 /end MEASUREMENT
/begin MEASUREMENT usmxshn "maximal erkannter Sondenspannungswert h.K. (neu), DLSSA" UBYTE spg_ub_b1p33 1 100 0 1.33 FORMAT "%5.3" ECU_ADDRESS 0x383119 /end MEASUREMENT
/begin MEASUREMENT usmxshn2 "maximal erkannter Sondenspannungswert h.K. (neu), DLSSA (Bank2)" UBYTE spg_ub_b1p33 1 100 0 1.33 FORMAT "%5.3" ECU_ADDRESS 0x38311A /end MEASUREMENT
/begin MEASUREMENT usrj "Regelschwelle der Lambdaregelung, ohne Offset, DLSSA" UBYTE spg_ub_b1p33 1 100 0 1.33 FORMAT "%5.3" ECU_ADDRESS 0x380CA7 /end MEASUREMENT
/begin MEASUREMENT usvkj "Spannung Lambdasonde vor Kat, ohne Offset, DLSSA" UBYTE spg_ub_b1p33 1 100 0 1.33 FORMAT "%5.3" ECU_ADDRESS 0x380CA8 /end MEASUREMENT
/begin MEASUREMENT usvkj2 "Spannung Lambdasonde vor Kat, ohne Offset, DLSSA (Bank2)" UBYTE spg_ub_b1p33 1 100 0 1.33 FORMAT "%5.3" ECU_ADDRESS 0x380CA9 /end MEASUREMENT
/begin MEASUREMENT usvkjf2_w "Gefilterte Spannung Lambdasonde vor Kat, ohne Offset, DLSSA (Bank2)" UWORD spg_uw_b1p33 1 100 0 1.33 FORMAT "%8.6" ECU_ADDRESS 0x3821B8 /end MEASUREMENT
/begin MEASUREMENT usvkjf_w "Gefilterte Spannung Lambdasonde vor Kat, ohne Offset, DLSSA" UWORD spg_uw_b1p33 1 100 0 1.33 FORMAT "%8.6" ECU_ADDRESS 0x3821BA /end MEASUREMENT
/begin MEASUREMENT wdkbad_w "Winkel Drosselklappe bezogen auf DK-Anschlag für Diagnose (16-Bit)" SWORD relDK_q0p02441 1 100 -800 799.976 FORMAT "%8.4" ECU_ADDRESS 0x382176 /end MEASUREMENT
/begin MEASUREMENT wldpab_ctr "" UBYTE dez 1 100 0 255 FORMAT "%5.1" ECU_ADDRESS 0x380D6E /end MEASUREMENT
/begin MEASUREMENT wzctc "Zähler Wiederholversuche Clamped Tube Check" UBYTE dez 1 100 0 255 FORMAT "%5.1" ECU_ADDRESS 0x380D6F /end MEASUREMENT
/begin MEASUREMENT wzcto "Zähler Wiederholversuche Close to Open Check" UBYTE dez 1 100 0 255 FORMAT "%5.1" ECU_ADDRESS 0x380D70 /end MEASUREMENT
/begin MEASUREMENT wzstl "" UBYTE dez 1 100 0 255 FORMAT "%5.1" ECU_ADDRESS 0x380D71 /end MEASUREMENT
/begin MEASUREMENT wztldp "" UWORD dez 1 100 0 65535 FORMAT "%8.2" ECU_ADDRESS 0x3826EC /end MEASUREMENT
/begin MEASUREMENT xdtpldp "" UWORD t10msxs_uw_b655p35 1 100 0 655.35 FORMAT "%8.4" ECU_ADDRESS 0x3826EE /end MEASUREMENT
/begin MEASUREMENT xwztldpmn "" UWORD dez 1 100 0 65535 FORMAT "%8.2" ECU_ADDRESS 0x3826F0 /end MEASUREMENT
/begin MEASUREMENT xzkrznt "Zähler Klopfregelung Zyklusflag Z_krnt" UBYTE dez 1 100 0 255 FORMAT "%5.1" ECU_ADDRESS 0x3809AE /end MEASUREMENT
/begin MEASUREMENT xzkrzof "Zähler Klopfregelung Zyklusflag Z_krof" UBYTE dez 1 100 0 255 FORMAT "%5.1" ECU_ADDRESS 0x3809AF /end MEASUREMENT
/begin MEASUREMENT xzkrzs "Zähler für Zyklusflag Diagnose Klopfsensor" UBYTE dez 1 100 0 255 FORMAT "%5.1" ARRAY_SIZE 4 ECU_ADDRESS 0x380CD1 /end MEASUREMENT
/begin MEASUREMENT xzkrztp "Zähler Klopfregelung Zyklusflag Z_krtp" UBYTE dez 1 100 0 255 FORMAT "%5.1" ECU_ADDRESS 0x3809AC /end MEASUREMENT
/begin MEASUREMENT xzsen "Entprellzähler Diagnose Klopfsensor" UBYTE dez 1 100 0 255 FORMAT "%5.1" ARRAY_SIZE 4 ECU_ADDRESS 0x380CD5 /end MEASUREMENT
/begin MEASUREMENT xzskrnt "Sicherheitszähler Klopfregelung Nulltest" UBYTE dez 1 100 0 255 FORMAT "%5.1" ECU_ADDRESS 0x3809B0 /end MEASUREMENT
/begin MEASUREMENT xzskrof "Sicherheitszähler Klopfregelung Offset" UBYTE dez 1 100 0 255 FORMAT "%5.1" ECU_ADDRESS 0x3809B1 /end MEASUREMENT
/begin MEASUREMENT xzskrtp "Zähler Klopfregelung Errorflag E_krtp" UBYTE dez 1 100 0 255 FORMAT "%5.1" ECU_ADDRESS 0x3809AD /end MEASUREMENT
/begin MEASUREMENT zlash2_w "Zeitzähler für Sondenspannung hinter KAT ober/unterhalb des Sollwertes, Bank2" UWORD t100msxs_uw_b6553p5 1 100 0 6553.5 FORMAT "%8.3" ECU_ADDRESS 0x381176 /end MEASUREMENT
/begin MEASUREMENT zlash_w "Zeitzähler für Sondenspannung hinter KAT ober/unterhalb des Sollwertes" UWORD t100msxs_uw_b6553p5 1 100 0 6553.5 FORMAT "%8.3" ECU_ADDRESS 0x381178 /end MEASUREMENT
/begin MEASUREMENT zlsatp "aktueller Periodenzähler für Ready-Flag der Periodendauerüberwachung" UBYTE dez 1 100 0 255 FORMAT "%5.1" ECU_ADDRESS 0x380A22 /end MEASUREMENT
/begin MEASUREMENT zlsatp2 "aktueller Periodenzähler für Ready-Flag der Periodendauerüberwachung, Bank2" UBYTE dez 1 100 0 255 FORMAT "%5.1" ECU_ADDRESS 0x380A23 /end MEASUREMENT
/begin MEASUREMENT zwdynsh "Zähler für Anzahl der Dynamikmessungen für Sonde hinter KAT" UBYTE dez 1 100 0 255 FORMAT "%5.1" ECU_ADDRESS 0x380C2C /end MEASUREMENT
/begin MEASUREMENT zwdynsh2 "Zähler für Anzahl der Dynamikmessungen für Sonde hinter KAT Bank2" UBYTE dez 1 100 0 255 FORMAT "%5.1" ECU_ADDRESS 0x380C2D /end MEASUREMENT
/begin MEASUREMENT zwpvk "Warteperiodenzaehler Periodendauerueberwachung" UBYTE dez 1 100 0 255 FORMAT "%5.1" ECU_ADDRESS 0x380A24 /end MEASUREMENT
/begin MEASUREMENT zwpvk2 "Warteperiodenzaehler Periodendauerueberwachung, Bank 2" UBYTE dez 1 100 0 255 FORMAT "%5.1" ECU_ADDRESS 0x380A25 /end MEASUREMENT
/begin MEASUREMENT Z_aav "Zyklusflag: Absperrventil Aktivkohlefilter (Funktion)" UWORD B_TRUE 1 100 0 1 BIT_MASK 0x2 FORMAT "%13.11" ECU_ADDRESS 0x3838AA /end MEASUREMENT
/begin MEASUREMENT Z_agre "Zyklusflag: Abgasrückführungsventil Endstufe" UWORD B_TRUE 1 100 0 1 BIT_MASK 0x2 FORMAT "%13.11" ECU_ADDRESS 0x3838AE /end MEASUREMENT
/begin MEASUREMENT Z_agrf "Zyklusflag: Überwachung AGR-FLOW" UWORD B_TRUE 1 100 0 1 BIT_MASK 0x2 FORMAT "%13.11" ECU_ADDRESS 0x3838B0 /end MEASUREMENT
/begin MEASUREMENT Z_dss "Zyklusflag: Saugrohr-Drucksensor" UWORD B_TRUE 1 100 0 1 BIT_MASK 0x2 FORMAT "%13.11" ECU_ADDRESS 0x3838D8 /end MEASUREMENT
/begin MEASUREMENT Z_mdb "Zyklusflag: Momentenbegrenzung begrenzt dauerhaft" UWORD B_TRUE 1 100 0 1 BIT_MASK 0x2 FORMAT "%13.11" ECU_ADDRESS 0x38396E /end MEASUREMENT
/begin MEASUREMENT Z_tesf "Zyklusflag: Tankentlüftungssystem Feinleck" UWORD B_TRUE 1 100 0 1 BIT_MASK 0x2 FORMAT "%13.11" ECU_ADDRESS 0x3839A4 /end MEASUREMENT
/begin MEASUREMENT Z_teve2 "Zyklusflag: Tankentlüftungsventil Endstufe 2" UWORD B_TRUE 1 100 0 1 BIT_MASK 0x2 FORMAT "%13.11" ECU_ADDRESS 0x3839AA /end MEASUREMENT
/begin FUNCTION DFPM_MDKOG "" /begin DEF_CHARACTERISTIC CDCMDB CDKMDB CDTMDB CLAMDB FFTMDB TSFMDB /end DEF_CHARACTERISTIC /begin REF_CHARACTERISTIC /end REF_CHARACTERISTIC /begin IN_MEASUREMENT /end IN_MEASUREMENT
 /begin OUT_MEASUREMENT B_bemdb B_bkmdb B_clmdb B_ftmdb B_mnmdb B_mxmdb B_npmdb B_simdb E_mdb sfpmdb TYP_mdb Z_mdb /end OUT_MEASUREMENT
 /begin LOC_MEASUREMENT /end LOC_MEASUREMENT
 /begin SUB_FUNCTION /end SUB_FUNCTION
/end FUNCTION
/begin FUNCTION DFPM_SWADP111 ""
 /begin DEF_CHARACTERISTIC CDCAAV CDCAGRE CDCAGRF CDCDSS CDCTESF CDCTEVE2 CDKAAV CDKAGRE CDKAGRF CDKDSS CDKTESF CDKTEVE2 CDTAAV CDTAGRE CDTAGRF CDTDSS CDTTESF CDTTEVE2 CLAAAV CLAAGRE CLAAGRF CLADSS CLATESF CLATEVE2 FFTAAV FFTAGRE FFTAGRF FFTDSS FFTTESF FFTTEVE2 TSFAAV TSFAGRE TSFAGRF TSFDSS TSFTESF TSFTEVE2 /end DEF_CHARACTERISTIC
 /begin REF_CHARACTERISTIC /end REF_CHARACTERISTIC
 /begin IN_MEASUREMENT /end IN_MEASUREMENT
 /begin OUT_MEASUREMENT E_aav E_agre E_agrf E_dss E_tesf E_teve2 sfpaav sfpagre sfpagrf sfpdss sfptesf sfpteve2 Z_aav Z_agre Z_agrf Z_dss Z_tesf Z_teve2 /end OUT_MEASUREMENT
 /begin LOC_MEASUREMENT /end LOC_MEASUREMENT
 /begin SUB_FUNCTION /end SUB_FUNCTION
/end FUNCTION
/begin FUNCTION DFRZ "OBDII; Beschreibung 'freeze frame'" /begin DEF_CHARACTERISTIC /end DEF_CHARACTERISTIC /begin REF_CHARACTERISTIC /end REF_CHARACTERISTIC /begin IN_MEASUREMENT /end IN_MEASUREMENT /begin OUT_MEASUREMENT /end OUT_MEASUREMENT /begin LOC_MEASUREMENT /end LOC_MEASUREMENT /begin SUB_FUNCTION /end SUB_FUNCTION /end FUNCTION
/begin FUNCTION DFSTT "Diagnose Fullstandsgeber Tank"
 /begin DEF_CHARACTERISTIC CWFSTD DFSKVO DFSKVU DKVBD SLOWRMX TANKABN TANKMN TFSTNP TVFSTD TVHATA /end DEF_CHARACTERISTIC
 /begin REF_CHARACTERISTIC /end REF_CHARACTERISTIC
 /begin IN_MEASUREMENT B_cdfst B_fstcanok B_fsttsh B_fsttval B_kvta B_lowra B_pwf B_tfst2ok B_tfstok fstt_w kvb_w tfst vfzg /end IN_MEASUREMENT
 /begin OUT_MEASUREMENT B_fsttd B_fsttin B_tank B_tankg DFSTTBUFRAM slowr_w /end OUT_MEASUREMENT
 /begin LOC_MEASUREMENT B_dfskvo B_dfskvu B_dtankm B_fstclr B_fstdakt B_fstini B_fstlowr B_fstsigf B_fsttab B_fsttden B_fsttzu B_kvbd B_lowra1 B_tankab B_tankdy B_tankend B_tankzu dfskv_w dfstigof_w dfstigo_w DFSTTbits DFSTTbits2 dfstt_w dkvbigo_w dkvb_w fstakt_w fstalt_w fsthin_w fstneu_w fsttin_w kvbadd_w kvbakt_w kvbres_w /end LOC_MEASUREMENT
 /begin SUB_FUNCTION /end SUB_FUNCTION
/end FUNCTION
/begin FUNCTION DHFM "Diagnose; Plausibilitätsprüfung HFM"
 /begin DEF_CHARACTERISTIC KFMLDMN KFMLDMX SDK08FEUW SNM08FEUW TDMLMN TDMLMX TDMLNF TDMLST TDUBHFM UBHFM ZMLRO /end DEF_CHARACTERISTIC
 /begin REF_CHARACTERISTIC MLOFS /end REF_CHARACTERISTIC
 /begin IN_MEASUREMENT B_stend mlhfmm_w nmot_w ub wdkba_w /end IN_MEASUREMENT
 /begin OUT_MEASUREMENT B_ehfm B_hfm esst_sdk08feuw esst_snm08feuw /end OUT_MEASUREMENT
 /begin LOC_MEASUREMENT mldmn_w mldmx_w mlhfmf_w wdkbad_w /end LOC_MEASUREMENT
 /begin SUB_FUNCTION /end SUB_FUNCTION
/end FUNCTION
/begin FUNCTION DHLS "Diagnose; Sondenheizung"
 /begin DEF_CHARACTERISTIC FRINH1 FRINH2 FRINV1 FRINV2 KFRINH KFRINH2 KFRINV KFRINV2 TADHMN TADHMX TERISA TVFHS TVHSEE TVRIF TVRISA UBDLSMX UHDMN UHDMX ZKARIH ZKARIV ZKPRIH ZKPRIV /end DEF_CHARACTERISTIC
 /begin REF_CHARACTERISTIC UBDLS /end REF_CHARACTERISTIC
 /begin IN_MEASUREMENT B_atmtpa B_atmtpa2 B_atmtpk B_atmtpk2 B_cdhsh B_cdhsv B_hshe B_hshe2 B_hsve B_hsve2 B_lowra B_nmot B_pwf B_rinh B_rinh2 B_rinv B_rinv2 B_sa B_vsigf B_vsigf2 cd_bits1_w phlsnh phlsnh2 phlsnv phlsnv2 rinh2_w rinh_w rinv2_w rinv_w tabgm tabgm2 tkatm tkatm2 ub uhsh uhsh2 uhsv uhsv2 /end IN_MEASUREMENT
 /begin OUT_MEASUREMENT phlsnhf phlsnhf2 phlsnvf phlsnvf2 rinkfh rinkfh2 rinkfv rinkfv2 rinsh2_w rinsh_w rinsv2_w rinsv_w tabgmf tabgmf2 tkatmf tkatmf2 /end OUT_MEASUREMENT
 /begin LOC_MEASUREMENT B_mnfhsh B_mnfhsh2 B_mnfhsv B_mnfhsv2 B_mxfhsh B_mxfhsh2 B_mxfhsv B_mxfhsv2 B_npfhsh B_npfhsh2 B_npfhsv B_npfhsv2 B_sifhsh B_sifhsh2 B_sifhsv B_sifhsv2 /end LOC_MEASUREMENT
 /begin SUB_FUNCTION /end SUB_FUNCTION
/end FUNCTION
/begin FUNCTION DIAVALVE "" /begin DEF_CHARACTERISTIC /end DEF_CHARACTERISTIC /begin REF_CHARACTERISTIC /end REF_CHARACTERISTIC /begin IN_MEASUREMENT eevx /end IN_MEASUREMENT /begin OUT_MEASUREMENT /end OUT_MEASUREMENT /begin LOC_MEASUREMENT /end LOC_MEASUREMENT /begin SUB_FUNCTION /end SUB_FUNCTION /end FUNCTION
/begin FUNCTION DIMC "OBDII; inspection/maintenance-ready" /begin DEF_CHARACTERISTIC SRYAGR SRYHS SRYKAT SRYLS SRYSLS SRYTES /end DEF_CHARACTERISTIC /begin REF_CHARACTERISTIC /end REF_CHARACTERISTIC
 /begin IN_MEASUREMENT B_cdagr B_cddmtl B_cdhsv B_cdkat B_cdldp B_cdlsv B_cdsls B_cdtes B_katfz B_pwf cd_bits1_w cd_bits2_w /end IN_MEASUREMENT
 /begin OUT_MEASUREMENT B_agrrdy B_hsrdy B_kathrdy B_katrdy B_kkrdy B_lsrdy B_slsrdy B_tesrdy evsup1 ready /end OUT_MEASUREMENT
 /begin LOC_MEASUREMENT cryhs crykat cryls crysls crytes /end LOC_MEASUREMENT
 /begin SUB_FUNCTION /end SUB_FUNCTION
/end FUNCTION
/begin FUNCTION DKAT "Eigendiagnose; Katalysatorkonvertierung"
 /begin DEF_CHARACTERISTIC ADKATNF AHKATKM AHKATMN AHKATMX AHKATS AHKATSB AHKTTSW APEKTDX AVKATFS CDKATLK DKATCW DMRKTD DRLKTDP FALRKTD FALRKTT KATBFML KATBFMN KATBFN KATBFNM KATBFNP KATBFSX KATBFXM KATBSG KATBSH KATBSHF KATBSHG NDKTSO NDKTSOT NDKTSU NDKTSUT NKTDX RLDKTOT RLDKTSO RLDKTSU RLDKTUT TDKATAKT TDKATATT TMINKAT TMNKATT TVDKAT TWDKATST TWKTDLP ZDKATAD ZDKATAF ZDKATSH ZDKTBD ZDKTBF ZKTDRL /end DEF_CHARACTERISTIC
 /begin REF_CHARACTERISTIC SML05DKUB SNM05DKUB /end REF_CHARACTERISTIC
 /begin IN_MEASUREMENT B_cdkat B_dtes B_edkvs B_edkvs2 B_enws B_fa B_fakat B_fakat2 B_ll B_lowra B_lr B_lr2 B_lrka B_lrka2 B_mdarv B_mdkat B_pwf B_sbbhk B_sbbhk2 B_tehb B_ukg cd_bits1_w esst_sml05dkub esst_snm05dkub fr2_w fr_w kmstand ml ml_w nmot rl tkatm tkatm2 tnse_w ushk ushk2 /end IN_MEASUREMENT
 /begin OUT_MEASUREMENT avkatf avkatf2 B_dktlp dmrdkt_w falrdkt tc6kata tc6katc tc6katc2 tc6kats tc6kats2 tc6katw tc6katw2 /end OUT_MEASUREMENT
 /begin LOC_MEASUREMENT ahkat ahkat2 ahkatn ahkatn2 ahktki2_w ahktki_w ahktnk ahktnk2 akatbn akatbn2 apedkt apedkt2 B_dkini B_dkini2 B_dklpi B_dklpi2 B_dkten B_dkten2 B_dktnr B_dktnr2 B_dktsb B_dktsb2 B_dktsp B_dktsp2 B_dktst B_dktst2 B_dktt B_dktt2 B_ekats B_ekats2 B_erdkt B_erdkt2 B_szkat B_szkat2 B_trig B_trig2 B_tvdkat B_zkatb B_zkatb2 B_zkats B_zkats2 B_zkatz B_zkatz2 dkatakt2_w dkatakt_w fahkatkm_w katbf katbf2 katbfi2_w katbfi_w katbfs katbfs2 katbftp katbftp2 katbshd2_w katbshd_w kbdkt2_w kbdkt_w rldkthp rldkthp2 urddktp urddktp2 ushdktp ushdktp2 /end LOC_MEASUREMENT
 /begin SUB_FUNCTION /end SUB_FUNCTION
/end FUNCTION
/begin FUNCTION DKOSE "Diagnose Klimakompressor-Endstufe" /begin DEF_CHARACTERISTIC /end DEF_CHARACTERISTIC /begin REF_CHARACTERISTIC /end REF_CHARACTERISTIC /begin IN_MEASUREMENT B_desee B_koe /end IN_MEASUREMENT /begin OUT_MEASUREMENT /end OUT_MEASUREMENT /begin LOC_MEASUREMENT /end LOC_MEASUREMENT /begin SUB_FUNCTION /end SUB_FUNCTION /end FUNCTION
/begin FUNCTION DKRNT "Diagnose; Klopfregelung, Nulltest (OBDII)" /begin DEF_CHARACTERISTIC CWDKRNT CWDKROF DKROFN DKROKU KRFHT UDKRGOFS /end DEF_CHARACTERISTIC /begin REF_CHARACTERISTIC DKROKD _IKRSCHWELLE /end REF_CHARACTERISTIC /begin IN_MEASUREMENT B_dnt B_pwf B_stend igod_w ikrma nmot tmfln_w tpnt_aktiv /end IN_MEASUREMENT /begin OUT_MEASUREMENT /end OUT_MEASUREMENT /begin LOC_MEASUREMENT xzkrznt xzkrzof xzskrnt xzskrof /end LOC_MEASUREMENT /begin SUB_FUNCTION /end SUB_FUNCTION /end FUNCTION
/begin FUNCTION DKRS "Diagnose; Klopfsensor (OBDII)" /begin DEF_CHARACTERISTIC CWDKS1 CWDKS2 CWDKS3 CWDKS4 KRFHKS NDKS UDKSNO UDKSNU /end DEF_CHARACTERISTIC /begin REF_CHARACTERISTIC KSZA SNM16KRUB /end REF_CHARACTERISTIC
 /begin IN_MEASUREMENT B_kr B_krldy B_krndy B_pwf B_synph B_tmkr esst_snm16krub ks_sym nmot rkr sen_c95 vkr /end IN_MEASUREMENT
 /begin OUT_MEASUREMENT B_krdws rkrn_w xzkrzs xzsen /end OUT_MEASUREMENT
 /begin LOC_MEASUREMENT /end LOC_MEASUREMENT
 /begin SUB_FUNCTION /end SUB_FUNCTION
/end FUNCTION
/begin FUNCTION DKRTP "Diagnose; Klopfregelung, Testimpuls (OBDII)" /begin DEF_CHARACTERISTIC CWDKRTP UDKRTP /end DEF_CHARACTERISTIC /begin REF_CHARACTERISTIC KRFHT /end REF_CHARACTERISTIC /begin IN_MEASUREMENT B_dtp B_pwf ikrma ikrmet tpnt_aktiv /end IN_MEASUREMENT /begin OUT_MEASUREMENT /end OUT_MEASUREMENT /begin LOC_MEASUREMENT xzkrztp xzskrtp /end LOC_MEASUREMENT /begin SUB_FUNCTION /end SUB_FUNCTION /end FUNCTION
/begin FUNCTION DKUPPL "Diagnose Kupplungsschalter" /begin DEF_CHARACTERISTIC AGANGW AKUPPLB TDKUPNOG VDKUPPLMN /end DEF_CHARACTERISTIC /begin REF_CHARACTERISTIC /end REF_CHARACTERISTIC /begin IN_MEASUREMENT B_autget B_brems B_lsd gangi S_kupp vfzg /end IN_MEASUREMENT /begin OUT_MEASUREMENT anzgangw anzkupplb B_gangok /end OUT_MEASUREMENT /begin LOC_MEASUREMENT /end LOC_MEASUREMENT /begin SUB_FUNCTION /end SUB_FUNCTION /end FUNCTION
/begin FUNCTION DKVS "Diagnose; Plausibilitätsprüfung Kraftstoffversorgungssysteme"
 /begin DEF_CHARACTERISTIC CPLRA DFRMST FRAE FRAODN FRAODX FRAUDN FRAUDX FRMSTDN FRMSTDX IMLKVSMX MLDKVSF MLDKVSG RKAE RKATDN RKATDX RKAZDN RKAZDX TFRA TFRAOZ TFRAUZ TFRMST TFRMZST TRKA TRKATZ TRKAZZ ZFRMST /end DEF_CHARACTERISTIC
 /begin REF_CHARACTERISTIC /end REF_CHARACTERISTIC
 /begin IN_MEASUREMENT B_cdkvs B_fa B_fakvs B_frao B_frau B_fraur B_fraur2 B_lr B_lr2 B_lra B_lra2 B_lrare B_lrare2 B_nofra B_norkat B_norkaz B_pwf B_rkat B_rkatr B_rkatr2 B_rkaz B_rkazr B_rkazr2 B_sa B_tal B_talval B_te cd_bits1_w frao2_w frao_w frau2_w frau_w frm2_w frm_w ml rkat2_w rkat_w rkaz2_w rkaz_w /end IN_MEASUREMENT
 /begin OUT_MEASUREMENT B_dkvsf B_dkvstr B_edkvs B_edkvs2 B_gae B_gaefra B_gaefra2 B_kvsffl /end OUT_MEASUREMENT
 /begin LOC_MEASUREMENT B_dkvsfm B_efrao B_efrao2 B_efrau B_efrau2 B_erkat B_erkat2 B_erkaz B_erkaz2 B_frste B_frste2 B_gaeing B_gaeing2 B_imlkvse B_norkam B_plra B_rkam B_rkamr B_rkamr2 DKVSbits frauzs2_w frauzs_w imlkvszs_w imlkvs_w rkam2_w rkamzs2_w rkamzs_w rkam_w /end LOC_MEASUREMENT
 /begin SUB_FUNCTION /end SUB_FUNCTION
/end FUNCTION
/begin FUNCTION DLDP "OBD II, Tankentlüftungsdiagnosemodul"
 /begin DEF_CHARACTERISTIC ANSWPUK CWDTLECK DHAKTIV DPUBABMX DPUKORDH DTMLDP FDKHLDP FSALULDP FTEADLDP KLDTPLDP KLWZTLDP MLDPKD PSLDPMX RLLDPRU TALDPMX TALDPO TALDPRO TALDPRU TALDPU TDHAKT TLDPEIN TLDPFL TLDPFP TLDPFTE TLDPLRMX TLDPMN TLDPNF TLDPONMX TLDPREF TLDPRKL TLDPRKO TLDPRKZ TLDPSD TLDPST1 TLDPTD TLDPVL TLDPWAB TMLDPO TMLDPU TULDPRO TULDPRU UBLDPMX VLDPMX VLDPRU VMAXLDP WLDPAB WZCTCMX WZLDPRO WZSTLMX /end DEF_CHARACTERISTIC
 /begin REF_CHARACTERISTIC /end REF_CHARACTERISTIC
 /begin IN_MEASUREMENT bssp B_bt B_btldp B_dtebel B_dtebn B_eobdlr B_fa B_fadldp B_gae B_puerr B_pwf B_stend B_te B_teabb DTEVNbits fho_w ftead_w ftefva_w ml_w pspvdk_w pukBits pukorf_w pukor_w rl S_ldpr tans tateout tmot tmotab tnst_w tumg ub vfzg /end IN_MEASUREMENT
 /begin OUT_MEASUREMENT B_bergab B_dldp B_dldpte B_dpuabb B_druck B_frzdh B_ldpein cpukor_w DldpNvBits dpubab_w dpukordh_w mldpkd_h mldpkd_l pukorfrz tc6ldpc tc6ldps tc6ldpw timtp /end OUT_MEASUREMENT
 /begin LOC_MEASUREMENT B_ctccka B_ctccke B_ctocka B_ctocke B_dldp_old B_eggldp B_estldp B_fadldp_old B_fbdtevn B_fbldp B_fbldpw B_fbldpw1 B_fbldpw2 B_fbldpwff B_fbldpw_old B_fbldp_old B_fbsperr B_flag0 B_flag1 B_flag2 B_fpuls B_ldpena B_ldpf1 B_ldpf2 B_ldpf2h B_ldpf3 B_ldpf4 B_ldpf4h B_ldpf5 B_ldpf6 B_ldpstp B_nfldp B_reads B_reads_old B_s0w B_s2w B_stage62 B_stend_old B_stldp B_stldpv B_stldpv1 B_stldpv2 B_stldpv3 B_stldpvff B_taakt B_taref B_tatumgok B_teilerbit B_timrs B_tlablp B_tlxldp B_tmabs B_tpldp B_zldp B_ztesb B_ztesk S6_1init SP_switchptr stptr stptrw taldpref tdhakt_ctr tildpabroc timfp timnf timrs timrsl timvldp tldpfpi tldpfte_ctr tldponmx_ctr tldprefctr tldpst1_ctr tldpswo tldpswu tmabsldp tpfper tpfpldp tpldp tpldpe wldpab_ctr wzctc wzcto wzstl wztldp xdtpldp xwztldpmn /end LOC_MEASUREMENT
 /begin SUB_FUNCTION /end SUB_FUNCTION
/end FUNCTION
/begin FUNCTION DLDPE "Endstufendiagnose; Überdruckpumpe der Tank-Leck-Diagnose" /begin DEF_CHARACTERISTIC /end DEF_CHARACTERISTIC /begin REF_CHARACTERISTIC /end REF_CHARACTERISTIC /begin IN_MEASUREMENT B_desee B_ldpein /end IN_MEASUREMENT /begin OUT_MEASUREMENT /end OUT_MEASUREMENT /begin LOC_MEASUREMENT /end LOC_MEASUREMENT /begin SUB_FUNCTION /end SUB_FUNCTION /end FUNCTION
/begin FUNCTION DLLR "28.20     Diagnose: Leerlaufregelung Erkennung blockierter Steller"
 /begin DEF_CHARACTERISTIC DASA DMLLRIDO DMLLRIDU DMLLRIDU2 DNDLLRO DNDLLRU FHDLLR RLDLLR TADLLR TDLLR TDLLRMN TDLLRMX TDLLRNF TFDLLRO TFDLLRU TMDLLR /end DEF_CHARACTERISTIC
 /begin REF_CHARACTERISTIC /end REF_CHARACTERISTIC
 /begin IN_MEASUREMENT B_cdllr B_dknolu B_dkpu B_dsls B_dtes B_ll B_llr B_nswo1 B_sa B_st B_tehb cd_bits2_w dmllri_w dns fho rl tans tmot tnse_w vfzg /end IN_MEASUREMENT
 /begin OUT_MEASUREMENT B_dllr B_dllra /end OUT_MEASUREMENT
 /begin LOC_MEASUREMENT B_lldia B_nollrflr /end LOC_MEASUREMENT
 /begin SUB_FUNCTION /end SUB_FUNCTION
/end FUNCTION
/begin FUNCTION DLSA "Lambdasondenalterungsüberwachung, OBDII"
 /begin DEF_CHARACTERISTIC ANZDPVK ANZTP CWDLSA KFTPKOR NTPKTO NTPKTU NTPVKO NTPVKU RLTPKTO RLTPKTU RLTPVKO RLTPVKU TKTPVK TKTVHK TSTEAA TSVKKTO TSVKKTU TSVKO TSVKU TVLRHMN TVLRHMN2 TVLRHMX TVLRHMX2 TWDDTV ZFTSVK /end DEF_CHARACTERISTIC
 /begin REF_CHARACTERISTIC _STERVK /end REF_CHARACTERISTIC
 /begin IN_MEASUREMENT atv atv2 B_cdlatp B_cdlatv B_dsls B_dtest B_edkvs B_edkvs2 B_enws B_fa B_fatp B_fatp2 B_fatv B_fatv2 B_gasp B_lowra B_lr B_lr2 B_lrhk B_lrhk2 B_lrtpp B_lrtpp2 B_mdarv B_st B_te B_tehb cd_bits2_w nmot rl tabgm tfrn2_w tfrn_w tfrp2_w tfrp_w tkatm tplrvk2_w tplrvk_w /end IN_MEASUREMENT
 /begin OUT_MEASUREMENT tpsvkmf2_w tpsvkmf_w tpsvkof2_w tpsvkof_w tzlsatv2_w tzlsatv_w t_tsteaa zlsatp zlsatp2 zwpvk zwpvk2 /end OUT_MEASUREMENT
 /begin LOC_MEASUREMENT B_dlaff B_dlaff2 B_dlatp B_dlatp2 B_dlatv B_dlatv2 B_lsastp B_lsastp2 B_nolatp B_nolatp2 B_nolatv B_nolatv2 tpotv2_w tpotv_w /end LOC_MEASUREMENT
 /begin SUB_FUNCTION /end SUB_FUNCTION
/end FUNCTION
/begin FUNCTION DLSAHK "Lambdasondenalterungsüberwachung hinter KAT"
 /begin DEF_CHARACTERISTIC ANZDYNSH CWDLSAHK DLAMLASHF DLAMLASHM DMRLASH FRMLASHO FRMLASHU KMXSTG MLLASH MLOSTEST MLUSSTG MLUSTEST SMLDYN TABGSTG TFRMB TLLASH TRIPFASH TSALASH TTLASH TUSCHUB TUSENLASH TUSHSMIN TUSLASH TUSSA USHLEAN USHRICH USHSTGMX USHSTSOLL USSCHUB /end DEF_CHARACTERISTIC
 /begin REF_CHARACTERISTIC /end REF_CHARACTERISTIC
 /begin IN_MEASUREMENT B_cdlash B_dsls B_dtest B_edkvs B_edkvs2 B_evloc B_fa B_fash B_fash2 B_gaeing B_gaeing2 B_lowra B_lr B_lr2 B_lrhk B_lrhk2 B_mdarv B_pwf B_sa B_sbbhk B_sbbhk2 B_tehb cd_bits2_w frm2_w frm_w lamsons2_w lamsons_w ml_w tkatm tkatm2 ushk ushk2 usrhk usrhk2 /end IN_MEASUREMENT
 /begin OUT_MEASUREMENT dmrlash_w lamlash2_w lamlash_w /end OUT_MEASUREMENT
 /begin LOC_MEASUREMENT B_abgstg B_abgstg2 B_ddylash B_ddylash2 B_dlash B_dlash2 B_dshk B_dshk2 B_dushsch B_dushsch2 B_dylash B_dylash2 B_enfmst B_enfmst2 B_enlash B_enlash2 B_entest B_entest2 B_frmlash B_frmlash2 B_lamend B_lamend2 B_lamlash B_lamlash2 B_lamverg B_lamverg2 B_lsahksp B_lsahksp2 B_maxlash B_maxlash2 B_minlash B_minlash2 B_mldyn B_mlustest B_nesch B_nesch2 B_nolash B_nolash2 B_steigm B_steigm2 B_teslash B_teslash2 B_trfash B_trfash2 B_ushkf B_ushkf2 B_ushkm B_ushkm2 B_ushsch B_ushsch2 frmtrip2_w frmtrip_w lamfrm2_w lamfrm_w LokBits1 mldyn_w NovBits ushfmxstg ushfmxstg2 ushkmxstg ushkmxstg2 ushksteig ushksteig2 zlash2_w zlash_w zwdynsh zwdynsh2 /end LOC_MEASUREMENT
 /begin SUB_FUNCTION /end SUB_FUNCTION
/end FUNCTION
/begin FUNCTION DLSH "Diagnose; Sondenbetriebsbereitschaft hinter Kat"
 /begin DEF_CHARACTERISTIC ABGMSIGH DLAMELSH DMRLSH DRISIGH PHLSNHMN RISIGRESH TABGMCSD TASIG TKATMSHU TRSAFA TRSAH TRSE TTBMH TUSDUFA TUSDUH TUSEINH TUSKS TUSMAX TUSTAL UBDLS USMAX USMIN USREFH USREMH /end DEF_CHARACTERISTIC
 /begin REF_CHARACTERISTIC /end REF_CHARACTERISTIC
 /begin IN_MEASUREMENT B_atmtpk B_atmtpk2 B_cdlsh B_dsls B_dtes B_esls B_fa B_falsh B_falsh2 B_hshe B_hshe2 B_lowra B_lrhk B_lrhk2 B_nmot B_pwf B_sls B_tal B_talval cd_bits1_w lamsons2_w lamsons_w phlsnh phlsnh2 rinh2_w rinh_w tkatm tkatm2 ub ushk2_w ushk_w /end IN_MEASUREMENT
 /begin OUT_MEASUREMENT B_risigh B_sbbhk B_sbbhk2 B_ttbmhh B_ttbmhh2 dmrlsh_w lamelsh2_w lamelsh_w /end OUT_MEASUREMENT
 /begin LOC_MEASUREMENT B_acsdh B_acsdh2 B_adsh B_adsh2 B_adshs B_adshs2 B_dshen B_dshen2 B_maxflsh B_maxflsh2 B_minflsh B_minflsh2 B_nolsh B_nolsh2 B_nplflsh B_nplflsh2 B_risigh2 B_sigflsh B_sigflsh2 B_trsah B_trsah2 B_ueinh B_ueinh2 B_uhsig B_uhsig2 DLSHbits DLSHerrors DLSHintbits /end LOC_MEASUREMENT
 /begin SUB_FUNCTION /end SUB_FUNCTION
/end FUNCTION
/begin FUNCTION DLSSA "Signalausgabe Lambdasonden"
 /begin DEF_CHARACTERISTIC ATVFETTO ATVFETTU ATVMAGO ATVMAGU SAFK1 SAFK2 TPSVKMN TPSVKMX TUSPNMN TUSPNMX TWDLSSA USIVMAXH USIVMAXV USIVMINH USIVMINV USMNSAMN USMNSAMX USMNSHMN USMNSHMX USMXSAMN USMXSAMX USMXSHMN USMXSHMX USRHKSHJ USRJ /end DEF_CHARACTERISTIC
 /begin REF_CHARACTERISTIC /end REF_CHARACTERISTIC
 /begin IN_MEASUREMENT atv atv2 B_dlatp B_dlatp2 B_lrhk B_lrhk2 B_lrtpp B_lrtpp2 B_pwf tfrn2_w tfrn_w tpsvkmf2_w tpsvkmf_w ushk ushk2 usvk usvk2 /end IN_MEASUREMENT
 /begin OUT_MEASUREMENT atvfett atvfett2 atvmager atvmager2 tpsvlssa tpsvlssa2 tuspnf tuspnf2 ushkj ushkj2 usmnsan usmnsan2 usmnshn usmnshn2 usmxsan usmxsan2 usmxshn usmxshn2 usrj usvkj usvkj2 /end OUT_MEASUREMENT
 /begin LOC_MEASUREMENT B_tuspn B_tuspn2 B_tusre B_tusre2 dlssabits twdlssa2_w twdlssa_w twdlssh2_w twdlssh_w ushkjf2_w ushkjf_w usmnsaa usmnsaa2 usmnsha usmnsha2 usmxsaa usmxsaa2 usmxsha usmxsha2 usvkjf2_w usvkjf_w /end LOC_MEASUREMENT
 /begin SUB_FUNCTION /end SUB_FUNCTION
/end FUNCTION
/begin COMPU_METHOD acc_uw_b55p55 "" RAT_FUNC "%6.5" "m/(s^2)" COEFFS 0 147456 0 0 0 125 /end COMPU_METHOD
/begin COMPU_METHOD B_TRUE "boolsche Zustände, positive Logik" TAB_VERB "%6.3" "" COMPU_TAB_REF B_TRUE /end COMPU_METHOD
/begin COMPU_VTAB B_TRUE "boolsche Zustände, positive Logik" TAB_VERB 2 0 "----" 1 "TRUE" /end COMPU_VTAB
/begin COMPU_METHOD dez "1 : 1 Umrechnug (dez/hex)" RAT_FUNC "%6.2" "" COEFFS 0 1 0 0 0 1 /end COMPU_METHOD
/begin COMPU_METHOD dldp_uw_b2p33 "" RAT_FUNC "%7.6" "kg" COEFFS 0 28125 0 0 0 1 /end COMPU_METHOD
/begin COMPU_METHOD fak_sb_b1 "" RAT_FUNC "%6.4" "-" COEFFS 0 256 0 0 0 2 /end COMPU_METHOD
/begin COMPU_METHOD fak_sw_b64 "" RAT_FUNC "%6.4" "-" COEFFS 0 65536 0 0 0 128 /end COMPU_METHOD
/begin COMPU_METHOD fak_ub_b1 "" RAT_FUNC "%6.4" "-" COEFFS 0 256 0 0 0 1 /end COMPU_METHOD
/begin COMPU_METHOD fak_ub_b2 "" RAT_FUNC "%6.4" "-" COEFFS 0 256 0 0 0 2 /end COMPU_METHOD
/begin COMPU_METHOD fak_ub_b4 "" RAT_FUNC "%6.4" "-" COEFFS 0 256 0 0 0 4 /end COMPU_METHOD
/begin COMPU_METHOD fak_ub_b64 "" RAT_FUNC "%6.3" "-" COEFFS 0 256 0 0 0 64 /end COMPU_METHOD
/begin COMPU_METHOD fak_ub_b8 "" RAT_FUNC "%6.4" "-" COEFFS 0 256 0 0 0 8 /end COMPU_METHOD
/begin COMPU_METHOD fak_ub_q0p01 "" RAT_FUNC "%6.4" "" COEFFS 0 1 0 0 0 0.01 /end COMPU_METHOD
/begin COMPU_METHOD fak_uw_b1 "" RAT_FUNC "%7.6" "-" COEFFS 0 65536 0 0 0 1 /end COMPU_METHOD
/begin COMPU_METHOD fak_uw_b16 "" RAT_FUNC "%6.5" "-" COEFFS 0 65536 0 0 0 16 /end COMPU_METHOD
/begin COMPU_METHOD fak_uw_b2 "" RAT_FUNC "%7.6" "-" COEFFS 0 65536 0 0 0 2 /end COMPU_METHOD
/begin COMPU_METHOD fak_uw_b4 "" RAT_FUNC "%7.6" "-" COEFFS 0 65536 0 0 0 4 /end COMPU_METHOD
/begin COMPU_METHOD freq_sw_b512 "" RAT_FUNC "%6.4" "1/s" COEFFS 0 65536 0 0 0 1024 /end COMPU_METHOD
/begin COMPU_METHOD km_uw_q10 "" RAT_FUNC "%6.1" "km" COEFFS 0 1 0 0 0 10 /end COMPU_METHOD
/begin COMPU_METHOD mgrad_sw_b28p44 "" RAT_FUNC "%6.5" "g/s" COEFFS 0 230.4 0 0 0 0.2 /end COMPU_METHOD
/begin COMPU_METHOD mgrad_ub_b221p35 "" RAT_FUNC "%6.2" "mg/s" COEFFS 0 230.4 0 0 0 200 /end COMPU_METHOD
/begin COMPU_METHOD mgrad_uw_q10p402 "" RAT_FUNC "%6.1" "mg/(V*s)" COEFFS 0 9805.82 0 0 0 102000 /end COMPU_METHOD
/begin COMPU_METHOD m_q0p00277 "" RAT_FUNC "%6.4" "g" COEFFS 0 360 0 0 0 1 /end COMPU_METHOD
/begin COMPU_METHOD m_q0p00355 "" RAT_FUNC "%6.4" "kg" COEFFS 0 1125 0 0 0 4 /end COMPU_METHOD
/begin COMPU_METHOD m_q0p1 "" RAT_FUNC "%6.3" "kg/h" COEFFS 0 10 0 0 0 1 /end COMPU_METHOD
/begin COMPU_METHOD m_sw_q0p1 "" RAT_FUNC "%6.3" "kg/h" COEFFS 0 1 0 0 0 0.1 /end COMPU_METHOD
/begin COMPU_METHOD m_ub_b1020 "" RAT_FUNC "%6.2" "kg/h" COEFFS 0 1 0 0 0 4 /end COMPU_METHOD
/begin COMPU_METHOD m_uw_b58888 "" RAT_FUNC "%6.2" "mg" COEFFS 0 230.4 0 0 0 200 /end COMPU_METHOD
/begin COMPU_METHOD m_uw_b6553p5 "" RAT_FUNC "%6.3" "kg/h" COEFFS 0 1 0 0 0 0.1 /end COMPU_METHOD
/begin COMPU_METHOD nmot_ub_q10 "" RAT_FUNC "%6.1" "U/min" COEFFS 0 1 0 0 0 10 /end COMPU_METHOD
/begin COMPU_METHOD nmot_ub_q40 "" RAT_FUNC "%6.1" "Upm" COEFFS 0 1 0 0 0 40 /end COMPU_METHOD
/begin COMPU_METHOD nmot_uw_q0p25 "" RAT_FUNC "%6.3" "U/min" COEFFS 0 1 0 0 0 0.25 /end COMPU_METHOD
/begin COMPU_METHOD p_uw_q0p039 "" RAT_FUNC "%6.4" "hPa" COEFFS 0 256 0 0 0 10 /end COMPU_METHOD
/begin COMPU_METHOD relDK_q0p02441 "" RAT_FUNC "%6.4" "% DK" COEFFS 0 65536 0 0 0 1600 /end COMPU_METHOD
/begin COMPU_METHOD rel_sb_q0p75 "" RAT_FUNC "%6.3" "%" COEFFS 0 1 0 0 0 0.75 /end COMPU_METHOD
/begin COMPU_METHOD rel_sw_b1536 "" RAT_FUNC "%6.4" "%" COEFFS 0 65536 0 0 0 3072 /end COMPU_METHOD
/begin COMPU_METHOD rel_ub_b50 "" RAT_FUNC "%6.3" "%" COEFFS 0 255 0 0 0 50 /end COMPU_METHOD
/begin COMPU_METHOD rel_ub_q0p75 "" RAT_FUNC "%6.3" "%" COEFFS 0 1 0 0 0 0.75 /end COMPU_METHOD
/begin COMPU_METHOD rel_uw_b100 "" RAT_FUNC "%6.4" "%" COEFFS 0 65536 0 0 0 100 /end COMPU_METHOD
/begin COMPU_METHOD r_q8 "" RAT_FUNC "%6.2" "Ohm" COEFFS 0 1 0 0 0 8 /end COMPU_METHOD
/begin COMPU_METHOD r_uw_q2 "" RAT_FUNC "%6.2" "Ohm" COEFFS 0 1 0 0 0 2 /end COMPU_METHOD
/begin COMPU_METHOD spgg_q0p52 "" RAT_FUNC "%6.3" "mV/ms" COEFFS 0 1 0 0 0 0.52 /end COMPU_METHOD
/begin COMPU_METHOD spgg_sw_b3052 "" RAT_FUNC "%6.3" "V/s" COEFFS 0 1 0 0 0 0.0931323 /end COMPU_METHOD
/begin COMPU_METHOD spg_sb_q0p01043 "" RAT_FUNC "%6.4" "V" COEFFS 0 255 0 0 0 2.66 /end COMPU_METHOD
/begin COMPU_METHOD spg_ub "" RAT_FUNC "%6.3" "V" COEFFS 0 1 0 0 0 0.0942 /end COMPU_METHOD
/begin COMPU_METHOD spg_ubatt "" RAT_FUNC "%6.3" "V" COEFFS 0 1 0 0 0 0.0942 /end COMPU_METHOD
/begin COMPU_METHOD spg_ub_b1p33 "" RAT_FUNC "%6.4" "V" COEFFS 0 255 0 0 0 1.33 /end COMPU_METHOD
/begin COMPU_METHOD spg_ub_b24 "" RAT_FUNC "%6.3" "1/V" COEFFS 0 1 0 0 0 0.09362 /end COMPU_METHOD
/begin COMPU_METHOD spg_ub_b5 "" RAT_FUNC "%6.4" "V" COEFFS 0 256 0 0 0 5 /end COMPU_METHOD
/begin COMPU_METHOD spg_ub_q0p0052 "" RAT_FUNC "%6.4" "V" COEFFS 0 255 0 0 0 1.33 /end COMPU_METHOD
/begin COMPU_METHOD spg_ub_q0p0052_o0p2 "" RAT_FUNC "%6.3" "V" COEFFS 0 255 51 0 0 1.33 /end COMPU_METHOD
/begin COMPU_METHOD spg_uw_b1280 "" RAT_FUNC "%7.4" "V" COEFFS 0 1000 0 0 0 19.531 /end COMPU_METHOD
/begin COMPU_METHOD spg_uw_b1p33 "" RAT_FUNC "%7.6" "V" COEFFS 0 65535 0 0 0 1.33 /end COMPU_METHOD
/begin COMPU_METHOD spg_uw_q0p00488_o1 "" RAT_FUNC "%6.3" "V" COEFFS 0 1024 1024 0 0 5 /end COMPU_METHOD
/begin COMPU_METHOD s_q0p02777_m "" RAT_FUNC "%6.4" "m" COEFFS 0 36 0 0 0 1 /end COMPU_METHOD
/begin COMPU_METHOD t100msxs_sb_q0p01 "" RAT_FUNC "%6.4" "s" COEFFS 0 1 0 0 0 0.01 /end COMPU_METHOD
/begin COMPU_METHOD t100msxs_ub_b25p5 "" RAT_FUNC "%6.3" "s" COEFFS 0 1 0 0 0 0.1 /end COMPU_METHOD
/begin COMPU_METHOD t100msxs_uw_b6553p5 "" RAT_FUNC "%6.3" "s" COEFFS 0 1 0 0 0 0.1 /end COMPU_METHOD
/begin COMPU_METHOD t100msxs_uw_q100 "" RAT_FUNC "%6.3" "s" COEFFS 0 1 0 0 0 0.1 /end COMPU_METHOD
/begin COMPU_METHOD t10msxs_ub_b2p55 "" RAT_FUNC "%6.4" "s" COEFFS 0 1 0 0 0 0.01 /end COMPU_METHOD
/begin COMPU_METHOD t10msxs_uw_b655p35 "" RAT_FUNC "%6.4" "s" COEFFS 0 1 0 0 0 0.01 /end COMPU_METHOD
/begin COMPU_METHOD t1sxs_ub_b255 "" RAT_FUNC "%6.2" "s" COEFFS 0 1 0 0 0 1 /end COMPU_METHOD
/begin COMPU_METHOD t1sxs_uw_b65535 "" RAT_FUNC "%6.2" "s" COEFFS 0 1 0 0 0 1 /end COMPU_METHOD
/begin COMPU_METHOD t200msxs_ub_b51 "" RAT_FUNC "%6.3" "s" COEFFS 0 1 0 0 0 0.2 /end COMPU_METHOD
/begin COMPU_METHOD t20msxs_ub_b5p1 "" RAT_FUNC "%6.4" "s" COEFFS 0 1 0 0 0 0.02 /end COMPU_METHOD
/begin COMPU_METHOD t20msxs_uw_b1310 "" RAT_FUNC "%7.4" "Sek." COEFFS 0 1 0 0 0 0.02 /end COMPU_METHOD
/begin COMPU_METHOD t40msxs_ub_q0p04 "" RAT_FUNC "%6.4" "s" COEFFS 0 1 0 0 0 0.04 /end COMPU_METHOD
/begin COMPU_METHOD t50msxs_q0p05 "" RAT_FUNC "%6.4" "s" COEFFS 0 1 0 0 0 0.05 /end COMPU_METHOD
/begin COMPU_METHOD t50msxs_ub_b12p75 "" RAT_FUNC "%6.4" "s" COEFFS 0 1 0 0 0 0.05 /end COMPU_METHOD
/begin COMPU_METHOD t50msxs_uw_b3276p75 "" RAT_FUNC "%6.4" "s" COEFFS 0 1 0 0 0 0.05 /end COMPU_METHOD
/begin COMPU_METHOD t50msxs_uw_b819p2 "" RAT_FUNC "%6.4" "s" COEFFS 0 1 0 0 0 0.0125 /end COMPU_METHOD
/begin COMPU_METHOD temp_ub_b191p25 "" RAT_FUNC "%6.3" "Grad C" COEFFS 0 1 0 0 0 0.75 /end COMPU_METHOD
/begin COMPU_METHOD temp_ub_q0p75_o48 "" RAT_FUNC "%6.2" "Grad C" COEFFS 0 1 48 0 0 0.75 /end COMPU_METHOD
/begin COMPU_METHOD temp_ub_q5_o50 "" RAT_FUNC "%6.2" "Grad C" COEFFS 0 1 50 0 0 5 /end COMPU_METHOD
/begin COMPU_METHOD tknockcon_sy "" RAT_FUNC "%8.7" "s" COEFFS 0 312500 0 0 0 1 /end COMPU_METHOD
/begin COMPU_METHOD t_q1 "" RAT_FUNC "%6.2" "s" COEFFS 0 1 0 0 0 1 /end COMPU_METHOD
/begin COMPU_METHOD vfzg_ub_q1p25 "" RAT_FUNC "%6.2" "km/h" COEFFS 0 1 0 0 0 1.25 /end COMPU_METHOD
/begin COMPU_METHOD vol_q0p1_l "" RAT_FUNC "%6.3" "L" COEFFS 0 1 0 0 0 0.1 /end COMPU_METHOD
/begin COMPU_METHOD vol_q1_l "" RAT_FUNC "%6.2" "L" COEFFS 0 1 0 0 0 1 /end COMPU_METHOD
/begin COMPU_METHOD vol_q3p90625Em3_l "" RAT_FUNC "%6.4" "L" COEFFS 0 65536 0 0 0 256 /end COMPU_METHOD
/begin COMPU_METHOD zk100msxs_uw_b6553 "" RAT_FUNC "%6.1" "s" COEFFS 0 0 65536 0 10 0 /end COMPU_METHOD
/begin COMPU_METHOD zk10msxs_ub_b2p55 "" RAT_FUNC "%6.4" "s" COEFFS 0 0 255 0 100 0 /end COMPU_METHOD
/begin COMPU_METHOD zk200msxs_ub_b51p2 "" RAT_FUNC "%6.3" "s" COEFFS 0 0 51.2 0 1 0 /end COMPU_METHOD
/begin COMPU_METHOD zk50msxs_ub_b12p8 "" RAT_FUNC "%6.3" "s" COEFFS 0 0 128 0 10 0 /end COMPU_METHOD
/begin RECORD_LAYOUT GkfWSw FNC_VALUES 1 SWORD COLUMN_DIR DIRECT /end RECORD_LAYOUT
/begin RECORD_LAYOUT GkfWUw FNC_VALUES 1 UWORD COLUMN_DIR DIRECT /end RECORD_LAYOUT
/begin RECORD_LAYOUT GklWSw FNC_VALUES 1 SWORD COLUMN_DIR DIRECT /end RECORD_LAYOUT
/begin RECORD_LAYOUT GklWUb FNC_VALUES 1 UBYTE COLUMN_DIR DIRECT /end RECORD_LAYOUT
/begin RECORD_LAYOUT GklWUw FNC_VALUES 1 UWORD COLUMN_DIR DIRECT /end RECORD_LAYOUT
/begin RECORD_LAYOUT KfAxUbAyUbSstxUbSstyUbWUb NO_AXIS_PTS_X 1 UBYTE NO_AXIS_PTS_Y 2 UBYTE AXIS_PTS_X 3 UBYTE INDEX_INCR DIRECT AXIS_PTS_Y 4 UBYTE INDEX_INCR DIRECT FNC_VALUES 5 UBYTE COLUMN_DIR DIRECT /end RECORD_LAYOUT
/begin RECORD_LAYOUT KlAUbSstUbWUb NO_AXIS_PTS_X 1 UBYTE AXIS_PTS_X 2 UBYTE INDEX_INCR DIRECT FNC_VALUES 3 UBYTE COLUMN_DIR DIRECT /end RECORD_LAYOUT
/begin RECORD_LAYOUT KlAUwSstUwWUw NO_AXIS_PTS_X 1 UWORD AXIS_PTS_X 2 UWORD INDEX_INCR DIRECT FNC_VALUES 3 UWORD COLUMN_DIR DIRECT /end RECORD_LAYOUT
/begin RECORD_LAYOUT KwbUb FNC_VALUES 1 UBYTE COLUMN_DIR DIRECT /end RECORD_LAYOUT
/begin RECORD_LAYOUT KwbUw FNC_VALUES 1 UWORD COLUMN_DIR DIRECT /end RECORD_LAYOUT
/begin RECORD_LAYOUT KwSb FNC_VALUES 1 SBYTE COLUMN_DIR DIRECT /end RECORD_LAYOUT
/begin RECORD_LAYOUT KwSw FNC_VALUES 1 SWORD COLUMN_DIR DIRECT /end RECORD_LAYOUT
/begin RECORD_LAYOUT KwUb FNC_VALUES 1 UBYTE COLUMN_DIR DIRECT /end RECORD_LAYOUT
/begin RECORD_LAYOUT KwUw FNC_VALUES 1 UWORD COLUMN_DIR DIRECT /end RECORD_LAYOUT
/begin RECORD_LAYOUT SstASwSstSw NO_AXIS_PTS_X 1 SWORD AXIS_PTS_X 2 SWORD INDEX_INCR DIRECT /end RECORD_LAYOUT
/begin RECORD_LAYOUT SstAUbSstUb NO_AXIS_PTS_X 1 UBYTE AXIS_PTS_X 2 UBYTE INDEX_INCR DIRECT /end RECORD_LAYOUT
/begin RECORD_LAYOUT SstAUwSstUw NO_AXIS_PTS_X 1 UWORD AXIS_PTS_X 2 UWORD INDEX_INCR DIRECT /end RECORD_LAYOUT
/end MODULE
/end PROJECT
