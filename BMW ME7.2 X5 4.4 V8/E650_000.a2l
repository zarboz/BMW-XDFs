ASAP2_VERSION 1 3
/begin PROJECT _7211165 "195"
/begin HEADER "" VERSION "_7211165" PROJECT_NO _7211165 /end HEADER
/begin MODULE DIM ""
/begin MOD_COMMON "" BYTE_ORDER MSB_LAST ALIGNMENT_BYTE 1 ALIGNMENT_WORD 2 ALIGNMENT_LONG 2 /end MOD_COMMON
/begin CHARACTERISTIC BMFA "Anzahl BM-Fehler (Zähler-Anfangswert)" VALUE 0x815740 KwUw 65535.00 dez 0.00 65535.00 FORMAT "%8.2" /end CHARACTERISTIC
/begin CHARACTERISTIC BMFMX "Zähler Maximalwert für BM-Fehler" VALUE 0x815742 KwUw 65535.00 dez 0.00 65535.00 FORMAT "%8.2" /end CHARACTERISTIC
/begin CHARACTERISTIC CAN_SU_TIME "" VALUE 0x8110B7 KwUb 2.550 t10msxs_ub_b2p55 0.00 2.550 FORMAT "%5.3" /end CHARACTERISTIC
/begin CHARACTERISTIC CBGRLP "Codewort Konfiguration Funktion BGRLP" VALUE 0x81008A KwUb 255.0 dez 0.00 255.0 FORMAT "%5.1" /end CHARACTERISTIC
/begin CHARACTERISTIC CDCACC "Codewort CARB: ACC" VAL_BLK 0x814F62 KwbUw 65535.00 dez 0.00 65535.00 FORMAT "%8.2" NUMBER 4 /end CHARACTERISTIC
/begin CHARACTERISTIC CDCAS "Codewort CARB: ASR - Eingriff" VAL_BLK 0x814F82 KwbUw 65535.00 dez 0.00 65535.00 FORMAT "%8.2" NUMBER 4 /end CHARACTERISTIC
/begin CHARACTERISTIC CDCCACC "Codewort CARB: CAN-Schnittstelle, Timeout ACC" VAL_BLK 0x814FA2 KwbUw 65535.00 dez 0.00 65535.00 FORMAT "%8.2" NUMBER 4 /end CHARACTERISTIC
/begin CHARACTERISTIC CDCCAS "Codewort CARB: CAN-Schnittstelle, Timeout ASC" VAL_BLK 0x814FAA KwbUw 65535.00 dez 0.00 65535.00 FORMAT "%8.2" NUMBER 4 /end CHARACTERISTIC
/begin CHARACTERISTIC CDCCGE "Codewort CARB: CAN-Schnittstelle, Timeout EGS" VAL_BLK 0x814FB2 KwbUw 65535.00 dez 0.00 65535.00 FORMAT "%8.2" NUMBER 4 /end CHARACTERISTIC
/begin CHARACTERISTIC CDCCINS "Codewort CARB: CAN-Schnittstelle, Timeout Instrument" VAL_BLK 0x814FBA KwbUw 65535.00 dez 0.00 65535.00 FORMAT "%8.2" NUMBER 4 /end CHARACTERISTIC
/begin CHARACTERISTIC CDCCTXU "Codewort CARB: CAN-Schnittstelle, Timeout TXU" VAL_BLK 0x814FC2 KwbUw 65535.00 dez 0.00 65535.00 FORMAT "%8.2" NUMBER 4 /end CHARACTERISTIC
/begin CHARACTERISTIC CDCDVEE "Codewort CARB: DV-E Endstufe" VAL_BLK 0x81503A KwbUw 65535.00 dez 0.00 65535.00 FORMAT "%8.2" NUMBER 4 /end CHARACTERISTIC
/begin CHARACTERISTIC CDCDVEF "Codewort CARB: DV-E Fehler bei Federprüfung" VAL_BLK 0x815042 KwbUw 65535.00 dez 0.00 65535.00 FORMAT "%8.2" NUMBER 4 /end CHARACTERISTIC
/begin CHARACTERISTIC CDCDVEL "Codewort CARB: DV-E Lageabweichung" VAL_BLK 0x81504A KwbUw 65535.00 dez 0.00 65535.00 FORMAT "%8.2" NUMBER 4 /end CHARACTERISTIC
/begin CHARACTERISTIC CDCDVEN "Codewort CARB: DV-E Fehler bei Prüfung Notluftposition" VAL_BLK 0x815052 KwbUw 65535.00 dez 0.00 65535.00 FORMAT "%8.2" NUMBER 4 /end CHARACTERISTIC
/begin CHARACTERISTIC CDCDVER "Codewort CARB: DV-E Regelbereich" VAL_BLK 0x81505A KwbUw 65535.00 dez 0.00 65535.00 FORMAT "%8.2" NUMBER 4 /end CHARACTERISTIC
/begin CHARACTERISTIC CDCDVEU "Codewort CARB: DV-E Fehler beim UMA-Lernen" VAL_BLK 0x815062 KwbUw 65535.00 dez 0.00 65535.00 FORMAT "%8.2" NUMBER 4 /end CHARACTERISTIC
/begin CHARACTERISTIC CDCDVEV "Codewort CARB: DV-E Fehler bei Verstärkerabgleich" VAL_BLK 0x81506A KwbUw 65535.00 dez 0.00 65535.00 FORMAT "%8.2" NUMBER 4 /end CHARACTERISTIC
/begin CHARACTERISTIC CDCSWE "Codewort CARB:	Beschleunigungssensor der Schlechtwegeerkennung" VAL_BLK 0x815332 KwbUw 65535.00 dez 0.00 65535.00 FORMAT "%8.2" NUMBER 4 /end CHARACTERISTIC
/begin CHARACTERISTIC CDKACC "Codewort Kunde: ACC Plausibilität" VALUE 0x8153EE KwUw 65535.00 dez 0.00 65535.00 FORMAT "%8.2" /end CHARACTERISTIC
/begin CHARACTERISTIC CDKAS "Codewort Kunde: ASR - Eingriff" VALUE 0x8153F6 KwUw 65535.00 dez 0.00 65535.00 FORMAT "%8.2" /end CHARACTERISTIC
/begin CHARACTERISTIC CDKCACC "Codewort Kunde: CAN_ Timeout ACC- Botschaft" VALUE 0x8153FE KwUw 65535.00 dez 0.00 65535.00 FORMAT "%8.2" /end CHARACTERISTIC
/begin CHARACTERISTIC CDKCAS "Codewort Kunde: CAN-Schnittstelle, Timeout ASC" VALUE 0x815400 KwUw 65535.00 dez 0.00 65535.00 FORMAT "%8.2" /end CHARACTERISTIC
/begin CHARACTERISTIC CDKCGE "Codewort Kunde: CAN-Schnittstelle, Timeout EGS" VALUE 0x815402 KwUw 65535.00 dez 0.00 65535.00 FORMAT "%8.2" /end CHARACTERISTIC
/begin CHARACTERISTIC CDKCINS "Codewort Kunde: CAN- timeout, Instrumente" VALUE 0x815404 KwUw 65535.00 dez 0.00 65535.00 FORMAT "%8.2" /end CHARACTERISTIC
/begin CHARACTERISTIC CDKCTXU "" VALUE 0x815406 KwUw 65535.00 dez 0.00 65535.00 FORMAT "%8.2" /end CHARACTERISTIC
/begin CHARACTERISTIC CDKDVEE "Codewort Kunde: DV-E Endstufe" VALUE 0x815424 KwUw 65535.00 dez 0.00 65535.00 FORMAT "%8.2" /end CHARACTERISTIC
/begin CHARACTERISTIC CDKDVEF "Codewort Kunde: DV-E Fehler bei Federprüfung" VALUE 0x815426 KwUw 65535.00 dez 0.00 65535.00 FORMAT "%8.2" /end CHARACTERISTIC
/begin CHARACTERISTIC CDKDVEL "Codewort Kunde: DV-E Lageabweichung" VALUE 0x815428 KwUw 65535.00 dez 0.00 65535.00 FORMAT "%8.2" /end CHARACTERISTIC
/begin CHARACTERISTIC CDKDVEN "Codewort Kunde: DV-E Fehler bei Prüfung Notlufposition" VALUE 0x81542A KwUw 65535.00 dez 0.00 65535.00 FORMAT "%8.2" /end CHARACTERISTIC
/begin CHARACTERISTIC CDKDVER "Codewort Kunde: DV-E Regelbereich" VALUE 0x81542C KwUw 65535.00 dez 0.00 65535.00 FORMAT "%8.2" /end CHARACTERISTIC
/begin CHARACTERISTIC CDKDVEU "Codewort Kunde: DV-E Fehler beim UMA-Lernen" VALUE 0x81542E KwUw 65535.00 dez 0.00 65535.00 FORMAT "%8.2" /end CHARACTERISTIC
/begin CHARACTERISTIC CDKDVEV "Codewort Kunde: DV-E Fehler bei Verstärkerabgleich" VALUE 0x815430 KwUw 65535.00 dez 0.00 65535.00 FORMAT "%8.2" /end CHARACTERISTIC
/begin CHARACTERISTIC CDKSWE "Codewort Kunde:	Beschleunigungssensor der Schlechtwegeerkennung" VALUE 0x8154E2 KwUw 65535.00 dez 0.00 65535.00 FORMAT "%8.2" /end CHARACTERISTIC
/begin CHARACTERISTIC CDTACC "Codewort Tester: ACC" VALUE 0x815514 KwUw 65535.00 dez 0.00 65535.00 FORMAT "%8.2" /end CHARACTERISTIC
/begin CHARACTERISTIC CDTAS "Codewort Tester: ASR - Eingriff" VALUE 0x81551C KwUw 65535.00 dez 0.00 65535.00 FORMAT "%8.2" /end CHARACTERISTIC
/begin CHARACTERISTIC CDTCACC "Codewort Tester: CAN-Schnittstelle, Timeout ACC" VALUE 0x815524 KwUw 65535.00 dez 0.00 65535.00 FORMAT "%8.2" /end CHARACTERISTIC
/begin CHARACTERISTIC CDTCAS "Codewort Tester: CAN-Schnittstelle, Timeout ASC" VALUE 0x815526 KwUw 65535.00 dez 0.00 65535.00 FORMAT "%8.2" /end CHARACTERISTIC
/begin CHARACTERISTIC CDTCGE "Codewort Tester: CAN-Schnittstelle, Timeout EGS" VALUE 0x815528 KwUw 65535.00 dez 0.00 65535.00 FORMAT "%8.2" /end CHARACTERISTIC
/begin CHARACTERISTIC CDTCINS "Codewort Tester: CAN-Timeout, Instrumente" VALUE 0x81552A KwUw 65535.00 dez 0.00 65535.00 FORMAT "%8.2" /end CHARACTERISTIC
/begin CHARACTERISTIC CDTCTXU "Codewort Tester: CAN-Schnittstelle, Timeout TXU" VALUE 0x81552C KwUw 65535.00 dez 0.00 65535.00 FORMAT "%8.2" /end CHARACTERISTIC
/begin CHARACTERISTIC CDTDVEE "Codewort Tester: DV-E Endstufe" VALUE 0x81554A KwUw 65535.00 dez 0.00 65535.00 FORMAT "%8.2" /end CHARACTERISTIC
/begin CHARACTERISTIC CDTDVEF "Codewort Tester: DV-E Fehler bei Federprüfung" VALUE 0x81554C KwUw 65535.00 dez 0.00 65535.00 FORMAT "%8.2" /end CHARACTERISTIC
/begin CHARACTERISTIC CDTDVEL "Codewort Tester: DV-E Lageabweichung" VALUE 0x81554E KwUw 65535.00 dez 0.00 65535.00 FORMAT "%8.2" /end CHARACTERISTIC
/begin CHARACTERISTIC CDTDVEN "Codewort Tester: DV-E Fehler bei Prüfung Notlufposition" VALUE 0x815550 KwUw 65535.00 dez 0.00 65535.00 FORMAT "%8.2" /end CHARACTERISTIC
/begin CHARACTERISTIC CDTDVER "Codewort Tester: DV-E Regelbereich" VALUE 0x815552 KwUw 65535.00 dez 0.00 65535.00 FORMAT "%8.2" /end CHARACTERISTIC
/begin CHARACTERISTIC CDTDVEU "Codewort Tester: DV-E Fehler beim UMA-Lernen" VALUE 0x815554 KwUw 65535.00 dez 0.00 65535.00 FORMAT "%8.2" /end CHARACTERISTIC
/begin CHARACTERISTIC CDTDVEV "Codewort Tester: DV-E Fehler bei Verstärkerabgleich" VALUE 0x815556 KwUw 65535.00 dez 0.00 65535.00 FORMAT "%8.2" /end CHARACTERISTIC
/begin CHARACTERISTIC CDTSWE "Codewort Tester: Beschleunigungssensor Schlechtwegeerk." VALUE 0x815608 KwUw 65535.00 dez 0.00 65535.00 FORMAT "%8.2" /end CHARACTERISTIC
/begin CHARACTERISTIC CL30LINE "30. Linie der Klassentabelle" VAL_BLK 0x81DEE6 KwbUb 255.0 dez 0.00 255.0 FORMAT "%5.1" NUMBER 13 /end CHARACTERISTIC
/begin CHARACTERISTIC CL31LINE "31. Linie der Klassentabelle" VAL_BLK 0x81DEF4 KwbUb 255.0 dez 0.00 255.0 FORMAT "%5.1" NUMBER 13 /end CHARACTERISTIC
/begin CHARACTERISTIC CL32LINE "32. Linie der Klassentabelle" VAL_BLK 0x81DF02 KwbUb 255.0 dez 0.00 255.0 FORMAT "%5.1" NUMBER 13 /end CHARACTERISTIC
/begin CHARACTERISTIC CL33LINE "33. Linie der Klassentabelle" VAL_BLK 0x81DF10 KwbUb 255.0 dez 0.00 255.0 FORMAT "%5.1" NUMBER 13 /end CHARACTERISTIC
/begin CHARACTERISTIC CL34LINE "34. Linie der Klassentabelle" VAL_BLK 0x81DF1E KwbUb 255.0 dez 0.00 255.0 FORMAT "%5.1" NUMBER 13 /end CHARACTERISTIC
/begin CHARACTERISTIC CL35LINE "35. Linie der Klassentabelle" VAL_BLK 0x81DF2C KwbUb 255.0 dez 0.00 255.0 FORMAT "%5.1" NUMBER 13 /end CHARACTERISTIC
/begin CHARACTERISTIC CL36LINE "36. Linie der Klassentabelle" VAL_BLK 0x81DF3A KwbUb 255.0 dez 0.00 255.0 FORMAT "%5.1" NUMBER 13 /end CHARACTERISTIC
/begin CHARACTERISTIC CL37LINE "37. Linie der Klassentabelle" VAL_BLK 0x81DF48 KwbUb 255.0 dez 0.00 255.0 FORMAT "%5.1" NUMBER 13 /end CHARACTERISTIC
/begin CHARACTERISTIC CL38LINE "38. Linie der Klassentabelle" VAL_BLK 0x81DF56 KwbUb 255.0 dez 0.00 255.0 FORMAT "%5.1" NUMBER 13 /end CHARACTERISTIC
/begin CHARACTERISTIC CL39LINE "39. Linie der Klassentabelle" VAL_BLK 0x81DF64 KwbUb 255.0 dez 0.00 255.0 FORMAT "%5.1" NUMBER 13 /end CHARACTERISTIC
/begin CHARACTERISTIC CLAACC "Fehlerklasse: ACC" VALUE 0x811605 KwUb 255.0 dez 0.00 255.0 FORMAT "%5.1" /end CHARACTERISTIC
/begin CHARACTERISTIC CLAAS "Fehlerklasse: ASR- Eingriff" VALUE 0x811609 KwUb 255.0 dez 0.00 255.0 FORMAT "%5.1" /end CHARACTERISTIC
/begin CHARACTERISTIC CLACACC "Fehlerklasse: CAN-Timeout ACC-Botschaft" VALUE 0x81160D KwUb 255.0 dez 0.00 255.0 FORMAT "%5.1" /end CHARACTERISTIC
/begin CHARACTERISTIC CLACAS "Fehlerklasse: CAN-Timeout ASC-Botschaft" VALUE 0x81160E KwUb 255.0 dez 0.00 255.0 FORMAT "%5.1" /end CHARACTERISTIC
/begin CHARACTERISTIC CLACGE "Fehlerklasse: CAN-Timeout EGS-Botschaft" VALUE 0x81160F KwUb 255.0 dez 0.00 255.0 FORMAT "%5.1" /end CHARACTERISTIC
/begin CHARACTERISTIC CLACINS "Fehlerklasse: CAN-Timeout Botschaft Kombiinstrument" VALUE 0x811610 KwUb 255.0 dez 0.00 255.0 FORMAT "%5.1" /end CHARACTERISTIC
/begin CHARACTERISTIC CLACTXU "Fehlerklasse: CAN-Timeout TXU-Botschaft" VALUE 0x811611 KwUb 255.0 dez 0.00 255.0 FORMAT "%5.1" /end CHARACTERISTIC
/begin CHARACTERISTIC CLADVEE "Fehlerklasse: DV-E Endstufe" VALUE 0x811620 KwUb 255.0 dez 0.00 255.0 FORMAT "%5.1" /end CHARACTERISTIC
/begin CHARACTERISTIC CLADVEF "Fehlerklasse: DV-E Fehler bei Federprüfung" VALUE 0x811621 KwUb 255.0 dez 0.00 255.0 FORMAT "%5.1" /end CHARACTERISTIC
/begin CHARACTERISTIC CLADVEL "Fehlerklasse: DV-E Lageabweichung" VALUE 0x811622 KwUb 255.0 dez 0.00 255.0 FORMAT "%5.1" /end CHARACTERISTIC
/begin CHARACTERISTIC CLADVEN "Fehlerklasse: DV-E Fehler bei Prüfung Notluftposition" VALUE 0x811623 KwUb 255.0 dez 0.00 255.0 FORMAT "%5.1" /end CHARACTERISTIC
/begin CHARACTERISTIC CLADVER "Fehlerklasse: DV-E Regelbereich" VALUE 0x811624 KwUb 255.0 dez 0.00 255.0 FORMAT "%5.1" /end CHARACTERISTIC
/begin CHARACTERISTIC CLADVEU "Fehlerklasse: DV-E Fehler beim UMA-Lernen" VALUE 0x811625 KwUb 255.0 dez 0.00 255.0 FORMAT "%5.1" /end CHARACTERISTIC
/begin CHARACTERISTIC CLADVEV "Fehlerklasse: DV-E Fehler bei Verstärkerabgleich" VALUE 0x811626 KwUb 255.0 dez 0.00 255.0 FORMAT "%5.1" /end CHARACTERISTIC
/begin CHARACTERISTIC CLASWE "Fehlerklasse: Beschleunigungssensor der Schlechtwegerkennung" VALUE 0x81167F KwUb 255.0 dez 0.00 255.0 FORMAT "%5.1" /end CHARACTERISTIC
/begin CHARACTERISTIC CWDASC "Code für ASC-Überwachungsumschaltung" VALUE 0x810061 KwUb 255.0 dez 0.00 255.0 FORMAT "%5.1" /end CHARACTERISTIC
/begin CHARACTERISTIC CWDDMTL "Codewort DDMTL-Funktion" VALUE 0x81A70E KwUb 255.0 dez 0.00 255.0 FORMAT "%5.1" /end CHARACTERISTIC
/begin CHARACTERISTIC CWDDMTL2 "Codewort DDMTL-Funktion" VALUE 0x81A70F KwUb 255.0 dez 0.00 255.0 FORMAT "%5.1" /end CHARACTERISTIC
/begin CHARACTERISTIC CWDDMTL3 "Codewort DDMTL-Funktion" VALUE 0x81A710 KwUb 255.0 dez 0.00 255.0 FORMAT "%5.1" /end CHARACTERISTIC
/begin CHARACTERISTIC CWDEGFE "Codewort für Abschaltung der Funktion %DEGFE" VALUE 0x819DB6 KwUb 255.0 dez 0.00 255.0 FORMAT "%5.1" /end CHARACTERISTIC
/begin CHARACTERISTIC DIFFMAX "max. zulässige Druckänderung während 100ms" VALUE 0x81760E KwUw 2559.961 p_uw_q0p039 0.00 2559.961 FORMAT "%8.3" /end CHARACTERISTIC
/begin CHARACTERISTIC DIPRFO "obere Schwelle delta Pumpenreferenzstrom" VALUE 0x81BC78 KwUw 399.9939 i_q6p1035_uA 0.00 399.9939 FORMAT "%8.4" /end CHARACTERISTIC
/begin CHARACTERISTIC DIPTREF "Offset Referenzpumpenstrom" VALUE 0x81BC7A KwSw 399.9939 i_q6p1035_uA -200.0000 199.9939 FORMAT "%8.4" /end CHARACTERISTIC
/begin CHARACTERISTIC DIPTSTAB "delta Pumpenstrom fuer Pumpenstrom stabil" VALUE 0x81BC7C KwUw 399.9939 i_q6p1035_uA 0.00 399.9939 FORMAT "%8.4" /end CHARACTERISTIC
/begin CHARACTERISTIC DIPTUMVU "Offset Pumpenstrom bei Aussendruck" VALUE 0x81BC7E KwSw 399.9939 i_q6p1035_uA -200.0000 199.9939 FORMAT "%8.4" /end CHARACTERISTIC
/begin CHARACTERISTIC DITEDTD "Schwelle Pumpenstromaenderung zur Tankdeckelerkennung" VALUE 0x81BC80 KwSw 399.9939 i_q6p1035_uA -200.0000 199.9939 FORMAT "%8.4" /end CHARACTERISTIC
/begin CHARACTERISTIC DITEDTK "Schwelle Pumpenstromaenderung zur Betankungserkennung" VALUE 0x81BC82 KwSw 399.9939 i_q6p1035_uA -200.0000 199.9939 FORMAT "%8.4" /end CHARACTERISTIC
/begin CHARACTERISTIC DMAUFASC "Deltamoment Aufregelung nach ASC-Fehler" VALUE 0x81000B KwUb 24.90 rel_ub_b24p9 0.00 24.90 FORMAT "%5.2" /end CHARACTERISTIC
/begin CHARACTERISTIC DPSF "Schwelle Stromabfall während Messung" VALUE 0x81BC84 KwUw 399.9939 i_q6p1035_uA 0.00 399.9939 FORMAT "%8.4" /end CHARACTERISTIC
/begin CHARACTERISTIC DRLDYNU "drl-Schwellwert für te-Nachspritzer/Reduktion" VALUE 0x814284 KwSw 1535.977 rel_sw_q0p0234 -768.0000 767.9766 FORMAT "%8.4" /end CHARACTERISTIC
/begin CHARACTERISTIC DTABUNPL "Schwelle Abstellzeit unplausibel" VALUE 0x81B70A KwUw 65535.00 t1sxs_uw_q1 0.00 65535.00 FORMAT "%8.2" /end CHARACTERISTIC
/begin CHARACTERISTIC DTEPRU "delta-te-Schwelle fuer Nachspritzer-/ti-Reduktion erkannt" VALUE 0x814286 KwUw 209.7478 t3p2usxms_uw_b209p7 0.00 209.7478 FORMAT "%8.4" /end CHARACTERISTIC
/begin CHARACTERISTIC DTUMTA "Offset Ansauglufttemperatur -> Umgebungstemperatur" VALUE 0x819DD6 KwSb 191.3 temp_sb_q0p75 -96.00 95.25 FORMAT "%5.2" /end CHARACTERISTIC
/begin CHARACTERISTIC DUBTES "Delta ub-Schwelle für Tankentlüftungsdiagnose" VALUE 0x81BC86 KwUw 25.59961 spg_q0p00039 0.00 25.59961 FORMAT "%8.5" /end CHARACTERISTIC
/begin CHARACTERISTIC DWF0SEG "Drehzahlwarnfeld: Schwelle f. 0 Segmente angesteuert" VALUE 0x81A86B KwUb 191.3 temp_ub_q0p75_o48 -48.00 143.3 FORMAT "%5.1" /end CHARACTERISTIC
/begin CHARACTERISTIC DWF1SEG "Drehzahlwarnfeld: Schwelle f. 1 Segment angesteuert" VALUE 0x81A86C KwUb 191.3 temp_ub_q0p75_o48 -48.00 143.3 FORMAT "%5.1" /end CHARACTERISTIC
/begin CHARACTERISTIC DWF2SEG "Drehzahlwarnfeld: Schwelle f. 2 Segmente angesteuert" VALUE 0x81A86D KwUb 191.3 temp_ub_q0p75_o48 -48.00 143.3 FORMAT "%5.1" /end CHARACTERISTIC
/begin CHARACTERISTIC DWF3SEG "Drehzahlwarnfeld: Schwelle f. 3 Segmente angesteuert" VALUE 0x81A86E KwUb 191.3 temp_ub_q0p75_o48 -48.00 143.3 FORMAT "%5.1" /end CHARACTERISTIC
/begin CHARACTERISTIC eskonf "Konfiguration Endstufen" VAL_BLK 0x811B50 KwbUb 255.0 dez 0.00 255.0 FORMAT "%5.1" NUMBER 8 /end CHARACTERISTIC
/begin CHARACTERISTIC FDVANS "Temperaturfaktor für Drosselventildurchfluß" CURVE 0x819D25 KlAUbSstUbWUb 1.992 fak_ub_b2 0.00 1.992 FORMAT "%5.3"
 /begin AXIS_DESCR STD_AXIS tans temp_ub_q0p75_o48 8 -48.00 143.3 FORMAT "%5.1" DEPOSIT ABSOLUTE /end AXIS_DESCR
/end CHARACTERISTIC
/begin CHARACTERISTIC FFTACC "Freeze Frame Tabelle: ACC" VAL_BLK 0x81169E KwbUb 255.0 dez 0.00 255.0 FORMAT "%5.1" NUMBER 4 /end CHARACTERISTIC
/begin CHARACTERISTIC FFTAS "Freeze Frame Tabelle: ASR- Eingriff" VAL_BLK 0x8116AE KwbUb 255.0 dez 0.00 255.0 FORMAT "%5.1" NUMBER 4 /end CHARACTERISTIC
/begin CHARACTERISTIC FFTCACC "Freeze Frame Tabelle: CAN-Timeout ACC-Botschaft" VAL_BLK 0x8116BE KwbUb 255.0 dez 0.00 255.0 FORMAT "%5.1" NUMBER 4 /end CHARACTERISTIC
/begin CHARACTERISTIC FFTCAS "Freeze Frame Tabelle: CAN-Timeout ASC-Botschaft" VAL_BLK 0x8116C2 KwbUb 255.0 dez 0.00 255.0 FORMAT "%5.1" NUMBER 4 /end CHARACTERISTIC
/begin CHARACTERISTIC FFTCGE "Freeze Frame Tabelle: CAN-Timeout EGS-Botschaft" VAL_BLK 0x8116C6 KwbUb 255.0 dez 0.00 255.0 FORMAT "%5.1" NUMBER 4 /end CHARACTERISTIC
/begin CHARACTERISTIC FFTCINS "Freeze Frame Tabelle: CAN-Timeout Instr.-Botschaft" VAL_BLK 0x8116CA KwbUb 255.0 dez 0.00 255.0 FORMAT "%5.1" NUMBER 4 /end CHARACTERISTIC
/begin CHARACTERISTIC FFTCTXU "Freeze Frame Tabelle: CAN-Timeout TXU-Botschaft" VAL_BLK 0x8116CE KwbUb 255.0 dez 0.00 255.0 FORMAT "%5.1" NUMBER 4 /end CHARACTERISTIC
/begin CHARACTERISTIC FFTDVEE "Freeze Frame Tabelle: DV-E Endstufe" VAL_BLK 0x81170A KwbUb 255.0 dez 0.00 255.0 FORMAT "%5.1" NUMBER 4 /end CHARACTERISTIC
/begin CHARACTERISTIC FFTDVEF "Freeze Frame Tabelle: DV-E Fehler bei Federprüfung" VAL_BLK 0x81170E KwbUb 255.0 dez 0.00 255.0 FORMAT "%5.1" NUMBER 4 /end CHARACTERISTIC
/begin CHARACTERISTIC FFTDVEL "Freeze Frame Tabelle: DV-E Lageabweichung" VAL_BLK 0x811712 KwbUb 255.0 dez 0.00 255.0 FORMAT "%5.1" NUMBER 4 /end CHARACTERISTIC
/begin CHARACTERISTIC FFTDVEN "Freeze Frame Tabelle: DV-E Fehler bei Prüfung Notluftposition" VAL_BLK 0x811716 KwbUb 255.0 dez 0.00 255.0 FORMAT "%5.1" NUMBER 4 /end CHARACTERISTIC
/begin CHARACTERISTIC FFTDVER "Freeze Frame Tabelle: DV-E Regelbereich" VAL_BLK 0x81171A KwbUb 255.0 dez 0.00 255.0 FORMAT "%5.1" NUMBER 4 /end CHARACTERISTIC
/begin CHARACTERISTIC FFTDVEU "Freeze Frame Tabelle: DV-E Fehler beim UMA-Lernen" VAL_BLK 0x81171E KwbUb 255.0 dez 0.00 255.0 FORMAT "%5.1" NUMBER 4 /end CHARACTERISTIC
/begin CHARACTERISTIC FFTDVEV "Freeze Frame Tabelle: DV-E Fehler bei Verstärkerabgleich" VAL_BLK 0x811722 KwbUb 255.0 dez 0.00 255.0 FORMAT "%5.1" NUMBER 4 /end CHARACTERISTIC
/begin CHARACTERISTIC FFTSWE "Freeze Frame Tabelle: Beschleunigungssensor Schlechtwegeerk." VAL_BLK 0x811886 KwbUb 255.0 dez 0.00 255.0 FORMAT "%5.1" NUMBER 4 /end CHARACTERISTIC
/begin CHARACTERISTIC FIP2STAB "Faktor Zeit für 2 stabilisierung" VALUE 0x81BC88 KwUw 0.9999847 fak_uw_b1 0.00 0.9999847 FORMAT "%9.7" /end CHARACTERISTIC
/begin CHARACTERISTIC FIPTGL "Faktor delta Pumpenstrom fuer Grobleckerkennung" CURVE 0x81BC8A KlAUwSstUwWUw 0.9999847 fak_uw_b1 0.00 0.9999847 FORMAT "%9.7"
 /begin AXIS_DESCR STD_AXIS iptgh_w i_q6p1035_uA 8 0.00 399.9939 FORMAT "%8.4" DEPOSIT ABSOLUTE /end AXIS_DESCR
/end CHARACTERISTIC
/begin CHARACTERISTIC FIPTGLR "Faktor delta Pumpenstrom fuer Grobleckerkennung in Bezug auf Referenz" CURVE 0x81BCAC KlAUwSstUwWUw 0.9999847 fak_uw_b1 0.00 0.9999847 FORMAT "%9.7"
 /begin AXIS_DESCR STD_AXIS iptgh_w i_q6p1035_uA 8 0.00 399.9939 FORMAT "%8.4" DEPOSIT ABSOLUTE /end AXIS_DESCR
/end CHARACTERISTIC
/begin CHARACTERISTIC FIPTUBF "Faktor Pumpenstrom" CURVE 0x81BCCE KlAUwSstUwWUw 1.999969 fak_uw_b2 0.00 1.999969 FORMAT "%8.6"
 /begin AXIS_DESCR STD_AXIS ubtesf_w spg_q0p00039 9 0.00 25.59961 FORMAT "%8.5" DEPOSIT ABSOLUTE /end AXIS_DESCR
/end CHARACTERISTIC
/begin CHARACTERISTIC FPVMXN "Faktor maximales Druckverhältnis mit Hauptlastsignal" CURVE 0x81A8F0 KlAUwSstUwWUw 1.999969 fak_uw_b2 0.00 1.999969 FORMAT "%8.6"
 /begin AXIS_DESCR STD_AXIS nmot_w nmot_uw_q0p25 6 0.00 16383.75 FORMAT "%8.2" DEPOSIT ABSOLUTE /end AXIS_DESCR
/end CHARACTERISTIC
/begin CHARACTERISTIC FPVMXN2 "Faktor maximales Druckverhältnis mit Nebenlastsignal" CURVE 0x81A90A KlAUwSstUwWUw 1.999969 fak_uw_b2 0.00 1.999969 FORMAT "%8.6"
 /begin AXIS_DESCR STD_AXIS nmot_w nmot_uw_q0p25 6 0.00 16383.75 FORMAT "%8.2" DEPOSIT ABSOLUTE /end AXIS_DESCR
/end CHARACTERISTIC
/begin CHARACTERISTIC FUMRMV "Faktor Dichte der Luft" VALUE 0x810080 KwUb 1.992 dichte_ub_b2 0.00 1.992 FORMAT "%5.3" /end CHARACTERISTIC
/begin CHARACTERISTIC FUMSTEK "Faktor Umschaltung auf Kennfeld (wdk/n) zur Berechnung Massenstrom TEV" VALUE 0x810081 KwUb 0.7031 fak_ub_b2 0.00 0.7031 /end CHARACTERISTIC
/begin CHARACTERISTIC HOTEDU "Untere Höhenschwelle für Durchführung Tankentlüftungsdiagnose" VALUE 0x81BCF4 KwUw 3.999939 fak_uw_b4 0.00 3.999939 FORMAT "%8.6" /end CHARACTERISTIC
/begin CHARACTERISTIC IMTUMTA "Schwelle integrierte Luftmasse für Bestimmung Umgebungstemperatur" VALUE 0x819DD7 KwUb 23.21 m_ub_b23p3 0.00 23.21 FORMAT "%5.2" /end CHARACTERISTIC
/begin CHARACTERISTIC IPTREFO "obere Schwelle Pumpenstrom bei Referenzmessung" VALUE 0x81BCF6 KwUw 399.9939 i_q6p1035_uA 0.00 399.9939 FORMAT "%8.4" /end CHARACTERISTIC
/begin CHARACTERISTIC IPTREFU "untere Schwelle Pumpenstrom bei Referenzmessung" VALUE 0x81BCF8 KwUw 399.9939 i_q6p1035_uA 0.00 399.9939 FORMAT "%8.4" /end CHARACTERISTIC
/begin CHARACTERISTIC KFAFTE "Kennfeld Durchflußcharkteristik TEV + Leitung AKF-TEV" MAP 0x810A5F KfAxUbAyUbSstxUbSstyUbWUb 1.992 fak_ub_b2 0.00 1.992 FORMAT "%5.3"
 /begin AXIS_DESCR STD_AXIS nmot nmot_ub_q40 10 0.00 10200. FORMAT "%5.0" DEPOSIT ABSOLUTE /end AXIS_DESCR
 /begin AXIS_DESCR STD_AXIS wdkba relDK_ub_b100 10 0.00 100.0 FORMAT "%5.1" DEPOSIT ABSOLUTE /end AXIS_DESCR
/end CHARACTERISTIC
/begin CHARACTERISTIC KFFWTBR "Wichtungsfaktor Tans/Tmot für Brennraumtemperaturmodell" MAP 0x819D36 KfAxUbAyUbSstxUbSstyUbWUb 0.9961 fak_ub_b1 0.00 0.9961
 /begin AXIS_DESCR STD_AXIS rl rel_ub_q0p75 10 0.00 191.3 FORMAT "%5.1" DEPOSIT ABSOLUTE /end AXIS_DESCR
 /begin AXIS_DESCR STD_AXIS nmot nmot_ub_q40 8 0.00 10200. FORMAT "%5.0" DEPOSIT ABSOLUTE /end AXIS_DESCR
/end CHARACTERISTIC
/begin CHARACTERISTIC KFPRG "interner Abgaspartialdruck abhängig von NW-Verstellung bei sumode=0" MAP 0x814306 GkfWUw 2559.961 p_uw_q0p039 0.00 2559.961 FORMAT "%8.3"
 /begin AXIS_DESCR COM_AXIS wnwue wkw_ub_q0p5 10 0.00 127.500 AXIS_PTS_REF SWN10FEUB /end AXIS_DESCR
 /begin AXIS_DESCR COM_AXIS nmot_w nmot_uw_q0p25 16 0.00 16383.75 AXIS_PTS_REF SNM16FEUW /end AXIS_DESCR
/end CHARACTERISTIC
/begin CHARACTERISTIC KFPRG2SU "interner Abgaspartialdruck abhängig von NW-Verstellung bei sumode=2" MAP 0x814446 GkfWUw 2559.961 p_uw_q0p039 0.00 2559.961 FORMAT "%8.3"
 /begin AXIS_DESCR COM_AXIS wnwue wkw_ub_q0p5 10 0.00 127.500 AXIS_PTS_REF SWN10FEUB /end AXIS_DESCR
 /begin AXIS_DESCR COM_AXIS nmot_w nmot_uw_q0p25 16 0.00 16383.75 AXIS_PTS_REF SNM16FEUW /end AXIS_DESCR
/end CHARACTERISTIC
/begin CHARACTERISTIC KFPRG3SU "interner Abgaspartialdruck abhängig von NW-Verstellung bei sumode=3" MAP 0x814586 GkfWUw 2559.961 p_uw_q0p039 0.00 2559.961 FORMAT "%8.3"
 /begin AXIS_DESCR COM_AXIS wnwue wkw_ub_q0p5 10 0.00 127.500 AXIS_PTS_REF SWN10FEUB /end AXIS_DESCR
 /begin AXIS_DESCR COM_AXIS nmot_w nmot_uw_q0p25 16 0.00 16383.75 AXIS_PTS_REF SNM16FEUW /end AXIS_DESCR
/end CHARACTERISTIC
/begin CHARACTERISTIC KFPRGSU "interner Abgaspartialdruck abhängig von NW-Verstellung bei sumode=1" MAP 0x8146C6 GkfWUw 2559.961 p_uw_q0p039 0.00 2559.961 FORMAT "%8.3"
 /begin AXIS_DESCR COM_AXIS wnwue wkw_ub_q0p5 10 0.00 127.500 AXIS_PTS_REF SWN10FEUB /end AXIS_DESCR
 /begin AXIS_DESCR COM_AXIS nmot_w nmot_uw_q0p25 16 0.00 16383.75 AXIS_PTS_REF SNM16FEUW /end AXIS_DESCR
/end CHARACTERISTIC
/begin CHARACTERISTIC KFTDSTAB "Zeit für Pumpstrom stabil" MAP 0x81BCFA KfAxUwAyUwSstxUwSstyUwWUw 6553.500 t100msxs_uw_b6553p5 0.00 6553.500 FORMAT "%8.3"
 /begin AXIS_DESCR STD_AXIS iptgh_w i_q6p1035_uA 8 0.00 399.9939 FORMAT "%8.4" DEPOSIT ABSOLUTE /end AXIS_DESCR
 /begin AXIS_DESCR STD_AXIS gvtaf_w vol_q0p1_l 8 0.00 6553.500 FORMAT "%8.3" DEPOSIT ABSOLUTE /end AXIS_DESCR
/end CHARACTERISTIC
/begin CHARACTERISTIC KFURL "Umrechnungsfaktor von ps->rl abhängig von NW-Verstellung bei sumode=0" MAP 0x814806 GkfWUw 0.2999954 rel_uw_b0p3 0.00 0.2999954 FORMAT "%9.7"
 /begin AXIS_DESCR COM_AXIS wnwue wkw_ub_q0p5 10 0.00 127.500 AXIS_PTS_REF SWN10FEUB /end AXIS_DESCR
 /begin AXIS_DESCR COM_AXIS nmot_w nmot_uw_q0p25 16 0.00 16383.75 AXIS_PTS_REF SNM16FEUW /end AXIS_DESCR
/end CHARACTERISTIC
/begin CHARACTERISTIC KFURL2SU "Umrechnungsfaktor von ps->rl abhängig von NW-Verstellung bei sumode=2" MAP 0x814946 GkfWUw 0.2999954 rel_uw_b0p3 0.00 0.2999954 FORMAT "%9.7"
 /begin AXIS_DESCR COM_AXIS wnwue wkw_ub_q0p5 10 0.00 127.500 AXIS_PTS_REF SWN10FEUB /end AXIS_DESCR
 /begin AXIS_DESCR COM_AXIS nmot_w nmot_uw_q0p25 16 0.00 16383.75 AXIS_PTS_REF SNM16FEUW /end AXIS_DESCR
/end CHARACTERISTIC
/begin CHARACTERISTIC KFURL3SU "Umrechnungsfaktor von ps->rl abhängig von NW-Verstellumg bei sumode=3" MAP 0x814A86 GkfWUw 0.2999954 rel_uw_b0p3 0.00 0.2999954 FORMAT "%9.7"
 /begin AXIS_DESCR COM_AXIS wnwue wkw_ub_q0p5 10 0.00 127.500 AXIS_PTS_REF SWN10FEUB /end AXIS_DESCR
 /begin AXIS_DESCR COM_AXIS nmot_w nmot_uw_q0p25 16 0.00 16383.75 AXIS_PTS_REF SNM16FEUW /end AXIS_DESCR
/end CHARACTERISTIC
/begin CHARACTERISTIC KFURLSU "Umrechnungsfaktor von ps->rl abhängig von NW-Verstellung bei sumode=1" MAP 0x814BC6 GkfWUw 0.2999954 rel_uw_b0p3 0.00 0.2999954 FORMAT "%9.7"
 /begin AXIS_DESCR COM_AXIS wnwue wkw_ub_q0p5 10 0.00 127.500 AXIS_PTS_REF SWN10FEUB /end AXIS_DESCR
 /begin AXIS_DESCR COM_AXIS nmot_w nmot_uw_q0p25 16 0.00 16383.75 AXIS_PTS_REF SNM16FEUW /end AXIS_DESCR
/end CHARACTERISTIC
/begin CHARACTERISTIC KISRM "Integratorbeiwert für Saugrohrmodell (Dynamik)" VALUE 0x8142EC KwUw 0.9999847 fak_uw_b1 0.00 0.9999847 FORMAT "%9.7" /end CHARACTERISTIC
/begin CHARACTERISTIC KISRM2SU "Integationsbeiwert für Saugrohrmodell bei sumode=2" VALUE 0x8142EE KwUw 0.9999847 fak_uw_b1 0.00 0.9999847 FORMAT "%9.7" /end CHARACTERISTIC
/begin CHARACTERISTIC KISRM3SU "Integrationsbeiwert für Saugrohrmodell bei sumode=3" VALUE 0x8142F0 KwUw 0.9999847 fak_uw_b1 0.00 0.9999847 FORMAT "%9.7" /end CHARACTERISTIC
/begin CHARACTERISTIC KISRMSU "Integrationsbeiwert für Saugrohrmodell bei sumode=1" VALUE 0x8142F2 KwUw 0.9999847 fak_uw_b1 0.00 0.9999847 FORMAT "%9.7" /end CHARACTERISTIC
/begin CHARACTERISTIC KLAFTE "Ausflußkennlinie für TEV incl. Leitung AKF-TEV" CURVE 0x813D84 KlAUwSstUwWUw 1.999969 fak_uw_b2 0.00 1.999969 FORMAT "%8.6"
 /begin AXIS_DESCR STD_AXIS pspvdk_w fak_uw_b2 14 0.00 1.999969 FORMAT "%8.6" DEPOSIT ABSOLUTE /end AXIS_DESCR
/end CHARACTERISTIC
/begin CHARACTERISTIC LNXQTM "Natürlicher Logarithmus aus Temperaturquotient" CURVE 0x81B70C KlAUwSstUwWUw 3.999939 fak_uw_b4 0.00 3.999939 FORMAT "%8.6"
 /begin AXIS_DESCR STD_AXIS xqtm_w fak_uw_b16 12 0.00 15.99976 FORMAT "%8.5" DEPOSIT ABSOLUTE /end AXIS_DESCR
/end CHARACTERISTIC
/begin CHARACTERISTIC MDNORM "Maximales indiziertes Motormoment für Moment-Normierung" VALUE 0x8110B8 KwUb 1008. md_ub_q16 0.00 1008. FORMAT "%5.0" /end CHARACTERISTIC
/begin CHARACTERISTIC MIMSRMXN "Maximal zulässiges MSR-Moment" CURVE 0x813ED4 KlAUwSstUwWUw 99.99847 rel_uw_b100 0.00 99.99847 FORMAT "%8.5"
 /begin AXIS_DESCR STD_AXIS nmot_w nmot_uw_q0p25 6 0.00 16383.75 FORMAT "%8.2" DEPOSIT ABSOLUTE /end AXIS_DESCR
/end CHARACTERISTIC
/begin CHARACTERISTIC MLMAX "Maximaler Luftfluß für die Lastberechnung nach SAE J1979" VALUE 0x81B55E KwUw 6553.500 m_uw_b6553p5 0.00 6553.500 FORMAT "%8.3" /end CHARACTERISTIC
/begin CHARACTERISTIC MSNTATE "Kennlinie normierter Massenstrom durch TEV" CURVE 0x813DBE KlAUwSstUwWUw 25.59961 m_uw_b25p6 0.00 25.59961 FORMAT "%8.5"
 /begin AXIS_DESCR STD_AXIS msntate_kge rel_uw_b100 10 0.00 99.99847 FORMAT "%8.5" DEPOSIT ABSOLUTE /end AXIS_DESCR
/end CHARACTERISTIC
/begin CHARACTERISTIC NDECJ "Drehzahl-Schwelle für CJ400-Endstufendiagnose" VALUE 0x811B58 KwUb 10200. nmot_ub_q40 0.00 10200. FORMAT "%5.0" /end CHARACTERISTIC
/begin CHARACTERISTIC NGLMHEMX "max. Anzahl Enable-erfuellt fuer Grobleckpruefung" VALUE 0x81A711 KwUb 255.0 dez 0.00 255.0 FORMAT "%5.1" /end CHARACTERISTIC
/begin CHARACTERISTIC NGLMTKMX "max. Anzahl Groblecktests fuer Feinstlecktpruefung" VALUE 0x81A712 KwUb 255.0 dez 0.00 255.0 FORMAT "%5.1" /end CHARACTERISTIC
/begin CHARACTERISTIC NGLTDA "max. Anzahl abgebrochener check filler cap Prüfungen" VALUE 0x81A713 KwUb 255.0 dez 0.00 255.0 FORMAT "%5.1" /end CHARACTERISTIC
/begin CHARACTERISTIC NGLTDW "max. Anzahl check filler cap Prüfungen" VALUE 0x81A714 KwUb 255.0 dez 0.00 255.0 FORMAT "%5.1" /end CHARACTERISTIC
/begin CHARACTERISTIC NKLDIPFMX "Limit Abbruch Feinleckmessung infolge Stromschwankungen" VALUE 0x81A715 KwUb 255.0 dez 0.00 255.0 FORMAT "%5.1" /end CHARACTERISTIC
/begin CHARACTERISTIC NKLMTKMX "max. Anzahl Feinstlecktpruefungsversuche nach Betankung" VALUE 0x81A716 KwUb 255.0 dez 0.00 255.0 FORMAT "%5.1" /end CHARACTERISTIC
/begin CHARACTERISTIC NMIN "Minimal Drehzahl" VALUE 0x814006 KwUw 16383.75 nmot_uw_q0p25 0.00 16383.75 FORMAT "%8.2" /end CHARACTERISTIC
/begin CHARACTERISTIC NOVZTE "Codeword für Soll-Tastverhältnis nicht verzögern" VALUE 0x810082 KwUb 255.0 dez 0.00 255.0 FORMAT "%5.1" /end CHARACTERISTIC
/begin CHARACTERISTIC NTUMTA "Schwelle Drehzahl für Bestimmung Umgebungstemperatur" VALUE 0x819DD8 KwUb 10200. nmot_ub_q40 0.00 10200. FORMAT "%5.0" /end CHARACTERISTIC
/begin CHARACTERISTIC PGFLWA "Anzahl PG-Flankenwechsel für DG-Fehler B_signal" VALUE 0x819931 KwUb 255.0 DEZ 0.00 255.0 FORMAT "%5.1" /end CHARACTERISTIC
/begin CHARACTERISTIC PUKORRV "Umgebungsdruckkorrektur abhängig von Fahrzeuggeschwindigkeit" CURVE 0x81BDFE KlAUwSstUwWUw 2559.961 p_uw_q0p039 0.00 2559.961 FORMAT "%8.3"
 /begin AXIS_DESCR STD_AXIS vfzg_w vfzg_uw_b512 8 0.00 511.9922 FORMAT "%8.4" DEPOSIT ABSOLUTE /end AXIS_DESCR
/end CHARACTERISTIC
/begin CHARACTERISTIC PUSMAX "maximal plausible Umgebungsdruckschwelle" VALUE 0x817610 KwUw 2559.961 p_uw_q0p039 0.00 2559.961 FORMAT "%8.3" /end CHARACTERISTIC
/begin CHARACTERISTIC PUSMIN "minimal plausible Umgebungsdruckschwelle" VALUE 0x817612 KwUw 2559.961 p_uw_q0p039 0.00 2559.961 FORMAT "%8.3" /end CHARACTERISTIC
/begin CHARACTERISTIC RKACOMN "untere Schwelle additive Korrektur pro Zeit LL-CO Abgleich" VALUE 0x8159D4 KwSw 20.01563 rel_sw_b1536 -20.01563 0.00 FORMAT "%8.5" /end CHARACTERISTIC
/begin CHARACTERISTIC RKACOMX "obere Schwelle additive Korrektur pro Zeit LL-CO Abgleich" VALUE 0x8159D6 KwSw 20.01563 rel_sw_b1536 0.00 20.01563 FORMAT "%8.5" /end CHARACTERISTIC
/begin CHARACTERISTIC SDMGLVU "untere Schwelle Fahrstrecke zwischen Betankung und Grobleckverdacht" VALUE 0x81BD9E KwUw 1820.417 s_q0p02777_m 0.00 1820.417 FORMAT "%8.3" /end CHARACTERISTIC
/begin CHARACTERISTIC SFTEDA "Beladungsschwelle für Verbot TE-Diagnose" VALUE 0x81A717 KwSb 127.5 fak_sb_q0p5 -64.00 63.50 FORMAT "%5.2" /end CHARACTERISTIC
/begin AXIS_PTS SNM16FEUW "" 0x8156F2 nmot_w SstAUwSstUw 16383.75 nmot_uw_q0p25 16 0.00 16383.75 FORMAT "%8.2" DEPOSIT ABSOLUTE /end AXIS_PTS
/begin CHARACTERISTIC STM_ERR "Lüfteranforderung bei CAN-INST3-Ausfall" VALUE 0x8197EC KwUb 15.00 dez 0.00 15.00 FORMAT "%5.2" /end CHARACTERISTIC
/begin AXIS_PTS SWN10FEUB "" 0x811AC6 wnwue SstAUbSstUb 127.500 wkw_ub_q0p5 10 0.00 127.500 DEPOSIT ABSOLUTE /end AXIS_PTS
/begin CHARACTERISTIC TABTESMN "min Abstellzeit für Tankentlüftungsdiagnose" VALUE 0x81BDA0 KwUw 65535.00 t1sxs_uw_q1 0.00 65535.00 FORMAT "%8.2" /end CHARACTERISTIC
/begin CHARACTERISTIC TACCNP "Entprellzeit ACC-Fehler unplaus." VALUE 0x810054 KwUb 5.100 t20msxs_ub_q0p02 0.00 5.100 FORMAT "%5.3" /end CHARACTERISTIC
/begin CHARACTERISTIC TACCSI "Entprellzeit ACC-Signalfehler" VALUE 0x810055 KwUb 10.20 t40msxs_ub_q0p04 0.00 10.20 FORMAT "%5.2" /end CHARACTERISTIC
/begin CHARACTERISTIC TANKDBE "Einschaltzeitpunkt Kombianzeige nach Kl.15" VALUE 0x81A718 KwUb 25.50 t100msxs_ub_b25p5 0.00 25.50 FORMAT "%5.2" /end CHARACTERISTIC
/begin CHARACTERISTIC TANKDD "Einschaltdauer Kombianzeige nach Kl.15" VALUE 0x81BDA2 KwUw 6553.500 t100msxs_uw_b6553p5 0.00 6553.500 FORMAT "%8.3" /end CHARACTERISTIC
/begin CHARACTERISTIC TASCNP "Entprellzeit ASC-Signal nicht plaus." VALUE 0x810062 KwUb 25.50 t100msxs_ub_b25p5 0.00 25.50 FORMAT "%5.2" /end CHARACTERISTIC
/begin CHARACTERISTIC TASCNP2 "Entprellzeit ASC-Signal nicht plaus." VALUE 0x810063 KwUb 2.550 t10msxs_ub_b2p55 0.00 2.550 FORMAT "%5.3" /end CHARACTERISTIC
/begin CHARACTERISTIC TDCACC "Zeit für Timeouterkennung CAN-Schnittstelle ACC" VALUE 0x813ECA KwUw 655.3500 t10msxs_uw_b655p35 0.00 655.3500 FORMAT "%8.4" /end CHARACTERISTIC
/begin CHARACTERISTIC TDCAS "Zeit für Timeouterkennung CAN-Schnittstelle ASC" VALUE 0x813ECC KwUw 655.3500 t10msxs_uw_b655p35 0.00 655.3500 FORMAT "%8.4" /end CHARACTERISTIC
/begin CHARACTERISTIC TDCGE "Zeit für Timeouterkennung CAN-Schnittstelle EGS" VALUE 0x813ECE KwUw 655.3500 t10msxs_uw_b655p35 0.00 655.3500 FORMAT "%8.4" /end CHARACTERISTIC
/begin CHARACTERISTIC TDCINS "Zeit für Timeouterkennung CAN-Schnittstelle Kombi-Instr." VALUE 0x813ED0 KwUw 655.3500 t10msxs_uw_b655p35 0.00 655.3500 FORMAT "%8.4" /end CHARACTERISTIC
/begin CHARACTERISTIC TDDPSF "Verzögerung Stromabfallerkennung während Messung" VALUE 0x8175D6 KwUw 6553.500 t100msxs_uw_b6553p5 0.00 6553.500 FORMAT "%8.3" /end CHARACTERISTIC
/begin CHARACTERISTIC TDEGFEMN "Zeitverzögerung für Setzen des MIN-Fehlers" VALUE 0x819DB7 KwUb 25.50 t100msxs_ub_b25p5 0.00 25.50 FORMAT "%5.2" /end CHARACTERISTIC
/begin CHARACTERISTIC TDEGFEMX "Zeitverzögerung für Setzen des MAX-Fehlers" VALUE 0x819DB8 KwUb 25.50 t100msxs_ub_b25p5 0.00 25.50 FORMAT "%5.2" /end CHARACTERISTIC
/begin CHARACTERISTIC TDEGFENO "Zeitverzögerung für Setzen des NO-Fehlers" VALUE 0x819DB9 KwUb 25.50 t100msxs_ub_b25p5 0.00 25.50 FORMAT "%5.2" /end CHARACTERISTIC
/begin CHARACTERISTIC TDEGFEST "Zeitverzögerung nach Start" VALUE 0x819DBA KwUb 25.50 t100msxs_ub_b25p5 0.00 25.50 FORMAT "%5.2" /end CHARACTERISTIC
/begin CHARACTERISTIC TDHCINS "Zeit für Fehlerheilung CAN-Timeout Kombi-Instr." VALUE 0x813ED2 KwUw 6553.500 t100msxs_uw_b6553p5 0.00 6553.500 FORMAT "%8.3" /end CHARACTERISTIC
/begin CHARACTERISTIC TDMGLGTF "Zeit fuer Grobleckpruefung" CURVE 0x81BDA4 KlAUwSstUwWUw 6553.500 t100msxs_uw_b6553p5 0.00 6553.500 FORMAT "%8.3"
 /begin AXIS_DESCR STD_AXIS gvtaf_w vol_q0p1_l 5 0.00 6553.500 FORMAT "%8.3" DEPOSIT ABSOLUTE /end AXIS_DESCR
/end CHARACTERISTIC
/begin CHARACTERISTIC TDMKLGTF "Zeit fuer Feinleckpruefung" CURVE 0x81BDBA KlAUwSstUwWUw 6553.500 t100msxs_uw_b6553p5 0.00 6553.500 FORMAT "%8.3"
 /begin AXIS_DESCR STD_AXIS gvtaf_w vol_q0p1_l 5 0.00 6553.500 FORMAT "%8.3" DEPOSIT ABSOLUTE /end AXIS_DESCR
/end CHARACTERISTIC
/begin CHARACTERISTIC TDMTGL "Zeit fuer Grobleckpruefung" VALUE 0x81BDD0 KwUw 6553.500 t100msxs_uw_b6553p5 0.00 6553.500 FORMAT "%8.3" /end CHARACTERISTIC
/begin CHARACTERISTIC TDMTGLR "Zeit fuer Referenztest bei Grobleckpruefung" VALUE 0x81BDD2 KwUw 6553.500 t100msxs_uw_b6553p5 0.00 6553.500 FORMAT "%8.3" /end CHARACTERISTIC
/begin CHARACTERISTIC TDMTKL "Zeit für Feinleckprüfung" VALUE 0x81BDD4 KwUw 6553.500 t100msxs_uw_b6553p5 0.00 6553.500 FORMAT "%8.3" /end CHARACTERISTIC
/begin CHARACTERISTIC TDMTLMX "max. Messzeit für Tankleckdiagnose" VALUE 0x81BDD6 KwUw 6553.500 t100msxs_uw_b6553p5 0.00 6553.500 FORMAT "%8.3" /end CHARACTERISTIC
/begin CHARACTERISTIC TDMTREF "Zeit fuer Referenzleckmessung" VALUE 0x81BDD8 KwUw 6553.500 t100msxs_uw_b6553p5 0.00 6553.500 FORMAT "%8.3" /end CHARACTERISTIC
/begin CHARACTERISTIC TDMTREFW "Zeit fuer Wiederholungs-Referenzleckmessung" VALUE 0x81BDDA KwUw 6553.500 t100msxs_uw_b6553p5 0.00 6553.500 FORMAT "%8.3" /end CHARACTERISTIC
/begin CHARACTERISTIC TDMTSTAB "Zeit fuer Pumpenstrom stabil" VALUE 0x81BDDC KwUw 6553.500 t100msxs_uw_b6553p5 0.00 6553.500 FORMAT "%8.3" /end CHARACTERISTIC
/begin CHARACTERISTIC TDTXU "Zeit für Timeouterkennung CAN-Schnittstelle TXU" VALUE 0x8197ED KwUb 5.100 t20msxs_ub_b5p1 0.00 5.100 FORMAT "%5.3" /end CHARACTERISTIC
/begin CHARACTERISTIC TDWF "Verzögerungszeit f. Änderung Ansteuerstatus Drehzahlwarnfeld" VALUE 0x81A86F KwUb 25.50 t100msxs_ub_b25p5 0.00 25.50 FORMAT "%5.2" /end CHARACTERISTIC
/begin CHARACTERISTIC TEPCL "Zeit ab Motorlauf bis EPCL-Testansteuerung Ende" VALUE 0x81007C KwUb 51.00 t200msxs_ub_b51 0.00 51.00 FORMAT "%5.2" /end CHARACTERISTIC
/begin CHARACTERISTIC TEPCLI "Zeit ab INI bis EPCL-Testansteuerung Ende" VALUE 0x81007D KwUb 51.00 t200msxs_ub_b51 0.00 51.00 FORMAT "%5.2" /end CHARACTERISTIC
/begin CHARACTERISTIC TFEDMMX "max. Zeit für Funktionsanforderung DM-TL-Endstufen" VALUE 0x81BDDE KwUw 6553.500 t100msxs_uw_b6553p5 0.00 6553.500 FORMAT "%8.3" /end CHARACTERISTIC
/begin CHARACTERISTIC TIPTPAMN "min. Zeit Pumpenstrompruefung in Grobleckphase" VALUE 0x81BDE0 KwUw 6553.500 t100msxs_uw_b6553p5 0.00 6553.500 FORMAT "%8.3" /end CHARACTERISTIC
/begin CHARACTERISTIC TIPTPAMX "max. Zeit Pumpenstrompruefung in Grobleckphase" VALUE 0x81BDE2 KwUw 6553.500 t100msxs_uw_b6553p5 0.00 6553.500 FORMAT "%8.3" /end CHARACTERISTIC
/begin CHARACTERISTIC TLLCO "Motortemp. - Schwelle CO - Korrektur" VALUE 0x810097 KwUb 191.3 temp_ub_q0p75_o48 -48.00 143.3 FORMAT "%5.1" /end CHARACTERISTIC
/begin CHARACTERISTIC TMSDMTLU "untere Startemperaturschwelle fuer DDMTL" VALUE 0x81A719 KwUb 191.3 temp_ub_q0p75_o48 -48.00 143.3 FORMAT "%5.1" /end CHARACTERISTIC
/begin CHARACTERISTIC TMVDBS "Entprellzeit Beschleunigungssignaldiagnose" VALUE 0x812459 KwUb 25.50 t100msxs_ub_b25p5 0.00 25.50 FORMAT "%5.2" /end CHARACTERISTIC
/begin CHARACTERISTIC TNLDSCMX "Maximale Zeit für SG-Nachlauf aus Anforderung DSC-System" VALUE 0x81BC3C KwUw 6553.500 t100msxs_uw_b6553p5 0.00 6553.500 FORMAT "%8.3" /end CHARACTERISTIC
/begin CHARACTERISTIC TNLSGM "Nachlaufzeit für SG abschalten" CURVE 0x819DD9 KlAUbSstUbWUb 255.0 t1sxs_ub_b255 0.00 255.0 FORMAT "%5.1"
 /begin AXIS_DESCR STD_AXIS tmotab temp_ub_q0p75_o48 6 -48.00 143.3 FORMAT "%5.1" DEPOSIT ABSOLUTE /end AXIS_DESCR
/end CHARACTERISTIC
/begin CHARACTERISTIC TNSTESMN "min Nachstartzeit für Tankentlüftungsdiagnose" VALUE 0x81BDE4 KwUw 6553.500 t100msxs_uw_b6553p5 0.00 6553.500 FORMAT "%8.3" /end CHARACTERISTIC
/begin CHARACTERISTIC TNSURLP "Zeit rl-Praediktions-Unterdrueckung im Nachstart" VALUE 0x810004 KwUb 25.50 t100msxs_ub_b25p5 0.00 25.50 FORMAT "%5.2" /end CHARACTERISTIC
/begin CHARACTERISTIC TPLUHRR "Zeit für Erkennung relative Zeit von Kombi-Uhr unplausibel" VALUE 0x81B73E KwUw 655.3500 t10msxs_uw_b655p35 0.00 655.3500 FORMAT "%8.4" /end CHARACTERISTIC
/begin CHARACTERISTIC TPUKOR "Filterzeit für PUKORF" VALUE 0x81A723 KwUb 25.4996 zk100msxs_ub_b25p5 0.100392 25.6000 FORMAT "%7.4" /end CHARACTERISTIC
/begin CHARACTERISTIC TSFACC "Fehlersummenzeit: ACC" VALUE 0x8118E4 KwUb 255.0 dez 0.00 255.0 FORMAT "%5.1" /end CHARACTERISTIC
/begin CHARACTERISTIC TSFAS "Fehlersummenzeit: ASR - Eingriff" VALUE 0x8118E8 KwUb 255.0 dez 0.00 255.0 FORMAT "%5.1" /end CHARACTERISTIC
/begin CHARACTERISTIC TSFCACC "Fehlersummenzeit: CAN-Schnittstelle, Timeout ACC" VALUE 0x8118EC KwUb 255.0 dez 0.00 255.0 FORMAT "%5.1" /end CHARACTERISTIC
/begin CHARACTERISTIC TSFCAS "Fehlersummenzeit: CAN-Schnittstelle, Timeout ASC" VALUE 0x8118ED KwUb 255.0 dez 0.00 255.0 FORMAT "%5.1" /end CHARACTERISTIC
/begin CHARACTERISTIC TSFCGE "Fehlersummenzeit: CAN-Schnittstelle, Timeout EGS" VALUE 0x8118EE KwUb 255.0 dez 0.00 255.0 FORMAT "%5.1" /end CHARACTERISTIC
/begin CHARACTERISTIC TSFCINS "Fehlersummenzeit: CAN-Schnittstelle, Timeout Instrument" VALUE 0x8118EF KwUb 255.0 dez 0.00 255.0 FORMAT "%5.1" /end CHARACTERISTIC
/begin CHARACTERISTIC TSFCTXU "Fehlersummenzeit: CAN-Schnittstelle, Timeout TXU" VALUE 0x8118F0 KwUb 255.0 dez 0.00 255.0 FORMAT "%5.1" /end CHARACTERISTIC
/begin CHARACTERISTIC TSFDVEE "Fehlersummenzeit: DV-E Endstufe" VALUE 0x8118FF KwUb 255.0 dez 0.00 255.0 FORMAT "%5.1" /end CHARACTERISTIC
/begin CHARACTERISTIC TSFDVEF "Fehlersummenzeit: DV-E Fehler bei Federprüfung" VALUE 0x811900 KwUb 255.0 dez 0.00 255.0 FORMAT "%5.1" /end CHARACTERISTIC
/begin CHARACTERISTIC TSFDVEL "Fehlersummenzeit: DV-E Lageabweichung" VALUE 0x811901 KwUb 255.0 dez 0.00 255.0 FORMAT "%5.1" /end CHARACTERISTIC
/begin CHARACTERISTIC TSFDVEN "Fehlersummenzeit: DV-E Fehler bei Prüfung Notluftposition" VALUE 0x811902 KwUb 255.0 dez 0.00 255.0 FORMAT "%5.1" /end CHARACTERISTIC
/begin CHARACTERISTIC TSFDVER "Fehlersummenzeit: DV-E Regelbereich" VALUE 0x811903 KwUb 255.0 dez 0.00 255.0 FORMAT "%5.1" /end CHARACTERISTIC
/begin CHARACTERISTIC TSFDVEU "Fehlersummenzeit: DV-E Fehler beim UMA-Lernen" VALUE 0x811904 KwUb 255.0 dez 0.00 255.0 FORMAT "%5.1" /end CHARACTERISTIC
/begin CHARACTERISTIC TSFDVEV "Fehlersummenzeit: DV-E Fehler bei Verstärkerabgleich" VALUE 0x811905 KwUb 255.0 dez 0.00 255.0 FORMAT "%5.1" /end CHARACTERISTIC
/begin CHARACTERISTIC TSFSWE "Fehlersummenzeit: Beschleunigungssensor der Schlechtwegeerkennung" VALUE 0x81195E KwUb 255.0 dez 0.00 255.0 FORMAT "%5.1" /end CHARACTERISTIC
/begin CHARACTERISTIC TTEDUBV "Zeitverzögerung für Ubat-Überwachung" VALUE 0x812466 KwUb 25.50 t100msxs_ub_b25p5 0.00 25.50 FORMAT "%5.2" /end CHARACTERISTIC
/begin CHARACTERISTIC TUMTAI "Initialisierungswert Umgebungstemperatur" VALUE 0x819DE6 KwUb 191.3 temp_ub_q0p75_o48 -48.00 143.3 FORMAT "%5.1" /end CHARACTERISTIC
/begin CHARACTERISTIC TUMTESO "obere Umgebungstemp.-Schwelle für TE-Diagnose" VALUE 0x81A71A KwUb 191.3 temp_ub_q0p75_o48 -48.00 143.3 FORMAT "%5.1" /end CHARACTERISTIC
/begin CHARACTERISTIC TUMTESU "untere Umgebungstemp.-Schwelle für TE-Diagnose" VALUE 0x81A71B KwUb 191.3 temp_ub_q0p75_o48 -48.00 143.3 FORMAT "%5.1" /end CHARACTERISTIC
/begin CHARACTERISTIC TVCO "CO-Korrektur" CURVE 0x8159D8 KlASwSstSwWSw 3071.953 rel_sw_b1536 -1536.000 1535.953 FORMAT "%8.3"
 /begin AXIS_DESCR STD_AXIS co_pot_w dez 8 -32768.00 32767.00 FORMAT "%8.2" DEPOSIT ABSOLUTE /end AXIS_DESCR
/end CHARACTERISTIC
/begin CHARACTERISTIC TVFGRAT "Verzögerungszeit für Ausgabe FGR-Bedientaste bei ausschalten" VALUE 0x8110B9 KwUb 2.550 t10msxs_ub_b2p55 0.00 2.550 FORMAT "%5.3" /end CHARACTERISTIC
/begin CHARACTERISTIC TVFGRSE "Verzögerungszeit für Ausgabe FGR-Bedientaste neu setzen" VALUE 0x8110BA KwUb 2.550 t10msxs_ub_b2p55 0.00 2.550 FORMAT "%5.3" /end CHARACTERISTIC
/begin CHARACTERISTIC TVMFLA "Verzögerungszeit für Ausgabe Status FGR-Lampe" VALUE 0x810013 KwUb 2.550 t10msxs_ub_b2p55 0.00 2.550 FORMAT "%5.3" /end CHARACTERISTIC
/begin CHARACTERISTIC TWBDCY "Wartezeit für Erkennung Bedingung 'driving cycle'" VALUE 0x810029 KwUb 51.00 t200msxs_ub_b51 0.00 51.00 FORMAT "%5.2" /end CHARACTERISTIC
/begin CHARACTERISTIC TWKL15IP "Wartezeit nach Kl.15 f@r Pumpenstromberechnung" VALUE 0x812467 KwUb 2.550 t10msxs_ub_b2p55 0.00 2.550 FORMAT "%5.3" /end CHARACTERISTIC
/begin CHARACTERISTIC TWTEDTA "Wartezeit Betankungserkennung" VALUE 0x81A71C KwUb 25.50 t100msxs_ub_b25p5 0.00 25.50 FORMAT "%5.2" /end CHARACTERISTIC
/begin CHARACTERISTIC TWTEMV "Wartezeit nach Magnetventilumschaltung" VALUE 0x812468 KwUb 25.50 t100msxs_ub_b25p5 0.00 25.50 FORMAT "%5.2" /end CHARACTERISTIC
/begin CHARACTERISTIC TWTESNL "Nachlauf-Wartezeit bis Beginn Tankentlueftungsdiagnose" VALUE 0x81BDE6 KwUw 6553.500 t100msxs_uw_b6553p5 0.00 6553.500 FORMAT "%8.3" /end CHARACTERISTIC
/begin CHARACTERISTIC TWUPKSO "Wartezeit Kurzschlusserkennung" VALUE 0x811B4E KwUb 2.550 t10msxs_ub_b2p55 0.00 2.550 FORMAT "%5.3" /end CHARACTERISTIC
/begin CHARACTERISTIC TWUPKSWE "Wartezeit Wiedereinschaltversuch bei Kurzschluss" VALUE 0x815814 KwUw 655.3500 t10msxs_uw_b655p35 0.00 655.3500 FORMAT "%8.4" /end CHARACTERISTIC
/begin CHARACTERISTIC UBATT12V "Festwert für Nominalbatteriespannung (DDMTL)" VALUE 0x8175D8 KwUw 25.59961 spg_q0p00039 0.00 25.59961 FORMAT "%8.5" READ_ONLY /end CHARACTERISTIC
/begin CHARACTERISTIC UBCJMN "Minimale UBat-Schwelle für Freigabe der CJ400-Endstufendiagnose" VALUE 0x811B59 KwUb 24.02 spg_ubatt 0.00 24.02 FORMAT "%5.2" /end CHARACTERISTIC
/begin CHARACTERISTIC UBCJMX "Maximale UBat-Schwelle für Freigabe der CJ400-Endstufendiagnose" VALUE 0x811B5A KwUb 24.02 spg_ubatt 0.00 24.02 FORMAT "%5.2" /end CHARACTERISTIC
/begin CHARACTERISTIC UBCJTJ "UBat-Schwelle für CJ450-Endstufendiagnose zur Erreichung der IC Übertemperatur" VALUE 0x811B5B KwUb 24.02 spg_ubatt 0.00 24.02 FORMAT "%5.2" /end CHARACTERISTIC
/begin CHARACTERISTIC UBDCAN "UBatt-Schwelle für Diagnose CAN-Timeout" VALUE 0x810015 KwUb 24.02 spg_ubatt 0.00 24.02 FORMAT "%5.2" /end CHARACTERISTIC
/begin CHARACTERISTIC UBPMEO "obere UB-Schwelle DM-TL Pumpenmotoransteuerung" VALUE 0x811B4F KwUb 25.50 spg_q0p1 0.00 25.50 FORMAT "%5.2" /end CHARACTERISTIC
/begin CHARACTERISTIC UBTEDFAO "obere UB-Schwelle für Tankentlüftungsdiagnose bei Funktionsanf.  über Tester" VALUE 0x81BDE8 KwUw 25.59961 spg_q0p00039 0.00 25.59961 FORMAT "%8.5" /end CHARACTERISTIC
/begin CHARACTERISTIC UBTEDFAU "untere UB-Schwelle für Tankentlüftungsdiagnose bei Funktionsanf.  über Tester" VALUE 0x81BDEA KwUw 25.59961 spg_q0p00039 0.00 25.59961 FORMAT "%8.5" /end CHARACTERISTIC
/begin CHARACTERISTIC UBTEDO "obere UB-Schwelle für Tankentlüftungsdiagnose" VALUE 0x81BDEC KwUw 25.59961 spg_q0p00039 0.00 25.59961 FORMAT "%8.5" /end CHARACTERISTIC
/begin CHARACTERISTIC UBTEDU "untere UB-Schwelle für Tankentlüftungsdiagnose" VALUE 0x81BDEE KwUw 25.59961 spg_q0p00039 0.00 25.59961 FORMAT "%8.5" /end CHARACTERISTIC
/begin CHARACTERISTIC UPTESO "Schwelle Pumpenspannung zur Kurzschlusserkennung" VALUE 0x815816 KwUw 319.9951 spg_q0p00488 0.00 319.9951 FORMAT "%8.4" /end CHARACTERISTIC
/begin CHARACTERISTIC VASRM "Geschwindigkeitsschwelle für Schlechtwegerkennung" VALUE 0x81245A KwUb 318.8 vfzg_ub_q1p25 0.00 318.8 FORMAT "%5.1" /end CHARACTERISTIC
/begin CHARACTERISTIC VBSMX "obere Plausibilitätsschwelle für Radgeschwindigkeit" VALUE 0x815FF8 KwUw 4095.938 vfzg_uw_q0p0625 0.00 4095.938 FORMAT "%8.3" /end CHARACTERISTIC
/begin CHARACTERISTIC VDSCMN "Minimale Geschwindigkeitsschwelle für Anforderung SG-Nachlauf von DSC-System" VALUE 0x81BC3E KwUw 511.9922 vfzg_uw_b512 0.00 511.9922 FORMAT "%8.4" /end CHARACTERISTIC
/begin CHARACTERISTIC VFZTANKD "Fahrzeuggeschwindikeit für Anzeige ""Check filler cap""" VALUE 0x81BDF0 KwUw 511.9922 vfzg_uw_b512 0.00 511.9922 FORMAT "%8.4" /end CHARACTERISTIC
/begin CHARACTERISTIC VTUMTA "Schwelle Fahrzeuggeschwindigkeit für Bestimmung Umgebungstemperatur" VALUE 0x819DE7 KwUb 318.8 vfzg_ub_q1p25 0.00 318.8 FORMAT "%5.1" /end CHARACTERISTIC
/begin CHARACTERISTIC ZBRT "Zeitkonstante für Brennraumtempmodell" VALUE 0x819D9A KwUb 25.4996 zk100msxs_ub_b25p5 0.100392 25.6000 FORMAT "%7.4" /end CHARACTERISTIC
/begin CHARACTERISTIC ZFMVRV "Zeitkonstante für Filterung des Geschwindigkeitssignals" VALUE 0x810089 KwUb 5.08000 zk20msxs_ub_b5p1 0.0200000 5.10000 FORMAT "%7.5" /end CHARACTERISTIC
/begin CHARACTERISTIC ZIDFBM "Zähler-Inkrementierung je Lückenkorrektur bei BM-Überprüfung" VALUE 0x815744 KwUw 65535.00 dez 0.00 65535.00 FORMAT "%8.2" /end CHARACTERISTIC
/begin CHARACTERISTIC ZIDNOBM "Zähler-Inkrementierung nach Verlust der Bezugsmarke" VALUE 0x815746 KwUw 65535.00 dez 0.00 65535.00 FORMAT "%8.2" /end CHARACTERISTIC
/begin CHARACTERISTIC ZIPTESB "Zeitkonstante iptes-Filterungs Beginn" VALUE 0x8175DA KwUw 655.350000 zk10msxs_uw_b655 0.0100001526 655.360000 FORMAT "%10.6" /end CHARACTERISTIC
/begin CHARACTERISTIC ZIPTESN "Zeitkonstante iptes-Filterung" VALUE 0x8175DC KwUw 655.350000 zk10msxs_uw_b655 0.0100001526 655.360000 FORMAT "%10.6" /end CHARACTERISTIC
/begin CHARACTERISTIC ZIPTKTKN "Zeitkonstante iptes-Filterung" VALUE 0x8175DE KwUw 655.350000 zk10msxs_uw_b655 0.0100001526 655.360000 FORMAT "%10.6" /end CHARACTERISTIC
/begin CHARACTERISTIC ZKFUB "Filterzeitkonstante für Batteriespannung" VALUE 0x81B3D8 KwUw 13107.0000 zk200msxs_uw_b13107 0.200003052 13107.2000 FORMAT "%10.4" /end CHARACTERISTIC
/begin CHARACTERISTIC ZKTABTU "Zeitkonstante für Motorabkühlung" CURVE 0x81B740 KlAUwSstUwWUw 65535.00 t1sxs_uw_q1 0.00 65535.00 FORMAT "%8.2"
 /begin AXIS_DESCR STD_AXIS tum_ein temp_ub_q0p75_o48 4 -48.00000 49103.25 FORMAT "%8.2" DEPOSIT ABSOLUTE /end AXIS_DESCR
/end CHARACTERISTIC
/begin CHARACTERISTIC ZNGFIL "Zeitkonstante für Drehzahlgradient-Filter" VALUE 0x81400A KwUw 655.350000 zk10msxs_uw_b655 0.0100001526 655.360000 FORMAT "%10.6" /end CHARACTERISTIC
/begin CHARACTERISTIC ZTDAGR "Zeitkonstante Temperaturdynamik bei AGR Auf- Abschaltung" VALUE 0x81B560 KwUw 6553.4999985 zk100msxs_uw_b6553 0.10000152590 6553.6000000 FORMAT "%12.7" /end CHARACTERISTIC
/begin CHARACTERISTIC ZTMMBR "Zeitkonstante Motortemperatur für Brennraumtempmodell" VALUE 0x81B562 KwUw 6553.4999985 zk100msxs_uw_b6553 0.10000152590 6553.6000000 FORMAT "%12.7" /end CHARACTERISTIC
/begin CHARACTERISTIC ZUBTESB "Zeitkonstante ub-Filterungs-Beginn" VALUE 0x81BDF2 KwUw 6553.4999985 zk100msxs_uw_b6553 0.10000152590 6553.6000000 FORMAT "%12.7" /end CHARACTERISTIC
/begin CHARACTERISTIC ZUBTESN "Zeitkonstante ub-Filterung" VALUE 0x81BDF4 KwUw 6553.4999985 zk100msxs_uw_b6553 0.10000152590 6553.6000000 FORMAT "%12.7" /end CHARACTERISTIC
/begin CHARACTERISTIC ZVTPRGSU "Zeitkonstante Tiefpaßfilterung bei Saugrohrklappendynamik" VALUE 0x810020 KwUb 5.08000 zk20msxs_ub_b5p1 0.0200000 5.10000 FORMAT "%7.5" /end CHARACTERISTIC
/begin CHARACTERISTIC ZWDKM1 "1. Zeitkonstante Dk-Modell" VALUE 0x8159D0 KwUw 2.550000 zk10msxs_uw_b2p55T 0.00 2.550000 FORMAT "%8.6" /end CHARACTERISTIC
/begin CHARACTERISTIC ZWDKM2 "2. Zeitkonstante Dk-Modell" VALUE 0x8159D2 KwUw 2.550000 zk10msxs_uw_b2p55T 0.00 2.550000 FORMAT "%8.6" /end CHARACTERISTIC
/begin MEASUREMENT acccod "Automatische ACC-SG Erkennung" UBYTE dez 1 100 0 255 FORMAT "%5.1" ECU_ADDRESS 0x382F31 /end MEASUREMENT
/begin MEASUREMENT acc_stat "ACC-Status (CAN-Signal)" UBYTE dez 1 100 0 255 FORMAT "%5.1" ECU_ADDRESS 0x380B44 /end MEASUREMENT
/begin MEASUREMENT addsu_u "AD-Messwert Umgebungsdrucksensor; DFPM Umweltbedingung" UBYTE dez 1 100 0 255 FORMAT "%5.1" ECU_ADDRESS 0x380BB8 /end MEASUREMENT
/begin MEASUREMENT adhfm_u "AD-Messwert Luftmassenmesser; DFPM Umweltbedingung" UBYTE dez 1 100 0 255 FORMAT "%5.1" ECU_ADDRESS 0x380BB9 /end MEASUREMENT
/begin MEASUREMENT adta_u "AD-Messwert Ansauglufttemperatur; DFPM Umweltbedingung" UBYTE dez 1 100 0 255 FORMAT "%5.1" ECU_ADDRESS 0x380BBA /end MEASUREMENT
/begin MEASUREMENT adtka_u "AD-Messwert Temperatur Kühlwasseraustritt; DFPM-Umweltbedingung" UBYTE dez 1 100 0 255 FORMAT "%5.1" ECU_ADDRESS 0x380BBB /end MEASUREMENT
/begin MEASUREMENT adtm_u "AD-Messwert Motortemperatur; DFPM Umweltbedingung" UBYTE dez 1 100 0 255 FORMAT "%5.1" ECU_ADDRESS 0x380BBC /end MEASUREMENT
/begin MEASUREMENT agrr "Abgasrückführrate" UBYTE rel_ub_b99p6 1 100 0 99.6094 FORMAT "%5.2" ECU_ADDRESS 0x38094C /end MEASUREMENT
/begin MEASUREMENT agrr_w "Abgasrückführrate word" UWORD rel_uw_b100 1 100 0 99.9985 FORMAT "%8.5" ECU_ADDRESS 0x3811F2 /end MEASUREMENT
/begin MEASUREMENT anzti "ti-Einspritzzähler" UBYTE dez 1 100 0 255 FORMAT "%5.1" ECU_ADDRESS 0x380A39 /end MEASUREMENT
/begin MEASUREMENT anzti_w "ti-Einspritzzähler" UWORD dez 1 100 0 65535 FORMAT "%8.2" ECU_ADDRESS 0x382248 /end MEASUREMENT
/begin MEASUREMENT asc4cod "Automatische TXU-SG Erkennung aus ASC4-Botschaft" UBYTE dez 1 100 0 255 FORMAT "%5.1" ECU_ADDRESS 0x382F32 /end MEASUREMENT
/begin MEASUREMENT asccod "Automatische ASC-SG Erkennung" UBYTE dez 1 100 0 255 FORMAT "%5.1" ECU_ADDRESS 0x382F33 /end MEASUREMENT
/begin MEASUREMENT asc_alive "ASC-Alive Zähler" UBYTE dez 1 100 0 15 FORMAT "%5.2" ECU_ADDRESS 0x380ABF /end MEASUREMENT
/begin MEASUREMENT bbdcy "Byte für Bedingung B_dcy als Triggerevent in DCLA" UBYTE dez 1 100 0 255 FORMAT "%5.1" ECU_ADDRESS 0x380AD2 /end MEASUREMENT
/begin MEASUREMENT bbno "Byte für Bedingung B_no  als Triggerevent in DCLA" UBYTE dez 1 100 0 255 FORMAT "%5.1" ECU_ADDRESS 0x382FF3 /end MEASUREMENT
/begin MEASUREMENT bbsp3 "Byte für Bedingung B_sp3 als Triggerevent in DCLA" UBYTE dez 1 100 0 255 FORMAT "%5.1" ECU_ADDRESS 0x382FF4 /end MEASUREMENT
/begin MEASUREMENT bbtim "Byte für Bedingung B_tim als Triggerevent in DCLA" UBYTE dez 1 100 0 255 FORMAT "%5.1" ECU_ADDRESS 0x380AD3 /end MEASUREMENT
/begin MEASUREMENT bfzglfgr "Fahrzeuglängsbeschleunigung" SBYTE bfzg_sb_q0p217 1 100 -27.776 27.559 FORMAT "%5.2" ECU_ADDRESS 0x380C72 /end MEASUREMENT
/begin MEASUREMENT BgtabstNvBits "" UBYTE dez 1 100 0 255 FORMAT "%5.1" ECU_ADDRESS 0x383121 /end MEASUREMENT
/begin MEASUREMENT bmfz_w "Zähler BM-Fehler für DG Diagnose" UWORD dez 1 100 0 65535 FORMAT "%8.2" ECU_ADDRESS 0x3810CE /end MEASUREMENT
/begin MEASUREMENT bremsacc "Bremseingriff für ACC-Funktion, bezogen auf BRE_NORM" UBYTE rel_ub_b100 1 100 0 100 FORMAT "%5.1" ECU_ADDRESS 0x380ABC /end MEASUREMENT
/begin MEASUREMENT bsc "Radbeschleunigungssignal aus ABS-Sensorsignal berechnet" UBYTE acc_ub_b55p55 1 100 0 55.335 FORMAT "%5.2" ECU_ADDRESS 0x380D3C /end MEASUREMENT
/begin MEASUREMENT B_4x4pkw "Bedingung Fahrzeug mit 4x4 erkannt und CAN-Botschaft ASC4 nicht unterbrochen" UWORD B_TRUE 1 100 0 1 BIT_MASK 0x40 FORMAT "%13.11" ECU_ADDRESS 0xFD70 /end MEASUREMENT
/begin MEASUREMENT B_ac "Bedingung Lastaufschaltung Klimaanlage" UWORD B_TRUE 1 100 0 1 BIT_MASK 0x2000 FORMAT "%13.11" ECU_ADDRESS 0xFD72 /end MEASUREMENT
/begin MEASUREMENT B_acc "Bedingung: ACC-Steuergerät vorhanden" UWORD B_TRUE 1 100 0 1 BIT_MASK 0x4 FORMAT "%13.11" ECU_ADDRESS 0xFD50 /end MEASUREMENT
/begin MEASUREMENT B_acccok "Bedingung CAN-Botschaft-ACC1 vorhanden" UWORD B_TRUE 1 100 0 1 BIT_MASK 0x1 FORMAT "%13.11" ECU_ADDRESS 0xFD70 /end MEASUREMENT
/begin MEASUREMENT B_accdef "Bedingung Defekt im ACC-Verbund" UWORD B_TRUE 1 100 0 1 BIT_MASK 0x2 FORMAT "%13.11" ECU_ADDRESS 0xFD70 /end MEASUREMENT
/begin MEASUREMENT B_accdme "Bedingung Quittierung der ACC-Anforderung" UWORD B_TRUE 1 100 0 1 BIT_MASK 0x8 FORMAT "%13.11" ECU_ADDRESS 0xFD50 /end MEASUREMENT
/begin MEASUREMENT B_accnew "Bedingung CAN-ACC-Botschaft i.O. empfangen" UWORD B_TRUE 1 100 0 1 BIT_MASK 0x4 FORMAT "%13.11" ECU_ADDRESS 0xFD70 /end MEASUREMENT
/begin MEASUREMENT B_accsipl "Bedingung ACC-Signal plausibel" UWORD B_TRUE 1 100 0 1 BIT_MASK 0x1 FORMAT "%13.11" ECU_ADDRESS 0xFD42 /end MEASUREMENT
/begin MEASUREMENT B_add "Bedingung Plausibilitäts- und Differenzbedingung für aktuelles PUS_W erfüllt" UBYTE B_TRUE 1 100 0 1 BIT_MASK 0x2 FORMAT "%13.11" ECU_ADDRESS 0x380D4F /end MEASUREMENT
/begin MEASUREMENT B_admtll "Bedingung DDMTL-Automat laeuft" UBYTE B_TRUE 1 100 0 1 BIT_MASK 0x1 FORMAT "%13.11" ECU_ADDRESS 0x383147 /end MEASUREMENT
/begin MEASUREMENT B_admtls "Bedingung DDMTL-Automat soll stoppen" UBYTE B_TRUE 1 100 0 1 BIT_MASK 0x2 FORMAT "%13.11" ECU_ADDRESS 0x383147 /end MEASUREMENT
/begin MEASUREMENT B_admtpm "Bedingung DMTL-Pumpenmotor an" UBYTE B_TRUE 1 100 0 1 BIT_MASK 0x1 FORMAT "%13.11" ECU_ADDRESS 0x38314E /end MEASUREMENT
/begin MEASUREMENT B_asc1cok "Bedingung CAN-ASC1-Botschaft empfangen" UWORD B_TRUE 1 100 0 1 BIT_MASK 0x80 FORMAT "%13.11" ECU_ADDRESS 0xFD70 /end MEASUREMENT
/begin MEASUREMENT B_asc1new "Bedingung CAN-ASC1-Botschaft empfangen" UWORD B_TRUE 1 100 0 1 BIT_MASK 0x100 FORMAT "%13.11" ECU_ADDRESS 0xFD70 /end MEASUREMENT
/begin MEASUREMENT B_asc2cok "Bedingung ASC verbaut und ASC2-Botschaft vorhanden" UWORD B_TRUE 1 100 0 1 BIT_MASK 0x200 FORMAT "%13.11" ECU_ADDRESS 0xFD70 /end MEASUREMENT
/begin MEASUREMENT B_asc2new "Bedingung CAN-ASC2-Botschaft empfangen" UWORD B_TRUE 1 100 0 1 BIT_MASK 0x400 FORMAT "%13.11" ECU_ADDRESS 0xFD70 /end MEASUREMENT
/begin MEASUREMENT B_asc3cok "Bedingung: CAN-Botschaft ASC3 vorhanden" UWORD B_TRUE 1 100 0 1 BIT_MASK 0x800 FORMAT "%13.11" ECU_ADDRESS 0xFD70 /end MEASUREMENT
/begin MEASUREMENT B_asc3new "Bedingung CAN-ASC3-Botschaft empfangen" UWORD B_TRUE 1 100 0 1 BIT_MASK 0x1000 FORMAT "%13.11" ECU_ADDRESS 0xFD70 /end MEASUREMENT
/begin MEASUREMENT B_asc4cok "Bedingung CAN-ASC4-Botschaft empfangen" UWORD B_TRUE 1 100 0 1 BIT_MASK 0x2000 FORMAT "%13.11" ECU_ADDRESS 0xFD70 /end MEASUREMENT
/begin MEASUREMENT B_asc4new "Bedingung CAN-ASC4-Botschaft  aktuell empfangen" UWORD B_TRUE 1 100 0 1 BIT_MASK 0x4000 FORMAT "%13.11" ECU_ADDRESS 0xFD70 /end MEASUREMENT
/begin MEASUREMENT B_ascdme "Bedingung : Quittierung ASC-Botschaft ok." UWORD B_TRUE 1 100 0 1 BIT_MASK 0x1 FORMAT "%13.11" ECU_ADDRESS 0xFD5E /end MEASUREMENT
/begin MEASUREMENT B_ascpkw "Bedingung Fahrzeug mit ASC erkannt und CAN-Botschaft nicht unterbrochen" UWORD B_TRUE 1 100 0 1 BIT_MASK 0x8000 FORMAT "%13.11" ECU_ADDRESS 0xFD70 /end MEASUREMENT
/begin MEASUREMENT B_ascsipl "Bedingung ASC-Signal plausibel" UWORD B_TRUE 1 100 0 1 BIT_MASK 0x2 FORMAT "%13.11" ECU_ADDRESS 0xFD5E /end MEASUREMENT
/begin MEASUREMENT B_asc_reg "CAN-Botschaft: ASC regelt (mit Bremsen-Eingriff)" UWORD B_TRUE 1 100 0 1 BIT_MASK 0x1 FORMAT "%13.11" ECU_ADDRESS 0xFD72 /end MEASUREMENT
/begin MEASUREMENT B_asrext "Bedingung für externe ASR-Anforderung" UWORD B_TRUE 1 100 0 1 BIT_MASK 0x4000 FORMAT "%13.11" ECU_ADDRESS 0xFD58 /end MEASUREMENT
/begin MEASUREMENT B_asrextmem "" UWORD B_TRUE 1 100 0 1 BIT_MASK 0x2 FORMAT "%13.11" ECU_ADDRESS 0xFD72 /end MEASUREMENT
/begin MEASUREMENT B_autget "Bedingung Automatikgetriebe" UWORD B_TRUE 1 100 0 1 BIT_MASK 0x80 FORMAT "%13.11" ECU_ADDRESS 0xFD72 /end MEASUREMENT
/begin MEASUREMENT B_beas "" UWORD B_TRUE 1 100 0 1 BIT_MASK 0x20 FORMAT "%13.11" ECU_ADDRESS 0x3838D4 /end MEASUREMENT
/begin MEASUREMENT B_becacc "" UWORD B_TRUE 1 100 0 1 BIT_MASK 0x20 FORMAT "%13.11" ECU_ADDRESS 0x3838DC /end MEASUREMENT
/begin MEASUREMENT B_becas "" UWORD B_TRUE 1 100 0 1 BIT_MASK 0x20 FORMAT "%13.11" ECU_ADDRESS 0x3838DE /end MEASUREMENT
/begin MEASUREMENT B_becge "" UWORD B_TRUE 1 100 0 1 BIT_MASK 0x20 FORMAT "%13.11" ECU_ADDRESS 0x3838E0 /end MEASUREMENT
/begin MEASUREMENT B_becins "" UWORD B_TRUE 1 100 0 1 BIT_MASK 0x20 FORMAT "%13.11" ECU_ADDRESS 0x3838E2 /end MEASUREMENT
/begin MEASUREMENT B_bectxu "" UWORD B_TRUE 1 100 0 1 BIT_MASK 0x20 FORMAT "%13.11" ECU_ADDRESS 0x3838E4 /end MEASUREMENT
/begin MEASUREMENT B_bedvee "" UWORD B_TRUE 1 100 0 1 BIT_MASK 0x20 FORMAT "%13.11" ECU_ADDRESS 0x383902 /end MEASUREMENT
/begin MEASUREMENT B_bedvef "" UWORD B_TRUE 1 100 0 1 BIT_MASK 0x20 FORMAT "%13.11" ECU_ADDRESS 0x383904 /end MEASUREMENT
/begin MEASUREMENT B_bedvel "" UWORD B_TRUE 1 100 0 1 BIT_MASK 0x20 FORMAT "%13.11" ECU_ADDRESS 0x383906 /end MEASUREMENT
/begin MEASUREMENT B_bedven "" UWORD B_TRUE 1 100 0 1 BIT_MASK 0x20 FORMAT "%13.11" ECU_ADDRESS 0x383908 /end MEASUREMENT
/begin MEASUREMENT B_bedver "" UWORD B_TRUE 1 100 0 1 BIT_MASK 0x20 FORMAT "%13.11" ECU_ADDRESS 0x38390A /end MEASUREMENT
/begin MEASUREMENT B_bedveu "" UWORD B_TRUE 1 100 0 1 BIT_MASK 0x20 FORMAT "%13.11" ECU_ADDRESS 0x38390C /end MEASUREMENT
/begin MEASUREMENT B_bedvev "" UWORD B_TRUE 1 100 0 1 BIT_MASK 0x20 FORMAT "%13.11" ECU_ADDRESS 0x38390E /end MEASUREMENT
/begin MEASUREMENT B_beswe "Bedingung Bandende-Funktionsanforderung Beschleunigungss. f Schlechtwegerkennung" UWORD B_TRUE 1 100 0 1 BIT_MASK 0x20 FORMAT "%13.11" ECU_ADDRESS 0x3839C0 /end MEASUREMENT
/begin MEASUREMENT B_bkas "" UWORD B_TRUE 1 100 0 1 BIT_MASK 0x40 FORMAT "%13.11" ECU_ADDRESS 0x3838D4 /end MEASUREMENT
/begin MEASUREMENT B_bkcacc "" UWORD B_TRUE 1 100 0 1 BIT_MASK 0x40 FORMAT "%13.11" ECU_ADDRESS 0x3838DC /end MEASUREMENT
/begin MEASUREMENT B_bkcas "Bedingung: CAN-Schnittstelle, Timeout ASC" UWORD B_TRUE 1 100 0 1 BIT_MASK 0x40 FORMAT "%13.11" ECU_ADDRESS 0x3838DE /end MEASUREMENT
/begin MEASUREMENT B_bkcge "Bedingung: CAN-Schnittstelle, Timeout EGS" UWORD B_TRUE 1 100 0 1 BIT_MASK 0x40 FORMAT "%13.11" ECU_ADDRESS 0x3838E0 /end MEASUREMENT
/begin MEASUREMENT B_bkcins "Bedingung: CAN-Schnittstelle, Timeout Instrument" UWORD B_TRUE 1 100 0 1 BIT_MASK 0x40 FORMAT "%13.11" ECU_ADDRESS 0x3838E2 /end MEASUREMENT
/begin MEASUREMENT B_bkctxu "" UWORD B_TRUE 1 100 0 1 BIT_MASK 0x40 FORMAT "%13.11" ECU_ADDRESS 0x3838E4 /end MEASUREMENT
/begin MEASUREMENT B_bkdvee "Bedingung: DV-E Endstufe" UWORD B_TRUE 1 100 0 1 BIT_MASK 0x40 FORMAT "%13.11" ECU_ADDRESS 0x383902 /end MEASUREMENT
/begin MEASUREMENT B_bkdvef "Bedingung: DV-E Fehler bei Federprüfung" UWORD B_TRUE 1 100 0 1 BIT_MASK 0x40 FORMAT "%13.11" ECU_ADDRESS 0x383904 /end MEASUREMENT
/begin MEASUREMENT B_bkdvel "Bedingung: DV-E Lageabweichung" UWORD B_TRUE 1 100 0 1 BIT_MASK 0x40 FORMAT "%13.11" ECU_ADDRESS 0x383906 /end MEASUREMENT
/begin MEASUREMENT B_bkdven "Ersatzwert aktiv: DV-E Notluftposition" UWORD B_TRUE 1 100 0 1 BIT_MASK 0x40 FORMAT "%13.11" ECU_ADDRESS 0x383908 /end MEASUREMENT
/begin MEASUREMENT B_bkdver "Bedingung: DV-E Regelbereich" UWORD B_TRUE 1 100 0 1 BIT_MASK 0x40 FORMAT "%13.11" ECU_ADDRESS 0x38390A /end MEASUREMENT
/begin MEASUREMENT B_bkdveu "Ersatzwert aktiv: DV-E UMA-Lernen" UWORD B_TRUE 1 100 0 1 BIT_MASK 0x40 FORMAT "%13.11" ECU_ADDRESS 0x38390C /end MEASUREMENT
/begin MEASUREMENT B_bkdvev "Ersatzwert aktiv: DV-E Verstärkerabgleich" UWORD B_TRUE 1 100 0 1 BIT_MASK 0x40 FORMAT "%13.11" ECU_ADDRESS 0x38390E /end MEASUREMENT
/begin MEASUREMENT B_bkswe "" UWORD B_TRUE 1 100 0 1 BIT_MASK 0x40 FORMAT "%13.11" ECU_ADDRESS 0x3839C0 /end MEASUREMENT
/begin MEASUREMENT B_bremsacc "Bedingung Bremsanforderung ACC über CAN" UWORD B_TRUE 1 100 0 1 BIT_MASK 0x8 FORMAT "%13.11" ECU_ADDRESS 0xFD70 /end MEASUREMENT
/begin MEASUREMENT B_clacc "Bedingung Fehlerflag ""ACC-Fehler"" löschen" UWORD B_TRUE 1 100 0 1 BIT_MASK 0x80 FORMAT "%13.11" ECU_ADDRESS 0x3838CC /end MEASUREMENT
/begin MEASUREMENT B_clas "Bedingung Fehlerpfad ASR/TC Schnittstelle löschen" UWORD B_TRUE 1 100 0 1 BIT_MASK 0x80 FORMAT "%13.11" ECU_ADDRESS 0x3838D4 /end MEASUREMENT
/begin MEASUREMENT B_clcacc "Bedingung Fehlerpfad CACC löschen" UWORD B_TRUE 1 100 0 1 BIT_MASK 0x80 FORMAT "%13.11" ECU_ADDRESS 0x3838DC /end MEASUREMENT
/begin MEASUREMENT B_clcas "Bedingung Fehlerpfad CAS löschen" UWORD B_TRUE 1 100 0 1 BIT_MASK 0x80 FORMAT "%13.11" ECU_ADDRESS 0x3838DE /end MEASUREMENT
/begin MEASUREMENT B_clcge "Bedingung Fehlerpfad CGE löschen" UWORD B_TRUE 1 100 0 1 BIT_MASK 0x80 FORMAT "%13.11" ECU_ADDRESS 0x3838E0 /end MEASUREMENT
/begin MEASUREMENT B_clcins "Bedingung Fehlerpfad CINS löschen" UWORD B_TRUE 1 100 0 1 BIT_MASK 0x80 FORMAT "%13.11" ECU_ADDRESS 0x3838E2 /end MEASUREMENT
/begin MEASUREMENT B_clctxu "Bedingung Fehlerpfad CAN-Timeout TXU löschen" UWORD B_TRUE 1 100 0 1 BIT_MASK 0x80 FORMAT "%13.11" ECU_ADDRESS 0x3838E4 /end MEASUREMENT
/begin MEASUREMENT B_cldvee "Flag für Löschmaßnahmen: DV-E Endstufe" UWORD B_TRUE 1 100 0 1 BIT_MASK 0x80 FORMAT "%13.11" ECU_ADDRESS 0x383902 /end MEASUREMENT
/begin MEASUREMENT B_cldvef "Flag für Löschung: DV-E Fehler bei Federprüfung" UWORD B_TRUE 1 100 0 1 BIT_MASK 0x80 FORMAT "%13.11" ECU_ADDRESS 0x383904 /end MEASUREMENT
/begin MEASUREMENT B_cldvel "Flag für Löschmaßnahmen: DV-E Lageabweichung" UWORD B_TRUE 1 100 0 1 BIT_MASK 0x80 FORMAT "%13.11" ECU_ADDRESS 0x383906 /end MEASUREMENT
/begin MEASUREMENT B_cldven "Flag für Löschung: DV-E Fehler bei Prüfung Notluftposition" UWORD B_TRUE 1 100 0 1 BIT_MASK 0x80 FORMAT "%13.11" ECU_ADDRESS 0x383908 /end MEASUREMENT
/begin MEASUREMENT B_cldver "Flag für Löschmaßnahmen: DV-E Regelabweichung" UWORD B_TRUE 1 100 0 1 BIT_MASK 0x80 FORMAT "%13.11" ECU_ADDRESS 0x38390A /end MEASUREMENT
/begin MEASUREMENT B_cldveu "Flag für Löschung: DV-E Fehler beim UMA-Lernen" UWORD B_TRUE 1 100 0 1 BIT_MASK 0x80 FORMAT "%13.11" ECU_ADDRESS 0x38390C /end MEASUREMENT
/begin MEASUREMENT B_cldvev "Flag für Löschung: DV-E Fehler bei Verstärkerabgleich" UWORD B_TRUE 1 100 0 1 BIT_MASK 0x80 FORMAT "%13.11" ECU_ADDRESS 0x38390E /end MEASUREMENT
/begin MEASUREMENT B_clswe "Flag : Fehlerpfad Diagnose Beschleunigungssensor löschen" UWORD B_TRUE 1 100 0 1 BIT_MASK 0x80 FORMAT "%13.11" ECU_ADDRESS 0x3839C0 /end MEASUREMENT
/begin MEASUREMENT B_cotrim "Bedingung für LL-CO Abgleich erfüllt" UWORD B_TRUE 1 100 0 1 BIT_MASK 0x10 FORMAT "%13.11" ECU_ADDRESS 0xFD9A /end MEASUREMENT
/begin MEASUREMENT B_dcy "Bedingung 'driving cycle' erkannt" UBYTE B_TRUE 1 100 0 1 BIT_MASK 0x1 FORMAT "%13.11" ECU_ADDRESS 0x380AD2 /end MEASUREMENT
/begin MEASUREMENT B_delayterm "" UWORD B_TRUE 1 100 0 1 BIT_MASK 0x10 FORMAT "%13.11" ECU_ADDRESS 0xFDD0 /end MEASUREMENT
/begin MEASUREMENT B_desee "Diagnose Endstufe: Eingangsbedingungen erfüllt" UWORD B_TRUE 1 100 0 1 BIT_MASK 0x800 FORMAT "%13.11" ECU_ADDRESS 0xFD8A /end MEASUREMENT
/begin MEASUREMENT B_diprfo "Bedingung delta Referenzstrom ueberschritten" UBYTE B_TRUE 1 100 0 1 BIT_MASK 0x4 FORMAT "%13.11" ECU_ADDRESS 0x383147 /end MEASUREMENT
/begin MEASUREMENT B_dmdiptge "Bedingung Grobleckmessung enabled nach Stromschwankungen" UBYTE B_TRUE 1 100 0 1 BIT_MASK 0x8 FORMAT "%13.11" ECU_ADDRESS 0x383147 /end MEASUREMENT
/begin MEASUREMENT B_dmdiptke "Bedingung Kleinstleckmessung enabled nach Stromschwankungen" UBYTE B_TRUE 1 100 0 1 BIT_MASK 0x10 FORMAT "%13.11" ECU_ADDRESS 0x383147 /end MEASUREMENT
/begin MEASUREMENT B_dmgltd "Bedingung Freigabe Grobleckprüfung durch check filler cap" UBYTE B_TRUE 1 100 0 1 BIT_MASK 0x1 FORMAT "%13.11" ECU_ADDRESS 0x380D45 /end MEASUREMENT
/begin MEASUREMENT B_dmkl15 "Bedingung Klemme15 ein waehrend Kleinstleckpruefung" UBYTE B_TRUE 1 100 0 1 BIT_MASK 0x2 FORMAT "%13.11" ECU_ADDRESS 0x38314E /end MEASUREMENT
/begin MEASUREMENT B_dmktke "Bedingung Kleinstleckmessung enabled nach Betankung" UBYTE B_TRUE 1 100 0 1 BIT_MASK 0x20 FORMAT "%13.11" ECU_ADDRESS 0x383147 /end MEASUREMENT
/begin MEASUREMENT B_dmktkr "Bedingung Kleinstleckmessung zuruecksetzen nach Betankung" UBYTE B_TRUE 1 100 0 1 BIT_MASK 0x40 FORMAT "%13.11" ECU_ADDRESS 0x383147 /end MEASUREMENT
/begin MEASUREMENT B_dmktks "Bedingung Kleinstleckmessung setzen nach Betankung" UBYTE B_TRUE 1 100 0 1 BIT_MASK 0x80 FORMAT "%13.11" ECU_ADDRESS 0x383147 /end MEASUREMENT
/begin MEASUREMENT B_dmmtev "TEV-schließen wegen Bedingung Endstufentest DMTL-Magnetventil" UWORD B_TRUE 1 100 0 1 BIT_MASK 0x10 FORMAT "%13.11" ECU_ADDRESS 0xFD8A /end MEASUREMENT
/begin MEASUREMENT B_dmmvtp "Bedingung Endstufentest DMTL-Magnetventil mit Prüfpuls" UWORD B_TRUE 1 100 0 1 BIT_MASK 0x20 FORMAT "%13.11" ECU_ADDRESS 0xFD8A /end MEASUREMENT
/begin MEASUREMENT B_dmtdc "Anforderung check filler cap" UBYTE B_TRUE 1 100 0 1 BIT_MASK 0x1 FORMAT "%13.11" ECU_ADDRESS 0x38314D /end MEASUREMENT
/begin MEASUREMENT B_dmtete "Bedingung Freigabe Funktionsanforderung DM-TL-Endstufen" UBYTE B_TRUE 1 100 0 1 BIT_MASK 0x1 FORMAT "%13.11" ECU_ADDRESS 0x380D43 /end MEASUREMENT
/begin MEASUREMENT B_dmtge "Bedingung Freigabe Grobleckmessung" UBYTE B_TRUE 1 100 0 1 BIT_MASK 0x1 FORMAT "%13.11" ECU_ADDRESS 0x383148 /end MEASUREMENT
/begin MEASUREMENT B_dmtglm "Bedingung Grobleckmessung aktiv" UBYTE B_TRUE 1 100 0 1 BIT_MASK 0x2 FORMAT "%13.11" ECU_ADDRESS 0x383148 /end MEASUREMENT
/begin MEASUREMENT B_dmtglmv "Bedingung Verlängerung Grobleckmessung" UBYTE B_TRUE 1 100 0 1 BIT_MASK 0x4 FORMAT "%13.11" ECU_ADDRESS 0x38314C /end MEASUREMENT
/begin MEASUREMENT B_dmtgtz "Bedingung TEV soll geschlossen werden" UBYTE B_TRUE 1 100 0 1 BIT_MASK 0x2 FORMAT "%13.11" ECU_ADDRESS 0x380D43 /end MEASUREMENT
/begin MEASUREMENT B_dmtgv "Tankentlüftungssystem Verdacht Grobleck" UBYTE B_TRUE 1 100 0 1 BIT_MASK 0x4 FORMAT "%13.11" ECU_ADDRESS 0x383148 /end MEASUREMENT
/begin MEASUREMENT B_dmtgvs "Tankentlüftungssystem Verdacht Grobleck" UBYTE B_TRUE 1 100 0 1 BIT_MASK 0x8 FORMAT "%13.11" ECU_ADDRESS 0x383148 /end MEASUREMENT
/begin MEASUREMENT B_dmtke "Bedingung Freigabe Kleinstleckmessung" UBYTE B_TRUE 1 100 0 1 BIT_MASK 0x10 FORMAT "%13.11" ECU_ADDRESS 0x383148 /end MEASUREMENT
/begin MEASUREMENT B_dmtkee "Bedingung Ende Freigabe Kleinstleckmessung" UBYTE B_TRUE 1 100 0 1 BIT_MASK 0x20 FORMAT "%13.11" ECU_ADDRESS 0x383148 /end MEASUREMENT
/begin MEASUREMENT B_dmtklm "Bedingung Kleinstleckmessung aktiv" UBYTE B_TRUE 1 100 0 1 BIT_MASK 0x40 FORMAT "%13.11" ECU_ADDRESS 0x383148 /end MEASUREMENT
/begin MEASUREMENT B_dmtklmv "Bedingung 2 Stabilisierungszeit laüft" UBYTE B_TRUE 1 100 0 1 BIT_MASK 0x80 FORMAT "%13.11" ECU_ADDRESS 0x38314C /end MEASUREMENT
/begin MEASUREMENT B_dmtktz "Bedingung TEV soll geschlossen werden" UBYTE B_TRUE 1 100 0 1 BIT_MASK 0x80 FORMAT "%13.11" ECU_ADDRESS 0x383148 /end MEASUREMENT
/begin MEASUREMENT B_dmtlefs "Bedingung externer Funktions-Stop der DMTL" UBYTE B_TRUE 1 100 0 1 BIT_MASK 0x4 FORMAT "%13.11" ECU_ADDRESS 0x380D45 /end MEASUREMENT
/begin MEASUREMENT B_dmtlfe "Bedingung Freigabe Funktionsanforderung Grob-/Kleinstleckmessung" UBYTE B_TRUE 1 100 0 1 BIT_MASK 0x1 FORMAT "%13.11" ECU_ADDRESS 0x383149 /end MEASUREMENT
/begin MEASUREMENT B_dmtlhe "Bedingung Hauptfreigabe Grob-/Kleinstleckmessung" UBYTE B_TRUE 1 100 0 1 BIT_MASK 0x4 FORMAT "%13.11" ECU_ADDRESS 0x380D43 /end MEASUREMENT
/begin MEASUREMENT B_dmtlmv "Bedingung DMTL-Magnetventil an" UBYTE B_TRUE 1 100 0 1 BIT_MASK 0x4 FORMAT "%13.11" ECU_ADDRESS 0x38314E /end MEASUREMENT
/begin MEASUREMENT B_dmtlpe "Prüfung Komponente auf Pumpstromschwellen gültig" UBYTE B_TRUE 1 100 0 1 BIT_MASK 0x40 FORMAT "%13.11" ECU_ADDRESS 0x38314C /end MEASUREMENT
/begin MEASUREMENT B_dmtlpm "Bedingung DMTL-Pumpenmotor an" UWORD B_TRUE 1 100 0 1 BIT_MASK 0x400 FORMAT "%13.11" ECU_ADDRESS 0xFD8A /end MEASUREMENT
/begin MEASUREMENT B_dmtltde "Bedingung Hauptfreigabe Check filler cap" UBYTE B_TRUE 1 100 0 1 BIT_MASK 0x2 FORMAT "%13.11" ECU_ADDRESS 0x380D45 /end MEASUREMENT
/begin MEASUREMENT B_dmtltz "Bedingung TEV soll geschlossen werden" UBYTE B_TRUE 1 100 0 1 BIT_MASK 0x8 FORMAT "%13.11" ECU_ADDRESS 0x38314E /end MEASUREMENT
/begin MEASUREMENT B_dmtmv "Bedingung DMTL-Magnetventil an" UBYTE B_TRUE 1 100 0 1 BIT_MASK 0x2 FORMAT "%13.11" ECU_ADDRESS 0x383149 /end MEASUREMENT
/begin MEASUREMENT B_dmtnge "Bedingung Freigabe nur Grobleckmessung" UBYTE B_TRUE 1 100 0 1 BIT_MASK 0x8 FORMAT "%13.11" ECU_ADDRESS 0x380D43 /end MEASUREMENT
/begin MEASUREMENT B_dmtpm "Bedingung DMTL-Pumpenmotor an" UBYTE B_TRUE 1 100 0 1 BIT_MASK 0x4 FORMAT "%13.11" ECU_ADDRESS 0x383149 /end MEASUREMENT
/begin MEASUREMENT B_dmtrfm "Bedingung Referenzleckmessung aktiv" UBYTE B_TRUE 1 100 0 1 BIT_MASK 0x8 FORMAT "%13.11" ECU_ADDRESS 0x383149 /end MEASUREMENT
/begin MEASUREMENT B_dpsf "Bedingung fallender Pumpenstrom während Messung" UBYTE B_TRUE 1 100 0 1 BIT_MASK 0x10 FORMAT "%13.11" ECU_ADDRESS 0x383149 /end MEASUREMENT
/begin MEASUREMENT B_dsc_reg "CAN-Botschaft: DSC regelt (Motor und Bremseingriffe)" UWORD B_TRUE 1 100 0 1 BIT_MASK 0x4 FORMAT "%13.11" ECU_ADDRESS 0xFD72 /end MEASUREMENT
/begin MEASUREMENT B_dteg "Nur Grobleckprüfung wegen leicht gasendem Kraftstoff" UBYTE B_TRUE 1 100 0 1 BIT_MASK 0x2 FORMAT "%13.11" ECU_ADDRESS 0x38314D /end MEASUREMENT
/begin MEASUREMENT B_dtegen "Bedingung Grobleckpruefungs-Enable" UBYTE B_TRUE 1 100 0 1 BIT_MASK 0x10 FORMAT "%13.11" ECU_ADDRESS 0x380D43 /end MEASUREMENT
/begin MEASUREMENT B_dtegfa "Bedingung Gunktionsanforderung Grobleckpruefung" UBYTE B_TRUE 1 100 0 1 BIT_MASK 0x20 FORMAT "%13.11" ECU_ADDRESS 0x380D43 /end MEASUREMENT
/begin MEASUREMENT B_dtegtr "Bedingung keine Grobleckpruefung in diesem Trip mehr" UBYTE B_TRUE 1 100 0 1 BIT_MASK 0x40 FORMAT "%13.11" ECU_ADDRESS 0x380D43 /end MEASUREMENT
/begin MEASUREMENT B_dteken "Bedingung Freigabe Feinstleckprüfung" UBYTE B_TRUE 1 100 0 1 BIT_MASK 0x20 FORMAT "%13.11" ECU_ADDRESS 0x383149 /end MEASUREMENT
/begin MEASUREMENT B_dtekfa "Bedingung Funktionsanforderung Feinstleckpruefung" UBYTE B_TRUE 1 100 0 1 BIT_MASK 0x40 FORMAT "%13.11" ECU_ADDRESS 0x383149 /end MEASUREMENT
/begin MEASUREMENT B_dtektr "Bedingung keine Feinstleckpruefung in diesem Trip mehr" UBYTE B_TRUE 1 100 0 1 BIT_MASK 0x80 FORMAT "%13.11" ECU_ADDRESS 0x383149 /end MEASUREMENT
/begin MEASUREMENT B_dtetd "Bedingung Tankdeckel wurde geoeffnet" UBYTE B_TRUE 1 100 0 1 BIT_MASK 0x1 FORMAT "%13.11" ECU_ADDRESS 0x38314A /end MEASUREMENT
/begin MEASUREMENT B_dtetk "Bedingung Betankung erkannt" UBYTE B_TRUE 1 100 0 1 BIT_MASK 0x2 FORMAT "%13.11" ECU_ADDRESS 0x38314A /end MEASUREMENT
/begin MEASUREMENT B_dtobd "Bedingung OBD-relevante DM-TL Diagnose" UBYTE B_TRUE 1 100 0 1 BIT_MASK 0x4 FORMAT "%13.11" ECU_ADDRESS 0x380D46 /end MEASUREMENT
/begin MEASUREMENT B_dubtes "Bedingung grosse Batteriespannungsschwankung Tankdiagnose" UBYTE B_TRUE 1 100 0 1 BIT_MASK 0x4 FORMAT "%13.11" ECU_ADDRESS 0x38314A /end MEASUREMENT
/begin MEASUREMENT B_edmtg "Tankentlüftungssystem Grobleck" UBYTE B_TRUE 1 100 0 1 BIT_MASK 0x8 FORMAT "%13.11" ECU_ADDRESS 0x38314A /end MEASUREMENT
/begin MEASUREMENT B_edmtk "Tankentlüftungssystem Kleinstleck" UBYTE B_TRUE 1 100 0 1 BIT_MASK 0x10 FORMAT "%13.11" ECU_ADDRESS 0x38314A /end MEASUREMENT
/begin MEASUREMENT B_edmtks "nicht geheilter Kleinstleckfehler erkannt" UBYTE B_TRUE 1 100 0 1 BIT_MASK 0x20 FORMAT "%13.11" ECU_ADDRESS 0x38314A /end MEASUREMENT
/begin MEASUREMENT B_edmtksnm "nicht geheilter Kleinstleckfehler erkannt bei nicht MIL relevantem Fehlerpfad" UBYTE B_TRUE 1 100 0 1 BIT_MASK 0x10 FORMAT "%13.11" ECU_ADDRESS 0x38314E /end MEASUREMENT
/begin MEASUREMENT B_eev "Bedingung Endstufenfehler EV" UWORD B_TRUE 1 100 0 1 BIT_MASK 0x4 FORMAT "%13.11" ECU_ADDRESS 0xFD94 /end MEASUREMENT
/begin MEASUREMENT B_egscok "Bedingung Getriebebotschaft CAN empfangen" UWORD B_TRUE 1 100 0 1 BIT_MASK 0x100 FORMAT "%13.11" ECU_ADDRESS 0xFD72 /end MEASUREMENT
/begin MEASUREMENT B_egsnew "Bedingung, daß eine neue Getriebebotschaft erkannt wurde" UWORD B_TRUE 1 100 0 1 BIT_MASK 0x200 FORMAT "%13.11" ECU_ADDRESS 0xFD72 /end MEASUREMENT
/begin MEASUREMENT B_epcl "Bedingung für Ansteuerung EGAS-Fehlerlampe" UWORD B_TRUE 1 100 0 1 BIT_MASK 0x10 FORMAT "%13.11" ECU_ADDRESS 0xFD50 /end MEASUREMENT
/begin MEASUREMENT B_esdia "Endstufendiagnose aktiv" UWORD B_TRUE 1 100 0 1 BIT_MASK 0x1000 FORMAT "%13.11" ECU_ADDRESS 0xFD8A /end MEASUREMENT
/begin MEASUREMENT B_esdmte "Bedingung DDMTL enabled bezueglich Endstufenfehler" UWORD B_TRUE 1 100 0 1 BIT_MASK 0x100 FORMAT "%13.11" ECU_ADDRESS 0xFDD0 /end MEASUREMENT
/begin MEASUREMENT B_esttxu "Bedingung Fehlerstatus Vorgelege-Getriebe TXU" UBYTE B_TRUE 1 100 0 1 BIT_MASK 0x2 FORMAT "%13.11" ECU_ADDRESS 0x380ACB /end MEASUREMENT
/begin MEASUREMENT B_evfzgv1 "Bedingung Fehler Geschwindigkeitssignal V1 (über CAN)" UWORD B_TRUE 1 100 0 1 BIT_MASK 0x8 FORMAT "%13.11" ECU_ADDRESS 0xFD72 /end MEASUREMENT
/begin MEASUREMENT B_fedmmv "Bedingung DMTL-Magnetventil an bei Funktionsanforderung" UBYTE B_TRUE 1 100 0 1 BIT_MASK 0x80 FORMAT "%13.11" ECU_ADDRESS 0x380D43 /end MEASUREMENT
/begin MEASUREMENT B_fedmpm "Bedingung DMTL-Pumpenmotor an bei Funktionsanforderung" UBYTE B_TRUE 1 100 0 1 BIT_MASK 0x1 FORMAT "%13.11" ECU_ADDRESS 0x380D44 /end MEASUREMENT
/begin MEASUREMENT B_fedmtl "Bedingung Funktionsanforderung Endstufe Tankentleckdiagnose" UBYTE B_TRUE 1 100 0 1 BIT_MASK 0x2 FORMAT "%13.11" ECU_ADDRESS 0x380D44 /end MEASUREMENT
/begin MEASUREMENT B_fedmtz "Bedingung TEV soll geschlossen werden" UBYTE B_TRUE 1 100 0 1 BIT_MASK 0x4 FORMAT "%13.11" ECU_ADDRESS 0x380D44 /end MEASUREMENT
/begin MEASUREMENT B_fgrabz "Bedingung zusätzliche FGR-Abschaltung" UWORD B_TRUE 1 100 0 1 BIT_MASK 0x2000 FORMAT "%13.11" ECU_ADDRESS 0xFD96 /end MEASUREMENT
/begin MEASUREMENT B_fs "Bedingung Fahrstufe" UWORD B_TRUE 1 100 0 1 BIT_MASK 0x2 FORMAT "%13.11" ECU_ADDRESS 0xFD20 /end MEASUREMENT
/begin MEASUREMENT B_fstcanok "CAN: Bedingung Tankfuellstands-Message okay" UWORD B_TRUE 1 100 0 1 BIT_MASK 0x4000 FORMAT "%13.11" ECU_ADDRESS 0xFD72 /end MEASUREMENT
/begin MEASUREMENT B_ftas "" UWORD B_TRUE 1 100 0 1 BIT_MASK 0x10 FORMAT "%13.11" ECU_ADDRESS 0x3838D4 /end MEASUREMENT
/begin MEASUREMENT B_ftcacc "" UWORD B_TRUE 1 100 0 1 BIT_MASK 0x10 FORMAT "%13.11" ECU_ADDRESS 0x3838DC /end MEASUREMENT
/begin MEASUREMENT B_ftcas "" UWORD B_TRUE 1 100 0 1 BIT_MASK 0x10 FORMAT "%13.11" ECU_ADDRESS 0x3838DE /end MEASUREMENT
/begin MEASUREMENT B_ftcge "" UWORD B_TRUE 1 100 0 1 BIT_MASK 0x10 FORMAT "%13.11" ECU_ADDRESS 0x3838E0 /end MEASUREMENT
/begin MEASUREMENT B_ftcins "" UWORD B_TRUE 1 100 0 1 BIT_MASK 0x10 FORMAT "%13.11" ECU_ADDRESS 0x3838E2 /end MEASUREMENT
/begin MEASUREMENT B_ftctxu "" UWORD B_TRUE 1 100 0 1 BIT_MASK 0x10 FORMAT "%13.11" ECU_ADDRESS 0x3838E4 /end MEASUREMENT
/begin MEASUREMENT B_ftdvee "" UWORD B_TRUE 1 100 0 1 BIT_MASK 0x10 FORMAT "%13.11" ECU_ADDRESS 0x383902 /end MEASUREMENT
/begin MEASUREMENT B_ftdvef "" UWORD B_TRUE 1 100 0 1 BIT_MASK 0x10 FORMAT "%13.11" ECU_ADDRESS 0x383904 /end MEASUREMENT
/begin MEASUREMENT B_ftdvel "" UWORD B_TRUE 1 100 0 1 BIT_MASK 0x10 FORMAT "%13.11" ECU_ADDRESS 0x383906 /end MEASUREMENT
/begin MEASUREMENT B_ftdven "" UWORD B_TRUE 1 100 0 1 BIT_MASK 0x10 FORMAT "%13.11" ECU_ADDRESS 0x383908 /end MEASUREMENT
/begin MEASUREMENT B_ftdver "" UWORD B_TRUE 1 100 0 1 BIT_MASK 0x10 FORMAT "%13.11" ECU_ADDRESS 0x38390A /end MEASUREMENT
/begin MEASUREMENT B_ftdveu "" UWORD B_TRUE 1 100 0 1 BIT_MASK 0x10 FORMAT "%13.11" ECU_ADDRESS 0x38390C /end MEASUREMENT
/begin MEASUREMENT B_ftdvev "" UWORD B_TRUE 1 100 0 1 BIT_MASK 0x10 FORMAT "%13.11" ECU_ADDRESS 0x38390E /end MEASUREMENT
/begin MEASUREMENT B_ftswe "" UWORD B_TRUE 1 100 0 1 BIT_MASK 0x10 FORMAT "%13.11" ECU_ADDRESS 0x3839C0 /end MEASUREMENT
/begin MEASUREMENT B_got "Bedingung Getriebeöl_Übertemperatur Stufe I" UWORD B_TRUE 1 100 0 1 BIT_MASK 0x400 FORMAT "%13.11" ECU_ADDRESS 0xFD72 /end MEASUREMENT
/begin MEASUREMENT B_gts "Bedingung Getriebeschutz" UWORD B_TRUE 1 100 0 1 BIT_MASK 0x800 FORMAT "%13.11" ECU_ADDRESS 0xFD72 /end MEASUREMENT
/begin MEASUREMENT B_hdc "Bedingung Hill Desent Control aktiv" UWORD B_TRUE 1 100 0 1 BIT_MASK 0x10 FORMAT "%13.11" ECU_ADDRESS 0xFD72 /end MEASUREMENT
/begin MEASUREMENT B_hdca "Bedingung Anforderung Hill Desent Control" UWORD B_TRUE 1 100 0 1 BIT_MASK 0x20 FORMAT "%13.11" ECU_ADDRESS 0xFD72 /end MEASUREMENT
/begin MEASUREMENT B_ins2cok "Bedingung: CAN-Botschaft INSTR2 vorhanden" UWORD B_TRUE 1 100 0 1 BIT_MASK 0x8000 FORMAT "%13.11" ECU_ADDRESS 0xFD72 /end MEASUREMENT
/begin MEASUREMENT B_ins2new "Bedingung CAN-Kombi-Botschaft 2 empfangen" UWORD B_TRUE 1 100 0 1 BIT_MASK 0x1 FORMAT "%13.11" ECU_ADDRESS 0xFD74 /end MEASUREMENT
/begin MEASUREMENT B_ins3cok "Bedingung CAN-Botschaft-INST3 vorhanden" UWORD B_TRUE 1 100 0 1 BIT_MASK 0x2 FORMAT "%13.11" ECU_ADDRESS 0xFD74 /end MEASUREMENT
/begin MEASUREMENT B_ins3new "Bedingung CAN-Kombi-Botschaft 3 empfangen" UWORD B_TRUE 1 100 0 1 BIT_MASK 0x4 FORMAT "%13.11" ECU_ADDRESS 0xFD74 /end MEASUREMENT
/begin MEASUREMENT B_ko "Bedingung Kompressor freigegeben" UWORD B_TRUE 1 100 0 1 BIT_MASK 0x8 FORMAT "%13.11" ECU_ADDRESS 0xFD74 /end MEASUREMENT
/begin MEASUREMENT B_koger "Bedingung geregelter/ungeregelter Klimakompressor" UWORD B_TRUE 1 100 0 1 BIT_MASK 0x10 FORMAT "%13.11" ECU_ADDRESS 0xFD74 /end MEASUREMENT
/begin MEASUREMENT B_lowr "Bedingung low range aktiv" UWORD B_TRUE 1 100 0 1 BIT_MASK 0x2000 FORMAT "%13.11" ECU_ADDRESS 0xFD46 /end MEASUREMENT
/begin MEASUREMENT B_lwscok "" UWORD B_TRUE 1 100 0 1 BIT_MASK 0x100 FORMAT "%13.11" ECU_ADDRESS 0xFD74 /end MEASUREMENT
/begin MEASUREMENT B_lwsnew "" UWORD B_TRUE 1 100 0 1 BIT_MASK 0x200 FORMAT "%13.11" ECU_ADDRESS 0xFD74 /end MEASUREMENT
/begin MEASUREMENT B_mdacc "Bedingung Momentenanforderung ACC über CAN" UWORD B_TRUE 1 100 0 1 BIT_MASK 0x10 FORMAT "%13.11" ECU_ADDRESS 0xFD70 /end MEASUREMENT
/begin MEASUREMENT B_mdasc "Bedingung ASC-Schnittstelle mit ASC-ALIVE-Signal" UWORD B_TRUE 1 100 0 1 BIT_MASK 0x800 FORMAT "%13.11" ECU_ADDRESS 0xFD46 /end MEASUREMENT
/begin MEASUREMENT B_mirdmtk "Bedingung MIL on wegen E_dmtk" UBYTE B_TRUE 1 100 0 1 BIT_MASK 0x8 FORMAT "%13.11" ECU_ADDRESS 0x380D44 /end MEASUREMENT
/begin MEASUREMENT B_mnacc "" UWORD B_TRUE 1 100 0 1 BIT_MASK 0x200 FORMAT "%13.11" ECU_ADDRESS 0x3838CC /end MEASUREMENT
/begin MEASUREMENT B_mnas "" UWORD B_TRUE 1 100 0 1 BIT_MASK 0x200 FORMAT "%13.11" ECU_ADDRESS 0x3838D4 /end MEASUREMENT
/begin MEASUREMENT B_mncacc "Bedingung: min-Fehler CAN-ACC-Botschaft" UWORD B_TRUE 1 100 0 1 BIT_MASK 0x200 FORMAT "%13.11" ECU_ADDRESS 0x3838DC /end MEASUREMENT
/begin MEASUREMENT B_mncas "Fehlertyp min.: CAN-Schnittstelle, Timeout ASC" UWORD B_TRUE 1 100 0 1 BIT_MASK 0x200 FORMAT "%13.11" ECU_ADDRESS 0x3838DE /end MEASUREMENT
/begin MEASUREMENT B_mncge "Fehlertyp min.: CAN-Schnittstelle, Timeout EGS" UWORD B_TRUE 1 100 0 1 BIT_MASK 0x200 FORMAT "%13.11" ECU_ADDRESS 0x3838E0 /end MEASUREMENT
/begin MEASUREMENT B_mncins "Fehlertyp min.: CAN-Schnittstelle, Timeout Instrument" UWORD B_TRUE 1 100 0 1 BIT_MASK 0x200 FORMAT "%13.11" ECU_ADDRESS 0x3838E2 /end MEASUREMENT
/begin MEASUREMENT B_mnctxu "" UWORD B_TRUE 1 100 0 1 BIT_MASK 0x200 FORMAT "%13.11" ECU_ADDRESS 0x3838E4 /end MEASUREMENT
/begin MEASUREMENT B_mndvee "Fehlerzyp min.: DV-E Endstufe" UWORD B_TRUE 1 100 0 1 BIT_MASK 0x200 FORMAT "%13.11" ECU_ADDRESS 0x383902 /end MEASUREMENT
/begin MEASUREMENT B_mndvef "Fehlertyp min.: DV-E Fehler bei Prüfung der öffnenden Feder" UWORD B_TRUE 1 100 0 1 BIT_MASK 0x200 FORMAT "%13.11" ECU_ADDRESS 0x383904 /end MEASUREMENT
/begin MEASUREMENT B_mndvel "Fehlertyp min.: DV-E Lageabweichung" UWORD B_TRUE 1 100 0 1 BIT_MASK 0x200 FORMAT "%13.11" ECU_ADDRESS 0x383906 /end MEASUREMENT
/begin MEASUREMENT B_mndven "Fehlertyp min.: DV-E Fehler bei Prüfung Notluftposition" UWORD B_TRUE 1 100 0 1 BIT_MASK 0x200 FORMAT "%13.11" ECU_ADDRESS 0x383908 /end MEASUREMENT
/begin MEASUREMENT B_mndver "Fehlerzyp min.: DV-E Regelbereich, kurzfristig überschritten" UWORD B_TRUE 1 100 0 1 BIT_MASK 0x200 FORMAT "%13.11" ECU_ADDRESS 0x38390A /end MEASUREMENT
/begin MEASUREMENT B_mndveu "Fehlertyp min.: DV-E Fehler beim UMA-Lernen" UWORD B_TRUE 1 100 0 1 BIT_MASK 0x200 FORMAT "%13.11" ECU_ADDRESS 0x38390C /end MEASUREMENT
/begin MEASUREMENT B_mndvev "Fehlertyp min.: DV-E Fehler bei Verstärkerabgleich" UWORD B_TRUE 1 100 0 1 BIT_MASK 0x200 FORMAT "%13.11" ECU_ADDRESS 0x38390E /end MEASUREMENT
/begin MEASUREMENT B_mnswe "Beschleunigungssensorsignal kleiner als Plausibilitätsschwelle" UWORD B_TRUE 1 100 0 1 BIT_MASK 0x200 FORMAT "%13.11" ECU_ADDRESS 0x3839C0 /end MEASUREMENT
/begin MEASUREMENT B_msrext "Bedingung für externe Anforderung MSR" UWORD B_TRUE 1 100 0 1 BIT_MASK 0x8000 FORMAT "%13.11" ECU_ADDRESS 0xFD58 /end MEASUREMENT
/begin MEASUREMENT B_mxacc "Fehlertyp 'Maximalwert' erkannt (keine ACC-Reaktion auf Abschaltbedingung" UWORD B_TRUE 1 100 0 1 BIT_MASK 0x100 FORMAT "%13.11" ECU_ADDRESS 0x3838CC /end MEASUREMENT
/begin MEASUREMENT B_mxas "" UWORD B_TRUE 1 100 0 1 BIT_MASK 0x100 FORMAT "%13.11" ECU_ADDRESS 0x3838D4 /end MEASUREMENT
/begin MEASUREMENT B_mxcacc "Fehlertyp: Maximalwertueberschreitung" UWORD B_TRUE 1 100 0 1 BIT_MASK 0x100 FORMAT "%13.11" ECU_ADDRESS 0x3838DC /end MEASUREMENT
/begin MEASUREMENT B_mxcas "Fehlertyp max.: CAN-Schnittstelle, Timeout Botschaft ASC" UWORD B_TRUE 1 100 0 1 BIT_MASK 0x100 FORMAT "%13.11" ECU_ADDRESS 0x3838DE /end MEASUREMENT
/begin MEASUREMENT B_mxcge "Fehlertyp max.: CAN-Schnittstelle, Timeout EGS" UWORD B_TRUE 1 100 0 1 BIT_MASK 0x100 FORMAT "%13.11" ECU_ADDRESS 0x3838E0 /end MEASUREMENT
/begin MEASUREMENT B_mxcins "Fehlertyp max.: CAN-Schnittstelle, Timeout Instrument" UWORD B_TRUE 1 100 0 1 BIT_MASK 0x100 FORMAT "%13.11" ECU_ADDRESS 0x3838E2 /end MEASUREMENT
/begin MEASUREMENT B_mxctxu "" UWORD B_TRUE 1 100 0 1 BIT_MASK 0x100 FORMAT "%13.11" ECU_ADDRESS 0x3838E4 /end MEASUREMENT
/begin MEASUREMENT B_mxdvee "Fehlertyp max.: DV-E Endstufe" UWORD B_TRUE 1 100 0 1 BIT_MASK 0x100 FORMAT "%13.11" ECU_ADDRESS 0x383902 /end MEASUREMENT
/begin MEASUREMENT B_mxdvef "Fehlertyp max.: DV-E Fehler bei Prüfung der Rückstellfeder" UWORD B_TRUE 1 100 0 1 BIT_MASK 0x100 FORMAT "%13.11" ECU_ADDRESS 0x383904 /end MEASUREMENT
/begin MEASUREMENT B_mxdvel "Fehlerzyp max.: DV-E Lageabweichung" UWORD B_TRUE 1 100 0 1 BIT_MASK 0x100 FORMAT "%13.11" ECU_ADDRESS 0x383906 /end MEASUREMENT
/begin MEASUREMENT B_mxdven "Fehlertyp max.: DV-E Fehler bei Prüfung Notluftposition" UWORD B_TRUE 1 100 0 1 BIT_MASK 0x100 FORMAT "%13.11" ECU_ADDRESS 0x383908 /end MEASUREMENT
/begin MEASUREMENT B_mxdver "Fehlertyp max.: DV-E Regelbereich, langfristig verletzt" UWORD B_TRUE 1 100 0 1 BIT_MASK 0x100 FORMAT "%13.11" ECU_ADDRESS 0x38390A /end MEASUREMENT
/begin MEASUREMENT B_mxdveu "Fehlertyp max.: DV-E Fehler beim UMA-Lernen" UWORD B_TRUE 1 100 0 1 BIT_MASK 0x100 FORMAT "%13.11" ECU_ADDRESS 0x38390C /end MEASUREMENT
/begin MEASUREMENT B_mxdvev "Fehlertyp max.: DV-E Fehler bei Verstärkerabgleich" UWORD B_TRUE 1 100 0 1 BIT_MASK 0x100 FORMAT "%13.11" ECU_ADDRESS 0x38390E /end MEASUREMENT
/begin MEASUREMENT B_mxswe "Beschleunigungssensorsignal größer als Plausibilitätsschwelle" UWORD B_TRUE 1 100 0 1 BIT_MASK 0x100 FORMAT "%13.11" ECU_ADDRESS 0x3839C0 /end MEASUREMENT
/begin MEASUREMENT B_ngasok "Bedingung Ringspeicher für ngas-Berechnung ok" UWORD B_TRUE 1 100 0 1 BIT_MASK 0x10 FORMAT "%13.11" ECU_ADDRESS 0xFD20 /end MEASUREMENT
/begin MEASUREMENT B_nglmtr "Bedingung Grobleckenable in diesem Trip" UBYTE B_TRUE 1 100 0 1 BIT_MASK 0x10 FORMAT "%13.11" ECU_ADDRESS 0x380D44 /end MEASUREMENT
/begin MEASUREMENT B_nkfl "Obere Schwelle abgebrochener Feinleckmessungen wegen Stromschwankungen überschr." UBYTE B_TRUE 1 100 0 1 BIT_MASK 0x40 FORMAT "%13.11" ECU_ADDRESS 0x38314E /end MEASUREMENT
/begin MEASUREMENT B_nkflg "Komponentenprüfung auf Stromschwankungen gültig" UBYTE B_TRUE 1 100 0 1 BIT_MASK 0x1 FORMAT "%13.11" ECU_ADDRESS 0x380D46 /end MEASUREMENT
/begin MEASUREMENT B_nldteg "Anforderung Steuergerätenachlauf Groblecktest" UBYTE B_TRUE 1 100 0 1 BIT_MASK 0x20 FORMAT "%13.11" ECU_ADDRESS 0x380D44 /end MEASUREMENT
/begin MEASUREMENT B_nldtek "Anforderung Steuergerätenachlauf Feinstlecktest" UBYTE B_TRUE 1 100 0 1 BIT_MASK 0x40 FORMAT "%13.11" ECU_ADDRESS 0x38314A /end MEASUREMENT
/begin MEASUREMENT B_nmin "Bedingung Unterdrehzahl: n < NMIN" UWORD B_TRUE 1 100 0 1 BIT_MASK 0x2000 FORMAT "%13.11" ECU_ADDRESS 0xFD58 /end MEASUREMENT
/begin MEASUREMENT B_nmot "Bedingung Motordrehzahl: n > NMIN" UWORD B_TRUE 1 100 0 1 BIT_MASK 0x40 FORMAT "%13.11" ECU_ADDRESS 0xFD20 /end MEASUREMENT
/begin MEASUREMENT B_no "unendlich-Trigger für Fehlerpfadmanagement" UBYTE B_TRUE 1 100 0 1 BIT_MASK 0x1 FORMAT "%13.11" ECU_ADDRESS 0x382FF3 /end MEASUREMENT
/begin MEASUREMENT B_nomilkl "No MIL on bei Feinleck" UBYTE B_TRUE 1 100 0 1 BIT_MASK 0x80 FORMAT "%13.11" ECU_ADDRESS 0x38314A /end MEASUREMENT
/begin MEASUREMENT B_npacc "Fehlertyp unplaus.: ACC-Signal unplaus." UWORD B_TRUE 1 100 0 1 BIT_MASK 0x800 FORMAT "%13.11" ECU_ADDRESS 0x3838CC /end MEASUREMENT
/begin MEASUREMENT B_npas "Signal unplausibel: ASR/TC Schnittstelle" UWORD B_TRUE 1 100 0 1 BIT_MASK 0x800 FORMAT "%13.11" ECU_ADDRESS 0x3838D4 /end MEASUREMENT
/begin MEASUREMENT B_npcacc "Plausfehler CAN-ACC-Botschaft" UWORD B_TRUE 1 100 0 1 BIT_MASK 0x800 FORMAT "%13.11" ECU_ADDRESS 0x3838DC /end MEASUREMENT
/begin MEASUREMENT B_npcas "Fehlertyp: CAN-Schnittstelle, Timeout ASC" UWORD B_TRUE 1 100 0 1 BIT_MASK 0x800 FORMAT "%13.11" ECU_ADDRESS 0x3838DE /end MEASUREMENT
/begin MEASUREMENT B_npcge "Fehlerart:CAN-Schnittstelle, Timeout EGS" UWORD B_TRUE 1 100 0 1 BIT_MASK 0x800 FORMAT "%13.11" ECU_ADDRESS 0x3838E0 /end MEASUREMENT
/begin MEASUREMENT B_npcins "Fehlerart:CAN-Schnittstelle, Timeout Instrument" UWORD B_TRUE 1 100 0 1 BIT_MASK 0x800 FORMAT "%13.11" ECU_ADDRESS 0x3838E2 /end MEASUREMENT
/begin MEASUREMENT B_npctxu "" UWORD B_TRUE 1 100 0 1 BIT_MASK 0x800 FORMAT "%13.11" ECU_ADDRESS 0x3838E4 /end MEASUREMENT
/begin MEASUREMENT B_npdvee "Fehlerzyp unplaus.: DV-E Endstufe" UWORD B_TRUE 1 100 0 1 BIT_MASK 0x800 FORMAT "%13.11" ECU_ADDRESS 0x383902 /end MEASUREMENT
/begin MEASUREMENT B_npdvef "Fehlertyp unplaus.: DV-E Fehler bei Federprüfung" UWORD B_TRUE 1 100 0 1 BIT_MASK 0x800 FORMAT "%13.11" ECU_ADDRESS 0x383904 /end MEASUREMENT
/begin MEASUREMENT B_npdvel "Fehlerzyp unplaus.: DV-E Lageabweichung" UWORD B_TRUE 1 100 0 1 BIT_MASK 0x800 FORMAT "%13.11" ECU_ADDRESS 0x383906 /end MEASUREMENT
/begin MEASUREMENT B_npdven "Fehlertyp unplaus.: DV-E Fehler bei Prüfung Notluftposition" UWORD B_TRUE 1 100 0 1 BIT_MASK 0x800 FORMAT "%13.11" ECU_ADDRESS 0x383908 /end MEASUREMENT
/begin MEASUREMENT B_npdver "Fehlerzyp unplaus.: DV-E Regelbereich" UWORD B_TRUE 1 100 0 1 BIT_MASK 0x800 FORMAT "%13.11" ECU_ADDRESS 0x38390A /end MEASUREMENT
/begin MEASUREMENT B_npdveu "Fehlertyp unplaus.: DV-E Fehler beim UMA-Lernen" UWORD B_TRUE 1 100 0 1 BIT_MASK 0x800 FORMAT "%13.11" ECU_ADDRESS 0x38390C /end MEASUREMENT
/begin MEASUREMENT B_npdvev "Fehlertyp unplaus.: DV-E Fehler bei Verstärkerabgleich" UWORD B_TRUE 1 100 0 1 BIT_MASK 0x800 FORMAT "%13.11" ECU_ADDRESS 0x38390E /end MEASUREMENT
/begin MEASUREMENT B_npswe "Beschleunigungssensorsignal ist nicht plausibel" UWORD B_TRUE 1 100 0 1 BIT_MASK 0x800 FORMAT "%13.11" ECU_ADDRESS 0x3839C0 /end MEASUREMENT
/begin MEASUREMENT B_nsp "Bedingung Nachspritzer" UWORD B_TRUE 1 100 0 1 BIT_MASK 0x400 FORMAT "%13.11" ECU_ADDRESS 0xFD4C /end MEASUREMENT
/begin MEASUREMENT B_ntkw "Bedingung Anforderung niedrige Kühlmitteltemp. (Wärmetauscherschutz)" UWORD B_TRUE 1 100 0 1 BIT_MASK 0x20 FORMAT "%13.11" ECU_ADDRESS 0xFD74 /end MEASUREMENT
/begin MEASUREMENT B_oldmiistc "" UWORD B_TRUE 1 100 0 1 BIT_MASK 0x1000 FORMAT "%13.11" ECU_ADDRESS 0xFD46 /end MEASUREMENT
/begin MEASUREMENT B_pltab "Bedingung Plausibilitätsprüfung Abstellzeit möglich" UWORD B_TRUE 1 100 0 1 BIT_MASK 0x2 FORMAT "%13.11" ECU_ADDRESS 0xFD9A /end MEASUREMENT
/begin MEASUREMENT B_pmekso "Kurzschluß Ubat DM-TL Pumpenmotor (Endstufe)" UBYTE B_TRUE 1 100 0 1 BIT_MASK 0x1 FORMAT "%13.11" ECU_ADDRESS 0x383110 /end MEASUREMENT
/begin MEASUREMENT B_pn "Bedingung für Fahrstufe P oder N" UWORD B_TRUE 1 100 0 1 BIT_MASK 0x4 FORMAT "%13.11" ECU_ADDRESS 0xFD20 /end MEASUREMENT
/begin MEASUREMENT B_puerr "Bedingung Fehler  korrigiertes Umgebungsdrucksignal für Bergabfahrterkennung" UBYTE B_TRUE 1 100 0 1 BIT_MASK 0x1 FORMAT "%13.11" ECU_ADDRESS 0x380D4F /end MEASUREMENT
/begin MEASUREMENT B_refo "obere Schwelle Pumpstrom während Referenzmessung erreicht" UBYTE B_TRUE 1 100 0 1 BIT_MASK 0x8 FORMAT "%13.11" ECU_ADDRESS 0x38314C /end MEASUREMENT
/begin MEASUREMENT B_refu "untere Schwelle Pumpstrom während Referenzmessung erreicht" UBYTE B_TRUE 1 100 0 1 BIT_MASK 0x10 FORMAT "%13.11" ECU_ADDRESS 0x38314C /end MEASUREMENT
/begin MEASUREMENT B_rfmgv "Bedingung zweite Referenzmessung wegen Grobleckvermutung" UBYTE B_TRUE 1 100 0 1 BIT_MASK 0x1 FORMAT "%13.11" ECU_ADDRESS 0x38314B /end MEASUREMENT
/begin MEASUREMENT B_rlp "Bedingung Lastpraediktion aktiv" UWORD B_TRUE 1 100 0 1 BIT_MASK 0x800 FORMAT "%13.11" ECU_ADDRESS 0xFD4C /end MEASUREMENT
/begin MEASUREMENT B_rlpns "Einschaltbedingung Lastpraediktion nach Start" UWORD B_TRUE 1 100 0 1 BIT_MASK 0x1000 FORMAT "%13.11" ECU_ADDRESS 0xFD4C /end MEASUREMENT
/begin MEASUREMENT B_rsdmtg "Bedingung Feinleckdiagnose deaktiviert" UBYTE B_TRUE 1 100 0 1 BIT_MASK 0x2 FORMAT "%13.11" ECU_ADDRESS 0x38314B /end MEASUREMENT
/begin MEASUREMENT B_rsngl "Bedingung Zähler nglmhe resetieren" UBYTE B_TRUE 1 100 0 1 BIT_MASK 0x4 FORMAT "%13.11" ECU_ADDRESS 0x38314B /end MEASUREMENT
/begin MEASUREMENT B_savacc "Bedingung: Schubabschalteverbot von ACC" UWORD B_TRUE 1 100 0 1 BIT_MASK 0x20 FORMAT "%13.11" ECU_ADDRESS 0xFD70 /end MEASUREMENT
/begin MEASUREMENT B_sdmglv "Bedingung Wegstrecke Grockleckverifikation aktiv" UBYTE B_TRUE 1 100 0 1 BIT_MASK 0x8 FORMAT "%13.11" ECU_ADDRESS 0x38314B /end MEASUREMENT
/begin MEASUREMENT B_siacc "Signalfehler ACC" UWORD B_TRUE 1 100 0 1 BIT_MASK 0x400 FORMAT "%13.11" ECU_ADDRESS 0x3838CC /end MEASUREMENT
/begin MEASUREMENT B_sias "" UWORD B_TRUE 1 100 0 1 BIT_MASK 0x400 FORMAT "%13.11" ECU_ADDRESS 0x3838D4 /end MEASUREMENT
/begin MEASUREMENT B_sicacc "Signalfehler CAN-Timeout ACC-Botschaft" UWORD B_TRUE 1 100 0 1 BIT_MASK 0x400 FORMAT "%13.11" ECU_ADDRESS 0x3838DC /end MEASUREMENT
/begin MEASUREMENT B_sicas "Signalfehler CAN-Timeout ASC-Botschaften" UWORD B_TRUE 1 100 0 1 BIT_MASK 0x400 FORMAT "%13.11" ECU_ADDRESS 0x3838DE /end MEASUREMENT
/begin MEASUREMENT B_sicge "Signalfehler CAN-Timeout EGS-Botschaft" UWORD B_TRUE 1 100 0 1 BIT_MASK 0x400 FORMAT "%13.11" ECU_ADDRESS 0x3838E0 /end MEASUREMENT
/begin MEASUREMENT B_sicins "Signalfehler CAN-Timeout Botschaft Kombi-Instruments" UWORD B_TRUE 1 100 0 1 BIT_MASK 0x400 FORMAT "%13.11" ECU_ADDRESS 0x3838E2 /end MEASUREMENT
/begin MEASUREMENT B_sictxu "Signalfehler CAN-Timeout TXU-Botschaft" UWORD B_TRUE 1 100 0 1 BIT_MASK 0x400 FORMAT "%13.11" ECU_ADDRESS 0x3838E4 /end MEASUREMENT
/begin MEASUREMENT B_sidvee "Fehlertyp sig.: DV-E Endstufe" UWORD B_TRUE 1 100 0 1 BIT_MASK 0x400 FORMAT "%13.11" ECU_ADDRESS 0x383902 /end MEASUREMENT
/begin MEASUREMENT B_sidvef "Fehlertyp sig.: DV-E Fehler bei Federprüfung" UWORD B_TRUE 1 100 0 1 BIT_MASK 0x400 FORMAT "%13.11" ECU_ADDRESS 0x383904 /end MEASUREMENT
/begin MEASUREMENT B_sidvel "Fehlertyp sig.: DV-E Lageabweichung" UWORD B_TRUE 1 100 0 1 BIT_MASK 0x400 FORMAT "%13.11" ECU_ADDRESS 0x383906 /end MEASUREMENT
/begin MEASUREMENT B_sidven "Fehlertyp sig.: DV-E Fehler bei Prüfung Notluftposition" UWORD B_TRUE 1 100 0 1 BIT_MASK 0x400 FORMAT "%13.11" ECU_ADDRESS 0x383908 /end MEASUREMENT
/begin MEASUREMENT B_sidver "Fehlertyp sig.: DV-E Regelbereich" UWORD B_TRUE 1 100 0 1 BIT_MASK 0x400 FORMAT "%13.11" ECU_ADDRESS 0x38390A /end MEASUREMENT
/begin MEASUREMENT B_sidveu "Fehlertyp sig.: DV-E Fehler beim UMA-Lernen" UWORD B_TRUE 1 100 0 1 BIT_MASK 0x400 FORMAT "%13.11" ECU_ADDRESS 0x38390C /end MEASUREMENT
/begin MEASUREMENT B_sidvev "Fehlertyp sig.: DV-E Fehler bei Verstärkerabgleich" UWORD B_TRUE 1 100 0 1 BIT_MASK 0x400 FORMAT "%13.11" ECU_ADDRESS 0x38390E /end MEASUREMENT
/begin MEASUREMENT B_siswe "Fehlertyp: Geschwindigkeitssignal nicht vorhanden" UWORD B_TRUE 1 100 0 1 BIT_MASK 0x400 FORMAT "%13.11" ECU_ADDRESS 0x3839C0 /end MEASUREMENT
/begin MEASUREMENT B_sp3 "Spezial-Bereichs-Trigger der Diagnose Kraftstoffversorgungssystem" UBYTE B_TRUE 1 100 0 1 BIT_MASK 0x1 FORMAT "%13.11" ECU_ADDRESS 0x382FF4 /end MEASUREMENT
/begin MEASUREMENT B_sumv "Pumpenstrom-Schwelle bei DM-TL Ventilpruefung erreicht" UBYTE B_TRUE 1 100 0 1 BIT_MASK 0x20 FORMAT "%13.11" ECU_ADDRESS 0x38314C /end MEASUREMENT
/begin MEASUREMENT B_syn2nd "" UWORD B_TRUE 1 100 0 1 BIT_MASK 0x20 FORMAT "%13.11" ECU_ADDRESS 0xFD20 /end MEASUREMENT
/begin MEASUREMENT B_synphlost "" UWORD B_TRUE 1 100 0 1 BIT_MASK 0x10 FORMAT "%13.11" ECU_ADDRESS 0xFD48 /end MEASUREMENT
/begin MEASUREMENT B_tabunpl "Bedingung Abstellzeit unplausibel" UWORD B_TRUE 1 100 0 1 BIT_MASK 0x4 FORMAT "%13.11" ECU_ADDRESS 0xFD9A /end MEASUREMENT
/begin MEASUREMENT B_talcan "Bedingung Tank leer aus Kombi-Botschaft" UWORD B_TRUE 1 100 0 1 BIT_MASK 0x40 FORMAT "%13.11" ECU_ADDRESS 0xFD74 /end MEASUREMENT
/begin MEASUREMENT B_tankd "Ansteuerung Lampe Check-Filler-Cap" UBYTE B_TRUE 1 100 0 1 BIT_MASK 0x2 FORMAT "%13.11" ECU_ADDRESS 0x380D46 /end MEASUREMENT
/begin MEASUREMENT B_tankdo "Tankdeckel offen" UBYTE B_TRUE 1 100 0 1 BIT_MASK 0x4 FORMAT "%13.11" ECU_ADDRESS 0x38314D /end MEASUREMENT
/begin MEASUREMENT B_tanks "Bedingung Tankvorgang" UBYTE B_TRUE 1 100 0 1 BIT_MASK 0x10 FORMAT "%13.11" ECU_ADDRESS 0x38314B /end MEASUREMENT
/begin MEASUREMENT B_tevzu "Bedingung TEV ist zu" UBYTE B_TRUE 1 100 0 1 BIT_MASK 0x20 FORMAT "%13.11" ECU_ADDRESS 0x38314B /end MEASUREMENT
/begin MEASUREMENT B_tim "Zeit-Trigger für Fehlerpfadmanagement" UBYTE B_TRUE 1 100 0 1 BIT_MASK 0x1 FORMAT "%13.11" ECU_ADDRESS 0x380AD3 /end MEASUREMENT
/begin MEASUREMENT B_tired "Bedingung ti-Reduktion" UWORD B_TRUE 1 100 0 1 BIT_MASK 0x2000 FORMAT "%13.11" ECU_ADDRESS 0xFD4C /end MEASUREMENT
/begin MEASUREMENT B_tlowr "Bedingung Wählhebelposition in Low Range" UBYTE B_TRUE 1 100 0 1 BIT_MASK 0x1 FORMAT "%13.11" ECU_ADDRESS 0x380ACB /end MEASUREMENT
/begin MEASUREMENT B_tns "Bedingung aus Schalter Tag-/Nachtbeleuchtung" UWORD B_TRUE 1 100 0 1 BIT_MASK 0x80 FORMAT "%13.11" ECU_ADDRESS 0xFD74 /end MEASUREMENT
/begin MEASUREMENT B_twdmnl "Wartezeit DM-TL-Start beendet" UBYTE B_TRUE 1 100 0 1 BIT_MASK 0x40 FORMAT "%13.11" ECU_ADDRESS 0x380D44 /end MEASUREMENT
/begin MEASUREMENT B_txdmts "Bedingung DDMTL-Stop wegen Maximalzeit" UBYTE B_TRUE 1 100 0 1 BIT_MASK 0x40 FORMAT "%13.11" ECU_ADDRESS 0x38314B /end MEASUREMENT
/begin MEASUREMENT B_txucok "Bedingung: CAN-Botschaft TXU vorhanden" UBYTE B_TRUE 1 100 0 1 BIT_MASK 0x8 FORMAT "%13.11" ECU_ADDRESS 0x380ACB /end MEASUREMENT
/begin MEASUREMENT B_txuget "Bedingung Untersetzungsgetriebe mit TXU" UBYTE B_TRUE 1 100 0 1 BIT_MASK 0x1 FORMAT "%13.11" ECU_ADDRESS 0x382FE1 /end MEASUREMENT
/begin MEASUREMENT B_txunew "Bedingung CAN-TXU-Botschaft i.O. empfangen" UBYTE B_TRUE 1 100 0 1 BIT_MASK 0x10 FORMAT "%13.11" ECU_ADDRESS 0x380ACB /end MEASUREMENT
/begin MEASUREMENT B_txurcip "Bedingung Gangwechsel Vorgelege-Getriebe läuft" UBYTE B_TRUE 1 100 0 1 BIT_MASK 0x4 FORMAT "%13.11" ECU_ADDRESS 0x380ACB /end MEASUREMENT
/begin MEASUREMENT B_ubdmte "Bedingung DDMTL enabled bezueglich ub" UBYTE B_TRUE 1 100 0 1 BIT_MASK 0x20 FORMAT "%13.11" ECU_ADDRESS 0x38314E /end MEASUREMENT
/begin MEASUREMENT B_uhrrnpl "Bedingung Uhr mit relativem Minutenzähler unplausibel" UBYTE B_TRUE 1 100 0 1 BIT_MASK 0x1 FORMAT "%13.11" ECU_ADDRESS 0x383121 /end MEASUREMENT
/begin MEASUREMENT B_vdmte "" UBYTE B_TRUE 1 100 0 1 BIT_MASK 0x80 FORMAT "%13.11" ECU_ADDRESS 0x380D44 /end MEASUREMENT
/begin MEASUREMENT B_wk "Bedingung: Wandlerkupplung überbrückt" UWORD B_TRUE 1 100 0 1 BIT_MASK 0x8 FORMAT "%13.11" ECU_ADDRESS 0xFD20 /end MEASUREMENT
/begin MEASUREMENT B_wkr "Bedingung für Wandlerkupplung geregelt" UWORD B_TRUE 1 100 0 1 BIT_MASK 0x1000 FORMAT "%13.11" ECU_ADDRESS 0xFD72 /end MEASUREMENT
/begin MEASUREMENT B_zdmpme "Zyklusflag: Fehler Endstufe DM-TL Pumpenmotor" UBYTE B_TRUE 1 100 0 1 BIT_MASK 0x10 FORMAT "%13.11" ECU_ADDRESS 0x380C61 /end MEASUREMENT
/begin MEASUREMENT B_zdmtg "Zyklusflag: Tankentlüftungssystem Grobleck" UBYTE B_TRUE 1 100 0 1 BIT_MASK 0x80 FORMAT "%13.11" ECU_ADDRESS 0x38314B /end MEASUREMENT
/begin MEASUREMENT B_zdmtgv "Zyklusflag: Tankentlüftungssystem Grobleckverdacht" UBYTE B_TRUE 1 100 0 1 BIT_MASK 0x1 FORMAT "%13.11" ECU_ADDRESS 0x38314C /end MEASUREMENT
/begin MEASUREMENT B_zdmtk "Zyklusflag: Tankentlüftungssystem Kleinstleck" UBYTE B_TRUE 1 100 0 1 BIT_MASK 0x2 FORMAT "%13.11" ECU_ADDRESS 0x38314C /end MEASUREMENT
/begin MEASUREMENT B_zdpmee "Zyklusflag: Kurzschluss nach Masse DM-TL Pumpenmotor" UBYTE B_TRUE 1 100 0 1 BIT_MASK 0x8 FORMAT "%13.11" ECU_ADDRESS 0x380C61 /end MEASUREMENT
/begin MEASUREMENT B_zmekso "Zyklusflag: Kurzschluss nach ub DM-TL Pumpenmotor" UBYTE B_TRUE 1 100 0 1 BIT_MASK 0x1 FORMAT "%13.11" ECU_ADDRESS 0x380C61 /end MEASUREMENT
/begin MEASUREMENT B_zmeksoz "Zyklusflag: Kurzschluss nach ub DM-TL Pumpenmotor" UBYTE B_TRUE 1 100 0 1 BIT_MASK 0x4 FORMAT "%13.11" ECU_ADDRESS 0x380C61 /end MEASUREMENT
/begin MEASUREMENT B_zxdmpme "Zyklusflag: Kurzschluss nach ub DM-TL Pumpenmotor" UBYTE B_TRUE 1 100 0 1 BIT_MASK 0x2 FORMAT "%13.11" ECU_ADDRESS 0x380C61 /end MEASUREMENT
/begin MEASUREMENT CantxuBits "" UBYTE dez 1 100 0 255 FORMAT "%5.1" ECU_ADDRESS 0x380ACB /end MEASUREMENT
/begin MEASUREMENT CantxuNvBits "" UBYTE dez 1 100 0 255 FORMAT "%5.1" ECU_ADDRESS 0x382FE1 /end MEASUREMENT
/begin MEASUREMENT co_pot "Leerlauf-CO-Gemisch-Versteller" SBYTE dez 1 100 -128 127 FORMAT "%5.1" ECU_ADDRESS 0x380C90 /end MEASUREMENT
/begin MEASUREMENT co_pot_w "Leerlauf-CO-Gemisch-Versteller" SWORD dez 1 100 -32768 32767 FORMAT "%8.2" ECU_ADDRESS 0x38224A /end MEASUREMENT
/begin MEASUREMENT DDMPMEbits "" UBYTE dez 1 100 0 255 FORMAT "%5.1" ECU_ADDRESS 0x380C61 /end MEASUREMENT
/begin MEASUREMENT DDMPMEnovbits "" UBYTE dez 1 100 0 255 FORMAT "%5.1" ECU_ADDRESS 0x383110 /end MEASUREMENT
/begin MEASUREMENT ddmtlLokBits_1 "" UBYTE dez 1 100 0 255 FORMAT "%5.1" ECU_ADDRESS 0x380D43 /end MEASUREMENT
/begin MEASUREMENT ddmtlLokBits_2 "" UBYTE dez 1 100 0 255 FORMAT "%5.1" ECU_ADDRESS 0x380D44 /end MEASUREMENT
/begin MEASUREMENT ddmtlLokBits_3 "" UBYTE dez 1 100 0 255 FORMAT "%5.1" ECU_ADDRESS 0x380D45 /end MEASUREMENT
/begin MEASUREMENT ddmtlNovLokBits_1 "" UBYTE dez 1 100 0 255 FORMAT "%5.1" ECU_ADDRESS 0x383147 /end MEASUREMENT
/begin MEASUREMENT ddmtlNovLokBits_2 "" UBYTE dez 1 100 0 255 FORMAT "%5.1" ECU_ADDRESS 0x383148 /end MEASUREMENT
/begin MEASUREMENT ddmtlNovLokBits_3 "" UBYTE dez 1 100 0 255 FORMAT "%5.1" ECU_ADDRESS 0x383149 /end MEASUREMENT
/begin MEASUREMENT ddmtlNovLokBits_4 "" UBYTE dez 1 100 0 255 FORMAT "%5.1" ECU_ADDRESS 0x38314A /end MEASUREMENT
/begin MEASUREMENT ddmtlNovLokBits_5 "" UBYTE dez 1 100 0 255 FORMAT "%5.1" ECU_ADDRESS 0x38314B /end MEASUREMENT
/begin MEASUREMENT ddmtlNovLokBits_6 "" UBYTE dez 1 100 0 255 FORMAT "%5.1" ECU_ADDRESS 0x38314C /end MEASUREMENT
/begin MEASUREMENT ddmtlNovLokBits_7 "" UBYTE dez 1 100 0 255 FORMAT "%5.1" ECU_ADDRESS 0x38314D /end MEASUREMENT
/begin MEASUREMENT dfcmFcm "" UBYTE dez 1 100 0 255 FORMAT "%5.1" ECU_ADDRESS 0x382FF5 /end MEASUREMENT
/begin MEASUREMENT dfcmNo "" UBYTE dez 1 100 0 255 FORMAT "%5.1" ECU_ADDRESS 0x382FF6 /end MEASUREMENT
/begin MEASUREMENT dfcmSfp "" UBYTE dez 1 100 0 255 FORMAT "%5.1" ECU_ADDRESS 0x382FF7 /end MEASUREMENT
/begin MEASUREMENT dfpmEpclState "" UWORD dez 1 100 0 65535 FORMAT "%8.2" ECU_ADDRESS 0x3835A6 /end MEASUREMENT
/begin MEASUREMENT dfpmMilState "" UWORD dez 1 100 0 65535 FORMAT "%8.2" ECU_ADDRESS 0x3835A7 /end MEASUREMENT
/begin MEASUREMENT dfpnlarray "Array für Fehlerpfade die im Nachlauf gesondert behandelt werden müssen" UWORD dez 1 100 0 65535 FORMAT "%8.2" ARRAY_SIZE 3 ECU_ADDRESS 0x380FF6 /end MEASUREMENT
/begin MEASUREMENT dfp_ap "" UBYTE dez 1 100 0 255 FORMAT "%5.1" ECU_ADDRESS 0x382FF8 /end MEASUREMENT
/begin MEASUREMENT diptgl_w "Differenz-Pumpenstrom" UWORD i_q6p1035_uA 1 100 0 399.994 FORMAT "%8.4" ECU_ADDRESS 0x383EBA /end MEASUREMENT
/begin MEASUREMENT dmtlbits0 "" UBYTE dez 1 100 0 255 FORMAT "%5.1" ECU_ADDRESS 0x380D46 /end MEASUREMENT
/begin MEASUREMENT dmtlNovBits_1 "" UBYTE dez 1 100 0 255 FORMAT "%5.1" ECU_ADDRESS 0x38314E /end MEASUREMENT
/begin MEASUREMENT dnmotas_w "Differenzdrehzahl über ein Arbeitsspiel" SWORD nmot_sw_q0p25 1 100 -8192 8191.75 FORMAT "%8.3" ECU_ADDRESS 0x381030 /end MEASUREMENT
/begin MEASUREMENT dnmot_w "Differenzdrehzahl zwischen zwei folgenden Segmenten" SWORD nmot_sw_q0p25 1 100 -8192 8191.75 FORMAT "%8.3" ECU_ADDRESS 0x381032 /end MEASUREMENT
/begin MEASUREMENT dpsdvs_w "delta Saugrohrdruck aus Drosselventilen (Word)" SWORD p_sw_q0p039 1 100 -1280 1279.96 FORMAT "%8.3" ECU_ADDRESS 0x381330 /end MEASUREMENT
/begin MEASUREMENT dpsfg_w "delta-Frischgaspartialdruck im Saugrohr" SWORD p_sw_q0p039 1 100 -1280 1279.96 FORMAT "%8.3" ECU_ADDRESS 0x3811F4 /end MEASUREMENT
/begin MEASUREMENT dpsmp_w "delta extrapolierter Saugrohrdruck (Word)" SWORD p_sw_q0p039 1 100 -1280 1279.96 FORMAT "%8.3" ECU_ADDRESS 0x381332 /end MEASUREMENT
/begin MEASUREMENT drlp_w "delta-Einspritzberechnungs-Last aus Praediktion (Word)" SWORD rel_sw_q0p0234 1 100 -768 767.977 FORMAT "%8.4" ECU_ADDRESS 0xF896 /end MEASUREMENT
/begin MEASUREMENT drl_w "Füllungsänderung (Word)" SWORD rel_sw_q0p0234 1 100 -768 767.977 FORMAT "%8.4" ECU_ADDRESS 0x3811F6 /end MEASUREMENT
/begin MEASUREMENT dv_lh "Radgeschwindigkeitsdifferenz links hinten" SWORD vfzg_uw_q0p0625 1 100 -2048 2047.94 FORMAT "%8.3" ECU_ADDRESS 0x38264A /end MEASUREMENT
/begin MEASUREMENT dv_lv "Radgeschwindigkeitsdifferenz links vorne" SWORD vfzg_uw_q0p0625 1 100 -2048 2047.94 FORMAT "%8.3" ECU_ADDRESS 0x38264C /end MEASUREMENT
/begin MEASUREMENT dv_rh "Radgeschwindigkeitsdifferenz rechts hinten" SWORD vfzg_uw_q0p0625 1 100 -2048 2047.94 FORMAT "%8.3" ECU_ADDRESS 0x38264E /end MEASUREMENT
/begin MEASUREMENT dv_rv "Radgeschwindigkeitsdifferenz rechts vorne" SWORD vfzg_uw_q0p0625 1 100 -2048 2047.94 FORMAT "%8.3" ECU_ADDRESS 0x382650 /end MEASUREMENT
/begin MEASUREMENT dwfc "Drehzahlwarnfeld: aufbereiteter Wert f. CAN zur Übergabe an Kombi" UBYTE dez 1 100 0 255 FORMAT "%5.1" ECU_ADDRESS 0x380D80 /end MEASUREMENT
/begin MEASUREMENT dwfn "" UBYTE dez 1 100 0 255 FORMAT "%5.1" ECU_ADDRESS 0x380D81 /end MEASUREMENT
/begin MEASUREMENT egscod "Automatische EGS-SG Erkennung" UBYTE dez 1 100 0 255 FORMAT "%5.1" ECU_ADDRESS 0x382F34 /end MEASUREMENT
/begin MEASUREMENT ekpausc "CAN-Botschaft EKP-Abschaltung über Crash-Sensor Airbag-SG" UBYTE dez 1 100 0 3 FORMAT "%5.3" ECU_ADDRESS 0x380AC6 /end MEASUREMENT
/begin MEASUREMENT ESKONF "" UBYTE dez 1 100 0 255 FORMAT "%5.1" ARRAY_SIZE 8 ECU_ADDRESS 0x380C62 /end MEASUREMENT
/begin MEASUREMENT evtmod "Einlaßventiltemperatur modelliert (Temperaturmodell)" SWORD temp_sw_q0p75 1 100 -24576 24575.3 FORMAT "%8.2" ECU_ADDRESS 0x3821C0 /end MEASUREMENT
/begin MEASUREMENT E_acc "Errorflag: ACC" UWORD B_TRUE 1 100 0 1 BIT_MASK 0x1 FORMAT "%13.11" ECU_ADDRESS 0x3838CC /end MEASUREMENT
/begin MEASUREMENT E_as "Errorflag: ASR-Eingriff" UWORD B_TRUE 1 100 0 1 BIT_MASK 0x1 FORMAT "%13.11" ECU_ADDRESS 0x3838D4 /end MEASUREMENT
/begin MEASUREMENT E_CACC "Errorflag: CAN-Schnittstelle, Timeout ACC" UWORD B_TRUE 1 100 0 1 BIT_MASK 0x1 FORMAT "%13.11" ECU_ADDRESS 0x3838DC /end MEASUREMENT
/begin MEASUREMENT E_CAS "Errorflag: CAN-Schnittstelle, Timeout ASC" UWORD B_TRUE 1 100 0 1 BIT_MASK 0x1 FORMAT "%13.11" ECU_ADDRESS 0x3838DE /end MEASUREMENT
/begin MEASUREMENT E_CGE "Errorflag: CAN-Schnittstelle, Timeout EGS" UWORD B_TRUE 1 100 0 1 BIT_MASK 0x1 FORMAT "%13.11" ECU_ADDRESS 0x3838E0 /end MEASUREMENT
/begin MEASUREMENT E_CINS "Errorflag: CAN-Schnittstelle, Timeout Instrument" UWORD B_TRUE 1 100 0 1 BIT_MASK 0x1 FORMAT "%13.11" ECU_ADDRESS 0x3838E2 /end MEASUREMENT
/begin MEASUREMENT E_ctxu "Errorflag: CAN-Schnittstelle, Timeout TXU" UWORD B_TRUE 1 100 0 1 BIT_MASK 0x1 FORMAT "%13.11" ECU_ADDRESS 0x3838E4 /end MEASUREMENT
/begin MEASUREMENT E_dvee "Errorflag: DV-E Endstufe" UWORD B_TRUE 1 100 0 1 BIT_MASK 0x1 FORMAT "%13.11" ECU_ADDRESS 0x383902 /end MEASUREMENT
/begin MEASUREMENT E_dvef "Errorflag: DV-E Fehler bei Federprüfung" UWORD B_TRUE 1 100 0 1 BIT_MASK 0x1 FORMAT "%13.11" ECU_ADDRESS 0x383904 /end MEASUREMENT
/begin MEASUREMENT E_dvel "Errorflag: DV-E Lageabweichung" UWORD B_TRUE 1 100 0 1 BIT_MASK 0x1 FORMAT "%13.11" ECU_ADDRESS 0x383906 /end MEASUREMENT
/begin MEASUREMENT E_dven "Errorflag: DV-E Fehler bei Prüfung Notluftposition" UWORD B_TRUE 1 100 0 1 BIT_MASK 0x1 FORMAT "%13.11" ECU_ADDRESS 0x383908 /end MEASUREMENT
/begin MEASUREMENT E_dver "Errorflag: DV-E Regelbereich" UWORD B_TRUE 1 100 0 1 BIT_MASK 0x1 FORMAT "%13.11" ECU_ADDRESS 0x38390A /end MEASUREMENT
/begin MEASUREMENT E_dveu "Errorflag: DV-E Fehler beim UMA-Lernen" UWORD B_TRUE 1 100 0 1 BIT_MASK 0x1 FORMAT "%13.11" ECU_ADDRESS 0x38390C /end MEASUREMENT
/begin MEASUREMENT E_dvev "Errorflag: DV-E Fehler bei Verstärkerabgleich" UWORD B_TRUE 1 100 0 1 BIT_MASK 0x1 FORMAT "%13.11" ECU_ADDRESS 0x38390E /end MEASUREMENT
/begin MEASUREMENT E_swe "Errorflag: Beschleunigungssensor der Schlechtwegeerkennung" UWORD B_TRUE 1 100 0 1 BIT_MASK 0x1 FORMAT "%13.11" ECU_ADDRESS 0x3839C0 /end MEASUREMENT
/begin MEASUREMENT faftekf "Faktor Ausfuß Tankentlüftungsventil: Wert aus Kennfeld" UBYTE fak_ub_b2 1 100 0 1.99219 FORMAT "%5.3" ECU_ADDRESS 0x3809E7 /end MEASUREMENT
/begin MEASUREMENT fafte_w "Faktor Ausfluß Tankentlüftungsventil" UWORD fak_uw_b2 1 100 0 1.99997 FORMAT "%8.6" ECU_ADDRESS 0x3812B6 /end MEASUREMENT
/begin MEASUREMENT fcmEnd "Anzahl Einträge im Fehlerspeicher" UBYTE dez 1 100 0 255 FORMAT "%5.1" ECU_ADDRESS 0x382FF9 /end MEASUREMENT
/begin MEASUREMENT FCMTab "" UWORD dez 1 100 0 65535 FORMAT "%8.2" ECU_ADDRESS 0x3835A8 /end MEASUREMENT
/begin MEASUREMENT fiptes_w "Faktor Pumpenstrom" UWORD fak_uw_b2 1 100 0 1.99997 FORMAT "%8.6" ECU_ADDRESS 0x383EF4 /end MEASUREMENT
/begin MEASUREMENT fr2_u "Lambda-Regler-Ausgang; Bank2 (Byte)" UBYTE fak_ub_b2 1 100 0 1.99219 FORMAT "%5.3" ECU_ADDRESS 0x380BBD /end MEASUREMENT
/begin MEASUREMENT fra2_u "multiplikative Gemischkorrektur der Gemischadaption (Byte)" UBYTE fak_ub_b2 1 100 0 1.99219 FORMAT "%5.3" ECU_ADDRESS 0x380BBE /end MEASUREMENT
/begin MEASUREMENT fra_u "multiplikative Gemischkorrektur der Gemischadaption (Byte)" UBYTE fak_ub_b2 1 100 0 1.99219 FORMAT "%5.3" ECU_ADDRESS 0x380BBF /end MEASUREMENT
/begin MEASUREMENT frhol_u "Umweltwert: Faktor Luftdichte f(Ansauglufttemp., Höhe) 8-Bit" UBYTE fak_ub_b2 1 100 0 1.99219 FORMAT "%5.3" ECU_ADDRESS 0x380BC0 /end MEASUREMENT
/begin MEASUREMENT frm2_u "schneller Mittelwert des Lambdaregelfaktors Bank 2 (1 Byte für Tester)" UBYTE fak_ub_b2 1 100 0 1.99219 FORMAT "%5.3" ECU_ADDRESS 0x380BC1 /end MEASUREMENT
/begin MEASUREMENT frm_u "schneller Mittelwert des Lambdaregelfaktors ( 1 Byte für Tester )" UBYTE fak_ub_b2 1 100 0 1.99219 FORMAT "%5.3" ECU_ADDRESS 0x380BC2 /end MEASUREMENT
/begin MEASUREMENT fr_u "Lambda-Regler-Ausgang (Byte)" UBYTE fak_ub_b2 1 100 0 1.99219 FORMAT "%5.3" ECU_ADDRESS 0x380BC3 /end MEASUREMENT
/begin MEASUREMENT ftbr "Faktor Temperaturkorrektur im Brennraum" UBYTE fak_ub_b2 1 100 0 1.99219 FORMAT "%5.3" ECU_ADDRESS 0x380C74 /end MEASUREMENT
/begin MEASUREMENT ftbr_w "Faktor Temperaturkorrektur im Brennraum" UWORD fak_uw_b2 1 100 0 1.99997 FORMAT "%8.6" ECU_ADDRESS 0x38148C /end MEASUREMENT
/begin MEASUREMENT ftho_w "Faktor Korrektur Höhe und Temperatur" UWORD fak_uw_b2 1 100 0 1.99997 FORMAT "%8.6" ECU_ADDRESS 0x3812B8 /end MEASUREMENT
/begin MEASUREMENT ftsr "Korrekturfaktor Lufttemperatur im Saugrohr" UBYTE fak_ub_b2 1 100 0 1.99219 FORMAT "%5.3" ECU_ADDRESS 0xF85C /end MEASUREMENT
/begin MEASUREMENT ftu "Faktor Temperatur Umgebung" UBYTE fak_ub_b2 1 100 0 1.99219 FORMAT "%5.3" ECU_ADDRESS 0x380C75 /end MEASUREMENT
/begin MEASUREMENT ftvdk "Korrekturfaktor Temperatur vor Drosselklappe" UBYTE fak_ub_b2 1 100 0 1.99219 FORMAT "%5.3" ECU_ADDRESS 0xF85D /end MEASUREMENT
/begin MEASUREMENT ftw "Faktor Temperaturgewichtung tmot, tans" UBYTE fak_ub_b1 1 100 0 0.996094 ECU_ADDRESS 0x380C76 /end MEASUREMENT
/begin MEASUREMENT fupsrl_w "Faktor systembezogene Umrechnung Druck auf Füllung (16-Bit)" UWORD rel_uw_b0p3 1 100 0 0.299995 FORMAT "%9.7" ECU_ADDRESS 0x3811F8 /end MEASUREMENT
/begin MEASUREMENT fvisrm_w "Faktor Verstärkung Integrator Saugrohrmodell" UWORD p_uw_b32 1 100 0 31.9995 FORMAT "%8.5" ECU_ADDRESS 0x3811FA /end MEASUREMENT
/begin MEASUREMENT fwprs_w "Faktor Preadiktionswinkel bezogen auf Segment" UWORD fak_uw_b32 1 100 0 31.9995 FORMAT "%8.5" ECU_ADDRESS 0x381334 /end MEASUREMENT
/begin MEASUREMENT gangauti "bei Automatikgetriebe über CAN empfangener aktueller Gang" UBYTE dez 1 100 0 255 FORMAT "%5.1" ECU_ADDRESS 0x380AC3 /end MEASUREMENT
/begin MEASUREMENT igod_u "Integratorgradient für Nulltest-Diagnose Klopfregelung (1 Byte für Tester)" SBYTE spgg_sb_b3052 1 100 -3052.01 3028.16 FORMAT "%5.0" ECU_ADDRESS 0x380BC4 /end MEASUREMENT
/begin MEASUREMENT igokr_u "Integratorgradient für Offsetkorrektur Klopfregelung (Byte)" SBYTE spgg_sb_b3052 1 100 -3052.01 3028.16 FORMAT "%5.0" ECU_ADDRESS 0x380BC5 /end MEASUREMENT
/begin MEASUREMENT iprfmn_w "minimaler Pumpenstrom Referenzleck" UWORD i_q6p1035_uA 1 100 0 399.994 FORMAT "%8.4" ECU_ADDRESS 0x383EBC /end MEASUREMENT
/begin MEASUREMENT iprfmx_w "maximaler Pumpenstrom Referenzleck" UWORD i_q6p1035_uA 1 100 0 399.994 FORMAT "%8.4" ECU_ADDRESS 0x383EBE /end MEASUREMENT
/begin MEASUREMENT ipteskfh_w "Pumpenstrom Tankdiagnose korrigiert und hochpaßgefiltert" SWORD i_q6p1035_uA 1 100 -200 199.994 FORMAT "%8.4" ECU_ADDRESS 0x383EF6 /end MEASUREMENT
/begin MEASUREMENT ipteskfm_w "Max. Pumpenstrom Tankdiagnose korrigiert und gefiltert während Messung" UWORD i_q6p1035_uA 1 100 0 399.994 FORMAT "%8.4" ECU_ADDRESS 0x383EF8 /end MEASUREMENT
/begin MEASUREMENT ipteskf_w "Pumpenstrom Tankdiagnose korrigiert und gefiltert" UWORD i_q6p1035_uA 1 100 0 399.994 FORMAT "%8.4" ECU_ADDRESS 0x383EFA /end MEASUREMENT
/begin MEASUREMENT iptesk_w "Pumpenstrom Tankdiagnose korrigiert" UWORD i_q6p1035_uA 1 100 0 399.994 FORMAT "%8.4" ECU_ADDRESS 0x383EFC /end MEASUREMENT
/begin MEASUREMENT iptgh "Differenz Pumpstrom zwischen Referenz und min. bei Grobleckmessung" UBYTE i_q0p1953_mA 1 100 0 49.8047 FORMAT "%5.2" ECU_ADDRESS 0x383139 /end MEASUREMENT
/begin MEASUREMENT iptgh_w "Differenz Pumpstrom zwischen Referenz und min. bei Grobleckmessung" UWORD i_q6p1035_uA 1 100 0 399.994 FORMAT "%8.4" ECU_ADDRESS 0x383EC0 /end MEASUREMENT
/begin MEASUREMENT iptgl "Pumpenstrom am Ende der Grobleckmessung" UBYTE i_q0p1953_mA 1 100 0 49.8047 FORMAT "%5.2" ECU_ADDRESS 0x38313A /end MEASUREMENT
/begin MEASUREMENT iptglmn_w "min. Pumpenstrom bei Grobleckmessung" UWORD i_q6p1035_uA 1 100 0 399.994 FORMAT "%8.4" ECU_ADDRESS 0x383EC2 /end MEASUREMENT
/begin MEASUREMENT iptglv_w "Pumpenstrom am Ende der verlängerter Grobleckmessung" UWORD i_q6p1035_uA 1 100 0 399.994 FORMAT "%8.4" ECU_ADDRESS 0x383EC4 /end MEASUREMENT
/begin MEASUREMENT iptgl_w "Pumpenstrom am Ende der Grobleckmessung" UWORD i_q6p1035_uA 1 100 0 399.994 FORMAT "%8.4" ECU_ADDRESS 0x383EC6 /end MEASUREMENT
/begin MEASUREMENT iptkf_w "Pumpenstrom Tankdiagnose korrigiert und gefiltert" UWORD i_q6p1035_uA 1 100 0 399.994 FORMAT "%8.4" ECU_ADDRESS 0x383EFE /end MEASUREMENT
/begin MEASUREMENT iptkl "Pumpenstrom am Ende der Feinstleckmessung" UBYTE i_q0p1953_mA 1 100 0 49.8047 FORMAT "%5.2" ECU_ADDRESS 0x38313B /end MEASUREMENT
/begin MEASUREMENT iptkl_w "Pumpenstrom am Ende der Feinstleckmessung" UWORD i_q6p1035_uA 1 100 0 399.994 FORMAT "%8.4" ECU_ADDRESS 0x383EC8 /end MEASUREMENT
/begin MEASUREMENT iptktkf_w "Pumpenstrom Tankdiagnose gefiltert fuer Betankung" UWORD i_q6p1035_uA 1 100 0 399.994 FORMAT "%8.4" ECU_ADDRESS 0x383F00 /end MEASUREMENT
/begin MEASUREMENT iptref "Pumpenstrom Referenzleck" UBYTE i_q0p1953_mA 1 100 0 49.8047 FORMAT "%5.2" ECU_ADDRESS 0x38313C /end MEASUREMENT
/begin MEASUREMENT iptrefr_w "Pumpenstrom Referenzleck" UWORD i_q6p1035_uA 1 100 0 399.994 FORMAT "%8.4" ECU_ADDRESS 0x383ECA /end MEASUREMENT
/begin MEASUREMENT iptref_w "Pumpenstrom Referenzleck" UWORD i_q6p1035_uA 1 100 0 399.994 FORMAT "%8.4" ECU_ADDRESS 0x383ECC /end MEASUREMENT
/begin MEASUREMENT iptsglv_w "Pumpenstrom-Schwelle bei verlängerter Grobleckmessung" UWORD i_q6p1035_uA 1 100 0 399.994 FORMAT "%8.4" ECU_ADDRESS 0x383ECE /end MEASUREMENT
/begin MEASUREMENT iptsgl_w "Pumpenstrom-Schwelle bei Grobleckmessung" UWORD i_q6p1035_uA 1 100 0 399.994 FORMAT "%8.4" ECU_ADDRESS 0x383ED0 /end MEASUREMENT
/begin MEASUREMENT iptsumv_w "Pumpenstrom-Schwelle bei DM-TL Ventilpruefung" UWORD i_q6p1035_uA 1 100 0 399.994 FORMAT "%8.4" ECU_ADDRESS 0x383ED2 /end MEASUREMENT
/begin MEASUREMENT iptumv "Pumpenstrom bei DM-TL Ventilpruefung" UBYTE i_q0p1953_mA 1 100 0 49.8047 FORMAT "%5.2" ECU_ADDRESS 0x38313D /end MEASUREMENT
/begin MEASUREMENT iptumv_w "Pumpenstrom bei DM-TL Ventilpruefung" UWORD i_q6p1035_uA 1 100 0 399.994 FORMAT "%8.4" ECU_ADDRESS 0x383ED4 /end MEASUREMENT
/begin MEASUREMENT iptvglv_w "Pumpenstrom Vergleich bei  2 Kleinleckpruefung" UWORD i_q6p1035_uA 1 100 0 399.994 FORMAT "%8.4" ECU_ADDRESS 0x383ED6 /end MEASUREMENT
/begin MEASUREMENT iptvgl_w "Pumpenstrom Vergleich bei Grobleckpruefung" UWORD i_q6p1035_uA 1 100 0 399.994 FORMAT "%8.4" ECU_ADDRESS 0x383ED8 /end MEASUREMENT
/begin MEASUREMENT irspsyn "Index für Ringspeicheradressierung tsegrsp_w, nmotrsp_w, rlrsp_w" UBYTE dez 1 100 0 255 FORMAT "%5.1" ECU_ADDRESS 0x38090C /end MEASUREMENT
/begin MEASUREMENT isadmtl "State Nr. DMTL-Automat" UBYTE dez 1 100 0 255 FORMAT "%5.1" ECU_ADDRESS 0x38313E /end MEASUREMENT
/begin MEASUREMENT kmstand "Fahrstrecke des Fahrzeugs als Information über CAN" UWORD km_uw_q10 1 100 0 655350 FORMAT "%8.1" ECU_ADDRESS 0x380F6A /end MEASUREMENT
/begin MEASUREMENT lamsons2_u "Lambda-Sollwert bezogen auf Einbauort Lambda-Sensor Bank2 (1 Byte für Tester)" UBYTE fak_ub_b16 1 100 0 15.9375 FORMAT "%5.2" ECU_ADDRESS 0x380BC6 /end MEASUREMENT
/begin MEASUREMENT lamsons_u "Lambda-Sollwert bezogen auf Einbauort Lambda-Sensor (1 Byte für Tester)" UBYTE fak_ub_b16 1 100 0 15.9375 FORMAT "%5.2" ECU_ADDRESS 0x380BC7 /end MEASUREMENT
/begin MEASUREMENT lws_w "Lenkwinkel" SWORD lws_q0p04375 1 100 -1433.6 1433.56 FORMAT "%8.3" ECU_ADDRESS 0x380F9C /end MEASUREMENT
/begin MEASUREMENT m6cddmtl "Mode 6 - Speicher: Component ID für DM-TL Tankleckdiagnose" UBYTE dez 1 100 0 255 FORMAT "%5.1" ECU_ADDRESS 0x38313F /end MEASUREMENT
/begin MEASUREMENT m6sddmtl_w "Mode 6 - Speicher: Schwellwert bei DM-TL Tankleckdiagnose" UWORD i_q6p1035_uA 1 100 0 399.994 FORMAT "%8.4" ECU_ADDRESS 0x383EDA /end MEASUREMENT
/begin MEASUREMENT m6wddmtl_w "Mode 6 - Speicher: Messwert DM-TL Tankleckdiagnose" UWORD i_q6p1035_uA 1 100 0 399.994 FORMAT "%8.4" ECU_ADDRESS 0x383EDC /end MEASUREMENT
/begin MEASUREMENT mdkog "Momentenaufnahme geregelter Klimakompressor" UBYTE md_ub_q1 1 100 0 31 FORMAT "%5.2" ECU_ADDRESS 0x380AC7 /end MEASUREMENT
/begin MEASUREMENT mdwancan "Drehmomentaufnahme des Wandlers über CAN" UBYTE rel_ub_b99p6 1 100 0 99.6094 FORMAT "%5.2" ECU_ADDRESS 0x380AC4 /end MEASUREMENT
/begin MEASUREMENT miacc "Momentenanforderung vom ACC  (bezogen auf MD_NORM)" UBYTE rel_ub_b100 1 100 0 100 FORMAT "%5.1" ECU_ADDRESS 0x380ABD /end MEASUREMENT
/begin MEASUREMENT miacc_w "Momentenanforderung vom ACC, indiziertes Moment" UWORD rel_uw_b100 1 100 0 99.9985 FORMAT "%8.5" ECU_ADDRESS 0x380F6E /end MEASUREMENT
/begin MEASUREMENT miasrl "ind. ASC-Moment für Luftpfad" UBYTE rel_ub_b100 1 100 0 100 FORMAT "%5.1" ECU_ADDRESS 0x380AC0 /end MEASUREMENT
/begin MEASUREMENT miasrl_w "Indiziertes Soll-Motormoment ASR für langsamen Eingriff" UWORD rel_uw_b100 1 100 0 99.9985 FORMAT "%8.5" ECU_ADDRESS 0x381028 /end MEASUREMENT
/begin MEASUREMENT miasrs "Indiziertes Soll-Motormoment ASR für schnellen Eingriff" UBYTE rel_ub_b100 1 100 0 100 FORMAT "%5.1" ECU_ADDRESS 0x380AC1 /end MEASUREMENT
/begin MEASUREMENT miasrs_w "Indiziertes Soll-Motormoment ASR für schnellen Eingriff" UWORD rel_uw_b100 1 100 0 99.9985 FORMAT "%8.5" ECU_ADDRESS 0x38102A /end MEASUREMENT
/begin MEASUREMENT migsrc_w "Anforderung Indiziertes Sollmoment bei Getriebeeingriff (CAN-Signal)" UWORD rel_uw_b100 1 100 0 99.9985 FORMAT "%8.5" ECU_ADDRESS 0x380F64 /end MEASUREMENT
/begin MEASUREMENT miistc "indiziertes Motormoment Hochdruckphase Istwert für Ausgabe auf CAN-Bus" UBYTE rel_ub_b100 1 100 0 100 FORMAT "%5.1" ECU_ADDRESS 0x380A4E /end MEASUREMENT
/begin MEASUREMENT mimsr "Indiziertes Soll-Motormoment MSR" UBYTE rel_ub_b100 1 100 0 100 FORMAT "%5.1" ECU_ADDRESS 0x380AC2 /end MEASUREMENT
/begin MEASUREMENT mimsr_w "Indiziertes Soll-Motormoment MSR" UWORD rel_uw_b100 1 100 0 99.9985 FORMAT "%8.5" ECU_ADDRESS 0x38102C /end MEASUREMENT
/begin MEASUREMENT mitxu_w "Anforderung Indiziertes Sollmoment bei Getriebeeingriff (CAN-TXU Signal)" UWORD rel_uw_b100 1 100 0 99.9985 FORMAT "%8.5" ECU_ADDRESS 0x380F9E /end MEASUREMENT
/begin MEASUREMENT ml "Luftmassenfluß" UBYTE m_ub_b1020 1 100 0 1020 FORMAT "%5.0" ECU_ADDRESS 0xF852 /end MEASUREMENT
/begin MEASUREMENT ml_w "Luftmassenfluß gefiltert (Word)" UWORD m_uw_b6553p5 1 100 0 6553.5 FORMAT "%8.3" ECU_ADDRESS 0xF854 /end MEASUREMENT
/begin MEASUREMENT msndkpk_w "normierter praedizierter korrig. Massenstrom ueber Drosselklappe (word)" UWORD m_uw_b6553p5 1 100 0 6553.5 FORMAT "%8.3" ECU_ADDRESS 0x381336 /end MEASUREMENT
/begin MEASUREMENT msntate_kge "" UWORD rel_uw_b100 1 100 0 99.9985 FORMAT "%8.5" ECU_ADDRESS 0x3812BA /end MEASUREMENT
/begin MEASUREMENT msntetev_w "normierter, überkritischer Massenstrom durch das TEV" UWORD m_uw_b25p6 1 100 0 25.5996 FORMAT "%8.5" ECU_ADDRESS 0x3812BC /end MEASUREMENT
/begin MEASUREMENT msntevo_w "normierter, überkritischer Massenstrom durch das 100% offene TEV" UWORD m_uw_b25p6 1 100 0 25.5996 FORMAT "%8.5" ECU_ADDRESS 0x3812BE /end MEASUREMENT
/begin MEASUREMENT mste "Massenstrom Tankentlüftung ins Saugrohr" UBYTE m_ub_b25p6 1 100 0 25.5 FORMAT "%5.2" ECU_ADDRESS 0xF886 /end MEASUREMENT
/begin MEASUREMENT mstedte "Massenstrom TEV für DTEV" UBYTE m_ub_b25p6 1 100 0 25.5 FORMAT "%5.2" ECU_ADDRESS 0x3809E8 /end MEASUREMENT
/begin MEASUREMENT msteo_w "Massenstom durch das 100% offene TEV" UWORD m_uw_b25p6 1 100 0 25.5996 FORMAT "%8.5" ECU_ADDRESS 0x3812C0 /end MEASUREMENT
/begin MEASUREMENT mstetev_w "Massenstrom durch das TEV" UWORD m_uw_b25p6 1 100 0 25.5996 FORMAT "%8.5" ECU_ADDRESS 0x3812C2 /end MEASUREMENT
/begin MEASUREMENT mste_w "Massenstrom Tankentlüftung in das Saugrohr" UWORD m_uw_b25p6 1 100 0 25.5996 FORMAT "%8.5" ECU_ADDRESS 0xFA3A /end MEASUREMENT
/begin MEASUREMENT nabtrc_w "Getriebe Abtriebsdrehzahl über CAN" UWORD ngetr_q1 1 100 0 65535 FORMAT "%8.2" ECU_ADDRESS 0x380F66 /end MEASUREMENT
/begin MEASUREMENT nadmtll_w "Anzahl begonnener Leckmessungen" UWORD dez 1 100 0 65535 FORMAT "%8.2" ECU_ADDRESS 0x383EDE /end MEASUREMENT
/begin MEASUREMENT ndiprfo_w "Anzahl abgebrochener Messungen wegen Stromschwankungen" UWORD dez 1 100 0 65535 FORMAT "%8.2" ECU_ADDRESS 0x383EE0 /end MEASUREMENT
/begin MEASUREMENT ngas_w "Drehzahlgradient über ein Arbeitsspiel" SWORD nmotg_sw_q0p39 1 100 -12800.2 12799.8 FORMAT "%8.2" ECU_ADDRESS 0x381034 /end MEASUREMENT
/begin MEASUREMENT ngfil "gefilterter Drehzahlgradient" SBYTE nmotg_sb_q100 1 100 -12800 12700 FORMAT "%5.0" ECU_ADDRESS 0x38090D /end MEASUREMENT
/begin MEASUREMENT ngfil_w "gefilterter Drehzahlgradient" SWORD nmotg_sw_q0p39 1 100 -12800.2 12799.8 FORMAT "%8.2" ECU_ADDRESS 0x381036 /end MEASUREMENT
/begin MEASUREMENT nglmhe "Anzahl Grobleckenables seit letzter Grobleckmessung" UBYTE dez 1 100 0 255 FORMAT "%5.1" ECU_ADDRESS 0x383140 /end MEASUREMENT
/begin MEASUREMENT nglmtk "Anzahl Grobleckmessungen seit letzter Betankung" UBYTE dez 1 100 0 255 FORMAT "%5.1" ECU_ADDRESS 0x383141 /end MEASUREMENT
/begin MEASUREMENT ngltdca "Anzahl abgebrochener check filler cap Prüfungen" UBYTE dez 1 100 0 255 FORMAT "%5.1" ECU_ADDRESS 0x383142 /end MEASUREMENT
/begin MEASUREMENT ngltdcw "Anzahl wiederholter check filler cap Prüfungen" UBYTE dez 1 100 0 255 FORMAT "%5.1" ECU_ADDRESS 0x383143 /end MEASUREMENT
/begin MEASUREMENT nkfl "Anzahl abgebrochener Leckmessungen wegen Stromschwankungen" UBYTE dez 1 100 0 255 FORMAT "%5.1" ECU_ADDRESS 0x383144 /end MEASUREMENT
/begin MEASUREMENT nklmtk "Anzahl Kleinstleckmessungsversuche nach Betankung" UBYTE dez 1 100 0 255 FORMAT "%5.1" ECU_ADDRESS 0x383145 /end MEASUREMENT
/begin MEASUREMENT nmot "Motordrehzahl" UBYTE nmot_ub_q40 1 100 0 10200 FORMAT "%5.0" ECU_ADDRESS 0xF844 /end MEASUREMENT
/begin MEASUREMENT nmotas_w "Motordrehzahl von 2 Umdrehungen (1 Arbeitsspiel) zuvor" UWORD nmot_uw_q0p25 1 100 0 16383.8 FORMAT "%8.2" ECU_ADDRESS 0x381038 /end MEASUREMENT
/begin MEASUREMENT nmotrsp_w "Beginn Ringspeicher für Drehzahl" UWORD nmot_uw_q0p25 1 100 0 16383.8 FORMAT "%8.2" ARRAY_SIZE 10 ECU_ADDRESS 0xF81C /end MEASUREMENT
/begin MEASUREMENT nmot_w "Motordrehzahl" UWORD nmot_uw_q0p25 1 100 0 16383.8 FORMAT "%8.2" ECU_ADDRESS 0xF846 /end MEASUREMENT
/begin MEASUREMENT ntglm_w "Gesamtzahl durchgefuehrte Grobleckmessungen" UWORD dez 1 100 0 65535 FORMAT "%8.2" ECU_ADDRESS 0x383EE2 /end MEASUREMENT
/begin MEASUREMENT ntklm_w "Gesamtzahl durchgefuehrte Kleinstleckmessungen" UWORD dez 1 100 0 65535 FORMAT "%8.2" ECU_ADDRESS 0x383EE4 /end MEASUREMENT
/begin MEASUREMENT obdstegs "aus CAN-Signal OBD_STAT_GS aufbereitete Größe für ME" UBYTE dez 1 100 0 4 FORMAT "%5.3" ECU_ADDRESS 0x380AC5 /end MEASUREMENT
/begin MEASUREMENT obdsttxu "aus CAN-Signal OBD_STAT_TXU aufbereitete Größe für ME" UBYTE dez 1 100 0 255 FORMAT "%5.1" ECU_ADDRESS 0x380ACC /end MEASUREMENT
/begin MEASUREMENT pirgro_w "Rohwert Partialdruck Restgas internes AGR" UWORD p_uw_q0p039 1 100 0 2559.96 FORMAT "%8.3" ECU_ADDRESS 0x3811FC /end MEASUREMENT
/begin MEASUREMENT pirg_w "Partialdruck Restgas interne AGR (16-Bit)" UWORD p_uw_q0p039 1 100 0 2559.96 FORMAT "%8.3" ECU_ADDRESS 0x3811FE /end MEASUREMENT
/begin MEASUREMENT psfg_w "Frischgaspartialdruck im Saugrohr (word)" UWORD p_uw_q0p039 1 100 0 2559.96 FORMAT "%8.3" ECU_ADDRESS 0x381200 /end MEASUREMENT
/begin MEASUREMENT psmppvdk_w "praed. ps/Druck vor Drosselklappe (word)" UWORD fak_uw_q0p001 1 100 0 65.535 FORMAT "%8.5" ECU_ADDRESS 0x381338 /end MEASUREMENT
/begin MEASUREMENT psmp_w "extrapolierter Saugrohrdruck (Word)" UWORD p_uw_q0p039 1 100 0 2559.96 FORMAT "%8.3" ECU_ADDRESS 0x38133A /end MEASUREMENT
/begin MEASUREMENT psmx_w "Saugrohrmaximaldruckbegrenzung für modellierten Saugrohrdruck" UWORD p_uw_q0p039 1 100 0 2559.96 FORMAT "%8.3" ECU_ADDRESS 0x381202 /end MEASUREMENT
/begin MEASUREMENT psp_w "praedizierter Saugrohrdruck (Word)" UWORD p_uw_q0p039 1 100 0 2559.96 FORMAT "%8.3" ECU_ADDRESS 0x38133C /end MEASUREMENT
/begin MEASUREMENT psrlro_w "Rohwert für Faktor systembezogene Umrechnung Druck auf Füllung" UWORD rel_uw_b0p3 1 100 0 0.299995 FORMAT "%9.7" ECU_ADDRESS 0x381204 /end MEASUREMENT
/begin MEASUREMENT ps_w "Saugrohr-Absolutdruck (Word)" UWORD p_uw_q0p039 1 100 0 2559.96 FORMAT "%8.3" ECU_ADDRESS 0xF856 /end MEASUREMENT
/begin MEASUREMENT pukBits "" UBYTE dez 1 100 0 255 FORMAT "%5.1" ECU_ADDRESS 0x380D4F /end MEASUREMENT
/begin MEASUREMENT pukorf_w "Umgebungsdruckwerte nach additiver Staudruckkorrektur gefiltert" UWORD p_uw_q0p039 1 100 0 2559.96 FORMAT "%8.3" ECU_ADDRESS 0x3826FA /end MEASUREMENT
/begin MEASUREMENT pukor_w "Umgebungsdruckwerte nach additiver Staudruckkorrektur" UWORD p_uw_q0p039 1 100 0 2559.96 FORMAT "%8.3" ECU_ADDRESS 0x3826FC /end MEASUREMENT
/begin MEASUREMENT pumean_w "Umgebungsdruckmittelwert der plausiblen Umgebungsdruckwerte (Ausreiserfilter)" UWORD p_uw_q0p039 1 100 0 2559.96 FORMAT "%8.3" ECU_ADDRESS 0x3826FE /end MEASUREMENT
/begin MEASUREMENT Q_asc "Quittung ASR-Botschaft" UWORD B_TRUE 1 100 0 1 BIT_MASK 0x40 FORMAT "%13.11" ECU_ADDRESS 0xFD72 /end MEASUREMENT
/begin MEASUREMENT rfagr_w "relative Füllung AGR (word)" UWORD rel_uw_q0p0234 1 100 0 1535.98 FORMAT "%8.3" ECU_ADDRESS 0x381206 /end MEASUREMENT
/begin MEASUREMENT rfges_w "gesamte relative Füllung (inclusive AGR) 16-Bit" UWORD rel_uw_q0p0234 1 100 0 1535.98 FORMAT "%8.3" ECU_ADDRESS 0x381208 /end MEASUREMENT
/begin MEASUREMENT rinh2_u "Istwert (Byte) Innenwiderstand Ri-Nernstzelle der Lambdasonde hinter KAT Bank2" UBYTE r_ub_q64 1 100 0 16320 FORMAT "%5.0" ECU_ADDRESS 0x380BC8 /end MEASUREMENT
/begin MEASUREMENT rinh_u "Istwert (Byte) Innenwiderstand Ri-Nernstzelle der Lambdasonde hinter KAT" UBYTE r_ub_q64 1 100 0 16320 FORMAT "%5.0" ECU_ADDRESS 0x380BC9 /end MEASUREMENT
/begin MEASUREMENT rinv2_u "Istwert (Byte) Innenwiderstand Ri-Nernstzelle der Lambdasonde vor KAT Bank2" UBYTE r_ub_q64 1 100 0 16320 FORMAT "%5.0" ECU_ADDRESS 0x380BCA /end MEASUREMENT
/begin MEASUREMENT rinv_u "Istwert (Byte) Innenwiderstand Ri-Nernstzelle der Lambdasonde vor KAT" UBYTE r_ub_q64 1 100 0 16320 FORMAT "%5.0" ECU_ADDRESS 0x380BCB /end MEASUREMENT
/begin MEASUREMENT rkaco_w "Additive Korrektur der rel. Kraftstoffmasse für LL-CO einstellen" SWORD rel_sw_b1536 1 100 -1536 1535.95 FORMAT "%8.3" ECU_ADDRESS 0x3813DE /end MEASUREMENT
/begin MEASUREMENT rkrn_u "" UBYTE spg_q0p625 1 100 0 159.375 FORMAT "%5.1" ARRAY_SIZE 8 ECU_ADDRESS 0x380BCC /end MEASUREMENT
/begin MEASUREMENT rl "relative Luftfüllung" UBYTE rel_ub_q0p75 1 100 0 191.25 FORMAT "%5.1" ECU_ADDRESS 0xF853 /end MEASUREMENT
/begin MEASUREMENT rlmp_w "rel. extrapolierte Luftfuellung (Word)" UWORD rel_uw_q0p0234 1 100 0 1535.98 FORMAT "%8.3" ECU_ADDRESS 0x38133E /end MEASUREMENT
/begin MEASUREMENT rlp "rel. Luftfüllung praediziert für Einspritzberechnung" UBYTE rel_ub_q0p75 1 100 0 191.25 FORMAT "%5.1" ECU_ADDRESS 0x380A11 /end MEASUREMENT
/begin MEASUREMENT rlp_w "rel. Luftfüllung praediziert für Einspritzberechnung (Word)" UWORD rel_uw_q0p0234 1 100 0 1535.98 FORMAT "%8.3" ECU_ADDRESS 0x381340 /end MEASUREMENT
/begin MEASUREMENT rlrohmp_w "rel. Luftfüllung Saugrohrzufluss bei Saugrohrdruck psmp_w (Word)" UWORD rel_uw_q0p0234 1 100 0 1535.98 FORMAT "%8.3" ECU_ADDRESS 0x381342 /end MEASUREMENT
/begin MEASUREMENT rl_u "relative Luftfüllung (Byte) für Fehlerspeicher-Umwelten" UBYTE rel_ub_b100 1 100 0 100 FORMAT "%5.1" ECU_ADDRESS 0x380BD4 /end MEASUREMENT
/begin MEASUREMENT rl_w "relative Luftfüllung (Word)" UWORD rel_uw_q0p0234 1 100 0 1535.98 FORMAT "%8.3" ECU_ADDRESS 0xF858 /end MEASUREMENT
/begin MEASUREMENT rml "relative Luftmasse (calc. load value) nach SAE J1979" UBYTE rel_ub_b99p6 1 100 0 99.6094 FORMAT "%5.2" ECU_ADDRESS 0x380C73 /end MEASUREMENT
/begin MEASUREMENT sdmglva_w "Fahrstrecke seit Grobleckerkennung" UWORD s_q0p02777_m 1 100 0 1820.42 FORMAT "%8.3" ECU_ADDRESS 0x383EE6 /end MEASUREMENT
/begin MEASUREMENT sfpacc "Status Fehlerpfad: Adaptiv Cruise Control" UWORD dez 1 100 0 65535 FORMAT "%8.2" ECU_ADDRESS 0x3838CC /end MEASUREMENT
/begin MEASUREMENT sfpas "Status Fehlerpfad: ASR/TC Schnittstelle" UWORD default 1 100 0 65535 FORMAT "%8.2" ECU_ADDRESS 0x3838D4 /end MEASUREMENT
/begin MEASUREMENT sfpcacc "Status Fehlerpfad: Diagnose CAN-Timeout ACC-Schnittstelle" UWORD dez 1 100 0 65535 FORMAT "%8.2" ECU_ADDRESS 0x3838DC /end MEASUREMENT
/begin MEASUREMENT sfpcas "Status Fehlerpfad: Diagnose CAN-Timeout ASC-Schnittstelle" UWORD dez 1 100 0 65535 FORMAT "%8.2" ECU_ADDRESS 0x3838DE /end MEASUREMENT
/begin MEASUREMENT sfpcge "Status Fehlerpfad: Diagnose CAN-Timeout EGS-Schnittstelle" UWORD dez 1 100 0 65535 FORMAT "%8.2" ECU_ADDRESS 0x3838E0 /end MEASUREMENT
/begin MEASUREMENT sfpcins "Status Fehlerpfad: Diagnose CAN-Timeout Kombiinstr." UWORD dez 1 100 0 65535 FORMAT "%8.2" ECU_ADDRESS 0x3838E2 /end MEASUREMENT
/begin MEASUREMENT sfpctxu "Status Fehlerpfad: Diagnose CAN-Timeout TXU-Schnittstelle" UWORD dez 1 100 0 65535 FORMAT "%8.2" ECU_ADDRESS 0x3838E4 /end MEASUREMENT
/begin MEASUREMENT sfpdvee "Statuswort: DV-E Endstufe" UWORD dez 1 100 0 65535 FORMAT "%8.2" ECU_ADDRESS 0x383902 /end MEASUREMENT
/begin MEASUREMENT sfpdvef "Statuswort: DV-E Fehler bei Federprüfung" UWORD dez 1 100 0 65535 FORMAT "%8.2" ECU_ADDRESS 0x383904 /end MEASUREMENT
/begin MEASUREMENT sfpdvel "Statuswort: DV-E Lageabweichung" UWORD dez 1 100 0 65535 FORMAT "%8.2" ECU_ADDRESS 0x383906 /end MEASUREMENT
/begin MEASUREMENT sfpdven "Statuswort: DV-E Fehler bei Prüfung Notluftposition" UWORD dez 1 100 0 65535 FORMAT "%8.2" ECU_ADDRESS 0x383908 /end MEASUREMENT
/begin MEASUREMENT sfpdver "Statuswort: DV-E Regelbereich" UWORD dez 1 100 0 65535 FORMAT "%8.2" ECU_ADDRESS 0x38390A /end MEASUREMENT
/begin MEASUREMENT sfpdveu "Statuswort: DV-E Fehler beim UMA-Lernen" UWORD dez 1 100 0 65535 FORMAT "%8.2" ECU_ADDRESS 0x38390C /end MEASUREMENT
/begin MEASUREMENT sfpdvev "Statuswort: DV-E Fehler bei Verstärkerabgleich" UWORD dez 1 100 0 65535 FORMAT "%8.2" ECU_ADDRESS 0x38390E /end MEASUREMENT
/begin MEASUREMENT sfpswe "Status Fehlerpfad: Schlechtwegerkennung" UWORD dez 1 100 0 65535 FORMAT "%8.2" ECU_ADDRESS 0x3839C0 /end MEASUREMENT
/begin MEASUREMENT stat_md_e "CAN-Signal: Status Momenteneingriff" UBYTE dez 1 100 0 255 FORMAT "%5.1" ECU_ADDRESS 0x380B50 /end MEASUREMENT
/begin MEASUREMENT stmlac "Anforderungsstufe E-Lüfter von Klimaanlage" UBYTE dez 1 100 0 15 FORMAT "%5.2" ECU_ADDRESS 0x380AC8 /end MEASUREMENT
/begin MEASUREMENT tabsmn_w "Abstellzeit aus relativem Minutenzähler" UWORD t1sxs_uw_q1 1 100 0 65535 FORMAT "%8.2" ECU_ADDRESS 0x382230 /end MEASUREMENT
/begin MEASUREMENT tabsnl_w "Abstellzeit aus SG-Nachlauf" UWORD t1sxs_uw_q1 1 100 0 65535 FORMAT "%8.2" ECU_ADDRESS 0x383A1E /end MEASUREMENT
/begin MEASUREMENT tabssc_w "Abstellzeit aus relativem Sekundenzähler" UWORD t1sxs_uw_q1 1 100 0 65535 FORMAT "%8.2" ECU_ADDRESS 0x382232 /end MEASUREMENT
/begin MEASUREMENT tabstm_w "Abstellzeit aus Abkühlung des Motors" UWORD t1sxs_uw_q1 1 100 0 65535 FORMAT "%8.2" ECU_ADDRESS 0x382234 /end MEASUREMENT
/begin MEASUREMENT tabst_w "Abstellzeit" UWORD t1sxs_uw_q1 1 100 0 65535 FORMAT "%8.2" ECU_ADDRESS 0x382236 /end MEASUREMENT
/begin MEASUREMENT tacczal "Timer: Zeit in der sich der Alivezähler nicht geändert hat" UBYTE t40msxs_ub_q0p04 1 100 0 10.2 FORMAT "%5.2" ECU_ADDRESS 0x380A15 /end MEASUREMENT
/begin MEASUREMENT tateist "aktuelles Ist-Tastverhältnis Tankentlüftungsventil" UBYTE rel_ub_b99p6 1 100 0 99.6094 FORMAT "%5.2" ECU_ADDRESS 0x3809E9 /end MEASUREMENT
/begin MEASUREMENT tateist_w "aktuelles Ist-Tastverhältnis Tankentlüftungsventil (16 Bit)" UWORD rel_uw_b100 1 100 0 99.9985 FORMAT "%8.5" ECU_ADDRESS 0x380E32 /end MEASUREMENT
/begin MEASUREMENT tateslo1 "Um einen Rechenschritt verzögertes Solltastverhältnis Tankentlüftungsventil" UBYTE rel_ub_b99p6 1 100 0 99.6094 FORMAT "%5.2" ECU_ADDRESS 0x3809EA /end MEASUREMENT
/begin MEASUREMENT tateslo2 "Um zwei Rechenschritte verzögertes Solltastverhältnis Tankentlüftungsventil" UBYTE rel_ub_b99p6 1 100 0 99.6094 FORMAT "%5.2" ECU_ADDRESS 0x3809EB /end MEASUREMENT
/begin MEASUREMENT tateslo3 "Um drei Rechenschritte verzögertes Solltastverhältnis Tankentlüftungsventil" UBYTE rel_ub_b99p6 1 100 0 99.6094 FORMAT "%5.2" ECU_ADDRESS 0x3809EC /end MEASUREMENT
/begin MEASUREMENT tdcacc_ctr "Timer: Zeit in der keine neue ACC-Botschaft angekommen ist" UWORD t10msxs_uw_b655p35 1 100 0 655.35 FORMAT "%8.4" ECU_ADDRESS 0x380F78 /end MEASUREMENT
/begin MEASUREMENT tdcas_ctr1 "Timer keine neue ASC1-Botschaft angekommen" UWORD t10msxs_uw_b655p35 1 100 0 655.35 FORMAT "%8.4" ECU_ADDRESS 0x380F7E /end MEASUREMENT
/begin MEASUREMENT tdcas_ctr2 "" UWORD t10msxs_uw_b655p35 1 100 0 655.35 FORMAT "%8.4" ECU_ADDRESS 0x380F80 /end MEASUREMENT
/begin MEASUREMENT tdcas_ctr4 "" UWORD t10msxs_uw_b655p35 1 100 0 655.35 FORMAT "%8.4" ECU_ADDRESS 0x380F82 /end MEASUREMENT
/begin MEASUREMENT tdmgl_w "Messzeit Grobleck" UWORD t100msxs_uw_b6553p5 1 100 0 6553.5 FORMAT "%8.3" ECU_ADDRESS 0x383EE8 /end MEASUREMENT
/begin MEASUREMENT tdmkl_w "Messzeit Feinleck" UWORD t100msxs_uw_b6553p5 1 100 0 6553.5 FORMAT "%8.3" ECU_ADDRESS 0x383EEA /end MEASUREMENT
/begin MEASUREMENT tdmlka "aktuelle Zeit Leckmessung" UBYTE t_q1p6_s 1 100 0 408 FORMAT "%5.1" ECU_ADDRESS 0x383146 /end MEASUREMENT
/begin MEASUREMENT tdmlka_w "aktuelle Zeit Leckmessung" UWORD t100msxs_uw_b6553p5 1 100 0 6553.5 FORMAT "%8.3" ECU_ADDRESS 0x383EEC /end MEASUREMENT
/begin MEASUREMENT tdmrfa_w "aktuelle Zeit Referenzleckmessung" UWORD t100msxs_uw_b6553p5 1 100 0 6553.5 FORMAT "%8.3" ECU_ADDRESS 0x383EEE /end MEASUREMENT
/begin MEASUREMENT tdmstba_w "aktuelle Zeit Pumpenstrom stabil" UWORD t100msxs_uw_b6553p5 1 100 0 6553.5 FORMAT "%8.3" ECU_ADDRESS 0x383EF0 /end MEASUREMENT
/begin MEASUREMENT tdmstth_w "Schwelle aktuelle Zeit Pumpenstrom stabil" UWORD t100msxs_uw_b6553p5 1 100 0 6553.5 FORMAT "%8.3" ECU_ADDRESS 0x383EF2 /end MEASUREMENT
/begin MEASUREMENT tevpero1 "Periodendauer Tankentlüftungsventil um einen Rechenschritt verzögert" UBYTE t500usxms_ub_q0p5 1 100 0 127.5 FORMAT "%5.1" ECU_ADDRESS 0x3809ED /end MEASUREMENT
/begin MEASUREMENT tevpero2 "Periodendauer Tankentlüftungsventil um zwei Rechenschritte verzögert" UBYTE t500usxms_ub_q0p5 1 100 0 127.5 FORMAT "%5.1" ECU_ADDRESS 0x3809EE /end MEASUREMENT
/begin MEASUREMENT tevpero3 "Periodendauer Tankentlüftungsventil um drei Rechenschritte verzögert" UBYTE t500usxms_ub_q0p5 1 100 0 127.5 FORMAT "%5.1" ECU_ADDRESS 0x3809EF /end MEASUREMENT
/begin MEASUREMENT tevpervz "Verzögerte Periodendauer TEV" UBYTE t500usxms_ub_q0p5 1 100 0 127.5 FORMAT "%5.1" ECU_ADDRESS 0x3809F0 /end MEASUREMENT
/begin MEASUREMENT tfst "Tankfüllstand" UBYTE fuel_ub_q1 1 100 0 255 FORMAT "%5.1" ECU_ADDRESS 0x380AC9 /end MEASUREMENT
/begin MEASUREMENT tistzyl "Zylindernummer der ersten Einspritzung und Zündung" UBYTE dez 1 100 0 255 FORMAT "%5.1" ECU_ADDRESS 0x380C8F /end MEASUREMENT
/begin MEASUREMENT tmot_u "Motor-Temperatur mit def. Quantisierung für FSP-Umwelten" UBYTE temp_ub_q1_o40 1 100 -40 215 FORMAT "%5.1" ECU_ADDRESS 0x380BD5 /end MEASUREMENT
/begin MEASUREMENT tnse_u "Zeit nach Startende Byte" UBYTE t25p6sxs_ub_b6528 1 100 0 6528 FORMAT "%5.0" ECU_ADDRESS 0x380BD6 /end MEASUREMENT
/begin MEASUREMENT tpsvkmf2_u "gefilterter Periodendauerwert des Sondensignals vor Kat, Bank2 (Byte)" UBYTE t10msxs_ub_b10p2 1 100 0 10.2 FORMAT "%5.2" ECU_ADDRESS 0x380BD7 /end MEASUREMENT
/begin MEASUREMENT tpsvkmf_u "gefilterter Periodendauerwert des Sondensignals vor Kat. (Byte)" UBYTE t10msxs_ub_b10p2 1 100 0 10.2 FORMAT "%5.2" ECU_ADDRESS 0x380BD8 /end MEASUREMENT
/begin MEASUREMENT trminaus_w "Relative Zeit des Motorabstellens in Minuten" UWORD tmin_uw_q1 1 100 0 65535 FORMAT "%8.2" ECU_ADDRESS 0x383A20 /end MEASUREMENT
/begin MEASUREMENT trminein_w "Relative Zeit des Motorstarts in Minuten" UWORD tmin_uw_q1 1 100 0 65535 FORMAT "%8.2" ECU_ADDRESS 0x382238 /end MEASUREMENT
/begin MEASUREMENT trmin_w "Relative Zeit in Minuten" UWORD tmin_uw_q1 1 100 0 65535 FORMAT "%8.2" ECU_ADDRESS 0x380F68 /end MEASUREMENT
/begin MEASUREMENT tsas_w "Zeit über ein Arbeitsspiel für ngas_w" UWORD TSQL 1 100 0 52428 FORMAT "%8.2" ECU_ADDRESS 0x38103A /end MEASUREMENT
/begin MEASUREMENT tsegrsp_w "Beginn Ringspeicher für Segmentzeit" UWORD TSQL 1 100 0 52428 FORMAT "%8.2" ARRAY_SIZE 10 ECU_ADDRESS 0xF830 /end MEASUREMENT
/begin MEASUREMENT tsges_w "Saugrohrgesamttemperatur (nach AGR-Einleitung) (word)" SWORD temp_sw_q0p75 1 100 -24576 24575.3 FORMAT "%8.2" ECU_ADDRESS 0x3821C2 /end MEASUREMENT
/begin MEASUREMENT ttooth10msCtr "" UBYTE dez 1 100 0 255 FORMAT "%5.1" ECU_ADDRESS 0x380BFD /end MEASUREMENT
/begin MEASUREMENT ttoothv10ms "" UBYTE t10msxs_ub_b2p55 1 100 0 2.55 FORMAT "%5.3" ECU_ADDRESS 0x380BFE /end MEASUREMENT
/begin MEASUREMENT tumgcan "Umgebungstemperatur empfangen von CAN-Kombiinstrument" SBYTE temp_q1 1 100 -128 127 FORMAT "%5.1" ECU_ADDRESS 0x380ACA /end MEASUREMENT
/begin MEASUREMENT tumta "Umgebungstemperatur aus Ansauglufttemperatur" UBYTE temp_ub_q0p75_o48 1 100 -48 143.25 FORMAT "%5.1" ECU_ADDRESS 0x383120 /end MEASUREMENT
/begin MEASUREMENT tum_ein "Umgebungstemperatur für Abstellzeitberechnung" UBYTE temp_ub_q0p75_o48 1 100 -48 143.25 FORMAT "%5.1" ECU_ADDRESS 0x380C8E /end MEASUREMENT
/begin MEASUREMENT txucod "Automatische TXU-SG Erkennung aus TXU-Botschaft" UBYTE dez 1 100 0 255 FORMAT "%5.1" ECU_ADDRESS 0x382FE2 /end MEASUREMENT
/begin MEASUREMENT TYP_acc "" UWORD B_TRUE 1 100 0 1 BIT_MASK 0xf00 FORMAT "%13.11" ECU_ADDRESS 0x3838CC /end MEASUREMENT
/begin MEASUREMENT TYP_as "" UWORD B_TRUE 1 100 0 1 BIT_MASK 0xf00 FORMAT "%13.11" ECU_ADDRESS 0x3838D4 /end MEASUREMENT
/begin MEASUREMENT TYP_cacc "" UWORD B_TRUE 1 100 0 1 BIT_MASK 0xf00 FORMAT "%13.11" ECU_ADDRESS 0x3838DC /end MEASUREMENT
/begin MEASUREMENT TYP_cas "" UWORD B_TRUE 1 100 0 1 BIT_MASK 0xf00 FORMAT "%13.11" ECU_ADDRESS 0x3838DE /end MEASUREMENT
/begin MEASUREMENT TYP_cge "" UWORD B_TRUE 1 100 0 1 BIT_MASK 0xf00 FORMAT "%13.11" ECU_ADDRESS 0x3838E0 /end MEASUREMENT
/begin MEASUREMENT TYP_cins "" UWORD B_TRUE 1 100 0 1 BIT_MASK 0xf00 FORMAT "%13.11" ECU_ADDRESS 0x3838E2 /end MEASUREMENT
/begin MEASUREMENT TYP_ctxu "" UWORD B_TRUE 1 100 0 1 BIT_MASK 0xf00 FORMAT "%13.11" ECU_ADDRESS 0x3838E4 /end MEASUREMENT
/begin MEASUREMENT TYP_dvee "Fehlertyp: DV-E Endstufe" UWORD B_TRUE 1 100 0 1 BIT_MASK 0xf00 FORMAT "%13.11" ECU_ADDRESS 0x383902 /end MEASUREMENT
/begin MEASUREMENT TYP_dvef "Fehlertyp: DV-E Fehler bei Federprüfung" UWORD B_TRUE 1 100 0 1 BIT_MASK 0xf00 FORMAT "%13.11" ECU_ADDRESS 0x383904 /end MEASUREMENT
/begin MEASUREMENT TYP_dvel "Fehlertyp: DV-E Lageabweichung" UWORD B_TRUE 1 100 0 1 BIT_MASK 0xf00 FORMAT "%13.11" ECU_ADDRESS 0x383906 /end MEASUREMENT
/begin MEASUREMENT TYP_dven "Fehlertyp: DV-E Fehler bei Prüfung Notluftposition" UWORD B_TRUE 1 100 0 1 BIT_MASK 0xf00 FORMAT "%13.11" ECU_ADDRESS 0x383908 /end MEASUREMENT
/begin MEASUREMENT TYP_dver "Fehlertyp: DV-E Regelbereich" UWORD B_TRUE 1 100 0 1 BIT_MASK 0xf00 FORMAT "%13.11" ECU_ADDRESS 0x38390A /end MEASUREMENT
/begin MEASUREMENT TYP_dveu "Fehlertyp: DV-E Fehler beim UMA-Lernen" UWORD B_TRUE 1 100 0 1 BIT_MASK 0xf00 FORMAT "%13.11" ECU_ADDRESS 0x38390C /end MEASUREMENT
/begin MEASUREMENT TYP_dvev "Fehlertyp: DV-E Fehler bei Verstärkerabgleich" UWORD B_TRUE 1 100 0 1 BIT_MASK 0xf00 FORMAT "%13.11" ECU_ADDRESS 0x38390E /end MEASUREMENT
/begin MEASUREMENT TYP_swe "" UWORD B_TRUE 1 100 0 1 BIT_MASK 0xf00 FORMAT "%13.11" ECU_ADDRESS 0x3839C0 /end MEASUREMENT
/begin MEASUREMENT ubf "gefilterte Batteriespannung für Batteriespannungsregelung" UBYTE spg_ubatt 1 100 0 24.021 FORMAT "%5.2" ECU_ADDRESS 0x380C47 /end MEASUREMENT
/begin MEASUREMENT ubtesf_w "Batteriespannung gefiltert" UWORD spg_q0p00039 1 100 0 25.5996 FORMAT "%8.5" ECU_ADDRESS 0x383F02 /end MEASUREMENT
/begin MEASUREMENT ubtref_w "Batteriespannung bei Referenzleckmessung" UWORD spg_q0p00039 1 100 0 25.5996 FORMAT "%8.5" ECU_ADDRESS 0x383F04 /end MEASUREMENT
/begin MEASUREMENT udkp1a_u "Spannung Drosselklappen-Poti 1 am (unteren) Anschlag (Byte)" UBYTE spg_ub_b5 1 100 0 4.98047 FORMAT "%5.3" ECU_ADDRESS 0x380BD9 /end MEASUREMENT
/begin MEASUREMENT udkp1_u "Spannung Drosselklappen-Poti 1 (Byte)" UBYTE spg_ub_b5 1 100 0 4.98047 FORMAT "%5.3" ECU_ADDRESS 0x380BDA /end MEASUREMENT
/begin MEASUREMENT udkp2_u "Spannung Drosselklappen-Poti 2 (Byte)" UBYTE spg_ub_b5 1 100 0 4.98047 FORMAT "%5.3" ECU_ADDRESS 0x380BDB /end MEASUREMENT
/begin MEASUREMENT upwg1_u "Spannung PWG-Poti 1 (Byte)" UBYTE spg_ub_b5 1 100 0 4.98047 FORMAT "%5.3" ECU_ADDRESS 0x380BDC /end MEASUREMENT
/begin MEASUREMENT upwg2d_u "Verdoppelte PWG-Poti-2-Spannung (Byte)" UBYTE spg_ub_b5 1 100 0 4.98047 FORMAT "%5.3" ECU_ADDRESS 0x380BDD /end MEASUREMENT
/begin MEASUREMENT upwg2_u "Spannung PWG-Poti 2 (Byte)" UBYTE spg_ub_b5 1 100 0 4.98047 FORMAT "%5.3" ECU_ADDRESS 0x380BDE /end MEASUREMENT
/begin MEASUREMENT uushk2_u "ADC-Spannung Lambdasonde hinter Katalysator Bank2 (Byte)" UBYTE spg_ub_b5 1 100 0 4.98047 FORMAT "%5.3" ECU_ADDRESS 0x380BDF /end MEASUREMENT
/begin MEASUREMENT uushk_u "ADC-Spannung Lambdasonde hinter Katalysator (Byte)" UBYTE spg_ub_b5 1 100 0 4.98047 FORMAT "%5.3" ECU_ADDRESS 0x380BE0 /end MEASUREMENT
/begin MEASUREMENT uusvk2_u "ADC-Spannung Lambdasonde vor Katalysator 2 (Byte)" UBYTE spg_ub_b5 1 100 0 4.98047 FORMAT "%5.3" ECU_ADDRESS 0x380BE1 /end MEASUREMENT
/begin MEASUREMENT uusvk_u "ADC-Spannung Lambdasonde vor Katalysator (Byte)" UBYTE spg_ub_b5 1 100 0 4.98047 FORMAT "%5.3" ECU_ADDRESS 0x380BE2 /end MEASUREMENT
/begin MEASUREMENT vfgrrf_w "Referenz-Fahrzeuggeschwindigkeit für FGR" UWORD vfzg_uw_b512 1 100 0 511.992 FORMAT "%8.4" ECU_ADDRESS 0x3821A6 /end MEASUREMENT
/begin MEASUREMENT vfgr_w "Fahrzeug-Ist-Geschwindigkeit für FGR" UWORD vfzg_uw_b512 1 100 0 511.992 FORMAT "%8.4" ECU_ADDRESS 0x3821A8 /end MEASUREMENT
/begin MEASUREMENT vfzgv1_w "Fahrzeuggeschwindigkeit, CAN-Signal V1" UWORD vfzg_uw_b512 1 100 0 511.992 FORMAT "%8.4" ECU_ADDRESS 0x380F4C /end MEASUREMENT
/begin MEASUREMENT vfzg_u "Fahrzeuggeschwindigkeit, mit def. Quantisierung für Tester" UBYTE vfzg_q1p0 1 100 0 255 FORMAT "%5.1" ECU_ADDRESS 0x380BE3 /end MEASUREMENT
/begin MEASUREMENT vfzv1f_w "Fahrzeuggeschwindigkeit, CAN-Signal V1 gefiltert" UWORD vfzg_uw_b512 1 100 0 511.992 FORMAT "%8.4" ECU_ADDRESS 0x3821AA /end MEASUREMENT
/begin MEASUREMENT vrad_lh "Radgeschwindigkeit links hinten" UWORD vfzg_uw_q0p0625 1 100 0 4095.94 FORMAT "%8.3" ECU_ADDRESS 0x380F4E /end MEASUREMENT
/begin MEASUREMENT vrad_lv "Radgeschwindigkeit links vorne" UWORD vfzg_uw_q0p0625 1 100 0 4095.94 FORMAT "%8.3" ECU_ADDRESS 0x380F50 /end MEASUREMENT
/begin MEASUREMENT vrad_rh "Radgeschwindigkeit rechts hinten" UWORD vfzg_uw_q0p0625 1 100 0 4095.94 FORMAT "%8.3" ECU_ADDRESS 0x380F52 /end MEASUREMENT
/begin MEASUREMENT vrad_rv "Radgeschwindigkeit rechts vorne" UWORD vfzg_uw_q0p0625 1 100 0 4095.94 FORMAT "%8.3" ECU_ADDRESS 0x380F54 /end MEASUREMENT
/begin MEASUREMENT vregdia_w "Volumenstrom Tankentlüftungsventil: Wert für Diagnose Tankdichtheit" UWORD vs_uw_b25p6 1 100 0 25.5996 FORMAT "%8.5" ECU_ADDRESS 0x3812C4 /end MEASUREMENT
/begin MEASUREMENT vwkw "KW-Winkelgeschwindigkeit" UBYTE rel_ub_q0p1875 1 100 0 47.8125 FORMAT "%5.2" ECU_ADDRESS 0x380A12 /end MEASUREMENT
/begin MEASUREMENT wdkbapb_w "fuer Einspritzung praediz. begr. Drosselklappenwinkel (Word)" UWORD rel_uw_b100 1 100 0 99.9985 FORMAT "%8.5" ECU_ADDRESS 0x381344 /end MEASUREMENT
/begin MEASUREMENT wdkbap_w "fuer Einspritzung praedizierter Drosselklappenwinkel (Word)" UWORD rel_uw_b100 1 100 0 99.9985 FORMAT "%8.5" ECU_ADDRESS 0x381348 /end MEASUREMENT
/begin MEASUREMENT wdknlpr_u "" UBYTE relDK_ub_b100 1 100 0 100 FORMAT "%5.1" ECU_ADDRESS 0x380BE4 /end MEASUREMENT
/begin MEASUREMENT wdknlp_u "" UBYTE relDK_ub_b100 1 100 0 100 FORMAT "%5.1" ECU_ADDRESS 0x380BE5 /end MEASUREMENT
/begin MEASUREMENT wnwi1_u "" SBYTE wkw_sb_b128 1 100 -128 127 FORMAT "%5.1" ECU_ADDRESS 0x380BE6 /end MEASUREMENT
/begin MEASUREMENT wnwi2_u "Istwinkel für Nockenwelle 2 (Byte)" SBYTE wkw_sb_b128 1 100 -128 127 FORMAT "%5.1" ECU_ADDRESS 0x380BE7 /end MEASUREMENT
/begin MEASUREMENT wpr "Einspritzberechnungs-Praediktions-Winkel" UBYTE zw_ub_q6 1 100 0 1530 FORMAT "%5.0" ECU_ADDRESS 0x380A13 /end MEASUREMENT
/begin MEASUREMENT wprnsp "Einspritzberechnungs-Praediktions-Winkel bei Nachspritzer" UBYTE zw_ub_q6 1 100 0 1530 FORMAT "%5.0" ECU_ADDRESS 0x380A14 /end MEASUREMENT
/begin MEASUREMENT xqtm_w "Temperaturquotient" UWORD fak_uw_b16 1 100 0 15.9998 FORMAT "%8.5" ECU_ADDRESS 0x38223A /end MEASUREMENT
/begin MEASUREMENT xtcan "" UBYTE t10msxs_ub_b2p55 1 100 0 2.55 FORMAT "%5.3" ECU_ADDRESS 0x380A4F /end MEASUREMENT
/begin MEASUREMENT zaccalive "Botschaftszähler für ACC über CAN" UBYTE dez 1 100 0 255 FORMAT "%5.1" ECU_ADDRESS 0x380ABE /end MEASUREMENT
/begin MEASUREMENT Z_acc "Zyklusflag: ACC" UWORD B_TRUE 1 100 0 1 BIT_MASK 0x2 FORMAT "%13.11" ECU_ADDRESS 0x3838CC /end MEASUREMENT
/begin MEASUREMENT Z_as "Zyklusflag: ASR-Eingriff" UWORD B_TRUE 1 100 0 1 BIT_MASK 0x2 FORMAT "%13.11" ECU_ADDRESS 0x3838D4 /end MEASUREMENT
/begin MEASUREMENT Z_CACC "Zyklusflag: CAN-Schnittstelle, Timeout ACC" UWORD B_TRUE 1 100 0 1 BIT_MASK 0x2 FORMAT "%13.11" ECU_ADDRESS 0x3838DC /end MEASUREMENT
/begin MEASUREMENT Z_CAS "Zyklusflag: CAN-Schnittstelle, Timeout ASC" UWORD B_TRUE 1 100 0 1 BIT_MASK 0x2 FORMAT "%13.11" ECU_ADDRESS 0x3838DE /end MEASUREMENT
/begin MEASUREMENT Z_CGE "Zyklusflag: CAN-Schnittstelle, Timeout EGS" UWORD B_TRUE 1 100 0 1 BIT_MASK 0x2 FORMAT "%13.11" ECU_ADDRESS 0x3838E0 /end MEASUREMENT
/begin MEASUREMENT Z_CINS "Zyklusflag: CAN-Schnittstelle, Timeout Instrument" UWORD B_TRUE 1 100 0 1 BIT_MASK 0x2 FORMAT "%13.11" ECU_ADDRESS 0x3838E2 /end MEASUREMENT
/begin MEASUREMENT Z_ctxu "Zyklusflag: CAN-Schnittstelle, Timeout TXU" UWORD B_TRUE 1 100 0 1 BIT_MASK 0x2 FORMAT "%13.11" ECU_ADDRESS 0x3838E4 /end MEASUREMENT
/begin MEASUREMENT Z_dvee "Zyklusflag: DV-E Endstufe" UWORD B_TRUE 1 100 0 1 BIT_MASK 0x2 FORMAT "%13.11" ECU_ADDRESS 0x383902 /end MEASUREMENT
/begin MEASUREMENT Z_dvef "Zyklusflag: DV-E Fehler bei Federprüfung" UWORD B_TRUE 1 100 0 1 BIT_MASK 0x2 FORMAT "%13.11" ECU_ADDRESS 0x383904 /end MEASUREMENT
/begin MEASUREMENT Z_dvel "Zyklusflag: DV-E Lageabweichung" UWORD B_TRUE 1 100 0 1 BIT_MASK 0x2 FORMAT "%13.11" ECU_ADDRESS 0x383906 /end MEASUREMENT
/begin MEASUREMENT Z_dven "Zyklusflag: DV-E Fehler bei Prüfung Notluftposition" UWORD B_TRUE 1 100 0 1 BIT_MASK 0x2 FORMAT "%13.11" ECU_ADDRESS 0x383908 /end MEASUREMENT
/begin MEASUREMENT Z_dver "Zyklusflag: DV-E Regelbereich" UWORD B_TRUE 1 100 0 1 BIT_MASK 0x2 FORMAT "%13.11" ECU_ADDRESS 0x38390A /end MEASUREMENT
/begin MEASUREMENT Z_dveu "Zyklusflag: DV-E Fehler beim UMA-Lernen" UWORD B_TRUE 1 100 0 1 BIT_MASK 0x2 FORMAT "%13.11" ECU_ADDRESS 0x38390C /end MEASUREMENT
/begin MEASUREMENT Z_dvev "Zyklusflag: DV-E Fehler bei Verstärkerabgleich" UWORD B_TRUE 1 100 0 1 BIT_MASK 0x2 FORMAT "%13.11" ECU_ADDRESS 0x38390E /end MEASUREMENT
/begin MEASUREMENT Z_swe "Zyklusflag: Beschleunigungssensor der Schlechtwegeerkennung" UWORD B_TRUE 1 100 0 1 BIT_MASK 0x2 FORMAT "%13.11" ECU_ADDRESS 0x3839C0 /end MEASUREMENT
/begin FUNCTION BGNG "Berechnete Größe Drehzahlgradient" /begin DEF_CHARACTERISTIC ZNGFIL /end DEF_CHARACTERISTIC /begin REF_CHARACTERISTIC _INGASOS _ZYLZA /end REF_CHARACTERISTIC /begin IN_MEASUREMENT nmot_w tseghi tseg_w /end IN_MEASUREMENT
 /begin OUT_MEASUREMENT B_ngasok B_syn2nd dnmotas_w dnmot_w irspsyn ngas_w ngfil ngfil_w nmotas_w nmotrsp_w tsas_w tsegrsp_w /end OUT_MEASUREMENT
 /begin LOC_MEASUREMENT /end LOC_MEASUREMENT
 /begin SUB_FUNCTION /end SUB_FUNCTION
/end FUNCTION
/begin FUNCTION BGNLDSC "Anforderung Steuergeräte-Nachlaufzeit für DSC-System" /begin DEF_CHARACTERISTIC TNLDSCMX VDSCMN /end DEF_CHARACTERISTIC /begin REF_CHARACTERISTIC /end REF_CHARACTERISTIC /begin IN_MEASUREMENT B_nldsc B_pn vfzg_w /end IN_MEASUREMENT /begin OUT_MEASUREMENT /end OUT_MEASUREMENT /begin LOC_MEASUREMENT /end LOC_MEASUREMENT /begin SUB_FUNCTION /end SUB_FUNCTION /end FUNCTION
/begin FUNCTION BGNMOT "Berechnete Größe Drehzahl" /begin DEF_CHARACTERISTIC NMIN /end DEF_CHARACTERISTIC /begin REF_CHARACTERISTIC /end REF_CHARACTERISTIC /begin IN_MEASUREMENT tseghi tseg_w /end IN_MEASUREMENT /begin OUT_MEASUREMENT B_nmin B_nmot nmot nmot_w ttooth10msCtr ttoothv10ms /end OUT_MEASUREMENT /begin LOC_MEASUREMENT /end LOC_MEASUREMENT /begin SUB_FUNCTION /end SUB_FUNCTION /end FUNCTION
/begin FUNCTION BGPUK "1.10      Berechnungsgröße Umgebungsdruck korrigiert (Bergabfahrterkennung)" /begin DEF_CHARACTERISTIC DIFFMAX PUKORRV PUSMAX PUSMIN TPUKOR /end DEF_CHARACTERISTIC /begin REF_CHARACTERISTIC /end REF_CHARACTERISTIC /begin IN_MEASUREMENT pus_w vfzg_w /end IN_MEASUREMENT /begin OUT_MEASUREMENT B_add B_puerr pukBits pukorf_w pukor_w /end OUT_MEASUREMENT /begin LOC_MEASUREMENT pumean_w /end LOC_MEASUREMENT /begin SUB_FUNCTION /end SUB_FUNCTION /end FUNCTION
/begin FUNCTION BGRBS "Berechnete Größe Radbeschleunigung aus Raddrehzahl" /begin DEF_CHARACTERISTIC TMVDBS VASRM VBSMX /end DEF_CHARACTERISTIC /begin REF_CHARACTERISTIC /end REF_CHARACTERISTIC /begin IN_MEASUREMENT B_asc2cok B_cdswe vfzg vrad_lh vrad_lv vrad_rh vrad_rv /end IN_MEASUREMENT /begin OUT_MEASUREMENT bsc dv_lh dv_lv dv_rh dv_rv /end OUT_MEASUREMENT /begin LOC_MEASUREMENT /end LOC_MEASUREMENT /begin SUB_FUNCTION /end SUB_FUNCTION /end FUNCTION
/begin FUNCTION BGRLP "Berechnungsgröße rlp prädizierte Luftfüllung" /begin DEF_CHARACTERISTIC CBGRLP DRLDYNU DTEPRU TNSURLP /end DEF_CHARACTERISTIC /begin REF_CHARACTERISTIC KFMSNWDK KLAF PSPVDKUGN _720_DIV_BY_ZYLZA /end REF_CHARACTERISTIC
 /begin IN_MEASUREMENT B_ll B_nswo2 B_st B_stend dpsfg_w drl_w frhodk_w fupsrl_w fvisrm_w klaf_kge msndko_w msnwdk_kge mste nmot nmot_w pirg_w psmx_w ps_w pvdk_w rfagr_w rfges_w rldvs_w rl_w te_w tvu_w umsrln_w wdkbap_w wdkugd_w wea wee /end IN_MEASUREMENT
 /begin OUT_MEASUREMENT B_nsp B_tired drlp_w rlp rlp_w /end OUT_MEASUREMENT
 /begin LOC_MEASUREMENT B_rlp B_rlpns dpsdvs_w dpsmp_w fwprs_w msndkpk_w psmppvdk_w psmp_w psp_w rlmp_w rlrohmp_w vwkw wdkbapb_w wpr wprnsp /end LOC_MEASUREMENT
 /begin SUB_FUNCTION /end SUB_FUNCTION
/end FUNCTION
/begin FUNCTION BGRML "Berechnungsgröße relative Luftmasse nach SAE J1979 Mode $01 + $02 PID $04" /begin DEF_CHARACTERISTIC MLMAX /end DEF_CHARACTERISTIC /begin REF_CHARACTERISTIC /end REF_CHARACTERISTIC /begin IN_MEASUREMENT fpvdk_w ml_w /end IN_MEASUREMENT /begin OUT_MEASUREMENT rml /end OUT_MEASUREMENT /begin LOC_MEASUREMENT /end LOC_MEASUREMENT /begin SUB_FUNCTION /end SUB_FUNCTION /end FUNCTION
/begin FUNCTION BGSRM "Füllungserfassung Saugrohrmodell"
 /begin DEF_CHARACTERISTIC FPVMXN FPVMXN2 KFPRG KFPRG2SU KFPRG3SU KFPRGSU KFURL KFURL2SU KFURL3SU KFURLSU KISRM KISRM2SU KISRM3SU KISRMSU ZVTPRGSU /end DEF_CHARACTERISTIC
 /begin REF_CHARACTERISTIC SNM16FEUW SWN10FEUB /end REF_CHARACTERISTIC
 /begin IN_MEASUREMENT B_hfm esst_snm16feuw esst_swn10feub fho_w ftbr_w ftsr nmot_w psagr_w pu_w pvdkds_w rlroh_w sumode umsrln_w wnwue /end IN_MEASUREMENT
 /begin OUT_MEASUREMENT agrr agrr_w dpsfg_w drl_w fupsrl_w fvisrm_w ml ml_w pirg_w psfg_w psmx_w ps_w rfagr_w rfges_w rl rl_w /end OUT_MEASUREMENT
 /begin LOC_MEASUREMENT pirgro_w psrlro_w /end LOC_MEASUREMENT
 /begin SUB_FUNCTION /end SUB_FUNCTION
/end FUNCTION
/begin FUNCTION BGTABST "Berechnete Größe Abstellzeit"
 /begin DEF_CHARACTERISTIC DTABUNPL DTUMTA IMTUMTA LNXQTM NTUMTA TNLSGM TPLUHRR TUMTAI VTUMTA ZKTABTU /end DEF_CHARACTERISTIC
 /begin REF_CHARACTERISTIC /end REF_CHARACTERISTIC
 /begin IN_MEASUREMENT B_abstnl B_etum B_ins2cok B_ins3cok B_nlwst B_nmin B_pwf B_stend B_tfu B_uhrrmin B_uhrrsec B_vbemg imlatm nmot swOffDlBits tans tmotab tmst tnst_w trmin_w tumg vfzg /end IN_MEASUREMENT
 /begin OUT_MEASUREMENT tabst_w /end OUT_MEASUREMENT
 /begin LOC_MEASUREMENT BgtabstNvBits B_pltab B_tabunpl B_uhrrnpl tabsmn_w tabsnl_w tabssc_w tabstm_w trminaus_w trminein_w tumta tum_ein xqtm_w /end LOC_MEASUREMENT
 /begin SUB_FUNCTION /end SUB_FUNCTION
/end FUNCTION
/begin FUNCTION BGTEMPK "3.30      Füllungserfassung Berechnung Temperaturkompensation" /begin DEF_CHARACTERISTIC FDVANS KFFWTBR ZBRT ZTDAGR ZTMMBR /end DEF_CHARACTERISTIC /begin REF_CHARACTERISTIC /end REF_CHARACTERISTIC /begin IN_MEASUREMENT agrr_w B_nmot nmot rl tags_w tans tmot /end IN_MEASUREMENT /begin OUT_MEASUREMENT ftbr ftbr_w ftsr ftu ftvdk ftw /end OUT_MEASUREMENT /begin LOC_MEASUREMENT evtmod tsges_w /end LOC_MEASUREMENT /begin SUB_FUNCTION /end SUB_FUNCTION /end FUNCTION
/begin FUNCTION BGTEV "Berechnungsgröße Massenstrom TEV" /begin DEF_CHARACTERISTIC FUMRMV FUMSTEK KFAFTE KLAFTE MSNTATE NOVZTE /end DEF_CHARACTERISTIC /begin REF_CHARACTERISTIC /end REF_CHARACTERISTIC /begin IN_MEASUREMENT B_dteaa fho_w ftvdk nmot pspvdk_w tatesoll tevper wdkba /end IN_MEASUREMENT /begin OUT_MEASUREMENT msntevo_w mste mstedte msteo_w mste_w tateist_w vregdia_w /end OUT_MEASUREMENT
 /begin LOC_MEASUREMENT faftekf fafte_w ftho_w msntate_kge msntetev_w mstetev_w tateist tateslo1 tateslo2 tateslo3 tevpero1 tevpero2 tevpero3 tevpervz /end LOC_MEASUREMENT
 /begin SUB_FUNCTION /end SUB_FUNCTION
/end FUNCTION
/begin FUNCTION BGUBF "Berechnete Größe ub gefiltert" /begin DEF_CHARACTERISTIC ZKFUB /end DEF_CHARACTERISTIC /begin REF_CHARACTERISTIC /end REF_CHARACTERISTIC /begin IN_MEASUREMENT ub /end IN_MEASUREMENT /begin OUT_MEASUREMENT ubf /end OUT_MEASUREMENT /begin LOC_MEASUREMENT /end LOC_MEASUREMENT /begin SUB_FUNCTION /end SUB_FUNCTION /end FUNCTION
/begin FUNCTION BGVFGR "Berechnete Geschwindigkeit für Fahrgeschwindigkeitsregler" /begin DEF_CHARACTERISTIC ZFMVRV /end DEF_CHARACTERISTIC /begin REF_CHARACTERISTIC /end REF_CHARACTERISTIC /begin IN_MEASUREMENT B_asc1cok B_evfzgv1 vfzgv1_w vfzg_w /end IN_MEASUREMENT /begin OUT_MEASUREMENT bfzglfgr B_fgrabz vfgrrf_w vfgr_w /end OUT_MEASUREMENT /begin LOC_MEASUREMENT vfzv1f_w /end LOC_MEASUREMENT /begin SUB_FUNCTION /end SUB_FUNCTION /end FUNCTION
/begin FUNCTION BGWD "Berechnete Größe: Drehzahlwarnfeld" /begin DEF_CHARACTERISTIC DWF0SEG DWF1SEG DWF2SEG DWF3SEG TDWF /end DEF_CHARACTERISTIC /begin REF_CHARACTERISTIC /end REF_CHARACTERISTIC /begin IN_MEASUREMENT B_dknolu B_dkpu m_tol /end IN_MEASUREMENT /begin OUT_MEASUREMENT dwfc /end OUT_MEASUREMENT /begin LOC_MEASUREMENT dwfn /end LOC_MEASUREMENT /begin SUB_FUNCTION /end SUB_FUNCTION /end FUNCTION
/begin FUNCTION BGWDKM "Berechnung Dk-Winkel Modell" /begin DEF_CHARACTERISTIC ZWDKM1 ZWDKM2 /end DEF_CHARACTERISTIC /begin REF_CHARACTERISTIC /end REF_CHARACTERISTIC /begin IN_MEASUREMENT wdksp_w /end IN_MEASUREMENT /begin OUT_MEASUREMENT wdkbap_w /end OUT_MEASUREMENT /begin LOC_MEASUREMENT /end LOC_MEASUREMENT /begin SUB_FUNCTION /end SUB_FUNCTION /end FUNCTION
/begin FUNCTION BGZZYL "" /begin DEF_CHARACTERISTIC /end DEF_CHARACTERISTIC /begin REF_CHARACTERISTIC /end REF_CHARACTERISTIC /begin IN_MEASUREMENT B_phas2 B_phase B_phsok B_phsok2 B_stend losphctr zzyl /end IN_MEASUREMENT /begin OUT_MEASUREMENT B_delayterm B_synphlost /end OUT_MEASUREMENT /begin LOC_MEASUREMENT /end LOC_MEASUREMENT /begin SUB_FUNCTION /end SUB_FUNCTION /end FUNCTION
/begin FUNCTION CANACC "CAN-Botschafts- und Signaldefinition ACC" /begin DEF_CHARACTERISTIC /end DEF_CHARACTERISTIC /begin REF_CHARACTERISTIC /end REF_CHARACTERISTIC /begin IN_MEASUREMENT B_clbacc B_eepdif B_pwf /end IN_MEASUREMENT
 /begin OUT_MEASUREMENT acc_stat bremsacc B_acc B_acccok B_accdef B_accnew B_bremsacc B_mdacc B_savacc miacc zaccalive /end OUT_MEASUREMENT
 /begin LOC_MEASUREMENT acccod /end LOC_MEASUREMENT
 /begin SUB_FUNCTION /end SUB_FUNCTION
/end FUNCTION
/begin FUNCTION CANASR "CAN-Botschafts- und Signaldefinition Antriebsschlupfregelung" /begin DEF_CHARACTERISTIC DMAUFASC /end DEF_CHARACTERISTIC /begin REF_CHARACTERISTIC TDCAS /end REF_CHARACTERISTIC /begin IN_MEASUREMENT B_msr B_pwf tdcas_ctr1 /end IN_MEASUREMENT
 /begin OUT_MEASUREMENT asc_alive B_4x4pkw B_asc1cok B_asc1new B_asc2cok B_asc2new B_asc3cok B_asc3new B_asc4cok B_asc4new B_ascpkw B_asc_reg B_asrext B_asrextmem B_dsc_reg B_evfzgv1 B_hdc B_hdca B_msrext miasrl miasrl_w miasrs miasrs_w mimsr Q_asc vfzgv1_w vrad_lh vrad_lv vrad_rh vrad_rv /end OUT_MEASUREMENT
 /begin LOC_MEASUREMENT asc4cod asccod /end LOC_MEASUREMENT
 /begin SUB_FUNCTION /end SUB_FUNCTION
/end FUNCTION
/begin FUNCTION CANDME "DME CAN-Botschafts- und Signaldefinitionen" /begin DEF_CHARACTERISTIC CAN_SU_TIME MDNORM TVFGRAT TVFGRSE /end DEF_CHARACTERISTIC /begin REF_CHARACTERISTIC CWDASC /end REF_CHARACTERISTIC
 /begin IN_MEASUREMENT B_accdme B_ascdme B_brems B_falls B_fgrat B_fgrhe B_fgrtbe B_fgrtve B_fgrtwa B_i_ska_fr B_i_ska_um B_kd B_kl15 B_kuppl B_nivns B_sa etazaist fgr_stat mdindlm mdverl_w miist_w mivbeg_w nmot_w obdsteuer pu_w synchroCtr tmot wped wped_w wpfgr_w zwout zwspae /end IN_MEASUREMENT
 /begin OUT_MEASUREMENT B_mdasc B_oldmiistc miistc stat_md_e /end OUT_MEASUREMENT
 /begin LOC_MEASUREMENT xtcan /end LOC_MEASUREMENT
 /begin SUB_FUNCTION /end SUB_FUNCTION
/end FUNCTION
/begin FUNCTION CANEGS "CAN-Botschafts- und Signaldefinition Getriebesteuerung" /begin DEF_CHARACTERISTIC /end DEF_CHARACTERISTIC /begin REF_CHARACTERISTIC /end REF_CHARACTERISTIC /begin IN_MEASUREMENT B_pwf /end IN_MEASUREMENT
 /begin OUT_MEASUREMENT B_autget B_egscok B_egsnew B_fs B_got B_gts B_pn B_wk B_wkr mdwancan migsrc_w nabtrc_w obdstegs /end OUT_MEASUREMENT
 /begin LOC_MEASUREMENT egscod gangauti /end LOC_MEASUREMENT
 /begin SUB_FUNCTION /end SUB_FUNCTION
/end FUNCTION
/begin FUNCTION CANINS "CAN-Botschafts- und Signaldefinition Kombiinstrument" /begin DEF_CHARACTERISTIC STM_ERR TVMFLA /end DEF_CHARACTERISTIC /begin REF_CHARACTERISTIC /end REF_CHARACTERISTIC
 /begin IN_MEASUREMENT B_epcl B_mil B_nocins B_tankd B_uetmc dwfc kvaverbr L_fgr m_tolc xtcan /end IN_MEASUREMENT
 /begin OUT_MEASUREMENT B_ac B_fstcanok B_ins2cok B_ins2new B_ins3cok B_ins3new B_ko B_koger B_ntkw B_talcan B_tns ekpausc kmstand mdkog stmlac tfst trmin_w tumgcan /end OUT_MEASUREMENT
 /begin LOC_MEASUREMENT /end LOC_MEASUREMENT
 /begin SUB_FUNCTION /end SUB_FUNCTION
/end FUNCTION
/begin FUNCTION CANLWS "CAN-Botschaft- und Signaldefinition Lenkradwinkelsensor" /begin DEF_CHARACTERISTIC /end DEF_CHARACTERISTIC /begin REF_CHARACTERISTIC /end REF_CHARACTERISTIC /begin IN_MEASUREMENT /end IN_MEASUREMENT /begin OUT_MEASUREMENT B_lwscok B_lwsnew lws_w /end OUT_MEASUREMENT /begin LOC_MEASUREMENT /end LOC_MEASUREMENT /begin SUB_FUNCTION /end SUB_FUNCTION /end FUNCTION
/begin FUNCTION CANTXU "CAN-Botschafts- und Signaldefinition Transfer Box Control ECU (TXU)" /begin DEF_CHARACTERISTIC /end DEF_CHARACTERISTIC /begin REF_CHARACTERISTIC /end REF_CHARACTERISTIC /begin IN_MEASUREMENT B_pwf /end IN_MEASUREMENT
 /begin OUT_MEASUREMENT B_esttxu B_lowr B_tlowr B_txucok B_txuget B_txunew B_txurcip CantxuBits CantxuNvBits mitxu_w /end OUT_MEASUREMENT
 /begin LOC_MEASUREMENT obdsttxu txucod /end LOC_MEASUREMENT
 /begin SUB_FUNCTION /end SUB_FUNCTION
/end FUNCTION
/begin FUNCTION CIFINA "CIFI Neuanteile ME7" /begin DEF_CHARACTERISTIC /end DEF_CHARACTERISTIC /begin REF_CHARACTERISTIC /end REF_CHARACTERISTIC /begin IN_MEASUREMENT evz_austot ti_tvu_w /end IN_MEASUREMENT /begin OUT_MEASUREMENT anzti anzti_w tistzyl /end OUT_MEASUREMENT /begin LOC_MEASUREMENT /end LOC_MEASUREMENT /begin SUB_FUNCTION /end SUB_FUNCTION /end FUNCTION
/begin FUNCTION CIFIVOR "" /begin DEF_CHARACTERISTIC /end DEF_CHARACTERISTIC /begin REF_CHARACTERISTIC NMIN /end REF_CHARACTERISTIC /begin IN_MEASUREMENT B_kl15 nmot_w /end IN_MEASUREMENT /begin OUT_MEASUREMENT /end OUT_MEASUREMENT /begin LOC_MEASUREMENT /end LOC_MEASUREMENT /begin SUB_FUNCTION /end SUB_FUNCTION /end FUNCTION
/begin FUNCTION COSA "Software-Abgleich" /begin DEF_CHARACTERISTIC RKACOMN RKACOMX TLLCO TVCO /end DEF_CHARACTERISTIC /begin REF_CHARACTERISTIC N0 NRKAB /end REF_CHARACTERISTIC /begin IN_MEASUREMENT B_eepdif B_ll B_ndsav B_nokatfz nmot tmot /end IN_MEASUREMENT /begin OUT_MEASUREMENT co_pot rkaco_w /end OUT_MEASUREMENT /begin LOC_MEASUREMENT B_cotrim co_pot_w /end LOC_MEASUREMENT /begin SUB_FUNCTION /end SUB_FUNCTION /end FUNCTION
/begin FUNCTION DACC "Plaus.-Prüfung ACC-Signale Diagnose" /begin DEF_CHARACTERISTIC TACCNP TACCSI /end DEF_CHARACTERISTIC /begin REF_CHARACTERISTIC /end REF_CHARACTERISTIC
 /begin IN_MEASUREMENT acc_stat bremsacc B_acc B_accnor B_bremsacc B_mdacc B_mflen B_noacc_um miacc tdcacc_ctr zaccalive /end IN_MEASUREMENT
 /begin OUT_MEASUREMENT B_accdme B_accsipl miacc_w tacczal /end OUT_MEASUREMENT
 /begin LOC_MEASUREMENT /end LOC_MEASUREMENT
 /begin SUB_FUNCTION /end SUB_FUNCTION
/end FUNCTION
/begin FUNCTION DANSKLE "Diagnose Ansaugklappe Endstufe" /begin DEF_CHARACTERISTIC /end DEF_CHARACTERISTIC /begin REF_CHARACTERISTIC /end REF_CHARACTERISTIC /begin IN_MEASUREMENT B_anskl B_desee /end IN_MEASUREMENT /begin OUT_MEASUREMENT /end OUT_MEASUREMENT /begin LOC_MEASUREMENT /end LOC_MEASUREMENT /begin SUB_FUNCTION /end SUB_FUNCTION /end FUNCTION
/begin FUNCTION DASC "Diagnose ASC-Signale" /begin DEF_CHARACTERISTIC CWDASC MIMSRMXN TASCNP TASCNP2 /end DEF_CHARACTERISTIC /begin REF_CHARACTERISTIC BZ_MSR_M /end REF_CHARACTERISTIC /begin IN_MEASUREMENT asc_alive B_asrext B_msrext miasrl miasrs mimsr nmot_w /end IN_MEASUREMENT /begin OUT_MEASUREMENT B_ascdme B_ascsipl mimsr_w /end OUT_MEASUREMENT /begin LOC_MEASUREMENT /end LOC_MEASUREMENT /begin SUB_FUNCTION /end SUB_FUNCTION /end FUNCTION
/begin FUNCTION DCACC "Diagnose; CAN-Timeout ACC-Schnittstelle" /begin DEF_CHARACTERISTIC TDCACC UBDCAN /end DEF_CHARACTERISTIC /begin REF_CHARACTERISTIC /end REF_CHARACTERISTIC /begin IN_MEASUREMENT B_acc B_accnew B_nmot ub /end IN_MEASUREMENT /begin OUT_MEASUREMENT /end OUT_MEASUREMENT /begin LOC_MEASUREMENT tdcacc_ctr /end LOC_MEASUREMENT /begin SUB_FUNCTION /end SUB_FUNCTION /end FUNCTION
/begin FUNCTION DCAS "Diagnose; CAN-Timeout ASC-Schnittstelle" /begin DEF_CHARACTERISTIC TDCAS /end DEF_CHARACTERISTIC /begin REF_CHARACTERISTIC UBDCAN /end REF_CHARACTERISTIC /begin IN_MEASUREMENT B_4x4pkw B_asc1new B_asc2new B_asc4new B_ascpkw B_nmot ub /end IN_MEASUREMENT /begin OUT_MEASUREMENT tdcas_ctr1 tdcas_ctr2 tdcas_ctr4 /end OUT_MEASUREMENT /begin LOC_MEASUREMENT /end LOC_MEASUREMENT /begin SUB_FUNCTION /end SUB_FUNCTION /end FUNCTION
/begin FUNCTION DCGE "Diagnose; CAN-Timeout GE-Schnittstelle" /begin DEF_CHARACTERISTIC TDCGE /end DEF_CHARACTERISTIC /begin REF_CHARACTERISTIC UBDCAN /end REF_CHARACTERISTIC /begin IN_MEASUREMENT B_autget B_egsnew B_nmot ub /end IN_MEASUREMENT /begin OUT_MEASUREMENT /end OUT_MEASUREMENT /begin LOC_MEASUREMENT /end LOC_MEASUREMENT /begin SUB_FUNCTION /end SUB_FUNCTION /end FUNCTION
/begin FUNCTION DCINS "Diagnose; CAN Timeout Instrument (Kombi)" /begin DEF_CHARACTERISTIC TDCINS TDHCINS /end DEF_CHARACTERISTIC /begin REF_CHARACTERISTIC UBDCAN /end REF_CHARACTERISTIC /begin IN_MEASUREMENT B_ins2new B_ins3new B_nmot ub /end IN_MEASUREMENT /begin OUT_MEASUREMENT /end OUT_MEASUREMENT /begin LOC_MEASUREMENT /end LOC_MEASUREMENT /begin SUB_FUNCTION /end SUB_FUNCTION /end FUNCTION
/begin FUNCTION DCLA "OBDII; Klassentabelle"
 /begin DEF_CHARACTERISTIC CL30LINE CL31LINE CL32LINE CL33LINE CL34LINE CL35LINE CL36LINE CL37LINE CL38LINE CL39LINE /end DEF_CHARACTERISTIC
 /begin REF_CHARACTERISTIC /end REF_CHARACTERISTIC
 /begin IN_MEASUREMENT /end IN_MEASUREMENT
 /begin OUT_MEASUREMENT /end OUT_MEASUREMENT
 /begin LOC_MEASUREMENT /end LOC_MEASUREMENT
 /begin SUB_FUNCTION /end SUB_FUNCTION
/end FUNCTION
/begin FUNCTION DCTXU "Diagnose; CAN-Timeout Schnittstelle Transfer Control Unit (TXU)" /begin DEF_CHARACTERISTIC TDTXU /end DEF_CHARACTERISTIC /begin REF_CHARACTERISTIC UBDCAN /end REF_CHARACTERISTIC /begin IN_MEASUREMENT B_nmot B_txuget B_txunew ub /end IN_MEASUREMENT /begin OUT_MEASUREMENT /end OUT_MEASUREMENT /begin LOC_MEASUREMENT /end LOC_MEASUREMENT /begin SUB_FUNCTION /end SUB_FUNCTION /end FUNCTION
/begin FUNCTION DDCY "OBDII; Erfüllung Bedingung 'driving cycle'" /begin DEF_CHARACTERISTIC TWBDCY /end DEF_CHARACTERISTIC /begin REF_CHARACTERISTIC /end REF_CHARACTERISTIC /begin IN_MEASUREMENT B_stend /end IN_MEASUREMENT /begin OUT_MEASUREMENT bbdcy B_dcy /end OUT_MEASUREMENT /begin LOC_MEASUREMENT /end LOC_MEASUREMENT /begin SUB_FUNCTION /end SUB_FUNCTION /end FUNCTION
/begin FUNCTION DDG "Diagnose Drehzahlgeber" /begin DEF_CHARACTERISTIC BMFA BMFMX PGFLWA ZIDFBM ZIDNOBM /end DEF_CHARACTERISTIC /begin REF_CHARACTERISTIC /end REF_CHARACTERISTIC /begin IN_MEASUREMENT B_fbm B_nmin zrph zrph2 /end IN_MEASUREMENT /begin OUT_MEASUREMENT bmfz_w /end OUT_MEASUREMENT /begin LOC_MEASUREMENT /end LOC_MEASUREMENT /begin SUB_FUNCTION /end SUB_FUNCTION /end FUNCTION
/begin FUNCTION DDMMVE "Diagnose Endstufe DM-TL Magnetventil" /begin DEF_CHARACTERISTIC /end DEF_CHARACTERISTIC /begin REF_CHARACTERISTIC TABTESMN TEFABE TNSTESMN /end REF_CHARACTERISTIC
 /begin IN_MEASUREMENT B_desee B_dmktke B_dmtlmv B_stend tabst_w tateist tnse_w top_w /end IN_MEASUREMENT
 /begin OUT_MEASUREMENT B_dmmtev B_dmmvtp /end OUT_MEASUREMENT
 /begin LOC_MEASUREMENT /end LOC_MEASUREMENT
 /begin SUB_FUNCTION /end SUB_FUNCTION
/end FUNCTION
/begin FUNCTION DDMPME "Diagnose Endstufe DM-TL Pumpenmotor" /begin DEF_CHARACTERISTIC TWUPKSO TWUPKSWE UBPMEO UPTESO /end DEF_CHARACTERISTIC /begin REF_CHARACTERISTIC /end REF_CHARACTERISTIC /begin IN_MEASUREMENT B_admtpm B_cddmtl B_desee B_kl15 B_pwf ubsq uptes_w /end IN_MEASUREMENT /begin OUT_MEASUREMENT B_dmtlpm DDMPMEbits DDMPMEnovbits /end OUT_MEASUREMENT /begin LOC_MEASUREMENT B_pmekso B_zdmpme B_zdpmee B_zmekso B_zmeksoz B_zxdmpme /end LOC_MEASUREMENT /begin SUB_FUNCTION /end SUB_FUNCTION /end FUNCTION
/begin FUNCTION DDMTL "Tankleckdiagnose mit DM-TL Modul"
 /begin DEF_CHARACTERISTIC CWDDMTL CWDDMTL2 CWDDMTL3 DIPRFO DIPTREF DIPTSTAB DIPTUMVU DITEDTD DITEDTK DPSF DUBTES FIP2STAB FIPTGL FIPTGLR FIPTUBF HOTEDU IPTREFO IPTREFU KFTDSTAB NGLMHEMX NGLMTKMX NGLTDA NGLTDW NKLDIPFMX NKLMTKMX SDMGLVU SFTEDA TABTESMN TANKDBE TANKDD TDDPSF TDMGLGTF TDMKLGTF TDMTGL TDMTGLR TDMTKL TDMTLMX TDMTREF TDMTREFW TDMTSTAB TFEDMMX TIPTPAMN TIPTPAMX TMSDMTLU TNSTESMN TTEDUBV TUMTESO TUMTESU TWKL15IP TWTEDTA TWTEMV TWTESNL UBATT12V UBTEDFAO UBTEDFAU UBTEDO UBTEDU VFZTANKD ZIPTESB ZIPTESN ZIPTKTKN ZUBTESB ZUBTESN /end DEF_CHARACTERISTIC
 /begin REF_CHARACTERISTIC /end REF_CHARACTERISTIC
 /begin IN_MEASUREMENT B_airbag B_cddmtl B_crdmtl B_dmmvet B_dmpmet B_dmtllhv B_fa B_fadmet B_fadmtl B_fstdmn B_fstdmx B_fsttg B_hag B_kl15 B_lowra B_nachl B_nldte B_nmot B_pwf B_stend B_tank B_tankg fho_w fteadf gvtaf_w iptes_w mstedte tabst_w tateist_w tmst tnse_w tumg ubsq_w vfzg_w /end IN_MEASUREMENT
 /begin OUT_MEASUREMENT B_admtpm B_dmkl15 B_dmtlmv B_dmtltz B_dtobd B_edmtksnm B_esdmte B_nkfl B_nkflg B_tankd B_txdmts B_ubdmte dmtlbits0 dmtlNovBits_1 m6cddmtl m6sddmtl_w m6wddmtl_w nadmtll_w ndiprfo_w nkfl /end OUT_MEASUREMENT
 /begin LOC_MEASUREMENT B_admtll B_admtls B_diprfo B_dmdiptge B_dmdiptke B_dmgltd B_dmktke B_dmktkr B_dmktks B_dmtdc B_dmtete B_dmtge B_dmtglm B_dmtglmv B_dmtgtz B_dmtgv B_dmtgvs B_dmtke B_dmtkee B_dmtklm B_dmtklmv B_dmtktz B_dmtlefs B_dmtlfe B_dmtlhe B_dmtlpe B_dmtltde B_dmtmv B_dmtnge B_dmtpm B_dmtrfm B_dpsf B_dteg B_dtegen B_dtegfa B_dtegtr B_dteken B_dtekfa B_dtektr B_dtetd B_dtetk B_dubtes B_edmtg B_edmtk B_edmtks B_fedmmv B_fedmpm B_fedmtl B_fedmtz B_mirdmtk B_nglmtr B_nldteg B_nldtek B_nomilkl B_refo B_refu B_rfmgv B_rsdmtg B_rsngl B_sdmglv B_sumv B_tankdo B_tanks B_tevzu B_twdmnl B_vdmte B_zdmtg B_zdmtgv B_zdmtk ddmtlLokBits_1 ddmtlLokBits_2 ddmtlLokBits_3 ddmtlNovLokBits_1 ddmtlNovLokBits_2 ddmtlNovLokBits_3 ddmtlNovLokBits_4 ddmtlNovLokBits_5 ddmtlNovLokBits_6 ddmtlNovLokBits_7 diptgl_w fiptes_w iprfmn_w iprfmx_w ipteskfh_w ipteskfm_w ipteskf_w iptesk_w iptgh iptgh_w iptgl iptglmn_w iptglv_w iptgl_w iptkf_w iptkl iptkl_w iptktkf_w iptref iptrefr_w iptref_w iptsglv_w iptsgl_w iptsumv_w iptumv iptumv_w iptvglv_w iptvgl_w isadmtl nglmhe nglmtk ngltdca ngltdcw nklmtk ntglm_w ntklm_w sdmglva_w tdmgl_w tdmkl_w tdmlka tdmlka_w tdmrfa_w tdmstba_w tdmstth_w ubtesf_w ubtref_w /end LOC_MEASUREMENT
 /begin SUB_FUNCTION /end SUB_FUNCTION
/end FUNCTION
/begin FUNCTION DECJ "Diagnose; Endstufe CJ4x/9x" /begin DEF_CHARACTERISTIC /end DEF_CHARACTERISTIC /begin REF_CHARACTERISTIC NDECJ UBCJMN UBCJMX UBCJTJ /end REF_CHARACTERISTIC /begin IN_MEASUREMENT nmot ub /end IN_MEASUREMENT /begin OUT_MEASUREMENT B_desee B_esdia /end OUT_MEASUREMENT /begin LOC_MEASUREMENT /end LOC_MEASUREMENT /begin SUB_FUNCTION /end SUB_FUNCTION /end FUNCTION
/begin FUNCTION DEGFE "Diagnose der Eingangsgrößen Füllungserfassung" /begin DEF_CHARACTERISTIC CWDEGFE TDEGFEMN TDEGFEMX TDEGFENO TDEGFEST /end DEF_CHARACTERISTIC /begin REF_CHARACTERISTIC /end REF_CHARACTERISTIC /begin IN_MEASUREMENT B_fkmsmn B_fkmsmx B_fkpvmn B_fkpvmx B_stend /end IN_MEASUREMENT /begin OUT_MEASUREMENT /end OUT_MEASUREMENT /begin LOC_MEASUREMENT /end LOC_MEASUREMENT /begin SUB_FUNCTION /end SUB_FUNCTION /end FUNCTION
/begin FUNCTION DEKON "Konfiguration der Endstufendiagnose" /begin DEF_CHARACTERISTIC eskonf NDECJ UBCJMN UBCJMX UBCJTJ /end DEF_CHARACTERISTIC /begin REF_CHARACTERISTIC /end REF_CHARACTERISTIC /begin IN_MEASUREMENT /end IN_MEASUREMENT /begin OUT_MEASUREMENT ESKONF /end OUT_MEASUREMENT /begin LOC_MEASUREMENT /end LOC_MEASUREMENT /begin SUB_FUNCTION /end SUB_FUNCTION /end FUNCTION
/begin FUNCTION DEKON3 "" /begin DEF_CHARACTERISTIC /end DEF_CHARACTERISTIC /begin REF_CHARACTERISTIC eskonf /end REF_CHARACTERISTIC /begin IN_MEASUREMENT B_nocins ESKONF nokatfz_flg /end IN_MEASUREMENT /begin OUT_MEASUREMENT /end OUT_MEASUREMENT /begin LOC_MEASUREMENT /end LOC_MEASUREMENT /begin SUB_FUNCTION /end SUB_FUNCTION /end FUNCTION
/begin FUNCTION DEKPE "Diagnose; Elektrokraftstoffpumpe Endstufe" /begin DEF_CHARACTERISTIC /end DEF_CHARACTERISTIC /begin REF_CHARACTERISTIC /end REF_CHARACTERISTIC /begin IN_MEASUREMENT B_desee /end IN_MEASUREMENT /begin OUT_MEASUREMENT /end OUT_MEASUREMENT /begin LOC_MEASUREMENT /end LOC_MEASUREMENT /begin SUB_FUNCTION /end SUB_FUNCTION /end FUNCTION
/begin FUNCTION DEPCL "Diagnose; Elektronik Powertrain Control Lampe" /begin DEF_CHARACTERISTIC TEPCL TEPCLI /end DEF_CHARACTERISTIC /begin REF_CHARACTERISTIC /end REF_CHARACTERISTIC /begin IN_MEASUREMENT B_nmot dfpmEpclState /end IN_MEASUREMENT /begin OUT_MEASUREMENT B_epcl /end OUT_MEASUREMENT /begin LOC_MEASUREMENT /end LOC_MEASUREMENT /begin SUB_FUNCTION /end SUB_FUNCTION /end FUNCTION
/begin FUNCTION DETS "Endstufendiagnose; elektrische Thermostatsteuerung" /begin DEF_CHARACTERISTIC /end DEF_CHARACTERISTIC /begin REF_CHARACTERISTIC /end REF_CHARACTERISTIC /begin IN_MEASUREMENT B_desee B_etr /end IN_MEASUREMENT /begin OUT_MEASUREMENT /end OUT_MEASUREMENT /begin LOC_MEASUREMENT /end LOC_MEASUREMENT /begin SUB_FUNCTION /end SUB_FUNCTION /end FUNCTION
/begin FUNCTION DEVE "Diagnose; Einspritzventil - Endstufe" /begin DEF_CHARACTERISTIC /end DEF_CHARACTERISTIC /begin REF_CHARACTERISTIC /end REF_CHARACTERISTIC /begin IN_MEASUREMENT B_desee B_sa B_stend evz_austot /end IN_MEASUREMENT /begin OUT_MEASUREMENT /end OUT_MEASUREMENT /begin LOC_MEASUREMENT B_eev /end LOC_MEASUREMENT /begin SUB_FUNCTION /end SUB_FUNCTION /end FUNCTION
/begin FUNCTION DFFT "Diagnose; Freeze Frame Auswahltabelle" /begin DEF_CHARACTERISTIC /end DEF_CHARACTERISTIC /begin REF_CHARACTERISTIC /end REF_CHARACTERISTIC
 /begin IN_MEASUREMENT egaspfad flglrs flglrs2 fr2_u fra2_u fra_u fr_u mi_duf ml mpfad nmot pu rinh2_u rinh_u rinv2_u rinv_u rl rml rstpfad skapfad tabgm tabgm2 tans tfst tkatm tkatm2 tmew tmot tmot_u tpsvkmf2_u tpsvkmf_u tumg ub udkp1_u udkp2_u uhsh uhsh2 uhsv uhsv2 upwg1_u upwg2d_u upwg2_u ushk ushk2 usvk usvk2 vfzg_u wdkba wdks wped /end IN_MEASUREMENT
 /begin OUT_MEASUREMENT /end OUT_MEASUREMENT
 /begin LOC_MEASUREMENT /end LOC_MEASUREMENT
 /begin SUB_FUNCTION /end SUB_FUNCTION
/end FUNCTION
/begin FUNCTION DFFTCNV "Diagnose; Freeze Frame Tabelle, Konvertierung zu Bytes" /begin DEF_CHARACTERISTIC /end DEF_CHARACTERISTIC /begin REF_CHARACTERISTIC NMAX /end REF_CHARACTERISTIC
 /begin IN_MEASUREMENT fr2_w fra2_w fra_w frhol_w frm2_w frm_w fr_w igod_w igokr_w lamsons2_w lamsons_w nmot_w rinh2_w rinh_w rinv2_w rinv_w rkrn_w rlugd_w rl_w tmotlin tnse_w tpsvkmf2_w tpsvkmf_w udkp1a_w udkp1_w udkp2_w upwg1_w upwg2d_w upwg2_w uushk2_w uushk_w uusvk2_w uusvk_w vfzg wdknlpr_w wdknlp_w wnwi_w /end IN_MEASUREMENT
 /begin OUT_MEASUREMENT addsu_u adhfm_u adta_u adtka_u adtm_u fr2_u fra2_u fra_u frhol_u frm2_u frm_u fr_u igod_u igokr_u lamsons2_u lamsons_u rinh2_u rinh_u rinv2_u rinv_u rkrn_u rl_u tmot_u tnse_u tpsvkmf2_u tpsvkmf_u udkp1a_u udkp1_u udkp2_u upwg1_u upwg2d_u upwg2_u uushk2_u uushk_u uusvk2_u uusvk_u vfzg_u wdknlpr_u wdknlp_u wnwi1_u wnwi2_u /end OUT_MEASUREMENT
 /begin LOC_MEASUREMENT /end LOC_MEASUREMENT
 /begin SUB_FUNCTION /end SUB_FUNCTION
/end FUNCTION
/begin FUNCTION DFFTK "Diagnose; Kundenspezifische Auswahlliste für Freeze Frame-Werte" /begin DEF_CHARACTERISTIC /end DEF_CHARACTERISTIC /begin REF_CHARACTERISTIC /end REF_CHARACTERISTIC
 /begin IN_MEASUREMENT addsu_u adhfm_u adta_u adtka_u adtm_u ahkat ahkat2 flgtiab frhol_u frm2_u frm_u fstt igod_u igokr_u ikrma ikrmet iptgh iptref iptumv lamsons2_u lamsons_u nmot phlsnh phlsnh2 phlsnv phlsnv2 rkrn_u tabgmf tabgmf2 taml tanwrhf tdmlka tkatmf tkatmf2 tmst tnse_u tvlrhi tvlrhi2 u5ref1 u5ref2 udkp1a_u uushk2_u uushk_u uusvk2_u uusvk_u vfzg2 wdknlpr_u wdknlp_u wnwi1_u wnwi2_u /end IN_MEASUREMENT
 /begin OUT_MEASUREMENT /end OUT_MEASUREMENT
 /begin LOC_MEASUREMENT /end LOC_MEASUREMENT
 /begin SUB_FUNCTION /end SUB_FUNCTION
/end FUNCTION
/begin FUNCTION DFPM "OBDII; Fehlerpfadmanager" /begin DEF_CHARACTERISTIC /end DEF_CHARACTERISTIC /begin REF_CHARACTERISTIC /end REF_CHARACTERISTIC
 /begin IN_MEASUREMENT bbwuc B_pwf egaspfad mi_duf mpfad nmot rstpfad skapfad tans tmot tmotlin top_w ushk ushk2 usvk usvk2 vfzg /end IN_MEASUREMENT
 /begin OUT_MEASUREMENT bbno bbsp3 bbtim B_no B_sp3 B_tim dfcmFcm dfcmNo dfcmSfp dfpmEpclState dfpmMilState dfp_ap fcmEnd FCMTab /end OUT_MEASUREMENT
 /begin LOC_MEASUREMENT /end LOC_MEASUREMENT
 /begin SUB_FUNCTION /end SUB_FUNCTION
/end FUNCTION
/begin FUNCTION DFPMNL "Diagnose Fehlerpfadmanagement im Nachlauf" /begin DEF_CHARACTERISTIC /end DEF_CHARACTERISTIC /begin REF_CHARACTERISTIC /end REF_CHARACTERISTIC /begin IN_MEASUREMENT B_nldte B_nlobd fcmEnd /end IN_MEASUREMENT /begin OUT_MEASUREMENT dfpnlarray /end OUT_MEASUREMENT /begin LOC_MEASUREMENT /end LOC_MEASUREMENT /begin SUB_FUNCTION /end SUB_FUNCTION /end FUNCTION
/begin FUNCTION DFPM_ADVE ""
 /begin DEF_CHARACTERISTIC CDCDVEE CDCDVEL CDCDVER CDKDVEE CDKDVEL CDKDVER CDTDVEE CDTDVEL CDTDVER CLADVEE CLADVEL CLADVER FFTDVEE FFTDVEL FFTDVER TSFDVEE TSFDVEL TSFDVER /end DEF_CHARACTERISTIC
 /begin REF_CHARACTERISTIC /end REF_CHARACTERISTIC
 /begin IN_MEASUREMENT /end IN_MEASUREMENT
 /begin OUT_MEASUREMENT B_bedvee B_bedvel B_bedver B_bkdvee B_bkdvel B_bkdver B_cldvee B_cldvel B_cldver B_ftdvee B_ftdvel B_ftdver B_mndvee B_mndvel B_mndver B_mxdvee B_mxdvel B_mxdver B_npdvee B_npdvel B_npdver B_sidvee B_sidvel B_sidver E_dvee E_dvel E_dver sfpdvee sfpdvel sfpdver TYP_dvee TYP_dvel TYP_dver Z_dvee Z_dvel Z_dver /end OUT_MEASUREMENT
 /begin LOC_MEASUREMENT /end LOC_MEASUREMENT
 /begin SUB_FUNCTION /end SUB_FUNCTION
/end FUNCTION
/begin FUNCTION DFPM_BGDVE ""
 /begin DEF_CHARACTERISTIC CDCDVEF CDCDVEN CDCDVEU CDCDVEV CDKDVEF CDKDVEN CDKDVEU CDKDVEV CDTDVEF CDTDVEN CDTDVEU CDTDVEV CLADVEF CLADVEN CLADVEU CLADVEV FFTDVEF FFTDVEN FFTDVEU FFTDVEV TSFDVEF TSFDVEN TSFDVEU TSFDVEV /end DEF_CHARACTERISTIC
 /begin REF_CHARACTERISTIC /end REF_CHARACTERISTIC
 /begin IN_MEASUREMENT /end IN_MEASUREMENT
 /begin OUT_MEASUREMENT B_bedvef B_bedven B_bedveu B_bedvev B_bkdvef B_bkdven B_bkdveu B_bkdvev B_cldvef B_cldven B_cldveu B_cldvev B_ftdvef B_ftdven B_ftdveu B_ftdvev B_mndvef B_mndven B_mndveu B_mndvev B_mxdvef B_mxdven B_mxdveu B_mxdvev B_npdvef B_npdven B_npdveu B_npdvev B_sidvef B_sidven B_sidveu B_sidvev E_dvef E_dven E_dveu E_dvev sfpdvef sfpdven sfpdveu sfpdvev TYP_dvef TYP_dven TYP_dveu TYP_dvev Z_dvef Z_dven Z_dveu Z_dvev /end OUT_MEASUREMENT
 /begin LOC_MEASUREMENT /end LOC_MEASUREMENT
 /begin SUB_FUNCTION /end SUB_FUNCTION
/end FUNCTION
/begin FUNCTION DFPM_BGRBS "" /begin DEF_CHARACTERISTIC CDCSWE CDKSWE CDTSWE CLASWE FFTSWE TSFSWE /end DEF_CHARACTERISTIC /begin REF_CHARACTERISTIC /end REF_CHARACTERISTIC /begin IN_MEASUREMENT /end IN_MEASUREMENT
 /begin OUT_MEASUREMENT B_beswe B_bkswe B_clswe B_ftswe B_mnswe B_mxswe B_npswe B_siswe E_swe sfpswe TYP_swe Z_swe /end OUT_MEASUREMENT
 /begin LOC_MEASUREMENT /end LOC_MEASUREMENT
 /begin SUB_FUNCTION /end SUB_FUNCTION
/end FUNCTION
/begin FUNCTION DFPM_DACC "" /begin DEF_CHARACTERISTIC CDCACC CDKACC CDTACC CLAACC FFTACC TSFACC /end DEF_CHARACTERISTIC /begin REF_CHARACTERISTIC /end REF_CHARACTERISTIC /begin IN_MEASUREMENT /end IN_MEASUREMENT
 /begin OUT_MEASUREMENT B_clacc B_mnacc B_mxacc B_npacc B_siacc E_acc sfpacc TYP_acc Z_acc /end OUT_MEASUREMENT
 /begin LOC_MEASUREMENT /end LOC_MEASUREMENT
 /begin SUB_FUNCTION /end SUB_FUNCTION
/end FUNCTION
/begin FUNCTION DFPM_DASC "" /begin DEF_CHARACTERISTIC CDCAS CDKAS CDTAS CLAAS FFTAS TSFAS /end DEF_CHARACTERISTIC /begin REF_CHARACTERISTIC /end REF_CHARACTERISTIC /begin IN_MEASUREMENT /end IN_MEASUREMENT
 /begin OUT_MEASUREMENT B_beas B_bkas B_clas B_ftas B_mnas B_mxas B_npas B_sias E_as sfpas TYP_as Z_as /end OUT_MEASUREMENT
 /begin LOC_MEASUREMENT /end LOC_MEASUREMENT
 /begin SUB_FUNCTION /end SUB_FUNCTION
/end FUNCTION
/begin FUNCTION DFPM_DCACC "" /begin DEF_CHARACTERISTIC CDCCACC CDKCACC CDTCACC CLACACC FFTCACC TSFCACC /end DEF_CHARACTERISTIC /begin REF_CHARACTERISTIC /end REF_CHARACTERISTIC /begin IN_MEASUREMENT /end IN_MEASUREMENT
 /begin OUT_MEASUREMENT B_becacc B_bkcacc B_clcacc B_ftcacc B_mncacc B_mxcacc B_npcacc B_sicacc E_CACC sfpcacc TYP_cacc Z_CACC /end OUT_MEASUREMENT
 /begin LOC_MEASUREMENT /end LOC_MEASUREMENT
 /begin SUB_FUNCTION /end SUB_FUNCTION
/end FUNCTION
/begin FUNCTION DFPM_DCAS "" /begin DEF_CHARACTERISTIC CDCCAS CDKCAS CDTCAS CLACAS FFTCAS TSFCAS /end DEF_CHARACTERISTIC /begin REF_CHARACTERISTIC /end REF_CHARACTERISTIC /begin IN_MEASUREMENT /end IN_MEASUREMENT
 /begin OUT_MEASUREMENT B_becas B_bkcas B_clcas B_ftcas B_mncas B_mxcas B_npcas B_sicas E_CAS sfpcas TYP_cas Z_CAS /end OUT_MEASUREMENT
 /begin LOC_MEASUREMENT /end LOC_MEASUREMENT
 /begin SUB_FUNCTION /end SUB_FUNCTION
/end FUNCTION
/begin FUNCTION DFPM_DCGE "" /begin DEF_CHARACTERISTIC CDCCGE CDKCGE CDTCGE CLACGE FFTCGE TSFCGE /end DEF_CHARACTERISTIC /begin REF_CHARACTERISTIC /end REF_CHARACTERISTIC /begin IN_MEASUREMENT /end IN_MEASUREMENT
 /begin OUT_MEASUREMENT B_becge B_bkcge B_clcge B_ftcge B_mncge B_mxcge B_npcge B_sicge E_CGE sfpcge TYP_cge Z_CGE /end OUT_MEASUREMENT
 /begin LOC_MEASUREMENT /end LOC_MEASUREMENT
 /begin SUB_FUNCTION /end SUB_FUNCTION
/end FUNCTION
/begin FUNCTION DFPM_DCINS "" /begin DEF_CHARACTERISTIC CDCCINS CDKCINS CDTCINS CLACINS FFTCINS TSFCINS /end DEF_CHARACTERISTIC /begin REF_CHARACTERISTIC /end REF_CHARACTERISTIC /begin IN_MEASUREMENT /end IN_MEASUREMENT
 /begin OUT_MEASUREMENT B_becins B_bkcins B_clcins B_ftcins B_mncins B_mxcins B_npcins B_sicins E_CINS sfpcins TYP_cins Z_CINS /end OUT_MEASUREMENT
 /begin LOC_MEASUREMENT /end LOC_MEASUREMENT
 /begin SUB_FUNCTION /end SUB_FUNCTION
/end FUNCTION
/begin FUNCTION DFPM_DCTXU "" /begin DEF_CHARACTERISTIC CDCCTXU CDKCTXU CDTCTXU CLACTXU FFTCTXU TSFCTXU /end DEF_CHARACTERISTIC /begin REF_CHARACTERISTIC /end REF_CHARACTERISTIC /begin IN_MEASUREMENT /end IN_MEASUREMENT
 /begin OUT_MEASUREMENT B_bectxu B_bkctxu B_clctxu B_ftctxu B_mnctxu B_mxctxu B_npctxu B_sictxu E_ctxu sfpctxu TYP_ctxu Z_ctxu /end OUT_MEASUREMENT
 /begin LOC_MEASUREMENT /end LOC_MEASUREMENT
 /begin SUB_FUNCTION /end SUB_FUNCTION
/end FUNCTION
/begin COMPU_METHOD acc_ub_b55p55 "" RAT_FUNC "%6.3" "m/(s^2)" COEFFS 0 1 0 0 0 0.217 /end COMPU_METHOD
/begin COMPU_METHOD bfzg_sb_q0p217 "" RAT_FUNC "%6.3" "m/s^2" COEFFS 0 1 0 0 0 0.217 /end COMPU_METHOD
/begin COMPU_METHOD B_TRUE "boolsche Zustände, positive Logik" TAB_VERB "%6.3" "" COMPU_TAB_REF B_TRUE /end COMPU_METHOD
/begin COMPU_VTAB B_TRUE "boolsche Zustände, positive Logik" TAB_VERB 2 0 "----" 1 "TRUE" /end COMPU_VTAB
/begin COMPU_METHOD DEZ "1 : 1 Umrechnug (dez/hex)" RAT_FUNC "%6.2" "" COEFFS 0 1 0 0 0 1 /end COMPU_METHOD
/begin COMPU_METHOD dez "1 : 1 Umrechnug (dez/hex)" RAT_FUNC "%6.2" "" COEFFS 0 1 0 0 0 1 /end COMPU_METHOD
/begin COMPU_METHOD dichte_ub_b2 "" RAT_FUNC "%6.4" "kg/m^3" COEFFS 0 256 0 0 0 2 /end COMPU_METHOD
/begin COMPU_METHOD fak_sb_q0p5 "" RAT_FUNC "%6.3" "-" COEFFS 0 256 0 0 0 128 /end COMPU_METHOD
/begin COMPU_METHOD fak_ub_b1 "" RAT_FUNC "%6.4" "-" COEFFS 0 256 0 0 0 1 /end COMPU_METHOD
/begin COMPU_METHOD fak_ub_b16 "" RAT_FUNC "%6.4" "-" COEFFS 0 256 0 0 0 16 /end COMPU_METHOD
/begin COMPU_METHOD fak_ub_b2 "" RAT_FUNC "%6.4" "-" COEFFS 0 256 0 0 0 2 /end COMPU_METHOD
/begin COMPU_METHOD fak_uw_b1 "" RAT_FUNC "%7.6" "-" COEFFS 0 65536 0 0 0 1 /end COMPU_METHOD
/begin COMPU_METHOD fak_uw_b16 "" RAT_FUNC "%6.5" "-" COEFFS 0 65536 0 0 0 16 /end COMPU_METHOD
/begin COMPU_METHOD fak_uw_b2 "" RAT_FUNC "%7.6" "-" COEFFS 0 65536 0 0 0 2 /end COMPU_METHOD
/begin COMPU_METHOD fak_uw_b32 "" RAT_FUNC "%6.5" "-" COEFFS 0 65536 0 0 0 32 /end COMPU_METHOD
/begin COMPU_METHOD fak_uw_b4 "" RAT_FUNC "%7.6" "-" COEFFS 0 65536 0 0 0 4 /end COMPU_METHOD
/begin COMPU_METHOD fak_uw_q0p001 "" RAT_FUNC "%6.5" "" COEFFS 0 65536 0 0 0 65.536 /end COMPU_METHOD
/begin COMPU_METHOD fuel_ub_q1 "" RAT_FUNC "%6.2" "l" COEFFS 0 1 0 0 0 1 /end COMPU_METHOD
/begin COMPU_METHOD i_q0p1953_mA "" RAT_FUNC "%6.3" "mA" COEFFS 0 256 0 0 0 50 /end COMPU_METHOD
/begin COMPU_METHOD i_q6p1035_uA "" RAT_FUNC "%6.4" "mA" COEFFS 0 65536 0 0 0 400 /end COMPU_METHOD
/begin COMPU_METHOD km_uw_q10 "" RAT_FUNC "%6.1" "km" COEFFS 0 1 0 0 0 10 /end COMPU_METHOD
/begin COMPU_METHOD lws_q0p04375 "" RAT_FUNC "%6.4" "°" COEFFS 0 1 0 0 0 0.04375 /end COMPU_METHOD
/begin COMPU_METHOD md_ub_q1 "" RAT_FUNC "%6.2" "Nm" COEFFS 0 1 0 0 0 1 /end COMPU_METHOD
/begin COMPU_METHOD md_ub_q16 "" RAT_FUNC "%6.1" "Nm" COEFFS 0 1 0 0 0 16 /end COMPU_METHOD
/begin COMPU_METHOD m_ub_b1020 "" RAT_FUNC "%6.2" "kg/h" COEFFS 0 1 0 0 0 4 /end COMPU_METHOD
/begin COMPU_METHOD m_ub_b23p3 "" RAT_FUNC "%6.3" "kg" COEFFS 0 2812.5 0 0 0 256 /end COMPU_METHOD
/begin COMPU_METHOD m_ub_b25p6 "" RAT_FUNC "%6.3" "kg/h" COEFFS 0 256 0 0 0 25.6 /end COMPU_METHOD
/begin COMPU_METHOD m_uw_b25p6 "" RAT_FUNC "%6.5" "kg/h" COEFFS 0 65536 0 0 0 25.6 /end COMPU_METHOD
/begin COMPU_METHOD m_uw_b6553p5 "" RAT_FUNC "%6.3" "kg/h" COEFFS 0 1 0 0 0 0.1 /end COMPU_METHOD
/begin COMPU_METHOD ngetr_q1 "" RAT_FUNC "%6.2" "rpm" COEFFS 0 1 0 0 0 1 /end COMPU_METHOD
/begin COMPU_METHOD nmotg_sb_q100 "" RAT_FUNC "%6.0" "U/min/s" COEFFS 0 1 0 0 0 100 /end COMPU_METHOD
/begin COMPU_METHOD nmotg_sw_q0p39 "" RAT_FUNC "%6.3" "U/min/s" COEFFS 0 1 0 0 0 0.39063 /end COMPU_METHOD
/begin COMPU_METHOD nmot_sw_q0p25 "" RAT_FUNC "%6.3" "U/min" COEFFS 0 1 0 0 0 0.25 /end COMPU_METHOD
/begin COMPU_METHOD nmot_ub_q40 "" RAT_FUNC "%6.1" "Upm" COEFFS 0 1 0 0 0 40 /end COMPU_METHOD
/begin COMPU_METHOD nmot_uw_q0p25 "" RAT_FUNC "%6.3" "U/min" COEFFS 0 1 0 0 0 0.25 /end COMPU_METHOD
/begin COMPU_METHOD p_sw_q0p039 "" RAT_FUNC "%6.4" "hPa" COEFFS 0 256 0 0 0 10 /end COMPU_METHOD
/begin COMPU_METHOD p_uw_b32 "" RAT_FUNC "%6.5" "hPa/%" COEFFS 0 65536 0 0 0 32 /end COMPU_METHOD
/begin COMPU_METHOD p_uw_q0p039 "" RAT_FUNC "%6.4" "hPa" COEFFS 0 256 0 0 0 10 /end COMPU_METHOD
/begin COMPU_METHOD relDK_ub_b100 "" RAT_FUNC "%6.3" "% DK" COEFFS 0 255 0 0 0 100 /end COMPU_METHOD
/begin COMPU_METHOD rel_sw_b1536 "" RAT_FUNC "%6.4" "%" COEFFS 0 65536 0 0 0 3072 /end COMPU_METHOD
/begin COMPU_METHOD rel_sw_q0p0234 "" RAT_FUNC "%6.4" "%/seg" COEFFS 0 32 0 0 0 0.75 /end COMPU_METHOD
/begin COMPU_METHOD rel_ub_b100 "" RAT_FUNC "%6.3" "%" COEFFS 0 255 0 0 0 100 /end COMPU_METHOD
/begin COMPU_METHOD rel_ub_b24p9 "" RAT_FUNC "%6.3" "%" COEFFS 0 255 0 0 0 24.9 /end COMPU_METHOD
/begin COMPU_METHOD rel_ub_b99p6 "" RAT_FUNC "%6.3" "%" COEFFS 0 256 0 0 0 100 /end COMPU_METHOD
/begin COMPU_METHOD rel_ub_q0p1875 "" RAT_FUNC "%6.3" "KW/ms" COEFFS 0 256 0 0 0 48 /end COMPU_METHOD
/begin COMPU_METHOD rel_ub_q0p75 "" RAT_FUNC "%6.3" "%" COEFFS 0 1 0 0 0 0.75 /end COMPU_METHOD
/begin COMPU_METHOD rel_uw_b0p3 "" RAT_FUNC "%8.7" "%/hPa" COEFFS 0 65536 0 0 0 0.3 /end COMPU_METHOD
/begin COMPU_METHOD rel_uw_b100 "" RAT_FUNC "%6.4" "%" COEFFS 0 65536 0 0 0 100 /end COMPU_METHOD
/begin COMPU_METHOD rel_uw_q0p0234 "" RAT_FUNC "%6.4" "%" COEFFS 0 32 0 0 0 0.75 /end COMPU_METHOD
/begin COMPU_METHOD r_ub_q64 "" RAT_FUNC "%6.1" "Ohm" COEFFS 0 1 0 0 0 64 /end COMPU_METHOD
/begin COMPU_METHOD spgg_sb_b3052 "" RAT_FUNC "%6.1" "V/s" COEFFS 0 1 0 0 0 23.8438 /end COMPU_METHOD
/begin COMPU_METHOD spg_q0p00039 "" RAT_FUNC "%6.5" "V" COEFFS 0 1 0 0 0 0.000390625 /end COMPU_METHOD
/begin COMPU_METHOD spg_q0p00488 "" RAT_FUNC "%6.4" "V" COEFFS 0 1024 0 0 0 5 /end COMPU_METHOD
/begin COMPU_METHOD spg_q0p1 "" RAT_FUNC "%6.3" "V" COEFFS 0 1 0 0 0 0.1 /end COMPU_METHOD
/begin COMPU_METHOD spg_q0p625 "" RAT_FUNC "%6.3" "V" COEFFS 0 8 0 0 0 5 /end COMPU_METHOD
/begin COMPU_METHOD spg_ubatt "" RAT_FUNC "%6.3" "V" COEFFS 0 1 0 0 0 0.0942 /end COMPU_METHOD
/begin COMPU_METHOD spg_ub_b5 "" RAT_FUNC "%6.4" "V" COEFFS 0 256 0 0 0 5 /end COMPU_METHOD
/begin COMPU_METHOD s_q0p02777_m "" RAT_FUNC "%6.4" "m" COEFFS 0 36 0 0 0 1 /end COMPU_METHOD
/begin COMPU_METHOD t100msxs_ub_b25p5 "" RAT_FUNC "%6.3" "s" COEFFS 0 1 0 0 0 0.1 /end COMPU_METHOD
/begin COMPU_METHOD t100msxs_uw_b6553p5 "" RAT_FUNC "%6.3" "s" COEFFS 0 1 0 0 0 0.1 /end COMPU_METHOD
/begin COMPU_METHOD t10msxs_ub_b10p2 "" RAT_FUNC "%6.4" "s" COEFFS 0 1 0 0 0 0.04 /end COMPU_METHOD
/begin COMPU_METHOD t10msxs_ub_b2p55 "" RAT_FUNC "%6.4" "s" COEFFS 0 1 0 0 0 0.01 /end COMPU_METHOD
/begin COMPU_METHOD t10msxs_uw_b655p35 "" RAT_FUNC "%6.4" "s" COEFFS 0 1 0 0 0 0.01 /end COMPU_METHOD
/begin COMPU_METHOD t1sxs_ub_b255 "" RAT_FUNC "%6.2" "s" COEFFS 0 1 0 0 0 1 /end COMPU_METHOD
/begin COMPU_METHOD t1sxs_uw_q1 "" RAT_FUNC "%6.2" "s" COEFFS 0 1 0 0 0 1 /end COMPU_METHOD
/begin COMPU_METHOD t200msxs_ub_b51 "" RAT_FUNC "%6.3" "s" COEFFS 0 1 0 0 0 0.2 /end COMPU_METHOD
/begin COMPU_METHOD t20msxs_ub_b5p1 "" RAT_FUNC "%6.4" "s" COEFFS 0 1 0 0 0 0.02 /end COMPU_METHOD
/begin COMPU_METHOD t20msxs_ub_q0p02 "" RAT_FUNC "%6.4" "s" COEFFS 0 50 0 0 0 1 /end COMPU_METHOD
/begin COMPU_METHOD t25p6sxs_ub_b6528 "" RAT_FUNC "%6.1" "s" COEFFS 0 1 0 0 0 25.6 /end COMPU_METHOD
/begin COMPU_METHOD t3p2usxms_uw_b209p7 "" RAT_FUNC "%6.4" "ms" COEFFS 0 65536 0 0 0 209.751 /end COMPU_METHOD
/begin COMPU_METHOD t40msxs_ub_q0p04 "" RAT_FUNC "%6.4" "s" COEFFS 0 1 0 0 0 0.04 /end COMPU_METHOD
/begin COMPU_METHOD t500usxms_ub_q0p5 "" RAT_FUNC "%6.3" "ms" COEFFS 0 1 0 0 0 0.5 /end COMPU_METHOD
/begin COMPU_METHOD temp_q1 "" RAT_FUNC "%6.2" "Grad C" COEFFS 0 1 0 0 0 1 /end COMPU_METHOD
/begin COMPU_METHOD temp_sb_q0p75 "" RAT_FUNC "%6.3" "Grad C" COEFFS 0 1 0 0 0 0.75 /end COMPU_METHOD
/begin COMPU_METHOD temp_sw_q0p75 "" RAT_FUNC "%6.3" "Grad C" COEFFS 0 4 0 0 0 3 /end COMPU_METHOD
/begin COMPU_METHOD temp_ub_q0p75_o48 "" RAT_FUNC "%6.2" "Grad C" COEFFS 0 1 48 0 0 0.75 /end COMPU_METHOD
/begin COMPU_METHOD temp_ub_q1_o40 "" RAT_FUNC "%6.2" "Grad C" COEFFS 0 1 40 0 0 1 /end COMPU_METHOD
/begin COMPU_METHOD tmin_uw_q1 "" RAT_FUNC "%6.2" "Min" COEFFS 0 1 0 0 0 1 /end COMPU_METHOD
/begin COMPU_METHOD TSQL "Quantisierung von te, 16 Bit mit  0.667[us]" RAT_FUNC "%6.2" "us" COEFFS 0 1 0 0 0 0.8 /end COMPU_METHOD
/begin COMPU_METHOD t_q1p6_s "" RAT_FUNC "%6.2" "s" COEFFS 0 2560 0 0 0 4096 /end COMPU_METHOD
/begin COMPU_METHOD vfzg_q1p0 "" RAT_FUNC "%6.2" "km/h" COEFFS 0 1 0 0 0 1 /end COMPU_METHOD
/begin COMPU_METHOD vfzg_ub_q1p25 "" RAT_FUNC "%6.2" "km/h" COEFFS 0 1 0 0 0 1.25 /end COMPU_METHOD
/begin COMPU_METHOD vfzg_uw_b512 "" RAT_FUNC "%6.4" "km/h" COEFFS 0 65536 0 0 0 512 /end COMPU_METHOD
/begin COMPU_METHOD vfzg_uw_q0p0625 "" RAT_FUNC "%6.4" "km/h" COEFFS 0 1 0 0 0 0.0625 /end COMPU_METHOD
/begin COMPU_METHOD vol_q0p1_l "" RAT_FUNC "%6.3" "L" COEFFS 0 1 0 0 0 0.1 /end COMPU_METHOD
/begin COMPU_METHOD vs_uw_b25p6 "" RAT_FUNC "%6.5" "m^3/h" COEFFS 0 65536 0 0 0 25.6 /end COMPU_METHOD
/begin COMPU_METHOD wkw_sb_b128 "" RAT_FUNC "%6.2" "Grad KW" COEFFS 0 1 0 0 0 1 /end COMPU_METHOD
/begin COMPU_METHOD wkw_ub_q0p5 "" RAT_FUNC "%7.3" "Grad KW" COEFFS 0 2 0 0 0 1 /end COMPU_METHOD
/begin COMPU_METHOD zk100msxs_ub_b25p5 "" RAT_FUNC "%6.3" "s" COEFFS 0 0 256 0 10 0 /end COMPU_METHOD
/begin COMPU_METHOD zk100msxs_uw_b6553 "" RAT_FUNC "%6.1" "s" COEFFS 0 0 65536 0 10 0 /end COMPU_METHOD
/begin COMPU_METHOD zk10msxs_uw_b2p55T "" TAB_INTP "%6.3" "s" COMPU_TAB_REF zk10msxs_uw_b2p55T /end COMPU_METHOD
/begin COMPU_TAB zk10msxs_uw_b2p55T "" TAB_INTP 35 128 2.55 145 2.25 163 2 186 1.75 217 1.5 251 1.3 283 1.15 326 1 362 0.9 407 0.8 465 0.7 541 0.6 649 0.5 720 0.45 809 0.4 923 0.35 1074 0.3 1285 0.25 1524 0.21 1872 0.17 2259 0.14 2426 0.13 2620 0.12 2847 0.11 3118 0.1 3446 0.09 3850 0.08 4362 0.07 5030 0.06 5939 0.05 7248 0.04 9288 0.03 12893 0.02 20713 0.01 32767 0 /end COMPU_TAB
/begin COMPU_METHOD zk10msxs_uw_b655 "" RAT_FUNC "%10.4" "s" COEFFS 0 0 65536 0 100 0 /end COMPU_METHOD
/begin COMPU_METHOD zk200msxs_uw_b13107 "" RAT_FUNC "%10.2" "s" COEFFS 0 0 13107.2 0 1 0 /end COMPU_METHOD
/begin COMPU_METHOD zk20msxs_ub_b5p1 "" RAT_FUNC "%6.4" "s" COEFFS 0 0 5.1 0 1 0 /end COMPU_METHOD
/begin COMPU_METHOD zw_ub_q6 "" RAT_FUNC "%6.2" "Grad KW" COEFFS 0 255 0 0 0 1530 /end COMPU_METHOD
/begin COMPU_METHOD default "" RAT_FUNC "%6.2" "" COEFFS 0 1 0 0 0 1 /end COMPU_METHOD
/begin RECORD_LAYOUT GkfWUw FNC_VALUES 1 UWORD COLUMN_DIR DIRECT /end RECORD_LAYOUT
/begin RECORD_LAYOUT KfAxUbAyUbSstxUbSstyUbWUb NO_AXIS_PTS_X 1 UBYTE NO_AXIS_PTS_Y 2 UBYTE AXIS_PTS_X 3 UBYTE INDEX_INCR DIRECT AXIS_PTS_Y 4 UBYTE INDEX_INCR DIRECT FNC_VALUES 5 UBYTE COLUMN_DIR DIRECT /end RECORD_LAYOUT
/begin RECORD_LAYOUT KfAxUwAyUwSstxUwSstyUwWUw NO_AXIS_PTS_X 1 UWORD NO_AXIS_PTS_Y 2 UWORD AXIS_PTS_X 3 UWORD INDEX_INCR DIRECT AXIS_PTS_Y 4 UWORD INDEX_INCR DIRECT FNC_VALUES 5 UWORD COLUMN_DIR DIRECT /end RECORD_LAYOUT
/begin RECORD_LAYOUT KlASwSstSwWSw NO_AXIS_PTS_X 1 SWORD AXIS_PTS_X 2 SWORD INDEX_INCR DIRECT FNC_VALUES 3 SWORD COLUMN_DIR DIRECT /end RECORD_LAYOUT
/begin RECORD_LAYOUT KlAUbSstUbWUb NO_AXIS_PTS_X 1 UBYTE AXIS_PTS_X 2 UBYTE INDEX_INCR DIRECT FNC_VALUES 3 UBYTE COLUMN_DIR DIRECT /end RECORD_LAYOUT
/begin RECORD_LAYOUT KlAUwSstUwWUw NO_AXIS_PTS_X 1 UWORD AXIS_PTS_X 2 UWORD INDEX_INCR DIRECT FNC_VALUES 3 UWORD COLUMN_DIR DIRECT /end RECORD_LAYOUT
/begin RECORD_LAYOUT KwbUb FNC_VALUES 1 UBYTE COLUMN_DIR DIRECT /end RECORD_LAYOUT
/begin RECORD_LAYOUT KwbUw FNC_VALUES 1 UWORD COLUMN_DIR DIRECT /end RECORD_LAYOUT
/begin RECORD_LAYOUT KwSb FNC_VALUES 1 SBYTE COLUMN_DIR DIRECT /end RECORD_LAYOUT
/begin RECORD_LAYOUT KwSw FNC_VALUES 1 SWORD COLUMN_DIR DIRECT /end RECORD_LAYOUT
/begin RECORD_LAYOUT KwUb FNC_VALUES 1 UBYTE COLUMN_DIR DIRECT /end RECORD_LAYOUT
/begin RECORD_LAYOUT KwUw FNC_VALUES 1 UWORD COLUMN_DIR DIRECT /end RECORD_LAYOUT
/begin RECORD_LAYOUT SstAUbSstUb NO_AXIS_PTS_X 1 UBYTE AXIS_PTS_X 2 UBYTE INDEX_INCR DIRECT /end RECORD_LAYOUT
/begin RECORD_LAYOUT SstAUwSstUw NO_AXIS_PTS_X 1 UWORD AXIS_PTS_X 2 UWORD INDEX_INCR DIRECT /end RECORD_LAYOUT
/end MODULE
/end PROJECT
