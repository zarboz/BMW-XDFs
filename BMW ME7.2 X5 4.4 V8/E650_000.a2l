/* Erstellt von DAMOS++ V1.17 */
ASAP2_VERSION 1 3
/begin PROJECT _7211165 "195"
/begin HEADER "" VERSION "_7211165" PROJECT_NO _7211165 /end HEADER
/begin MODULE DIM ""
/begin MOD_PAR "195" VERSION "PrV = E650 mit _00" ADDR_EPK 0x812C38 EPK "37/1/BMW/11/195//E6500/Dst_00/250101/" CUSTOMER_NO "11" USER "" PHONE_NO "" CPU_TYPE "S80166" ECU "BMW"
 /begin MEMORY_SEGMENT Pst800000 "" CODE EPROM EXTERN 0x800000 0x10000 -1 -1 -1 -1 -1 /begin IF_DATA ETK ADDRESS_MAPPING 0x800000 0x800000 0x10000 /end IF_DATA /end MEMORY_SEGMENT
 /begin MEMORY_SEGMENT Pst820000 "" CODE EPROM EXTERN 0x820000 0x60000 -1 -1 -1 -1 -1 /begin IF_DATA ETK ADDRESS_MAPPING 0x820000 0x820000 0x60000 /end IF_DATA /end MEMORY_SEGMENT
 /begin MEMORY_SEGMENT Dst810000 "" DATA EPROM EXTERN 0x810000 0x10000 -1 -1 -1 -1 -1 /begin IF_DATA ETK ADDRESS_MAPPING 0x810000 0x810000 0x10000 /end IF_DATA /end MEMORY_SEGMENT
 /begin MEMORY_SEGMENT ExtRam380000 "" VARIABLES RAM EXTERN 0x380000 0x8000 -1 -1 -1 -1 -1 /begin IF_DATA ETK ADDRESS_MAPPING 0x380000 0x380000 0x8000 /end IF_DATA /end MEMORY_SEGMENT
 SYSTEM_CONSTANT "EPK_MAX_LEN" "50"
 SYSTEM_CONSTANT "SK_PEASIC" "1"
 SYSTEM_CONSTANT "SK_UMASIC" "1"
 SYSTEM_CONSTANT "SWOFFDL_REQUEST_MASK" "16383"
 SYSTEM_CONSTANT "SY_2SG" "0"
 SYSTEM_CONSTANT "SY_720_DIV_BY_ZYLZA" "15"
 SYSTEM_CONSTANT "SY_AGR" "0"
 SYSTEM_CONSTANT "SY_AGR_DSS" "0"
 SYSTEM_CONSTANT "SY_AIRBAG" "1"
 SYSTEM_CONSTANT "SY_ASICRUNTIME" "1"
 SYSTEM_CONSTANT "SY_ASR" "1"
 SYSTEM_CONSTANT "SY_ATR" "0"
 SYSTEM_CONSTANT "SY_BDE" "0"
 SYSTEM_CONSTANT "SY_CAN" "0"
 SYSTEM_CONSTANT "SY_CCmfaICI" "81"
 SYSTEM_CONSTANT "SY_CDCSIZE" "4"
 SYSTEM_CONSTANT "SY_CDKSIZE" "1"
 SYSTEM_CONSTANT "SY_CDTSIZE" "1"
 SYSTEM_CONSTANT "SY_CLASIZE" "1"
 SYSTEM_CONSTANT "SY_CONFSL" "1"
 SYSTEM_CONSTANT "SY_CRCTAB" "2"
 SYSTEM_CONSTANT "SY_CS32FM" "0"
 SYSTEM_CONSTANT "SY_CSBVAR" "0"
 SYSTEM_CONSTANT "SY_CVT" "0"
 SYSTEM_CONSTANT "SY_DELFCMS" "0"
 SYSTEM_CONSTANT "SY_DFPMENV" "4"
 SYSTEM_CONSTANT "SY_DFPMTIM" "2"
 SYSTEM_CONSTANT "SY_DFPMVAR" "3"
 SYSTEM_CONSTANT "SY_DFPNL" "3"
 SYSTEM_CONSTANT "SY_DMDDVS" "0"
 SYSTEM_CONSTANT "SY_DMTL" "1"
 SYSTEM_CONSTANT "SY_DMTLKSH" "0"
 SYSTEM_CONSTANT "SY_DSL10MS" "0"
 SYSTEM_CONSTANT "SY_DSL2MS" "0"
 SYSTEM_CONSTANT "SY_DSWES" "0"
 SYSTEM_CONSTANT "SY_DT_3M8" "583"
 SYSTEM_CONSTANT "SY_DT_3P8" "684"
 SYSTEM_CONSTANT "SY_DT_4M8" "777"
 SYSTEM_CONSTANT "SY_DT_4P8" "913"
 SYSTEM_CONSTANT "SY_DT_5M8" "972"
 SYSTEM_CONSTANT "SY_DT_5P8" "1141"
 SYSTEM_CONSTANT "SY_DVEADA" "0"
 SYSTEM_CONSTANT "SY_EEPROM_ADDRESS_MODE" "0"
 SYSTEM_CONSTANT "SY_EEPROM_SIZE" "1024"
 SYSTEM_CONSTANT "SY_EGAS" "1"
 SYSTEM_CONSTANT "SY_EGFE" "9"
 SYSTEM_CONSTANT "SY_ENVBLOK" "3"
 SYSTEM_CONSTANT "SY_ERCOS_TIMER_INPUT_SEL" "5"
 SYSTEM_CONSTANT "SY_EVMB" "165"
 SYSTEM_CONSTANT "SY_EVMB2" "90"
 SYSTEM_CONSTANT "SY_EVOFS" "4"
 SYSTEM_CONSTANT "SY_FANT" "0"
 SYSTEM_CONSTANT "SY_FCMIRD" "0"
 SYSTEM_CONSTANT "SY_FCMSIZE" "20"
 SYSTEM_CONSTANT "SY_FFESIZE" "0"
 SYSTEM_CONSTANT "SY_FFTSIZE" "4"
 SYSTEM_CONSTANT "SY_FFXSIZE" "11"
 SYSTEM_CONSTANT "SY_FLUQ" "37"
 SYSTEM_CONSTANT "SY_FR5ROM" "1"
 SYSTEM_CONSTANT "SY_FRAME_MAX" "7322"
 SYSTEM_CONSTANT "SY_FRAME_MIN" "6042"
 SYSTEM_CONSTANT "SY_FREQ_CPU" "20000"
 SYSTEM_CONSTANT "SY_GAP" "2"
 SYSTEM_CONSTANT "SY_GRUNDWERT" "54"
 SYSTEM_CONSTANT "SY_IKRSCHWELLE" "37"
 SYSTEM_CONSTANT "SY_INGASOS" "10"
 SYSTEM_CONSTANT "SY_INJTIM_PRE" "64"
 SYSTEM_CONSTANT "SY_ISOPROT" "0"
 SYSTEM_CONSTANT "SY_KORRZ" "1"
 SYSTEM_CONSTANT "SY_KRMFTIM_PRE" "64"
 SYSTEM_CONSTANT "SY_KS1" "0"
 SYSTEM_CONSTANT "SY_KS2" "1"
 SYSTEM_CONSTANT "SY_KS3" "2"
 SYSTEM_CONSTANT "SY_KS4" "3"
 SYSTEM_CONSTANT "SY_M1I00A" "191"
 SYSTEM_CONSTANT "SY_M1I00B" "159"
 SYSTEM_CONSTANT "SY_M1I00C" "249"
 SYSTEM_CONSTANT "SY_M1I00D" "145"
 SYSTEM_CONSTANT "SY_M1I20A" "128"
 SYSTEM_CONSTANT "SY_M1I20B" "0"
 SYSTEM_CONSTANT "SY_M1I20C" "0"
 SYSTEM_CONSTANT "SY_M1I20D" "0"
 SYSTEM_CONSTANT "SY_M2I00A" "127"
 SYSTEM_CONSTANT "SY_M2I00B" "152"
 SYSTEM_CONSTANT "SY_M2I00C" "0"
 SYSTEM_CONSTANT "SY_M2I00D" "0"
 SYSTEM_CONSTANT "SY_M5IH00A" "195"
 SYSTEM_CONSTANT "SY_M5IH00B" "0"
 SYSTEM_CONSTANT "SY_M5IH00C" "0"
 SYSTEM_CONSTANT "SY_M5IH00D" "0"
 SYSTEM_CONSTANT "SY_M5IH20A" "0"
 SYSTEM_CONSTANT "SY_M5IH20B" "0"
 SYSTEM_CONSTANT "SY_M5IH20C" "0"
 SYSTEM_CONSTANT "SY_M5IH20D" "0"
 SYSTEM_CONSTANT "SY_M5IH40A" "0"
 SYSTEM_CONSTANT "SY_M5IH40B" "0"
 SYSTEM_CONSTANT "SY_M5IH40C" "0"
 SYSTEM_CONSTANT "SY_M5IH40D" "0"
 SYSTEM_CONSTANT "SY_M5IH60A" "0"
 SYSTEM_CONSTANT "SY_M5IH60B" "0"
 SYSTEM_CONSTANT "SY_M5IH60C" "0"
 SYSTEM_CONSTANT "SY_M5IH60D" "0"
 SYSTEM_CONSTANT "SY_M5IH80A" "0"
 SYSTEM_CONSTANT "SY_M5IH80B" "0"
 SYSTEM_CONSTANT "SY_M5IH80C" "0"
 SYSTEM_CONSTANT "SY_M5IH80D" "0"
 SYSTEM_CONSTANT "SY_M5IV00A" "195"
 SYSTEM_CONSTANT "SY_M5IV00B" "128"
 SYSTEM_CONSTANT "SY_M5IV00C" "0"
 SYSTEM_CONSTANT "SY_M5IV00D" "1"
 SYSTEM_CONSTANT "SY_M5IV20A" "0"
 SYSTEM_CONSTANT "SY_M5IV20B" "1"
 SYSTEM_CONSTANT "SY_M5IV20C" "192"
 SYSTEM_CONSTANT "SY_M5IV20D" "0"
 SYSTEM_CONSTANT "SY_M5IV40A" "0"
 SYSTEM_CONSTANT "SY_M5IV40B" "0"
 SYSTEM_CONSTANT "SY_M5IV40C" "0"
 SYSTEM_CONSTANT "SY_M5IV40D" "0"
 SYSTEM_CONSTANT "SY_M5IV60A" "0"
 SYSTEM_CONSTANT "SY_M5IV60B" "0"
 SYSTEM_CONSTANT "SY_M5IV60C" "0"
 SYSTEM_CONSTANT "SY_M5IV60D" "0"
 SYSTEM_CONSTANT "SY_M5IV80A" "0"
 SYSTEM_CONSTANT "SY_M5IV80B" "0"
 SYSTEM_CONSTANT "SY_M5IV80C" "0"
 SYSTEM_CONSTANT "SY_M5IV80D" "0"
 SYSTEM_CONSTANT "SY_M6I00A" "168"
 SYSTEM_CONSTANT "SY_M6I00B" "128"
 SYSTEM_CONSTANT "SY_M6I00C" "0"
 SYSTEM_CONSTANT "SY_M6I00D" "0"
 SYSTEM_CONSTANT "SY_M8I00B" "128"
 SYSTEM_CONSTANT "SY_M8I00C" "0"
 SYSTEM_CONSTANT "SY_M8I00D" "0"
 SYSTEM_CONSTANT "SY_M8I00E" "0"
 SYSTEM_CONSTANT "SY_M9I00A" "60"
 SYSTEM_CONSTANT "SY_M9I00B" "0"
 SYSTEM_CONSTANT "SY_M9I00C" "0"
 SYSTEM_CONSTANT "SY_M9I00D" "0"
 SYSTEM_CONSTANT "SY_MLSUBREF" "138"
 SYSTEM_CONSTANT "SY_NWS" "1"
 SYSTEM_CONSTANT "SY_NWVAR" "1"
 SYSTEM_CONSTANT "SY_OVERSIZE" "2"
 SYSTEM_CONSTANT "SY_PECVFZ_RELOAD" "50"
 SYSTEM_CONSTANT "SY_PGRAD2" "0"
 SYSTEM_CONSTANT "SY_PHTWIN" "1"
 SYSTEM_CONSTANT "SY_REDMX" "8"
 SYSTEM_CONSTANT "SY_REVTIM_PRE" "16"
 SYSTEM_CONSTANT "SY_RLTEST" "50"
 SYSTEM_CONSTANT "SY_SGANZ" "1"
 SYSTEM_CONSTANT "SY_SHK_OT" "1"
 SYSTEM_CONSTANT "SY_STA" "0"
 SYSTEM_CONSTANT "SY_STEREO" "1"
 SYSTEM_CONSTANT "SY_STERHK" "1"
 SYSTEM_CONSTANT "SY_STERSY" "0"
 SYSTEM_CONSTANT "SY_STERVK" "1"
 SYSTEM_CONSTANT "SY_STETLR" "0"
 SYSTEM_CONSTANT "SY_STK" "0"
 SYSTEM_CONSTANT "SY_SU" "0"
 SYSTEM_CONSTANT "SY_SWE_B" "1"
 SYSTEM_CONSTANT "SY_SWE_C" "0"
 SYSTEM_CONSTANT "SY_SWE_S" "0"
 SYSTEM_CONSTANT "SY_TABST" "1"
 SYSTEM_CONSTANT "SY_TEBF" "0"
 SYSTEM_CONSTANT "SY_TEETH" "60"
 SYSTEM_CONSTANT "SY_TFA" "0"
 SYSTEM_CONSTANT "SY_TFBA" "0"
 SYSTEM_CONSTANT "SY_TFMA" "1"
 SYSTEM_CONSTANT "SY_TFMAP" "0"
 SYSTEM_CONSTANT "SY_TFMO" "0"
 SYSTEM_CONSTANT "SY_TFNS" "0"
 SYSTEM_CONSTANT "SY_TFUMG" "1"
 SYSTEM_CONSTANT "SY_TFVA" "0"
 SYSTEM_CONSTANT "SY_TFWL" "0"
 SYSTEM_CONSTANT "SY_TIMER1_PRESCALER" "16"
 SYSTEM_CONSTANT "SY_TIMER3_PRESCALER" "64"
 SYSTEM_CONSTANT "SY_TIMER8_PRESCALER" "64"
 SYSTEM_CONSTANT "SY_TLR" "0"
 SYSTEM_CONSTANT "SY_TN" "1"
 SYSTEM_CONSTANT "SY_TSFSIZE" "1"
 SYSTEM_CONSTANT "SY_TURBO" "0"
 SYSTEM_CONSTANT "SY_TVVR" "0"
 SYSTEM_CONSTANT "SY_TWO_ZYLZA" "16"
 SYSTEM_CONSTANT "SY_UBDEDIS" "74"
 SYSTEM_CONSTANT "SY_UBDEEN" "86"
 SYSTEM_CONSTANT "SY_UBKL15" "0"
 SYSTEM_CONSTANT "SY_UBOKDIS" "63"
 SYSTEM_CONSTANT "SY_UBOKEN" "74"
 SYSTEM_CONSTANT "SY_UBSQ_W" "965"
 SYSTEM_CONSTANT "SY_UMALS" "0"
 SYSTEM_CONSTANT "SY_USOFF" "205"
 SYSTEM_CONSTANT "SY_VS" "0"
 SYSTEM_CONSTANT "SY_WDTINPUT_SEL" "1"
 SYSTEM_CONSTANT "SY_WKW075" "120"
 SYSTEM_CONSTANT "SY_WMAX" "72"
 SYSTEM_CONSTANT "SY_WMIN" "-32"
 SYSTEM_CONSTANT "SY_WNBM" "6"
 SYSTEM_CONSTANT "SY_ZAS" "0"
 SYSTEM_CONSTANT "SY_ZYLMASK" "255"
 SYSTEM_CONSTANT "SY_ZYLZA" "8"
 SYSTEM_CONSTANT "SY_ZZBANK" "90"
 SYSTEM_CONSTANT "TSROHRES" "1000" /end MOD_PAR
/begin MOD_COMMON "" BYTE_ORDER MSB_LAST ALIGNMENT_BYTE 1 ALIGNMENT_WORD 2 ALIGNMENT_LONG 2 /end MOD_COMMON
/* --- AgI-Objekt für ETKP1 (ASAP V1.3), Stand 1.4 9.8.00 --- */
/begin IF_DATA ETK
 /begin TP_BLOB /*version:*/ 0x1000001 /*pba:*/ 0x0 /*reset_cfg:*/ 0xFFFFFF07
  /begin DISTAB_CFG /*dsptab:*/ 0xC /*dat_mod:*/ 0x1 /*rfg:*/ 0x2 /*trgsegad:*/ 0x382E00 /*trg_cfg:*/ 0x1020100 TRG_MOD /*Id:*/ 0x0 /*trg_mod:*/ 0x27 0x0 0x0 0x0 /end DISTAB_CFG
  CODE_CHK /*prg_data:*/ 0x0 /*prg_length:*/ 0x0 /*prg_eram:*/ 0x0 /*prg_length:*/ 0x0 ETK_CFG 0xf 0xf0 0xff 0x3 0xff 0xee 0xff 0x1 /* EMU_RAM start_addr length CS offset >>>>> (multiple) */ /* EMU_DATA start_addr length CS offset >>>>> (multiple) */ /* EMU_CODE start_addr length CS offset >>>>> (multiple) */ /* RESERVED start_addr length CS offset >>>>> (multiple) */ RESERVED_DISTAB_MEMORY /*start_addr:*/ 0x817F68 0x144 EXTERN -1 -1 -1 -1 -1 ETK_MAILBOX /*pattern:*/ 0x55555555 /*page_ecu:*/ DATA /*ecu_adr:*/ 0x600000 /*..length:*/ 0x8000 /*page_am:*/ EXRAM /*am_adr:*/ 0x620000 /*..length:*/ 0x8000 /end TP_BLOB
 /begin SOURCE "Synchro" 103 1 QP_BLOB 1 0xA 0x817F68 0x381E88 0x382E36 0 0 0 /end SOURCE
 /begin SOURCE "10ms" 4 1 QP_BLOB 2 0x1A 0x817F7E 0x381E92 0x382E38 10 0 0 /end SOURCE
 /begin SOURCE "100ms" 5 1 QP_BLOB 3 0x1E 0x817FB4 0x381EAC 0x382E3A 100 0 0 /end SOURCE
/end IF_DATA
/begin CHARACTERISTIC A0 "Übertragungsfunktionskoeffizient" VALUE 0x814288 KwSw 0.1249981 fak_sw_b0p0625 -0.06250000 0.06249809 FORMAT "%10.8" /end CHARACTERISTIC
/begin CHARACTERISTIC A1 "Übertragungsfunktionskoeffizient" VALUE 0x81428A KwSw 0.1249981 fak_sw_b0p0625 -0.06250000 0.06249809 FORMAT "%10.8" /end CHARACTERISTIC
/begin CHARACTERISTIC A2 "Übertragungsfunktionskoeffizient" VALUE 0x81428C KwSw 0.1249981 fak_sw_b0p0625 -0.06250000 0.06249809 FORMAT "%10.8" /end CHARACTERISTIC
/begin CHARACTERISTIC ABOLRAR "Schwelle Anzahl Starts mit Benzin im Öl für reduzierte LRA" VALUE 0x811B70 KwUb 255.0 dez 0.00 255.0 FORMAT "%5.1" /end CHARACTERISTIC
/begin CHARACTERISTIC ABOMX "max. Anzahl Start-Zähler für Erkennung Benzin im Öl" VALUE 0x811B71 KwUb 255.0 dez 0.00 255.0 FORMAT "%5.1" /end CHARACTERISTIC
/begin CHARACTERISTIC ATMABKA "Faktor für Abgastemperaturabnahme = f(Abstellzeit)" CURVE 0x819932 GklWUb 0.9961 fak_ub_b1 0.00 0.9961
 /begin AXIS_DESCR COM_AXIS tabst_w t1sxs_uw_q1 6 0.00 65535.00 AXIS_PTS_REF STS06TMUW /end AXIS_DESCR
/end CHARACTERISTIC
/begin CHARACTERISTIC ATMABKA2 "Faktor für Abgastemperaturabnahme = f(Abstellzeit) Bank2" CURVE 0x819938 GklWUb 0.9961 fak_ub_b1 0.00 0.9961
 /begin AXIS_DESCR COM_AXIS tabst_w t1sxs_uw_q1 6 0.00 65535.00 AXIS_PTS_REF STS06TMUW /end AXIS_DESCR
/end CHARACTERISTIC
/begin CHARACTERISTIC ATMABKK "Faktor für Abnahme der Katalysatortemperatur = f(Abstellzeit)" CURVE 0x81993E GklWUb 0.9961 fak_ub_b1 0.00 0.9961
 /begin AXIS_DESCR COM_AXIS tabst_w t1sxs_uw_q1 6 0.00 65535.00 AXIS_PTS_REF STS06TMUW /end AXIS_DESCR
/end CHARACTERISTIC
/begin CHARACTERISTIC ATMABKK2 "Faktor für Abnahme der Katalysatortemperatur = f(Abstellzeit) Bank 2" CURVE 0x819944 GklWUb 0.9961 fak_ub_b1 0.00 0.9961
 /begin AXIS_DESCR COM_AXIS tabst_w t1sxs_uw_q1 6 0.00 65535.00 AXIS_PTS_REF STS06TMUW /end AXIS_DESCR
/end CHARACTERISTIC
/begin CHARACTERISTIC ATMTANS "Temperaturkorrektur der Abgas-Modell-Temperatur" CURVE 0x81B194 KlAUbSstUbWSb 1275. temp_q5 -640.0 635.0 FORMAT "%5.1"
 /begin AXIS_DESCR STD_AXIS tatu temp_ub_q0p75_o48 3 -48.00 143.3 FORMAT "%5.1" DEPOSIT ABSOLUTE /end AXIS_DESCR
/end CHARACTERISTIC
/begin CHARACTERISTIC B1 "Übertragungsfunktionskoeffizient" VALUE 0x81428E KwSw 3.999939 fak_sw_b2 -2.000000 1.999939 FORMAT "%8.6" /end CHARACTERISTIC
/begin CHARACTERISTIC B2 "Übertragungsfunktionskoeffizient" VALUE 0x814290 KwSw 3.999939 fak_sw_b2 -2.000000 1.999939 FORMAT "%8.6" /end CHARACTERISTIC
/begin CHARACTERISTIC BFGRO "Obere Schwelle für Beschleunigung im FGR-Betrieb" VALUE 0x811B60 KwSb 55.34 bfzg_sb_q0p217 -27.78 27.56 FORMAT "%5.2" /end CHARACTERISTIC
/begin CHARACTERISTIC BFGRU "Untere Schwelle für Beschleunigung im FGR-Betrieb" VALUE 0x811B61 KwSb 55.34 bfzg_sb_q0p217 -27.78 27.56 FORMAT "%5.2" /end CHARACTERISTIC
/begin CHARACTERISTIC BTRKHTMS "Kennline zur Freigabe B_trkh" CURVE 0x81A3A1 KlAUbSstUbWUb 255.0 dez 0.00 255.0 FORMAT "%5.1"
 /begin AXIS_DESCR STD_AXIS tmst temp_ub_q0p75_o48 8 -48.00 143.3 FORMAT "%5.1" DEPOSIT ABSOLUTE /end AXIS_DESCR
/end CHARACTERISTIC
/begin CHARACTERISTIC CWBBFGR "Codewort für BBFGR" VALUE 0x811B62 KwUb 255.0 dez 0.00 255.0 FORMAT "%5.1" /end CHARACTERISTIC
/begin CHARACTERISTIC CWBFGROF "Codewort für BBFGR bei externen Abschalt-Anforderungen" VALUE 0x811B63 KwUb 255.0 dez 0.00 255.0 FORMAT "%5.1" /end CHARACTERISTIC
/begin CHARACTERISTIC CWKHZ "Codewort für Katheizsteuerung" VALUE 0x81A3B2 KwUb 255.0 dez 0.00 255.0 FORMAT "%5.1" /end CHARACTERISTIC
/begin CHARACTERISTIC CWLOWR "Codewort für Erkennung und Umschaltung Low Range Betrieb" VALUE 0x812BB1 KwUb 255.0 dez 0.00 255.0 FORMAT "%5.1" /end CHARACTERISTIC
/begin CHARACTERISTIC CWPKAPP "Codewort Applikation Druckreferenz für Kraftstoffdruckregler" VALUE 0x819DD2 KwUb 255.0 dez 0.00 255.0 FORMAT "%5.1" /end CHARACTERISTIC
/begin CHARACTERISTIC DANTGESWNV "Schwelle Aktivierung D-Anteil (Geschwindigkeit) im unverstärkten Bereich" VALUE 0x8142A4 KwSw 1599.976 relDK_q0p02441 -800.0000 799.9756 FORMAT "%8.4" /end CHARACTERISTIC
/begin CHARACTERISTIC DANTGESWV "Schwelle Aktivierung D-Anteil (Geschwindigkeit) im verstärkten Bereich" VALUE 0x8142A6 KwSw 1599.976 relDK_q0p02441 -800.0000 799.9756 FORMAT "%8.4" /end CHARACTERISTIC
/begin CHARACTERISTIC DANTSCHWNV "Schwelle Aktivierung D-Anteil (Abweichung) im unverstärkten Bereich" VALUE 0x8142A8 KwSw 1599.976 relDK_q0p02441 -800.0000 799.9756 FORMAT "%8.4" /end CHARACTERISTIC
/begin CHARACTERISTIC DANTSCHWV "Schwelle Aktivierung D-Anteil (Abweichung) im verstärkten Bereich" VALUE 0x8142AA KwSw 1599.976 relDK_q0p02441 -800.0000 799.9756 FORMAT "%8.4" /end CHARACTERISTIC
/begin CHARACTERISTIC DFKMSMN "Delta FKMSDKMN zum Rücksetzen von B_fkmsmn" VALUE 0x8109D1 KwUb 3.984 fak_ub_b4 0.00 3.984 FORMAT "%5.3" /end CHARACTERISTIC
/begin CHARACTERISTIC DFKMSMX "Delta FKMSDKMX zum Rücksetzen von B_fkmsmx" VALUE 0x8109D2 KwUb 3.984 fak_ub_b4 0.00 3.984 FORMAT "%5.3" /end CHARACTERISTIC
/begin CHARACTERISTIC DFKPVMN "Delta FKPVDKMN zum Rücksetzen von B_fkpvmn" VALUE 0x8109D3 KwUb 3.984 fak_ub_b4 0.00 3.984 FORMAT "%5.3" /end CHARACTERISTIC
/begin CHARACTERISTIC DFKPVMX "Delta FKPVDKMX zum Rücksetzen von B_fkpvmx" VALUE 0x8109D4 KwUb 3.984 fak_ub_b4 0.00 3.984 FORMAT "%5.3" /end CHARACTERISTIC
/begin CHARACTERISTIC DFTEDS "Hysteresebreite Beladung für Umschaltung auf Dauertankentlüftung" VALUE 0x81B6EC KwSw 127.9980 fak_sw_b64 -64.00000 63.99805 FORMAT "%8.5" /end CHARACTERISTIC
/begin CHARACTERISTIC DILBN "Delta Integratorwert Batterieladebilanz" CURVE 0x81B38C KlAUbSstUbWSb 255.0 dez -128.0 127.0 FORMAT "%5.1"
 /begin AXIS_DESCR STD_AXIS nmotll nmot_ub_q10 6 0.00 2550. FORMAT "%5.0" DEPOSIT ABSOLUTE /end AXIS_DESCR
/end CHARACTERISTIC
/begin CHARACTERISTIC DILBST "Delta Integratorwert Batterieladebilanz im Start" VALUE 0x819BE5 KwSb 255.0 dez -128.0 127.0 FORMAT "%5.1" /end CHARACTERISTIC
/begin CHARACTERISTIC DITNS "Delta Integratorwert Batterieladebilanz bei Nacht" VALUE 0x819BE6 KwSb 255.0 dez -128.0 127.0 FORMAT "%5.1" /end CHARACTERISTIC
/begin CHARACTERISTIC DKLAGERT "zulässige Fehlerzeit für DK-Soll-/Istvergleich" VALUE 0x8100A4 KwUb 5.100 t20msxs_ub_b5p1 0.00 5.100 FORMAT "%5.3" /end CHARACTERISTIC
/begin CHARACTERISTIC DKPSTGMIN "min. Steigung des DK-Poti zur Umr. abs. auf rel. Winkel im worst case" VALUE 0x8157C8 KwUw 39.99939 rel_uw_b40 0.00 39.99939 FORMAT "%8.5" /end CHARACTERISTIC
/begin CHARACTERISTIC DLRDWDKSS1 "DLR, obere Grenze zur Parameterumschaltung" VALUE 0x8142AC KwSw 99.99847 relDK_q0p00152 -50.00000 49.99847 FORMAT "%8.5" /end CHARACTERISTIC
/begin CHARACTERISTIC DLRDWDKSS2 "DLR, untere Grenze zur Parameterumschaltung" VALUE 0x8142AE KwSw 99.99847 relDK_q0p00152 -50.00000 49.99847 FORMAT "%8.5" /end CHARACTERISTIC
/begin CHARACTERISTIC DLRIAMAX "" VALUE 0x8142B0 KwUw 6412.329 rel_q0p1957 0.00 6412.329 FORMAT "%8.3" /end CHARACTERISTIC
/begin CHARACTERISTIC DLRIKLPAR "DLR, I-Klein Parameter" VALUE 0x8100A5 KwUb 15.94 relDK_q0p0625 0.00 15.94 FORMAT "%5.2" /end CHARACTERISTIC
/begin CHARACTERISTIC DLRININI "I-Anteil bei Inititialisierung der NLP-Funktion" VALUE 0x8142B2 KwUw 12824.85 rel_q0p1957 0.00 12824.85 FORMAT "%8.2" /end CHARACTERISTIC
/begin CHARACTERISTIC DLRKDONLP0 "DLR, D-Parameter über NLP" VALUE 0x8100A6 KwUb 1020. relDK_q4 0.00 1020. FORMAT "%5.0" /end CHARACTERISTIC
/begin CHARACTERISTIC DLRKDUNLP0 "DLR, D-Parameter unter NLP (schwach)" VALUE 0x8100A7 KwUb 1020. relDK_q4 0.00 1020. FORMAT "%5.0" /end CHARACTERISTIC
/begin CHARACTERISTIC DLRKDUNLP1 "DLR, D-Parameter unter NLP (mittel)" VALUE 0x8100A8 KwUb 1020. relDK_q4 0.00 1020. FORMAT "%5.0" /end CHARACTERISTIC
/begin CHARACTERISTIC DLRKDUNLP2 "DLR, D-Parameter unter NLP (stark)" VALUE 0x8100A9 KwUb 1020. relDK_q4 0.00 1020. FORMAT "%5.0" /end CHARACTERISTIC
/begin CHARACTERISTIC DLRKIONLP0 "I-Anteil als f(abs(dwdkdlr_w)), über NLP" VAL_BLK 0x8100AA KwbUb 15.94 relDK_q0p0625 0.00 15.94 FORMAT "%5.2" NUMBER 32 /end CHARACTERISTIC
/begin CHARACTERISTIC DLRKIUNLP0 "I-Anteil als f(abs(dwdkdlr_w)), unter NLP (schwach)" VAL_BLK 0x8100CA KwbUb 15.94 relDK_q0p0625 0.00 15.94 FORMAT "%5.2" NUMBER 32 /end CHARACTERISTIC
/begin CHARACTERISTIC DLRKIUNLP1 "I-Anteil als f(abs(dwdkdlr_w)), unter NLP (mittel)" VAL_BLK 0x8100EA KwbUb 15.94 relDK_q0p0625 0.00 15.94 FORMAT "%5.2" NUMBER 32 /end CHARACTERISTIC
/begin CHARACTERISTIC DLRKIUNLP2 "I-Anteil als f(abs(dwdkdlr_w)), unter NLP (stark)" VAL_BLK 0x81010A KwbUb 15.94 relDK_q0p0625 0.00 15.94 FORMAT "%5.2" NUMBER 32 /end CHARACTERISTIC
/begin CHARACTERISTIC DLRKPONLP0 "DLR, P-Parameter über NLP" VALUE 0x81012A KwUb 255.0 relDK_q1 0.00 255.0 FORMAT "%5.1" /end CHARACTERISTIC
/begin CHARACTERISTIC DLRKPUNLP0 "DLR, P-Parameter unter NLP (schwach)" VALUE 0x81012B KwUb 255.0 relDK_q1 0.00 255.0 FORMAT "%5.1" /end CHARACTERISTIC
/begin CHARACTERISTIC DLRKPUNLP1 "DLR, P-Parameter unter NLP (mittel)" VALUE 0x81012C KwUb 255.0 relDK_q1 0.00 255.0 FORMAT "%5.1" /end CHARACTERISTIC
/begin CHARACTERISTIC DLRKPUNLP2 "DLR, P-Parameter unter NLP (stark)" VALUE 0x81012D KwUb 255.0 relDK_q1 0.00 255.0 FORMAT "%5.1" /end CHARACTERISTIC
/begin CHARACTERISTIC DLRKREIS "DLR, Faktor Kreisverstärkung" VALUE 0x81001E KwUb 1.992 fak_ub_b2 0.00 1.992 FORMAT "%5.3" /end CHARACTERISTIC
/begin CHARACTERISTIC DLRKREISST "DLR, Faktor Kreisverstärkung zur Zeit des Motorstarts" VALUE 0x81001F KwUb 1.992 fak_ub_b2 0.00 1.992 FORMAT "%5.3" /end CHARACTERISTIC
/begin CHARACTERISTIC DLRNLPD "Unschärfebereich für DK-Notluftposition" VALUE 0x8142B4 KwUw 100.0000 relDK_uw_b100 0.00 100.0000 FORMAT "%8.4" /end CHARACTERISTIC
/begin CHARACTERISTIC DLRPID1T "zulässige Fehlerzeit 1 für DLR-Stellbereich am Anschlag" VALUE 0x8142B6 KwUw 655.3500 t10msxs_uw_b655p35 0.00 655.3500 FORMAT "%8.4" /end CHARACTERISTIC
/begin CHARACTERISTIC DLRPID2T "zulässige Fehlerzeit 2 für DLR-Stellbereich am Anschlag" VALUE 0x8142B8 KwUw 655.3500 t10msxs_uw_b655p35 0.00 655.3500 FORMAT "%8.4" /end CHARACTERISTIC
/begin CHARACTERISTIC DLRPIDMAX "max. zulässiges PWM-Tastverhältnis für DLR" VALUE 0x8142BA KwUw 99.99847 rel_uw_b100 0.00 99.99847 FORMAT "%8.5" /end CHARACTERISTIC
/begin CHARACTERISTIC DLRPIDMIN "min. zulässiges PWM-Tastverhältnis für DLR" VALUE 0x8142BC KwUw 99.99847 rel_uw_b100 0.00 99.99847 FORMAT "%8.5" /end CHARACTERISTIC
/begin CHARACTERISTIC DLRPIDSTMN "min. Schwelle für PWM-Tastverhältnis des DLR bei temp. UMA-Adapt." VALUE 0x8157CA KwUw 99.99847 rel_uw_b100 0.00 99.99847 FORMAT "%8.5" /end CHARACTERISTIC
/begin CHARACTERISTIC DLRUBSOLL "DLR, Batterie Normalspannung" VALUE 0x813E4A KwUb 24.02 spg_ubatt 0.00 24.02 FORMAT "%5.2" /end CHARACTERISTIC
/begin CHARACTERISTIC DLRUMABAND "Unsicherheitsband bei Sprung aus UMA-Bereich" VALUE 0x8142BE KwUw 1599.976 relDK_q0p02441 0.00 1599.976 FORMAT "%8.3" /end CHARACTERISTIC
/begin CHARACTERISTIC DLRUMAIINI "Vorladewert I-Anteil bei Sprung aus UMA-Bereich" VALUE 0x8142C0 KwSw 12824.85 rel_q0p1957 -6412.524 6412.329 FORMAT "%8.3" /end CHARACTERISTIC
/begin CHARACTERISTIC DMDAROG "obere Schwelle für Momenteneingriff Gangabhängig" CURVE 0x81ABFE GklWSw 199.9969 rel_sw_b100 -100.0000 99.99695 FORMAT "%8.4" /begin AXIS_DESCR COM_AXIS gangi dez 7 0.00 255.0 AXIS_PTS_REF SGA07MDUB /end AXIS_DESCR /end CHARACTERISTIC
/begin CHARACTERISTIC DMDARUG "untere Schwelle für Momenteneingriff Gangabhängig" CURVE 0x81AC0C GklWSw 199.9969 rel_sw_b100 -100.0000 99.99695 FORMAT "%8.4" /begin AXIS_DESCR COM_AXIS gangi dez 7 0.00 255.0 AXIS_PTS_REF SGA07MDUB /end AXIS_DESCR /end CHARACTERISTIC
/begin CHARACTERISTIC DNARAO "Drehzahlhysterese für AR aktiv" VALUE 0x81008C KwUb 10200. nmot_ub_q40 0.00 10200. FORMAT "%5.0" /end CHARACTERISTIC
/begin CHARACTERISTIC DNFILO "obere Schwelle für Gradient des Filterausgangs ndfil" VALUE 0x814292 KwSw 8191.750 nmot_sw_q0p25 0.00 8191.750 FORMAT "%8.3" /end CHARACTERISTIC
/begin CHARACTERISTIC DNIARNG "Delta Drehzahl für nmod-Initialisierung von Drehzahlgradient" CURVE 0x813E2E KlASwSstSwWSw 16383.75 nmot_sw_q0p25 -8192.000 8191.750 FORMAT "%8.3"
 /begin AXIS_DESCR STD_AXIS ngfar_w nmotg_sw_q0p39 6 -12800.16 12799.77 FORMAT "%8.2" DEPOSIT ABSOLUTE /end AXIS_DESCR
/end CHARACTERISTIC
/begin CHARACTERISTIC DNSAH "Delta n SA high bezogen auf nWE" VALUE 0x810016 KwUb 5080. nmot_ub_q40 0.00 5080. FORMAT "%5.0" /end CHARACTERISTIC
/begin CHARACTERISTIC DNSAL "Delta n SA low bezogen auf nWE" VALUE 0x810017 KwUb 5080. nmot_ub_q40 0.00 5080. FORMAT "%5.0" /end CHARACTERISTIC
/begin CHARACTERISTIC DNSLL "Schubabschalte-Hysterese bei WE im Leerlauf" VALUE 0x810018 KwUb 10200. nmot_ub_q40 0.00 10200. FORMAT "%5.0" /end CHARACTERISTIC
/begin CHARACTERISTIC DNVSA "Schubabschaltedrehzahlanhebung bei kleiner Geschwindigkeit" VALUE 0x810019 KwUb 10200. nmot_ub_q40 0.00 10200. FORMAT "%5.0" /end CHARACTERISTIC
/begin CHARACTERISTIC DNWEK "Delta n für WE bei Klima (AC)" VALUE 0x81001A KwUb 10200. nmot_ub_q40 0.00 10200. FORMAT "%5.0" /end CHARACTERISTIC
/begin CHARACTERISTIC DRLANSKL "Hysteresis rl für Ansteuerung Ansaugklappe" VALUE 0x81A829 KwUb 191.3 rel_ub_q0p75 0.00 191.3 FORMAT "%5.1" /end CHARACTERISTIC
/begin CHARACTERISTIC DTAANSKL "Hysteresis Ansauglufttemperatur für Schaltbedingung Ansaugklappe" VALUE 0x81A82A KwUb 191.3 temp_ub_b191p25 0.00 191.3 FORMAT "%5.1" /end CHARACTERISTIC
/begin CHARACTERISTIC DTKATMN "Hysterese Katalysatortemperaturregelschwelle für Kat warmhalten" VALUE 0x81A3B3 KwUb 1275. temp_ub_q5_o50 -50.00 1225. FORMAT "%5.0" /end CHARACTERISTIC
/begin CHARACTERISTIC DTKH "Betrag Differenztemperatur (tans-tmst) für Katheizen" VALUE 0x81A3B4 KwUb 191.3 temp_ub_b191p25 0.00 191.3 FORMAT "%5.1" /end CHARACTERISTIC
/begin CHARACTERISTIC DTMABKH "Temperaturdifferenz zwischen Abstellen und Neustart für Freigabe Katheizen" VALUE 0x81A3B5 KwUb 191.3 temp_ub_b191p25 0.00 191.3 FORMAT "%5.1" /end CHARACTERISTIC
/begin CHARACTERISTIC DTUMTAT "Offset Ansauglufttemperatur -> Umgebungstemperatur" VALUE 0x81994A KwUb 191.3 temp_ub_b191p25 0.00 191.3 FORMAT "%5.1" /end CHARACTERISTIC
/begin CHARACTERISTIC DUDKNLPO "Toleranzband für NLP nach oben (inkl. Rü)" VALUE 0x8157CC KwUw 5.004090 spg_uw_q0p001222 0.00 5.004090 FORMAT "%8.6" /end CHARACTERISTIC
/begin CHARACTERISTIC DUDKNLPU "Toleranzband für NLP nach unten" VALUE 0x8157CE KwUw 5.004090 spg_uw_q0p001222 0.00 5.004090 FORMAT "%8.6" /end CHARACTERISTIC
/begin CHARACTERISTIC DUDKPTMP "Delta eines Rampenschrittes bei der temp. UMA-Adaption" VALUE 0x8157D0 KwUw 80.07888 spg_uw_q0p001222 0.004888000 80.08377 FORMAT "%8.5" /end CHARACTERISTIC
/begin CHARACTERISTIC DVAQUGMX "Max. zul. Geschw.differenz bei Aquaplaningerkennung für große Geschw." VALUE 0x815836 KwUw 511.9922 vfzg_uw_b512 0.00 511.9922 FORMAT "%8.4" /end CHARACTERISTIC
/begin CHARACTERISTIC DVAQUKMX "Max. zul. Geschw.differenz bei Aquaplaningerkennung für kleine Geschw." VALUE 0x815838 KwUw 511.9922 vfzg_uw_b512 0.00 511.9922 FORMAT "%8.4" /end CHARACTERISTIC
/begin CHARACTERISTIC DVEEST "Zeit für Heilungsversuch der DV-E-Endstufe" VALUE 0x81012E KwUb 2.550 t10msxs_ub_b2p55 0.00 2.550 FORMAT "%5.3" /end CHARACTERISTIC
/begin CHARACTERISTIC DVFGREO "Delta-Geschw. für obere FGR-Einschaltgeschwindigkeit" VALUE 0x81583A KwUw 511.9922 vfzg_uw_b512 0.00 511.9922 FORMAT "%8.4" /end CHARACTERISTIC
/begin CHARACTERISTIC DVFGREU "Delta-Geschw. für untere FGR-Einschaltgeschwindigkeit" VALUE 0x81583C KwUw 511.9922 vfzg_uw_b512 0.00 511.9922 FORMAT "%8.4" /end CHARACTERISTIC
/begin CHARACTERISTIC DVFZAR "Hysterese fuer Geschwindigkeitsschwelle bei AR" VALUE 0x81008D KwUb 318.8 vfzg_ub_q1p25 0.00 318.8 FORMAT "%5.1" /end CHARACTERISTIC
/begin CHARACTERISTIC DVIVZMX "Max. zul. Abweichung zw. Istgeschw. und Zielgeschw. bei FGR-Konstantfahrt" VALUE 0x81583E KwUw 511.9922 vfzg_uw_b512 0.00 511.9922 FORMAT "%8.4" /end CHARACTERISTIC
/begin CHARACTERISTIC DVSA "delta Geschwindigkeitsschwelle für SA-Drehzahlanhebung" VALUE 0x81001B KwUb 318.8 vfzg_ub_q1p25 0.00 318.8 FORMAT "%5.1" /end CHARACTERISTIC
/begin CHARACTERISTIC DVZVIMX "Max. zul. Abweichung zw. Zielgeschw. und Istgeschw. bei FGR-Konstantfahrt" VALUE 0x815840 KwUw 511.9922 vfzg_uw_b512 0.00 511.9922 FORMAT "%8.4" /end CHARACTERISTIC
/begin CHARACTERISTIC DWDKSBAMX "max. Soll-/Ist-DK-Winkel-Abweichung als f(dwdks)" CURVE 0x813E4C KlAUwSstUwWUw 100.0000 relDK_uw_b100 0.00 100.0000 FORMAT "%8.4"
 /begin AXIS_DESCR STD_AXIS dwdks_kge relDK_uw_b100 5 0.00 100.0000 FORMAT "%8.4" DEPOSIT ABSOLUTE /end AXIS_DESCR
/end CHARACTERISTIC
/begin CHARACTERISTIC DWDKSIKLS "Schwelle zur Aktivierung des I-Kleinanteils" VALUE 0x8142C2 KwSw 1599.976 relDK_q0p02441 -800.0000 799.9756 FORMAT "%8.4" /end CHARACTERISTIC
/begin CHARACTERISTIC ENASAG "Freigabe SA gangabhaengig" VALUE 0x81001C KwUb 255.0 dez 0.00 255.0 FORMAT "%5.1" /end CHARACTERISTIC
/begin CHARACTERISTIC FATMRML "Faktor fuer die Aufteilung Abgas-/Abgas-Rohrwandtemperatur" CURVE 0x81994B GklWUb 0.9961 fak_ub_b1 0.00 0.9961
 /begin AXIS_DESCR COM_AXIS ml_w m_uw_b6553p5 7 0.00 6553.500 AXIS_PTS_REF SML07TMUW /end AXIS_DESCR
/end CHARACTERISTIC
/begin CHARACTERISTIC FATMRML2 "Faktor fuer die Aufteilung Abgas-/Abgas-Rohrwandtemperatur Bank2" CURVE 0x819952 GklWUb 0.9961 fak_ub_b1 0.00 0.9961
 /begin AXIS_DESCR COM_AXIS ml_w m_uw_b6553p5 7 0.00 6553.500 AXIS_PTS_REF SML07TMUW /end AXIS_DESCR
/end CHARACTERISTIC
/begin CHARACTERISTIC FATMVM "Abgastemperaturaenderung abhaengig von der Fahrgeschwindigkeit" CURVE 0x819959 KlAUbSstUbWUb 0.9961 fak_ub_b1 0.00 0.9961
 /begin AXIS_DESCR STD_AXIS vfzg vfzg_ub_q1p25 6 0.00 318.8 FORMAT "%5.1" DEPOSIT ABSOLUTE /end AXIS_DESCR
/end CHARACTERISTIC
/begin CHARACTERISTIC FHOKH "minimaler Höhenfaktor für Katheizen" VALUE 0x81B88A KwUw 3.999939 fak_uw_b4 0.00 3.999939 FORMAT "%8.6" /end CHARACTERISTIC
/begin CHARACTERISTIC FKHABMN "Schwelle Abregelfaktor Katheizen" VALUE 0x81A3B6 KwUb 0.9961 fak_ub_b1 0.00 0.9961 /end CHARACTERISTIC
/begin CHARACTERISTIC FKHLA "Wichtungsfaktor Lambda-Soll für Katheizen" CURVE 0x81B88C KlAUwSstUwWUw 0.9999847 fak_uw_b1 0.00 0.9999847 FORMAT "%9.7"
 /begin AXIS_DESCR STD_AXIS imlpr_w fak_uw_b1 8 0.00 0.9999847 FORMAT "%9.7" DEPOSIT ABSOLUTE /end AXIS_DESCR
/end CHARACTERISTIC
/begin CHARACTERISTIC FKHLA2 "Wichtungsfaktor Lambda-Soll für Fzg. ohne Kat" CURVE 0x81B8AE KlAUwSstUwWUw 0.9999847 fak_uw_b1 0.00 0.9999847 FORMAT "%9.7"
 /begin AXIS_DESCR STD_AXIS imlpr_w fak_uw_b1 8 0.00 0.9999847 FORMAT "%9.7" DEPOSIT ABSOLUTE /end AXIS_DESCR
/end CHARACTERISTIC
/begin CHARACTERISTIC FKHMD "Wichtungsfaktor Drehmomentreserve für Katheizen" CURVE 0x81B8D0 KlAUwSstUwWUw 0.9999847 fak_uw_b1 0.00 0.9999847 FORMAT "%9.7"
 /begin AXIS_DESCR STD_AXIS imlpr_w fak_uw_b1 8 0.00 0.9999847 FORMAT "%9.7" DEPOSIT ABSOLUTE /end AXIS_DESCR
/end CHARACTERISTIC
/begin CHARACTERISTIC FKMSDKMN "min.Korrekturfaktor schneller Massenstromabgleich" VALUE 0x8109D5 KwUb 3.984 fak_ub_b4 0.00 3.984 FORMAT "%5.3" /end CHARACTERISTIC
/begin CHARACTERISTIC FKMSDKMX "max.Korrekturfaktor schneller Massenstromabgleich" VALUE 0x8109D6 KwUb 3.984 fak_ub_b4 0.00 3.984 FORMAT "%5.3" /end CHARACTERISTIC
/begin CHARACTERISTIC FKPVDKE "Initialisierungswert für Integrator Korrekturfaktor Massenstromabgleich" VALUE 0x81002A KwUb 3.984 fak_ub_b4 0.00 3.984 FORMAT "%5.3" /end CHARACTERISTIC
/begin CHARACTERISTIC FKPVDKMN "Minimaler Korrekturfaktor langsamer Massenstomabgleich" VALUE 0x81002B KwUb 3.984 fak_ub_b4 0.00 3.984 FORMAT "%5.3" /end CHARACTERISTIC
/begin CHARACTERISTIC FKPVDKMX "Maximaler Korrekturfaktor langsamer Massenstomabgleich" VALUE 0x81002C KwUb 3.984 fak_ub_b4 0.00 3.984 FORMAT "%5.3" /end CHARACTERISTIC
/begin CHARACTERISTIC FLRAG "Verstärkung Lastregler bei AT" CURVE 0x8196E6 GklWUb 15.94 fak_ub_b16 0.00 15.94 FORMAT "%5.2" /begin AXIS_DESCR COM_AXIS gangi dez 7 0.00 255.0 AXIS_PTS_REF SGA07MDUB /end AXIS_DESCR /end CHARACTERISTIC
/begin CHARACTERISTIC FLRAWG "Verstärkung Lastregler bei AT, WK geschlossen" CURVE 0x8196ED GklWUb 15.94 fak_ub_b16 0.00 15.94 FORMAT "%5.2" /begin AXIS_DESCR COM_AXIS gangi dez 7 0.00 255.0 AXIS_PTS_REF SGA07MDUB /end AXIS_DESCR /end CHARACTERISTIC
/begin CHARACTERISTIC FLRHG "Verstärkung Lastregler" CURVE 0x8196F4 GklWUb 15.94 fak_ub_b16 0.00 15.94 FORMAT "%5.2" /begin AXIS_DESCR COM_AXIS gangi dez 7 0.00 255.0 AXIS_PTS_REF SGA07MDUB /end AXIS_DESCR /end CHARACTERISTIC
/begin CHARACTERISTIC FPRAT "Ansauglufttemperaturschwelle für DV-E-Federprüfung" VALUE 0x811B39 KwUb 191.3 temp_ub_q0p75_o48 -48.00 143.3 FORMAT "%5.1" /end CHARACTERISTIC
/begin CHARACTERISTIC FPRMT "Motortemperaturschwelle für DV-E-Federprüfung" VALUE 0x811B3A KwUb 191.3 temp_ub_q0p75_o48 -48.00 143.3 FORMAT "%5.1" /end CHARACTERISTIC
/begin CHARACTERISTIC FPRNMAX "Motordrehzahlschwelle für DV-E-Federprüfung" VALUE 0x811B3B KwUb 2550. nmot_ub_q10 0.00 2550. FORMAT "%5.0" /end CHARACTERISTIC
/begin CHARACTERISTIC FPRTIM1_T "DV-E-Federprüfung, Wartezeit in Prüfschritt 1" VALUE 0x811B3C KwUb 2.540 t10msxs_ub_b2p55 0.01000 2.550 FORMAT "%5.3" /end CHARACTERISTIC
/begin CHARACTERISTIC FPRTIM2_T "DV-E-Federprüfung, Wartezeit in Prüfschritt 2" VALUE 0x811B3D KwUb 2.540 t10msxs_ub_b2p55 0.01000 2.550 FORMAT "%5.3" /end CHARACTERISTIC
/begin CHARACTERISTIC FRARAG "Verstärkungsfaktor bei AT" CURVE 0x8196FB GklWUb 3.113 fak_ub_b3p125 0.00 3.113 FORMAT "%5.3" /begin AXIS_DESCR COM_AXIS gangi dez 7 0.00 255.0 AXIS_PTS_REF SGA07MDUB /end AXIS_DESCR /end CHARACTERISTIC
/begin CHARACTERISTIC FRARAWG "Verstärkungsfaktor bei AT, WK geschlossen" CURVE 0x819702 GklWUb 3.113 fak_ub_b3p125 0.00 3.113 FORMAT "%5.3" /begin AXIS_DESCR COM_AXIS gangi dez 7 0.00 255.0 AXIS_PTS_REF SGA07MDUB /end AXIS_DESCR /end CHARACTERISTIC
/begin CHARACTERISTIC FRARHG "Verstärkungsfaktor" CURVE 0x819709 GklWUb 3.113 fak_ub_b3p125 0.00 3.113 FORMAT "%5.3" /begin AXIS_DESCR COM_AXIS gangi dez 7 0.00 255.0 AXIS_PTS_REF SGA07MDUB /end AXIS_DESCR /end CHARACTERISTIC
/begin CHARACTERISTIC FRLFSDP "Einspritzkorrektur bei RLFS" CURVE 0x81B6BC KlAUwSstSwWUw 1.999969 fak_uw_b2 0.00 1.999969 FORMAT "%8.6"
 /begin AXIS_DESCR STD_AXIS dpus_w p_sw_q0p078 11 -2560.000 2559.922 FORMAT "%8.3" DEPOSIT ABSOLUTE /end AXIS_DESCR
/end CHARACTERISTIC
/begin CHARACTERISTIC FTEADZU "Schwelle Beladung für Unterbrechung TE-Phase für Diagnose Funktionen" VALUE 0x81B6EE KwSw 127.9980 fak_sw_b64 -64.00000 63.99805 FORMAT "%8.5" /end CHARACTERISTIC
/begin CHARACTERISTIC FTEDS "Schwelle Beladung für Umschaltung auf Dauertankentlüftung" VALUE 0x81B6F0 KwSw 127.9980 fak_sw_b64 -64.00000 63.99805 FORMAT "%8.5" /end CHARACTERISTIC
/begin CHARACTERISTIC FTMLAKH "tmot-Korrektur der Lambda-Bewertung bei Katheizen" CURVE 0x81A3B7 KlAUbSstUbWUb 0.9961 fak_ub_b1 0.00 0.9961
 /begin AXIS_DESCR STD_AXIS tmot temp_ub_q0p75_o48 4 -48.00 143.3 FORMAT "%5.1" DEPOSIT ABSOLUTE /end AXIS_DESCR
/end CHARACTERISTIC
/begin CHARACTERISTIC FWMABGW "Faktor für Wärmemengen bei Wiederholstart für Taupunktende Abgas vor Vorkat" VALUE 0x819966 KwUb 0.9961 fak_ub_b1 0.00 0.9961 /end CHARACTERISTIC
/begin CHARACTERISTIC FWMABGW2 "Faktor für Wärmemengen bei Wiederholstart Abgas Bank2" VALUE 0x819967 KwUb 0.9961 fak_ub_b1 0.00 0.9961 /end CHARACTERISTIC
/begin CHARACTERISTIC FWMKATW "Faktor für Wärmemengen bei Wiederholstart für Taupunktende hinter Hauptkat" VALUE 0x819968 KwUb 0.9961 fak_ub_b1 0.00 0.9961 /end CHARACTERISTIC
/begin CHARACTERISTIC FWMKATW2 "Faktor für Wärmemengen bei Wiederholstart für Taupunktende hinter Hauptkat Bank2" VALUE 0x819969 KwUb 0.9961 fak_ub_b1 0.00 0.9961 /end CHARACTERISTIC
/begin CHARACTERISTIC GAFGRO "Max. zul. Gang bei FGR-Betrieb" VALUE 0x811B64 KwUb 255.0 dez 0.00 255.0 FORMAT "%5.1" /end CHARACTERISTIC
/begin CHARACTERISTIC GAFGRU "Min. zul. Gang bei FGR-Betrieb" VALUE 0x811B65 KwUb 255.0 dez 0.00 255.0 FORMAT "%5.1" /end CHARACTERISTIC
/begin CHARACTERISTIC IGESGA "Gesamt-Übersetzungsverhältnis" CURVE 0x811B31 FklWUb 25.50 fak_q0p1 0.00 25.50 FORMAT "%5.2"
 /begin AXIS_DESCR FIX_AXIS gangi dez 8 0.00 7.000 FORMAT "%5.3" FIX_AXIS_PAR 0 0 8 /end AXIS_DESCR
/end CHARACTERISTIC
/begin CHARACTERISTIC IKURUN "Schwelle Erkennung Kupplung rutscht negativ" CURVE 0x815790 GklWSw 511.9922 qnv_sw_q0p0078 -256.0000 255.9922 FORMAT "%8.4" /begin AXIS_DESCR COM_AXIS gangi dez 7 0.00 255.0 AXIS_PTS_REF SGA07MDUB /end AXIS_DESCR /end CHARACTERISTIC
/begin CHARACTERISTIC IKURUP "Schwelle Erkennung Kupplung rutscht positiv" CURVE 0x81579E GklWSw 511.9922 qnv_sw_q0p0078 -256.0000 255.9922 FORMAT "%8.4" /begin AXIS_DESCR COM_AXIS gangi dez 7 0.00 255.0 AXIS_PTS_REF SGA07MDUB /end AXIS_DESCR /end CHARACTERISTIC
/begin CHARACTERISTIC ILBHYSO "Integratorwert Batterieladebilanz Hysterese Oberwert" VALUE 0x81B39A KwSw 65535.00 dez -32768.00 32767.00 FORMAT "%8.2" /end CHARACTERISTIC
/begin CHARACTERISTIC ILBHYSU "Integratorwert Batterieladebilanz Hysterese Unterwert" VALUE 0x81B39C KwSw 65535.00 dez -32768.00 32767.00 FORMAT "%8.2" /end CHARACTERISTIC
/begin CHARACTERISTIC ILBINI "Integrator -Initialisierungwert Batterieladebilanz" VALUE 0x81B39E KwSw 65535.00 dez -32768.00 32767.00 FORMAT "%8.2" /end CHARACTERISTIC
/begin CHARACTERISTIC ILBMN "minimaler Integratorwert Batterieladebilanz" VALUE 0x81B3A0 KwSw 65535.00 dez -32768.00 32767.00 FORMAT "%8.2" /end CHARACTERISTIC
/begin CHARACTERISTIC ILBMX "maximaler Integratorwert Batterieladebilanz" VALUE 0x81B3A2 KwSw 65535.00 dez -32768.00 32767.00 FORMAT "%8.2" /end CHARACTERISTIC
/begin CHARACTERISTIC IMLKHMX "max. Verhältnisfaktor psum_w/mlsu für Einschaltung Katheizen" VALUE 0x81A3C0 KwUb 0.9961 fak_ub_b1 0.00 0.9961 /end CHARACTERISTIC
/begin CHARACTERISTIC IMLKHTMS "imlpr-Schwelle für Übergang auf Lambda-Katheizen" CURVE 0x815D2A KlAUbSstUbWUb 0.9961 fak_ub_b1 0.00 0.9961
 /begin AXIS_DESCR STD_AXIS tmst temp_ub_q0p75_o48 8 -48.00 143.3 FORMAT "%5.1" DEPOSIT ABSOLUTE /end AXIS_DESCR
/end CHARACTERISTIC
/begin CHARACTERISTIC IMLKS "Schwelle für integrierten Luftmassenstrom für Erkennung Benzin im Öl" VALUE 0x811B72 KwUb 23.21 m_ub_b23p3 0.00 23.21 FORMAT "%5.2" /end CHARACTERISTIC
/begin CHARACTERISTIC IMTUMTAT "Schwelle integrierte Luftmasse für Bestimmung Umgebungstemperatur aus TANS" VALUE 0x81B19C KwUw 23.30133 m_uw_b23p3 0.00 23.30133 FORMAT "%8.5" /end CHARACTERISTIC
/begin CHARACTERISTIC KDLRIDDVE "Identifizierung des DLR-Parametersatzes zu DV-E-Typ" VALUE 0x81971E KwUb 255.0 dez 0.00 255.0 FORMAT "%5.1" /end CHARACTERISTIC
/begin CHARACTERISTIC KFANSKL "Kennfeld für Ansaugklappe" MAP 0x81A82B KfAxUbAyUbSstxUbSstyUbWUb 191.3 rel_ub_q0p75 0.00 191.3 FORMAT "%5.1"
 /begin AXIS_DESCR STD_AXIS nmot nmot_ub_q40 6 0.00 10200. FORMAT "%5.0" DEPOSIT ABSOLUTE /end AXIS_DESCR
 /begin AXIS_DESCR STD_AXIS rl rel_ub_q0p75 6 0.00 191.3 FORMAT "%5.1" DEPOSIT ABSOLUTE /end AXIS_DESCR
/end CHARACTERISTIC
/begin CHARACTERISTIC KFATMLA "Kennfeld Abgastemperatur-Korrektur = f(Lambda)" MAP 0x81996A GkfWSb 1275. temp_q5 -640.0 635.0 FORMAT "%5.1" /begin AXIS_DESCR COM_AXIS ml m_ub_b1020 6 0.00 1020. AXIS_PTS_REF SML06TMUB /end AXIS_DESCR
 /begin AXIS_DESCR COM_AXIS lamsons_w fak_uw_b16 6 0.00 15.99976 AXIS_PTS_REF SLX06TMUW /end AXIS_DESCR
/end CHARACTERISTIC
/begin CHARACTERISTIC KFATMLA2 "Kennfeld Abgastemperatur-Korrektur = f(lambda) Bank2" MAP 0x81998E GkfWSb 1275. temp_q5 -640.0 635.0 FORMAT "%5.1" /begin AXIS_DESCR COM_AXIS ml m_ub_b1020 6 0.00 1020. AXIS_PTS_REF SML06TMUB /end AXIS_DESCR
 /begin AXIS_DESCR COM_AXIS lamsons2_w fak_uw_b16 6 0.00 15.99976 AXIS_PTS_REF SLY06TMUW /end AXIS_DESCR
/end CHARACTERISTIC
/begin CHARACTERISTIC KFATMLAE "Kennfeld Kat-Exotherme für Kattemperatur = f(Lambda)" MAP 0x8199B2 GkfWSb 1275. temp_q5 -640.0 635.0 FORMAT "%5.1" /begin AXIS_DESCR COM_AXIS ml m_ub_b1020 6 0.00 1020. AXIS_PTS_REF SML06TMUB /end AXIS_DESCR
 /begin AXIS_DESCR COM_AXIS lamsons_w fak_uw_b16 6 0.00 15.99976 AXIS_PTS_REF SLX06TMUW /end AXIS_DESCR
/end CHARACTERISTIC
/begin CHARACTERISTIC KFATMLAE2 "Kennfeld Kat-Exotherme für Kattemperatur = f(Lambda) Bank2" MAP 0x8199D6 GkfWSb 1275. temp_q5 -640.0 635.0 FORMAT "%5.1" /begin AXIS_DESCR COM_AXIS ml m_ub_b1020 6 0.00 1020. AXIS_PTS_REF SML06TMUB /end AXIS_DESCR
 /begin AXIS_DESCR COM_AXIS lamsons2_w fak_uw_b16 6 0.00 15.99976 AXIS_PTS_REF SLY06TMUW /end AXIS_DESCR
/end CHARACTERISTIC
/begin CHARACTERISTIC KFATMZW "Kennfeld Abgastemperatur-Korrektur = f(Zündwinkelverstellung)" MAP 0x8199FA GkfWSb 1275. temp_q5 -640.0 635.0 FORMAT "%5.1" /begin AXIS_DESCR COM_AXIS ml m_ub_b1020 6 0.00 1020. AXIS_PTS_REF SML06TMUB /end AXIS_DESCR
 /begin AXIS_DESCR COM_AXIS etazwimt rel_ub_b127p5 6 0.00 127.5 AXIS_PTS_REF SEZ06TMUB /end AXIS_DESCR
/end CHARACTERISTIC
/begin CHARACTERISTIC KFATMZW2 "Kennfeld Abgastemperatur-Korrektur = f(Zündwinkel) Bank2" MAP 0x819A1E GkfWSb 1275. temp_q5 -640.0 635.0 FORMAT "%5.1" /begin AXIS_DESCR COM_AXIS ml m_ub_b1020 6 0.00 1020. AXIS_PTS_REF SML06TMUB /end AXIS_DESCR
 /begin AXIS_DESCR COM_AXIS etazwimt rel_ub_b127p5 6 0.00 127.5 AXIS_PTS_REF SEZ06TMUB /end AXIS_DESCR
/end CHARACTERISTIC
/begin CHARACTERISTIC KFATMZWE "Kennfeld Kat-Exotherme für Kattemperatur = f(etazwist)" MAP 0x819A42 GkfWSb 1275. temp_q5 -640.0 635.0 FORMAT "%5.1" /begin AXIS_DESCR COM_AXIS ml m_ub_b1020 6 0.00 1020. AXIS_PTS_REF SML06TMUB /end AXIS_DESCR
 /begin AXIS_DESCR COM_AXIS etazwimt rel_ub_b127p5 6 0.00 127.5 AXIS_PTS_REF SEZ06TMUB /end AXIS_DESCR
/end CHARACTERISTIC
/begin CHARACTERISTIC KFDILU "Kennfeld delta Integratorwert Batterieladebilanz abh. von" MAP 0x81B3A4 KfAxUbAyUbSstxUbSstyUbWSb 255.0 dez -128.0 127.0 FORMAT "%5.1"
 /begin AXIS_DESCR STD_AXIS ub spg_ubatt 6 0.00 24.02 FORMAT "%5.2" DEPOSIT ABSOLUTE /end AXIS_DESCR
 /begin AXIS_DESCR STD_AXIS tumg temp_ub_q0p75_o48 6 -48.00 143.3 FORMAT "%5.1" DEPOSIT ABSOLUTE /end AXIS_DESCR
/end CHARACTERISTIC
/begin CHARACTERISTIC KFMSNWDK "Kennfeld normierter Massenstrom über DK" MAP 0x8136A6 KfAxUwAyUwSstxUwSstyUwWUw 6553.500 m_uw_b6553p5 0.00 6553.500 FORMAT "%8.3"
 /begin AXIS_DESCR STD_AXIS wdkbab_w rel_uw_b100 16 0.00 99.99847 FORMAT "%8.5" DEPOSIT ABSOLUTE /end AXIS_DESCR
 /begin AXIS_DESCR STD_AXIS nmot_w nmot_uw_q0p25 6 0.00 16383.75 FORMAT "%8.2" DEPOSIT ABSOLUTE /end AXIS_DESCR
/end CHARACTERISTIC
/begin CHARACTERISTIC KFTATM "Kennfeld Abgastemperatur   f(nmot,rl)" MAP 0x819A66 KfAxUbAyUbSstxUbSstyUbWUb 1275. temp_ub_q5_o50 -50.00 1225. FORMAT "%5.0"
 /begin AXIS_DESCR STD_AXIS nmot nmot_ub_q40 8 0.00 10200. FORMAT "%5.0" DEPOSIT ABSOLUTE /end AXIS_DESCR
 /begin AXIS_DESCR STD_AXIS rl rel_ub_q0p75 8 0.00 191.3 FORMAT "%5.1" DEPOSIT ABSOLUTE /end AXIS_DESCR
/end CHARACTERISTIC
/begin CHARACTERISTIC KFTATM2 "Kennfeld Abgastemperatur f(nmot,rl) Bank2" MAP 0x819AB8 KfAxUbAyUbSstxUbSstyUbWUb 1275. temp_ub_q5_o50 -50.00 1225. FORMAT "%5.0"
 /begin AXIS_DESCR STD_AXIS nmot nmot_ub_q40 8 0.00 10200. FORMAT "%5.0" DEPOSIT ABSOLUTE /end AXIS_DESCR
 /begin AXIS_DESCR STD_AXIS rl rel_ub_q0p75 8 0.00 191.3 FORMAT "%5.1" DEPOSIT ABSOLUTE /end AXIS_DESCR
/end CHARACTERISTIC
/begin CHARACTERISTIC KFTEVP "Kennfeld Periodendauer TEV" MAP 0x819560 KfAxUbAyUbSstxUbSstyUbWUb 127.5 t500usxms_ub_q0p5 0.00 127.5 FORMAT "%5.1"
 /begin AXIS_DESCR STD_AXIS nmot nmot_ub_q40 5 0.00 10200. FORMAT "%5.0" DEPOSIT ABSOLUTE /end AXIS_DESCR
 /begin AXIS_DESCR STD_AXIS tatesoll rel_ub_b99p6 9 0.00 99.61 FORMAT "%5.2" DEPOSIT ABSOLUTE /end AXIS_DESCR
/end CHARACTERISTIC
/begin CHARACTERISTIC KFTVSA "Verzögerungszeit für Schubabschalten" MAP 0x81900B GkfWUb 5.100 t20msxs_ub_b5p1 0.00 5.100 FORMAT "%5.3"
 /begin AXIS_DESCR COM_AXIS tmot temp_ub_q0p75_o48 5 -48.00 143.3 AXIS_PTS_REF STM05SAUB /end AXIS_DESCR
 /begin AXIS_DESCR COM_AXIS nmot nmot_ub_q40 8 0.00 10200. AXIS_PTS_REF SNM08__UB /end AXIS_DESCR
/end CHARACTERISTIC
/begin CHARACTERISTIC KFTVSALR "Verzögerungszeit für Schubabschalten mit Getriebe im Low-Range" MAP 0x819033 GkfWUb 5.100 t20msxs_ub_b5p1 0.00 5.100 FORMAT "%5.3"
 /begin AXIS_DESCR COM_AXIS tmot temp_ub_q0p75_o48 5 -48.00 143.3 AXIS_PTS_REF STM05SAUB /end AXIS_DESCR
 /begin AXIS_DESCR COM_AXIS nmot nmot_ub_q40 8 0.00 10200. AXIS_PTS_REF SNM08__UB /end AXIS_DESCR
/end CHARACTERISTIC
/begin CHARACTERISTIC KFTVSAM "Verzögerungszeit für Schubabschalten" MAP 0x81905B GkfWUb 5.100 t20msxs_ub_b5p1 0.00 5.100 FORMAT "%5.3"
 /begin AXIS_DESCR COM_AXIS tmot temp_ub_q0p75_o48 5 -48.00 143.3 AXIS_PTS_REF STM05SAUB /end AXIS_DESCR
 /begin AXIS_DESCR COM_AXIS nmot nmot_ub_q40 8 0.00 10200. AXIS_PTS_REF SNM08__UB /end AXIS_DESCR
/end CHARACTERISTIC
/begin CHARACTERISTIC KFTVSAMLR "Verzögerungszeit für Schubabschalten mit Gertiebe im Low-Range" MAP 0x819083 GkfWUb 5.100 t20msxs_ub_b5p1 0.00 5.100 FORMAT "%5.3"
 /begin AXIS_DESCR COM_AXIS tmot temp_ub_q0p75_o48 5 -48.00 143.3 AXIS_PTS_REF STM05SAUB /end AXIS_DESCR
 /begin AXIS_DESCR COM_AXIS nmot nmot_ub_q40 8 0.00 10200. AXIS_PTS_REF SNM08__UB /end AXIS_DESCR
/end CHARACTERISTIC
/begin CHARACTERISTIC KFWMABG "Kennfeld für Wärmemengen-Schwellwert Taupunktende Abgas" MAP 0x81B19E GkfWUw 29695.55 q_uw_q0p45 0.00 29695.55 FORMAT "%8.2"
 /begin AXIS_DESCR COM_AXIS tabgmst temp_ub_q5_o50 7 -50.00 1225. AXIS_PTS_REF ST107TMUB /end AXIS_DESCR
 /begin AXIS_DESCR COM_AXIS tmst temp_ub_q0p75_o48 5 -48.00000 49103.25 AXIS_PTS_REF STM05TMUB /end AXIS_DESCR
/end CHARACTERISTIC
/begin CHARACTERISTIC KFWMABG2 "Kennfeld für Wärmemengen-Schwellwert Taupunktende Abgas Bank2" MAP 0x81B1E4 GkfWUw 29695.55 q_uw_q0p45 0.00 29695.55 FORMAT "%8.2"
 /begin AXIS_DESCR COM_AXIS tabgmst2 temp_ub_q5_o50 7 -50.00 1225. AXIS_PTS_REF ST207TMUB /end AXIS_DESCR
 /begin AXIS_DESCR COM_AXIS tmst temp_ub_q0p75_o48 5 -48.00000 49103.25 AXIS_PTS_REF STM05TMUB /end AXIS_DESCR
/end CHARACTERISTIC
/begin CHARACTERISTIC KFWMKAT "Kennfeld für Wärmemengen-Schwellwert Taupunktende hinter Kat" MAP 0x81B22A GkfWUw 29695.55 q_uw_q0p45 0.00 29695.55 FORMAT "%8.2"
 /begin AXIS_DESCR COM_AXIS tkatmst temp_ub_q5_o50 7 -50.00 1225. AXIS_PTS_REF ST307TMUB /end AXIS_DESCR
 /begin AXIS_DESCR COM_AXIS tmst temp_ub_q0p75_o48 5 -48.00000 49103.25 AXIS_PTS_REF STM05TMUB /end AXIS_DESCR
/end CHARACTERISTIC
/begin CHARACTERISTIC KFWMKAT2 "Kennfeld für Wärmemengen-Schwellwert Taupunktende hinter Kat Bank2" MAP 0x81B270 GkfWUw 29695.55 q_uw_q0p45 0.00 29695.55 FORMAT "%8.2"
 /begin AXIS_DESCR COM_AXIS tkatmst2 temp_ub_q5_o50 7 -50.00 1225. AXIS_PTS_REF ST407TMUB /end AXIS_DESCR
 /begin AXIS_DESCR COM_AXIS tmst temp_ub_q0p75_o48 5 -48.00000 49103.25 AXIS_PTS_REF STM05TMUB /end AXIS_DESCR
/end CHARACTERISTIC
/begin CHARACTERISTIC KIFZGAG "Integratorverstärkung des Fahrzeugmodells bei AT" CURVE 0x81AC1A GklWUw 4863.926 fak_uw_b4864 0.00 4863.926 FORMAT "%8.3" /begin AXIS_DESCR COM_AXIS gangi dez 7 0.00 255.0 AXIS_PTS_REF SGA07MDUB /end AXIS_DESCR /end CHARACTERISTIC
/begin CHARACTERISTIC KIFZGAWG "Integratorverstärkung des Fahrzeugmodells bei AT, geschlossene WK" CURVE 0x81AC28 GklWUw 4863.926 fak_uw_b4864 0.00 4863.926 FORMAT "%8.3" /begin AXIS_DESCR COM_AXIS gangi dez 7 0.00 255.0 AXIS_PTS_REF SGA07MDUB /end AXIS_DESCR /end CHARACTERISTIC
/begin CHARACTERISTIC KIFZGHG "Integratorverstärkung des Fahrzeugmodells bei HG" CURVE 0x81AC36 GklWUw 4863.926 fak_uw_b4864 0.00 4863.926 FORMAT "%8.3" /begin AXIS_DESCR COM_AXIS gangi dez 7 0.00 255.0 AXIS_PTS_REF SGA07MDUB /end AXIS_DESCR /end CHARACTERISTIC
/begin CHARACTERISTIC KIMSA "Beiwert für Leerlaufluftmassenintegrator für E-Gas" VALUE 0x8190BC KwUb 0.1660 m_ub_b0p166 0.00 0.1660 FORMAT "%6.4" /end CHARACTERISTIC
/begin CHARACTERISTIC KIMSALL "Beiwert für Leerlaufluftmassenintegrator für E-Gas" VALUE 0x8190BD KwUb 10.58 m_ub_q0p0415 0.00 10.58 FORMAT "%5.2" /end CHARACTERISTIC
/begin CHARACTERISTIC KLAF "Ausflußkennlinie" CURVE 0x813796 FklWUw 0.9999847 fak_uw_b1 0.00 0.9999847 FORMAT "%9.7"
 /begin AXIS_DESCR FIX_AXIS klaf_kge fak_uw_q0p001 501 0.5000000 1.000000 FORMAT "%8.6" FIX_AXIS_PAR 500 0 501 /end AXIS_DESCR
/end CHARACTERISTIC
/begin CHARACTERISTIC KRKTE "Umrechnung relative Kraftstoffmasse rk in effektive Einspritzzeit te" VALUE 0x819DD3 KwUb 0.5440 rkti_sy 0.00 0.5440 /end CHARACTERISTIC
/begin CHARACTERISTIC KTNDMRKH "Int.-Konstante für Anforderung Drehmomentenreserve Katheizen" VALUE 0x81B8F2 KwUw 0.9999847 fak_uw_b1 0.00 0.9999847 FORMAT "%9.7" /end CHARACTERISTIC
/begin CHARACTERISTIC KUMSRL "Umrechnungskonstante von Massenstrom in relative Luftfüllung" VALUE 0x81002D KwUb 0.001992 kumsrl_ub_b0p002 0.00 0.001992 FORMAT "%8.6" /end CHARACTERISTIC
/begin CHARACTERISTIC KVLAD "Konstante für Umrechnung von Ladedruck in Luftmasse" VALUE 0x81002E KwUb 1.992 rel_ub_b2p0 0.00 1.992 FORMAT "%5.3" /end CHARACTERISTIC
/begin CHARACTERISTIC LADFIL "Ladedruckfilterung" VALUE 0x81002F KwUb 0.9961 fak_ub_b1 0.00 0.9961 /end CHARACTERISTIC
/begin CHARACTERISTIC LRNST1_T "Wartezeit in Lernschritt 1" VALUE 0x811B3E KwUb 5.080 t20msxs_ub_b5p1 0.02000 5.100 FORMAT "%5.3" /end CHARACTERISTIC
/begin CHARACTERISTIC LRNST3_T "Wartezeit in Lernschritt 3" VALUE 0x811B3F KwUb 5.080 t20msxs_ub_b5p1 0.02000 5.100 FORMAT "%5.3" /end CHARACTERISTIC
/begin CHARACTERISTIC LRNST7_T "Wartezeit in Lernschritt 7" VALUE 0x811B40 KwUb 5.080 t20msxs_ub_b5p1 0.02000 5.100 FORMAT "%5.3" /end CHARACTERISTIC
/begin CHARACTERISTIC LRNST9_T "Wartezeit in Lernschritt 9" VALUE 0x811B41 KwUb 5.080 t20msxs_ub_b5p1 0.02000 5.100 FORMAT "%5.3" /end CHARACTERISTIC
/begin CHARACTERISTIC LRNVB_T "Lernverbotszeit für 'normales Lernen'" VALUE 0x8157D2 KwUw 1310.700 t20msxs_uw_q0p02 0.00 1310.700 FORMAT "%8.3" /end CHARACTERISTIC
/begin CHARACTERISTIC LRNVB_TDI "Lernverbotszeit für 'Lernen per Diagnose'" VALUE 0x8157D4 KwUw 1310.700 t20msxs_uw_q0p02 0.00 1310.700 FORMAT "%8.3" /end CHARACTERISTIC
/begin CHARACTERISTIC MDIAGMX "Festwert max. erlaubtes ind. Motormoment (bei AG) bei CAN-Timeout" VALUE 0x811EF4 KwUb 99.61 rel_ub_b99p6 0.00 99.61 FORMAT "%5.2" /end CHARACTERISTIC
/begin CHARACTERISTIC MDITXUMX "Festwert max. erlaubtes ind. Motormoment (bei TXU) bei CAN-Timeout" VALUE 0x811EF5 KwUb 99.61 rel_ub_b99p6 0.00 99.61 FORMAT "%5.2" /end CHARACTERISTIC
/begin CHARACTERISTIC MLFKMSDK "Luftmassenstromschwelle für multipl. Abgleich von HFM- und DK-Massenstrom" VALUE 0x81425C KwUw 6553.500 m_uw_b6553p5 0.00 6553.500 FORMAT "%8.3" /end CHARACTERISTIC
/begin CHARACTERISTIC MLKHMX "max. Luftmasse für Katheizen" VALUE 0x81A3C1 KwUb 1020. m_ub_b1020 0.00 1020. FORMAT "%5.0" /end CHARACTERISTIC
/begin CHARACTERISTIC MLSUS "Sollwert Luftmassen-Integral für motorisches Katheizen" CURVE 0x81A3C2 KlAUbSstUbWUb 5.803 m_ub_b5p8 0.00 5.803 FORMAT "%5.3"
 /begin AXIS_DESCR STD_AXIS tmst temp_ub_q0p75_o48 12 -48.00 143.3 FORMAT "%5.1" DEPOSIT ABSOLUTE /end AXIS_DESCR
/end CHARACTERISTIC
/begin CHARACTERISTIC MLSUS2 "Sollwert Luftmassen Integral für Fzg. ohne Kat" CURVE 0x81A3DB KlAUbSstUbWUb 5.803 m_ub_b5p8 0.00 5.803 FORMAT "%5.3"
 /begin AXIS_DESCR STD_AXIS tmst temp_ub_q0p75_o48 12 -48.00 143.3 FORMAT "%5.1" DEPOSIT ABSOLUTE /end AXIS_DESCR
/end CHARACTERISTIC
/begin CHARACTERISTIC MSALLMN "Minimale Leerlaufluftmassenadaption für E-Gas" VALUE 0x8109D7 KwUb 25.50 m_ub_q0p1 0.00 25.50 FORMAT "%5.2" /end CHARACTERISTIC
/begin CHARACTERISTIC MSALLMX "Maximale Leerlaufluftmassenadaption für E-Gas" VALUE 0x8109D8 KwUb 25.50 m_ub_q0p1 0.00 25.50 FORMAT "%5.2" /end CHARACTERISTIC
/begin CHARACTERISTIC MSLG "Massenstrom Leckluft gesamt" VALUE 0x8109D9 KwUb 25.50 m_ub_q0p1 0.00 25.50 FORMAT "%5.2" /end CHARACTERISTIC
/begin CHARACTERISTIC NARA "Drehzahlschwelle für Antiruckelfunktion" VALUE 0x81008E KwUb 10200. nmot_ub_q40 0.00 10200. FORMAT "%5.0" /end CHARACTERISTIC
/begin CHARACTERISTIC NARASTG "Drehzahlschwelle in hoeherem Gang fuer AR aktiv" CURVE 0x810B13 KlAUbSstUbWUb 10200. nmot_ub_q40 0.00 10200. FORMAT "%5.0"
 /begin AXIS_DESCR STD_AXIS gangi dez 6 0.00 255.0 FORMAT "%5.1" DEPOSIT ABSOLUTE /end AXIS_DESCR
/end CHARACTERISTIC
/begin CHARACTERISTIC NARLL "Drehzahlschwelle für AR im Leerlauf" VALUE 0x81008F KwUb 10200. nmot_ub_q40 0.00 10200. FORMAT "%5.0" /end CHARACTERISTIC
/begin CHARACTERISTIC NFGRMAX "Max. zul. Drehzahl bei FGR-Betrieb" VALUE 0x811B66 KwUb 10200. nmot_ub_q40 0.00 10200. FORMAT "%5.0" /end CHARACTERISTIC
/begin CHARACTERISTIC NFSKHM "LL-Solldrehzahl mit Fahrstufe und Katheizen" CURVE 0x81A3F4 GklWUb 2550. nmot_ub_q10 0.00 2550. FORMAT "%5.0"
 /begin AXIS_DESCR COM_AXIS tmot temp_ub_q0p75_o48 4 -48.00 143.3 AXIS_PTS_REF STM04__UB /end AXIS_DESCR
/end CHARACTERISTIC
/begin CHARACTERISTIC NFSKHM2 "LL-Solldrehzahl mit Fahrstufe bei Fzg. ohne Kat" CURVE 0x81A3F8 GklWUb 2550. nmot_ub_q10 0.00 2550. FORMAT "%5.0"
 /begin AXIS_DESCR COM_AXIS tmot temp_ub_q0p75_o48 4 -48.00 143.3 AXIS_PTS_REF STM04__UB /end AXIS_DESCR
/end CHARACTERISTIC
/begin CHARACTERISTIC NGANGMIN "Schwelle fuer Gangerkennung, Mindestwert PLausibilitaetstest" VALUE 0x8157AE KwUw 16383.75 nmot_uw_q0p25 0.00 16383.75 FORMAT "%8.2" /end CHARACTERISTIC
/begin CHARACTERISTIC NGDNSA "Drehzahlgradient beim Absteuern der Schubabschalthysterese" VALUE 0x814018 KwSw 10239.84 nmotg_sw_q0p15625 -5120.000 5119.844 FORMAT "%8.3" /end CHARACTERISTIC
/begin CHARACTERISTIC NLLKHM "Leerlaufsolldrehzahl bei Kat.-Heizung" CURVE 0x81A3FC GklWUb 2550. nmot_ub_q10 0.00 2550. FORMAT "%5.0"
 /begin AXIS_DESCR COM_AXIS tmot temp_ub_q0p75_o48 4 -48.00 143.3 AXIS_PTS_REF STM04__UB /end AXIS_DESCR
/end CHARACTERISTIC
/begin CHARACTERISTIC NLLKHM2 "Leerlaufsolldrehzahl für Fzg. ohne Kat" CURVE 0x81A400 GklWUb 2550. nmot_ub_q10 0.00 2550. FORMAT "%5.0"
 /begin AXIS_DESCR COM_AXIS tmot temp_ub_q0p75_o48 4 -48.00 143.3 AXIS_PTS_REF STM04__UB /end AXIS_DESCR
/end CHARACTERISTIC
/begin CHARACTERISTIC NLLKT "Leerlaufsolldrehzahl bei Kurztest Sekundärluftdiagnose" VALUE 0x81A404 KwUb 2550. nmot_ub_q10 0.00 2550. FORMAT "%5.0" /end CHARACTERISTIC
/begin CHARACTERISTIC NLPST1T "Wartezeit 1 im NLP-Lernen" VALUE 0x811B42 KwUb 2.540 t10msxs_ub_b2p55 0.01000 2.550 FORMAT "%5.3" /end CHARACTERISTIC
/begin CHARACTERISTIC NLPST2T "Wartezeit 2 im NLP-Lernen" VALUE 0x811B43 KwUb 2.540 t10msxs_ub_b2p55 0.01000 2.550 FORMAT "%5.3" /end CHARACTERISTIC
/begin CHARACTERISTIC NMSNDKO "Drehzahlschwelle für Integratorfreigabe zur Adaption der Leckluft" VALUE 0x8109DA KwUb 10200. nmot_ub_q40 0.00 10200. FORMAT "%5.0" /end CHARACTERISTIC
/begin CHARACTERISTIC NMXSKA "Maximaldrehzahl bei unbekannter Drosselklappenposition -> Ev-Abschaltung" VALUE 0x810060 KwUb 10200. nmot_ub_q40 0.00 10200. FORMAT "%5.0" /end CHARACTERISTIC
/begin CHARACTERISTIC NNST "Drehzahlübergang Normal -> Start" VALUE 0x814D08 DI__Kwuw__________ 8000.000 NQ1_W 0.00 8000.000 FORMAT "%8.3" /end CHARACTERISTIC
/begin CHARACTERISTIC NNSTA "Drehzahlübergang Normal -> Start" CURVE 0x81A6F9 KlAUbSstUbWUb 10200. nmot_ub_q40 0.00 10200. FORMAT "%5.0"
 /begin AXIS_DESCR STD_AXIS tans temp_ub_q0p75_o48 3 -48.00 143.3 FORMAT "%5.1" DEPOSIT ABSOLUTE /end AXIS_DESCR
/end CHARACTERISTIC
/begin CHARACTERISTIC NSTNM "Übergang Start -> Normal" CURVE 0x81A700 KlAUbSstUbWUb 10200. nmot_ub_q40 0.00 10200. FORMAT "%5.0"
 /begin AXIS_DESCR STD_AXIS tmot temp_ub_q0p75_o48 3 -48.00 143.3 FORMAT "%5.1" DEPOSIT ABSOLUTE /end AXIS_DESCR
/end CHARACTERISTIC
/begin CHARACTERISTIC NSUBO "nsoll bei Batterieladebilanz zu niedrig" VALUE 0x819BE7 KwUb 2550. nmot_ub_q10 0.00 2550. FORMAT "%5.0" /end CHARACTERISTIC
/begin CHARACTERISTIC NSUBU "nsoll bei Batterieladebilanz iO" VALUE 0x819BE8 KwUb 2550. nmot_ub_q10 0.00 2550. FORMAT "%5.0" /end CHARACTERISTIC
/begin CHARACTERISTIC NTAREIN "Sperrzeit für Antiruckelfunktion" CURVE 0x810B20 KlAUbSstUbWUb 2.550 t10msxs_ub_b2p55 0.00 2.550 FORMAT "%5.3"
 /begin AXIS_DESCR STD_AXIS nmot nmot_ub_q40 5 0.00 10200. FORMAT "%5.0" DEPOSIT ABSOLUTE /end AXIS_DESCR
/end CHARACTERISTIC
/begin CHARACTERISTIC NTUMTAT "Schwelle Drehzahl für Bestimmung Umgebungstemperatur aus TANS" VALUE 0x819B0A KwUb 10200. nmot_ub_q40 0.00 10200. FORMAT "%5.0" /end CHARACTERISTIC
/begin CHARACTERISTIC NUEMAX "Motorüberdrehzahlgrenzwert" VALUE 0x813FFE KwUw 16383.75 nmot_uw_q0p25 0.00 16383.75 FORMAT "%8.2" /end CHARACTERISTIC
/begin CHARACTERISTIC NVQUOT1O "Gangerkennung n/v 1 Gang oben" VALUE 0x8157B0 KwUw 511.9922 qnv_uw_b512 0.00 511.9922 FORMAT "%8.4" /end CHARACTERISTIC
/begin CHARACTERISTIC NVQUOT1U "Gangerekennung n/v 1 Gang unten" VALUE 0x8157B2 KwUw 511.9922 qnv_uw_b512 0.00 511.9922 FORMAT "%8.4" /end CHARACTERISTIC
/begin CHARACTERISTIC NVQUOT2O "Gangerkennung n/v 2 Gang oben" VALUE 0x8157B4 KwUw 511.9922 qnv_uw_b512 0.00 511.9922 FORMAT "%8.4" /end CHARACTERISTIC
/begin CHARACTERISTIC NVQUOT2U "Gangerkennung n/v 2 Gang unten" VALUE 0x8157B6 KwUw 511.9922 qnv_uw_b512 0.00 511.9922 FORMAT "%8.4" /end CHARACTERISTIC
/begin CHARACTERISTIC NVQUOT3O "Gangerkennung n/v 3 Gang oben" VALUE 0x8157B8 KwUw 511.9922 qnv_uw_b512 0.00 511.9922 FORMAT "%8.4" /end CHARACTERISTIC
/begin CHARACTERISTIC NVQUOT3U "Gangerkennung n/v 3 Gang unten" VALUE 0x8157BA KwUw 511.9922 qnv_uw_b512 0.00 511.9922 FORMAT "%8.4" /end CHARACTERISTIC
/begin CHARACTERISTIC NVQUOT4O "Gangerkennung n/v 4 Gang oben" VALUE 0x8157BC KwUw 511.9922 qnv_uw_b512 0.00 511.9922 FORMAT "%8.4" /end CHARACTERISTIC
/begin CHARACTERISTIC NVQUOT4U "Gangerkennung n/v 4 Gang unten" VALUE 0x8157BE KwUw 511.9922 qnv_uw_b512 0.00 511.9922 FORMAT "%8.4" /end CHARACTERISTIC
/begin CHARACTERISTIC NVQUOT5O "Gangerkennung n/v 5 Gang oben" VALUE 0x8157C0 KwUw 511.9922 qnv_uw_b512 0.00 511.9922 FORMAT "%8.4" /end CHARACTERISTIC
/begin CHARACTERISTIC NVQUOT5U "Gangerkennung n/v 5 Gang unten" VALUE 0x8157C2 KwUw 511.9922 qnv_uw_b512 0.00 511.9922 FORMAT "%8.4" /end CHARACTERISTIC
/begin CHARACTERISTIC NVQUOT6O "Gangerkennung n/v 6 Gang oben" VALUE 0x8157C4 KwUw 511.9922 qnv_uw_b512 0.00 511.9922 FORMAT "%8.4" /end CHARACTERISTIC
/begin CHARACTERISTIC NVQUOT6U "Gangerkennung n/v 6 Gang unten" VALUE 0x8157C6 KwUw 511.9922 qnv_uw_b512 0.00 511.9922 FORMAT "%8.4" /end CHARACTERISTIC
/begin CHARACTERISTIC NWEM "Wiedereinsetzdrehzahl" CURVE 0x8190AB GklWUb 10200. nmot_ub_q40 0.00 10200. FORMAT "%5.0"
 /begin AXIS_DESCR COM_AXIS tmot temp_ub_q0p75_o48 5 -48.00 143.3 AXIS_PTS_REF STM05SAUB /end AXIS_DESCR
/end CHARACTERISTIC
/begin CHARACTERISTIC NWENG "Wiedereinsetzdrehzahl" CURVE 0x813280 KlAUbSstSbWUb 10200. nmot_ub_q40 0.00 10200. FORMAT "%5.0"
 /begin AXIS_DESCR STD_AXIS ngfil nmotg_sb_q100 5 -12800. 12700. FORMAT "%5.0" DEPOSIT ABSOLUTE /end AXIS_DESCR
/end CHARACTERISTIC
/begin CHARACTERISTIC PSAPES "Saugrohrdruck für Applikation Einspritzung" VALUE 0x81B6EA KwUw 2559.961 p_uw_q0p039 0.00 2559.961 FORMAT "%8.3" /end CHARACTERISTIC
/begin CHARACTERISTIC PSPVDKUGN "Verhältnis pspvdk ungedrosselt" CURVE 0x813B80 KlAUwSstUwWUw 1.999969 fak_uw_b2 0.00 1.999969 FORMAT "%8.6"
 /begin AXIS_DESCR STD_AXIS nmot_w nmot_uw_q0p25 12 0.00 16383.75 FORMAT "%8.2" DEPOSIT ABSOLUTE /end AXIS_DESCR
/end CHARACTERISTIC
/begin CHARACTERISTIC REDABM "Ev-Abschaltmuster für Momentenreduzierung" MAP 0x8109F2 FkfNoShNoOffWUb 255.0 dez 0.00 255.0 FORMAT "%5.1"
 /begin AXIS_DESCR FIX_AXIS evrbgn_one dez 8 0.00 7.000 FORMAT "%5.3" FIX_AXIS_PAR 0 0 8 /end AXIS_DESCR
 /begin AXIS_DESCR FIX_AXIS redsol_one dez 8 0.00 7.000 FORMAT "%5.3" FIX_AXIS_PAR 0 0 8 /end AXIS_DESCR
/end CHARACTERISTIC
/begin CHARACTERISTIC RLNOT "Notlauf rl bei E_DK und E_LM" CURVE 0x8109DB KlAUbSstUbWUb 191.3 rel_ub_q0p75 0.00 191.3 FORMAT "%5.1"
 /begin AXIS_DESCR STD_AXIS nmot nmot_ub_q40 6 0.00 10200. FORMAT "%5.0" DEPOSIT ABSOLUTE /end AXIS_DESCR
/end CHARACTERISTIC
/begin AXIS_PTS SEZ06TMUB "Stützstellenverteilung, Zündwinkelwirkungsgrad" 0x81981D etazwimt SstAUbSstUb 127.5 rel_ub_b127p5 6 0.00 127.5 FORMAT "%5.1" DEPOSIT ABSOLUTE /end AXIS_PTS
/begin AXIS_PTS SGA07MDUB "" 0x811986 gangi SstAUbSstUb 255.0 dez 7 0.00 255.0 FORMAT "%5.1" DEPOSIT ABSOLUTE /end AXIS_PTS
/begin AXIS_PTS SLX06TMUW "Stützstellenverteilung, Lambdasoll" 0x81B114 lamsons_w SstAUwSstUw 15.99976 fak_uw_b16 6 0.00 15.99976 FORMAT "%8.5" DEPOSIT ABSOLUTE /end AXIS_PTS
/begin AXIS_PTS SLY06TMUW "Stützstellenverteilung, Lambdasoll Bank2" 0x81B122 lamsons2_w SstAUwSstUw 15.99976 fak_uw_b16 6 0.00 15.99976 FORMAT "%8.5" DEPOSIT ABSOLUTE /end AXIS_PTS
/begin AXIS_PTS SML06TMUB "Stützstellenverteilung, Luftmasse, 6 Stützstellen" 0x819831 ml SstAUbSstUb 1020. m_ub_b1020 6 0.00 1020. FORMAT "%5.0" DEPOSIT ABSOLUTE /end AXIS_PTS
/begin AXIS_PTS SML07TMUW "Stützstellenverteilung, Luftmasse, 7 Stützstellen" 0x81B13C ml_w SstAUwSstUw 6553.500 m_uw_b6553p5 7 0.00 6553.500 FORMAT "%8.3" DEPOSIT ABSOLUTE /end AXIS_PTS
/begin AXIS_PTS SNM08__UB "Stützstellenverteilung Drehzahl, 8 Sst." 0x8119EA nmot SstAUbSstUb 10200. nmot_ub_q40 8 0.00 10200. FORMAT "%5.0" DEPOSIT ABSOLUTE /end AXIS_PTS
/begin AXIS_PTS ST107TMUB "Stützstellenverteilung, Starttemperatur an Sonde vorne" 0x81988E tabgmst SstAUbSstUb 1275. temp_ub_q5_o50 7 -50.00 1225. FORMAT "%5.0" DEPOSIT ABSOLUTE /end AXIS_PTS
/begin AXIS_PTS ST207TMUB "Stützstellenverteilung, Starttemperatur an Sonde vorne, Bank2" 0x819896 tabgmst2 SstAUbSstUb 1275. temp_ub_q5_o50 7 -50.00 1225. FORMAT "%5.0" DEPOSIT ABSOLUTE /end AXIS_PTS
/begin AXIS_PTS ST307TMUB "Stützstellenverteilung, Starttemperatur an Sonde hinten" 0x81989E tkatmst SstAUbSstUb 1275. temp_ub_q5_o50 7 -50.00 1225. FORMAT "%5.0" DEPOSIT ABSOLUTE /end AXIS_PTS
/begin AXIS_PTS ST407TMUB "Stützstellenverteilung, Starttemperatur an Sonde hinten, Bank2" 0x8198A6 tkatmst2 SstAUbSstUb 1275. temp_ub_q5_o50 7 -50.00 1225. FORMAT "%5.0" DEPOSIT ABSOLUTE /end AXIS_PTS
/begin AXIS_PTS STM04__UB "" 0x8198BC tmot SstAUbSstUb 191.3 temp_ub_q0p75_o48 4 -48.00 143.3 FORMAT "%5.1" DEPOSIT ABSOLUTE /end AXIS_PTS
/begin AXIS_PTS STM05SAUB "Stützstellenverteilung" 0x8198C1 tmot SstAUbSstUb 191.3 temp_ub_q0p75_o48 5 -48.00 143.3 FORMAT "%5.1" DEPOSIT ABSOLUTE /end AXIS_PTS
/begin AXIS_PTS STM05TMUB "Stützstellenverteilung, Motorstarttemperatur" 0x81B16C tmst SstAUwSstUw 49151.25 temp_ub_q0p75_o48 5 -48.00000 49103.25 FORMAT "%8.2" DEPOSIT ABSOLUTE /end AXIS_PTS
/begin AXIS_PTS STS06TMUW "Stützstellenverteilung, Abgasmassenfluß" 0x81B178 tabst_w SstAUwSstUw 65535.00 t1sxs_uw_q1 6 0.00 65535.00 FORMAT "%8.2" DEPOSIT ABSOLUTE /end AXIS_PTS
/begin CHARACTERISTIC TAANSKTU "Schwelle Ansauglufttemperatur für Schaltbedingung Ansaugklappe" CURVE 0x81A85D KlAUbSstUbWUb 191.3 temp_ub_q0p75_o48 -48.00 143.3 FORMAT "%5.1"
 /begin AXIS_DESCR STD_AXIS tumg temp_ub_q0p75_o48 6 -48.00 143.3 FORMAT "%5.1" DEPOSIT ABSOLUTE /end AXIS_DESCR
/end CHARACTERISTIC
/begin CHARACTERISTIC TABGMEX "Abgastemperatur unterhalb der Kat-Anspringtemperatur" VALUE 0x819B0B KwUb 1275. temp_q5 0.00 1275. FORMAT "%5.0" /end CHARACTERISTIC
/begin CHARACTERISTIC TABSTKH "Mindestabstellzeit für Freigabe Kat-Heizen" VALUE 0x81B8F4 KwUw 65535.00 t1sxs_uw_b65535 0.00 65535.00 FORMAT "%8.2" /end CHARACTERISTIC
/begin CHARACTERISTIC TACCMXRMP "max. Reaktionszeit für ACC" VALUE 0x811B5C KwUb 5.100 t20msxs_ub_q0p02 0.00 5.100 FORMAT "%5.3" /end CHARACTERISTIC
/begin CHARACTERISTIC TACCREAKX "max. zulässige Zeit für ACC-Abschaltreaktion nach MFL OFF" VALUE 0x811B5D KwUb 5.100 t20msxs_ub_q0p02 0.00 5.100 FORMAT "%5.3" /end CHARACTERISTIC
/begin CHARACTERISTIC TACCSRG "Zeit in der ACC auf S/V WA im Zustand Standby reagieren muß, um den Regelz. zu e" VALUE 0x811B5E KwUb 5.100 t20msxs_ub_q0p02 0.00 5.100 FORMAT "%5.3" /end CHARACTERISTIC
/begin CHARACTERISTIC TAPVLTM "Schwelle Abstellzeit für EKP-Vorlauf" CURVE 0x8179CA KlAUbSstUbWUw 65535.00 t1sxs_uw_b65535 0.00 65535.00 FORMAT "%8.2"
 /begin AXIS_DESCR STD_AXIS tmotab temp_ub_q0p75_o48 12 -48.00 143.3 FORMAT "%5.1" DEPOSIT ABSOLUTE /end AXIS_DESCR
/end CHARACTERISTIC
/begin CHARACTERISTIC TAREIN "Sperrzeit für Antiruckelfunktion" VALUE 0x810090 KwUb 2.550 t10msxs_ub_b2p55 0.00 2.550 FORMAT "%5.3" /end CHARACTERISTIC
/begin CHARACTERISTIC TASTBFA "Modell-Temperatur vor Vorkatalysator Startwert bei B_faatm Anforderung" VALUE 0x819B0C KwUb 1275. temp_ub_q5_o50 -50.00 1225. FORMAT "%5.0" /end CHARACTERISTIC
/begin CHARACTERISTIC TATEGMX "Maximales Tastverhältnis für getakteten Betrieb." VALUE 0x810084 KwUb 99.61 rel_ub_b99p6 0.00 99.61 FORMAT "%5.2" /end CHARACTERISTIC
/begin CHARACTERISTIC TATELL "tans- Schwelle für Tankentlüfung bei B_ll = 1" VALUE 0x819DD4 KwUb 191.3 temp_ub_q0p75_o48 -48.00 143.3 FORMAT "%5.1" /end CHARACTERISTIC
/begin CHARACTERISTIC TATEMSN "Kennlinie Tastverhältnis TEV abhängig vom gewünschten Massenstrom" CURVE 0x813DE8 KlAUwSstUwWUw 99.99847 rel_uw_b100 0.00 99.99847 FORMAT "%8.5"
 /begin AXIS_DESCR STD_AXIS msntev_w m_uw_b25p6 10 0.00 25.59961 FORMAT "%8.5" DEPOSIT ABSOLUTE /end AXIS_DESCR
/end CHARACTERISTIC
/begin CHARACTERISTIC TATMKH "Abgastemperaturkorrektur bei Kat-Heizen aktiv" VALUE 0x819B0D KwUb 1275. temp_q5 0.00 1275. FORMAT "%5.0" /end CHARACTERISTIC
/begin CHARACTERISTIC TATMKH2 "Abgastemperaturkorrektur bei Kat-Heizen aktiv Bank2" VALUE 0x819B0E KwUb 1275. temp_q5 0.00 1275. FORMAT "%5.0" /end CHARACTERISTIC
/begin CHARACTERISTIC TATMKW "Abgastemperaturkorrektur bei Kat warmhalten aktiv" VALUE 0x819B0F KwUb 1275. temp_q5 0.00 1275. FORMAT "%5.0" /end CHARACTERISTIC
/begin CHARACTERISTIC TATMSA "Abgastemperatur bei Schubabschneiden" VALUE 0x819B10 KwUb 1275. temp_ub_q5_o50 -50.00 1225. FORMAT "%5.0" /end CHARACTERISTIC
/begin CHARACTERISTIC TATMSTI "Initialisierungswert für tabgm, tkatm Startwert bei Powerfail" VALUE 0x819B11 KwUb 1275. temp_ub_q5_o50 -50.00 1225. FORMAT "%5.0" /end CHARACTERISTIC
/begin CHARACTERISTIC TATMTMOT "Motortemperatur warmer Motor , für Temperaturkorrektur beim Kaltstart" VALUE 0x819B12 KwUb 191.3 temp_ub_q0p75_o48 -48.00 143.3 FORMAT "%5.1" /end CHARACTERISTIC
/begin CHARACTERISTIC TATMTP "Abgastaupunkttemperatur" VALUE 0x819B13 KwUb 1275. temp_ub_q5_o50 -50.00 1225. FORMAT "%5.0" /end CHARACTERISTIC
/begin CHARACTERISTIC TATMWMK "Temperaturoffset  für Wärmemengenberechnung" VALUE 0x819B14 KwSb 1275. temp_q5 -640.0 635.0 FORMAT "%5.1" /end CHARACTERISTIC
/begin CHARACTERISTIC TDKLAGDE "Zeitdelta für Fehlerzählerlöschung bei DK-Soll-/Istvergleich" VALUE 0x81012F KwUb 5.100 t20msxs_ub_b5p1 0.00 5.100 FORMAT "%5.3" /end CHARACTERISTIC
/begin CHARACTERISTIC TDKNLPE "Zeit bis stromlose DK in NLP einschwingt" VALUE 0x8157D6 KwUw 6553.500 t100msxs_uw_b6553p5 0.00 6553.500 FORMAT "%8.3" /end CHARACTERISTIC
/begin CHARACTERISTIC TDLRPIDMX "max. Zeit für PWM-Tastverhältnis des DLR bei temp. UMA-Adapt." VALUE 0x811B44 KwUb 12.75 t50msxs_q0p05 0.00 12.75 FORMAT "%5.2" /end CHARACTERISTIC
/begin CHARACTERISTIC TDVIVZ "Toleranzzeit bei zu großer Abweichung zw. Istgeschw. und Zielgeschw." VALUE 0x815842 KwUw 1310.680 t20msxs_uw_q0p02 0.02000000 1310.700 FORMAT "%8.3" /end CHARACTERISTIC
/begin CHARACTERISTIC TDVZVI "Toleranzzeit bei zu großer Abweichung zw. Zielgeschw. und Istgeschw." VALUE 0x815844 KwUw 1310.680 t20msxs_uw_q0p02 0.02000000 1310.700 FORMAT "%8.3" /end CHARACTERISTIC
/begin CHARACTERISTIC TFGRAQU "Toleranzzeit für Aquaplaningerkennung im FGR-Betrieb" VALUE 0x811B67 KwUb 5.080 t20msxs_ub_b5p1 0.02000 5.100 FORMAT "%5.3" /end CHARACTERISTIC
/begin CHARACTERISTIC TFGRASCOF "Zeit für FGR-Abschaltung bei aktivem Brems-Eingriff" VALUE 0x815846 KwUw 1310.700 t20msxs_uw_q0p02 0.00 1310.700 FORMAT "%8.3" /end CHARACTERISTIC
/begin CHARACTERISTIC TFGRBREOF "Zeit für FGR-Abschaltung bei aktivem Brems-Eingriff" VALUE 0x815848 KwUw 1310.700 t20msxs_uw_q0p02 0.00 1310.700 FORMAT "%8.3" /end CHARACTERISTIC
/begin CHARACTERISTIC TFGRDSCOF "Zeit für FGR-Abschaltung bei aktivem DSC-Eingriff" VALUE 0x81584A KwUw 1310.700 t20msxs_uw_q0p02 0.00 1310.700 FORMAT "%8.3" /end CHARACTERISTIC
/begin CHARACTERISTIC TFGRUEOB "Toleranzzeit für Überschreiten der oberen Beschleunigungsschwelle im FGR-Betrieb" VALUE 0x811B68 KwUb 5.080 t20msxs_ub_b5p1 0.02000 5.100 FORMAT "%5.3" /end CHARACTERISTIC
/begin CHARACTERISTIC TFGRUM "Toleranzzeit für Erkennung FGR-Betrieb in der Funktionsüberwachung" VALUE 0x811B69 KwUb 5.080 t20msxs_ub_b5p1 0.02000 5.100 FORMAT "%5.3" /end CHARACTERISTIC
/begin CHARACTERISTIC TFGRUNUB "Toleranzzeit für Unterschreiten der unteren Beschl.schwelle im FGR-Betrieb" VALUE 0x811B6A KwUb 5.080 t20msxs_ub_b5p1 0.02000 5.100 FORMAT "%5.3" /end CHARACTERISTIC
/begin CHARACTERISTIC TIMSA "Integratorsteigung für multi. Adaption" VALUE 0x8190BE KwUb 51.00 t200msxs_ub_b51 0.00 51.00 FORMAT "%5.2" /end CHARACTERISTIC
/begin CHARACTERISTIC TIMSALL "Integratorsteigung für multi. Adaption  (langsam)" VALUE 0x8190BF KwUb 51.00 t200msxs_ub_b51 0.00 51.00 FORMAT "%5.2" /end CHARACTERISTIC
/begin CHARACTERISTIC TKATMN "Katalysatortemperaturregelschwelle für Kat warmhalten" VALUE 0x81A405 KwUb 1275. temp_ub_q5_o50 -50.00 1225. FORMAT "%5.0" /end CHARACTERISTIC
/begin CHARACTERISTIC TKATSAN "Katalysator-Temperaturschwelle für Schubabschalten f(nmot)" CURVE 0x81052F KlAUbSstUbWUb 1275. temp_ub_q5_o50 -50.00 1225. FORMAT "%5.0"
 /begin AXIS_DESCR STD_AXIS nmot nmot_ub_q40 2 0.00 10200. FORMAT "%5.0" DEPOSIT ABSOLUTE /end AXIS_DESCR
/end CHARACTERISTIC
/begin CHARACTERISTIC TKATW "Katalysatortemperaturschwelle für Kat warmhalten" VALUE 0x81A406 KwUb 1275. temp_ub_q5_o50 -50.00 1225. FORMAT "%5.0" /end CHARACTERISTIC
/begin CHARACTERISTIC TKHABB "Entprellzeit für Abbruchbedingungen der Funktion Katheizen" VALUE 0x81A407 KwUb 25.50 t100msxs_ub_b25p5 0.00 25.50 FORMAT "%5.2" /end CHARACTERISTIC
/begin CHARACTERISTIC TKHFSAB "Entprellzeit für Umschaltung auf Katheizdrehzahl bei Fahrstufe" VALUE 0x81A408 KwUb 25.50 t100msxs_ub_b25p5 0.00 25.50 FORMAT "%5.2" /end CHARACTERISTIC
/begin CHARACTERISTIC TKHLL "Abbruchzeit Katheizen Leerlauf" VALUE 0x81B8F6 KwUw 6553.500 t100msxs_uw_b6553p5 0.00 6553.500 FORMAT "%8.3" /end CHARACTERISTIC
/begin CHARACTERISTIC TKHLLAB "Entprellzeit für Ende Katheizdrehzahl im LL" VALUE 0x81A409 KwUb 25.50 t100msxs_ub_b25p5 0.00 25.50 FORMAT "%5.2" /end CHARACTERISTIC
/begin CHARACTERISTIC TKHLLMX "Maximale Zeit für angehobene Katheiz-Drehzahl" VALUE 0x81B8F8 KwUw 655.3500 t10msxs_uw_b655p35 0.00 655.3500 FORMAT "%8.4" /end CHARACTERISTIC
/begin CHARACTERISTIC TKHLLMX2 "Maximale Zeit für angehobene Katheiz-Drehzahl" VALUE 0x81B8FA KwUw 655.3500 t10msxs_uw_b655p35 0.00 655.3500 FORMAT "%8.4" /end CHARACTERISTIC
/begin CHARACTERISTIC TKHMX "Maximale Einschaltdauer der Funktion Katheizen" VALUE 0x81B8FC KwUw 655.3500 t10msxs_uw_b655p35 0.00 655.3500 FORMAT "%8.4" /end CHARACTERISTIC
/begin CHARACTERISTIC TKSTBFA "Modell-Temperatur hinter Hauptkat Startwert bei B_faatm Anforderun" VALUE 0x819B15 KwUb 1275. temp_ub_q5_o50 -50.00 1225. FORMAT "%5.0" /end CHARACTERISTIC
/begin CHARACTERISTIC TMAR "Untere tmot-Schwelle für AR-Freigabe" VALUE 0x810091 KwUb 0.7500 temp_ub_q0p75_o48 -48.00 -47.25 FORMAT "%5.2" /end CHARACTERISTIC
/begin CHARACTERISTIC TMARSTM "Untere tmot-Schwelle von Starttemperatur für Antiruckel" CURVE 0x819710 KlAUbSstUbWUb 191.3 temp_ub_q0p75_o48 -48.00 143.3 FORMAT "%5.1"
 /begin AXIS_DESCR STD_AXIS tmst temp_ub_q0p75_o48 5 -48.00 143.3 FORMAT "%5.1" DEPOSIT ABSOLUTE /end AXIS_DESCR
/end CHARACTERISTIC
/begin CHARACTERISTIC TMESP "Motortemperaturschwelle Schnellstart" VALUE 0x811AE3 KwUb 191.3 temp_ub_q0p75_o48 -48.00 143.3 FORMAT "%5.1" /end CHARACTERISTIC
/begin CHARACTERISTIC TMFKMSDKA "Mot.-Temperaturschwelle für multi. Adaption" VALUE 0x8109E8 KwUb 191.3 temp_ub_q0p75_o48 -48.00 143.3 FORMAT "%5.1" /end CHARACTERISTIC
/begin CHARACTERISTIC TMSKS "Motortemperaturschwelle für Erkennung Benzin im Öl" VALUE 0x811B73 KwUb 191.3 temp_ub_q0p75_o48 -48.00 143.3 FORMAT "%5.1" /end CHARACTERISTIC
/begin CHARACTERISTIC TMSLOF "Motortemperaturschwelle für Sperre Sekundärluft" VALUE 0x81A40A KwUb 191.3 temp_ub_q0p75_o48 -48.00 143.3 FORMAT "%5.1" /end CHARACTERISTIC
/begin CHARACTERISTIC TMSNOGA "Schwelle tms für Dauerspülen nach Fahrzyklus mit erfolgter Gemischadaption" VALUE 0x819DD5 KwUb 191.3 temp_ub_q0p75_o48 -48.00 143.3 FORMAT "%5.1" /end CHARACTERISTIC
/begin CHARACTERISTIC TMSUTMUMA "untere Tmot-Schwelle für temporäre UMA-Adaption" VALUE 0x811B45 KwUb 191.3 temp_ub_q0p75_o48 -48.00 143.3 FORMAT "%5.1" /end CHARACTERISTIC
/begin CHARACTERISTIC TNLEKPVL "Schwelle SG-Nachlaufzeit für EKP-Vorlauf" VALUE 0x812B74 KwUb 255.0 t1sxs_ub_b255 0.00 255.0 FORMAT "%5.1" /end CHARACTERISTIC
/begin CHARACTERISTIC TNSDMRKH "Zeit nach Start für Drehmomentenreserve Katheizen" VALUE 0x81B8FE KwUw 655.3500 t10msxs_uw_b655p35 0.00 655.3500 FORMAT "%8.4" /end CHARACTERISTIC
/begin CHARACTERISTIC TPVL "Zeit für Pumpenvorlauf" VALUE 0x812B75 KwUb 2.550 t10msxs_ub_b2p55 0.00 2.550 FORMAT "%5.3" /end CHARACTERISTIC
/begin CHARACTERISTIC TRD "Zahnperiodenzeit für Rückdrehen im Auslauf" VALUE 0x811AE4 KwUb 0.2000 t10msxs_ub_b2p55 0.00 0.2000 /end CHARACTERISTIC
/begin CHARACTERISTIC TTE "Zeit für Tankentlüftungsphase" VALUE 0x81B6F2 KwUw 6553.500 t100msxs_uw_b6553p6 0.00 6553.500 FORMAT "%8.3" /end CHARACTERISTIC
/begin CHARACTERISTIC TTEAE "Zeit für Tankentlüftungsphase bei eingeschwungener Gemischadaption" VALUE 0x81B6F4 KwUw 6553.500 t100msxs_uw_b6553p6 0.00 6553.500 FORMAT "%8.3" /end CHARACTERISTIC
/begin CHARACTERISTIC TTEBSTP "Maximal Zeit für TE-Stop im Leerlauf bei nicht gesetzten Zyklusflags" VALUE 0x81B6F6 KwUw 6553.500 t100msxs_uw_b6553p6 0.00 6553.500 FORMAT "%8.3" /end CHARACTERISTIC
/begin CHARACTERISTIC TTEGA "Zeit bei der Tankentlüftung für Grundadaption" VALUE 0x81B6F8 KwUw 6553.500 t100msxs_uw_b6553p6 0.00 6553.500 FORMAT "%8.3" /end CHARACTERISTIC
/begin CHARACTERISTIC TTEGAI "Zeitdauer der ersten  Gemischadaptionsphase" VALUE 0x81B6FA KwUw 6553.500 t100msxs_uw_b6553p6 0.00 6553.500 FORMAT "%8.3" /end CHARACTERISTIC
/begin CHARACTERISTIC TTEGAZO "Zeit für Tankentlüftungsstop wg. Gemischadaption, obere Schwelle" VALUE 0x81B6FC KwUw 6553.500 t100msxs_uw_b6553p6 0.00 6553.500 FORMAT "%8.3" /end CHARACTERISTIC
/begin CHARACTERISTIC TTEGAZU "Zeit für Tankentlüftungsstop wg. Gemischadaption, untere Schwelle" VALUE 0x81B6FE KwUw 6553.500 t100msxs_uw_b6553p6 0.00 6553.500 FORMAT "%8.3" /end CHARACTERISTIC
/begin CHARACTERISTIC TTEINI "Zeit für Tankentlüftung in erster TE-Phase nach Initialisierung (B_ini)" VALUE 0x81B700 KwUw 6553.500 t100msxs_uw_b6553p6 0.00 6553.500 FORMAT "%8.3" /end CHARACTERISTIC
/begin CHARACTERISTIC TTEMN "Zeit für Tankentlüftungsphase minimal" VALUE 0x81B702 KwUw 6553.500 t100msxs_uw_b6553p6 0.00 6553.500 FORMAT "%8.3" /end CHARACTERISTIC
/begin CHARACTERISTIC TTEPRIO "Zeit ab Start für Umschalten auf Dauertankentlüftung" VALUE 0x81B704 KwUw 6553.500 t100msxs_uw_b6553p6 0.00 6553.500 FORMAT "%8.3" /end CHARACTERISTIC
/begin CHARACTERISTIC TTEVUB "Batteriespannungsabhängige Verzugszeit des TEV" CURVE 0x81959D KlAUbSstUbWUb 40.00 t500usxms_ub_q0p5 0.00 40.00 FORMAT "%5.2"
 /begin AXIS_DESCR STD_AXIS ub spg_ubatt 6 0.00 24.02 FORMAT "%5.2" DEPOSIT ABSOLUTE /end AXIS_DESCR
/end CHARACTERISTIC
/begin CHARACTERISTIC TTEZAO "Zeit für Tankentlüftung Daueraktivierung, obere Schwelle" VALUE 0x81B706 KwUw 6553.500 t100msxs_uw_b6553p6 0.00 6553.500 FORMAT "%8.3" /end CHARACTERISTIC
/begin CHARACTERISTIC TTEZAU "Zeit für Tankentlüftung Daueraktivierung, untere Schwelle" VALUE 0x81B708 KwUw 6553.500 t100msxs_uw_b6553p6 0.00 6553.500 FORMAT "%8.3" /end CHARACTERISTIC
/begin CHARACTERISTIC TTMUMASTA "Zeitdauer für Stationärzustand bei temp. UMA-Adaption" VALUE 0x811B46 KwUb 255.0 t1sxs_ub_b255 0.00 255.0 FORMAT "%5.1" /end CHARACTERISTIC
/begin CHARACTERISTIC TUMTAIT "Initialisierungswert Umgebungstemperatur aus TANS" VALUE 0x819B16 KwUb 191.3 temp_ub_q0p75_o48 -48.00 143.3 FORMAT "%5.1" /end CHARACTERISTIC
/begin CHARACTERISTIC TVFGRSTAT "Verzögerungszeit (Haltezeit) für Ausgabe Status-FGR" VALUE 0x811B5F KwUb 5.100 t20msxs_ub_q0p02 0.00 5.100 FORMAT "%5.3" /end CHARACTERISTIC
/begin CHARACTERISTIC TVKURU "Verzögerung der Differenzbildung um x Sekunden" VALUE 0x81005F KwUb 0.08000 t20msxs_ub_b5p1 0.02000 0.1000 /end CHARACTERISTIC
/begin CHARACTERISTIC TVSATM "Sperrzeit Schubabschalten nach Startende" CURVE 0x8190B0 GklWUb 255.0 t1sxs_ub_b255 0.00 255.0 FORMAT "%5.1"
 /begin AXIS_DESCR COM_AXIS tmot temp_ub_q0p75_o48 5 -48.00 143.3 AXIS_PTS_REF STM05SAUB /end AXIS_DESCR
/end CHARACTERISTIC
/begin CHARACTERISTIC TVUB "Spannungskorrektur" CURVE 0x8159C0 KlAUbSstUbWUw 209.7120 tinjection_sy 0.00 209.7120 FORMAT "%8.4"
 /begin AXIS_DESCR STD_AXIS ub spg_ubatt 5 0.00 24.02 FORMAT "%5.2" DEPOSIT ABSOLUTE /end AXIS_DESCR
/end CHARACTERISTIC
/begin CHARACTERISTIC TWPEDBR "Entprellzeit für Plausibilisierung Fahrpedalwert mit Bremspedal" VALUE 0x810083 KwUb 2.550 t10msxs_ub_b2p55 0.00 2.550 FORMAT "%5.3" /end CHARACTERISTIC
/begin CHARACTERISTIC TZMIN "Zeitfenster für Zahnerkennung nach UBatt-Einbruch" VALUE 0x812B76 KwUb 2.550 t10msxs_ub_b2p55 0.00 2.550 FORMAT "%5.3" /end CHARACTERISTIC
/begin CHARACTERISTIC TZSPINI "Sperrzeit fuer Filterinitialisierung" VALUE 0x810092 KwUb 2.550 t10msxs_ub_b2p55 0.00 2.550 FORMAT "%5.3" /end CHARACTERISTIC
/begin CHARACTERISTIC UANAUFRP "Schrittweite für AUF-Rampe" VALUE 0x8157D8 KwUw 0.9994659 relDK_uw_b100 0.00 0.9994659 FORMAT "%9.7" /end CHARACTERISTIC
/begin CHARACTERISTIC UANNMAX "Motordrehzahlschwelle für Freigabe UMA-Lernen und Verstärkerabgleich" VALUE 0x811B47 KwUb 2550. nmot_ub_q10 0.00 2550. FORMAT "%5.0" /end CHARACTERISTIC
/begin CHARACTERISTIC UANPEDMAX "Pedalschwelle für UMA-Lernen erlaubt" VALUE 0x811B48 KwUb 100.0 relDK_ub_b100 0.00 100.0 FORMAT "%5.1" /end CHARACTERISTIC
/begin CHARACTERISTIC UANPIDMIN "Abbruchschwelle PID-Summe für ZU-Rampe" VALUE 0x8157DA KwUw 99.99847 rel_uw_b100 0.00 99.99847 FORMAT "%8.5" /end CHARACTERISTIC
/begin CHARACTERISTIC UANPIDMINA "Abbruchschwelle PID-Summe für AUF-Rampe" VALUE 0x8157DC KwUw 99.99847 rel_uw_b100 0.00 99.99847 FORMAT "%8.5" /end CHARACTERISTIC
/begin CHARACTERISTIC UANUATS "untere Ansauglufttemperaturschwelle für Lernfreigabe" VALUE 0x811B49 KwUb 191.3 temp_ub_q0p75_o48 -48.00 143.3 FORMAT "%5.1" /end CHARACTERISTIC
/begin CHARACTERISTIC UANZURP "Schrittweite für ZU-Rampe" VALUE 0x8157DE KwUw 0.05010200 spg_uw_q0p001222 0.00 0.05010200 FORMAT "%10.8" /end CHARACTERISTIC
/begin CHARACTERISTIC UAN_O_MT "obere Motortemperaturschwelle für Anschlag" VALUE 0x811B4A KwUb 191.3 temp_ub_q0p75_o48 -48.00 143.3 FORMAT "%5.1" /end CHARACTERISTIC
/begin CHARACTERISTIC UAN_STORE "Schwelle für Abspeicherung neuer Lernwerte" VALUE 0x8157E0 KwUw 0.05010200 spg_uw_q0p001222 0.00 0.05010200 FORMAT "%10.8" /end CHARACTERISTIC
/begin CHARACTERISTIC UAN_U_MT "untere Motortemperaturschwelle für Anschlag" VALUE 0x811B4B KwUb 191.3 temp_ub_q0p75_o48 -48.00 143.3 FORMAT "%5.1" /end CHARACTERISTIC
/begin CHARACTERISTIC UBSTS "Schwelle zur Erkennung UBatt-Einbruch im Start" VALUE 0x812B77 KwUb 24.02 spg_ubatt 0.00 24.02 FORMAT "%5.2" /end CHARACTERISTIC
/begin CHARACTERISTIC UB_UANL "Batteriespannungsschwelle für Lernfreigabe" VALUE 0x811B4C KwUb 24.02 spg_ubatt 0.00 24.02 FORMAT "%5.2" /end CHARACTERISTIC
/begin CHARACTERISTIC UDKNLP1N "Nennwert-Spannung DK-Poti 1 in NLP-Stellung" VALUE 0x8157E2 KwUw 5.004090 spg_uw_q0p001222 0.00 5.004090 FORMAT "%8.6" /end CHARACTERISTIC
/begin CHARACTERISTIC UDKNLP2N "Nennwert-Spannung DK-Poti 2 in NLP-Stellung" VALUE 0x8157E4 KwUw 5.004090 spg_uw_q0p001222 0.00 5.004090 FORMAT "%8.6" /end CHARACTERISTIC
/begin CHARACTERISTIC UDKP1AMAX "max. Spannung DK-Poti 1 am unteren DK-Anschlag" VALUE 0x8157E6 KwUw 5.004090 spg_uw_q0p001222 0.00 5.004090 FORMAT "%8.6" /end CHARACTERISTIC
/begin CHARACTERISTIC UDKP1AMIN "min. Spannung DK-Poti 1 am unteren DK-Anschlag" VALUE 0x8157E8 KwUw 5.004090 spg_uw_q0p001222 0.00 5.004090 FORMAT "%8.6" /end CHARACTERISTIC
/begin CHARACTERISTIC UDKP1AURI "Spannung DK-Poti 1 am unt. DK-Anschlag, Initial. Wert" VALUE 0x8157EA KwUw 5.004090 spg_uw_q0p001222 0.00 5.004090 FORMAT "%8.6" /end CHARACTERISTIC
/begin CHARACTERISTIC UDKP1DUS "Nennumschaltschwelle zur DK-Poti-1-Umschaltung" VALUE 0x811B4D KwUb 4.980 spg_ub_b5 0.00 4.980 FORMAT "%5.3" /end CHARACTERISTIC
/begin CHARACTERISTIC UDKP1NHUB "Nennhub der Drosselklappe im DV-E, (Poti 1)" VALUE 0x8157EC KwUw 5.004090 spg_uw_q0p001222 0.00 5.004090 FORMAT "%8.6" /end CHARACTERISTIC
/begin CHARACTERISTIC UDKP1VID "Nennverstärkung für DK-Poti 1" VALUE 0x8157EE KwUw 7.996094 fak_q0p0039 0.00 7.996094 FORMAT "%8.6" /end CHARACTERISTIC
/begin CHARACTERISTIC UDKP1VOMA "max. Offsetfehler für DK-Poti-1-Verstärker" VALUE 0x8157F0 KwSw 5.004090 spg_sw_q0p001222 0.00 5.004090 FORMAT "%8.6" /end CHARACTERISTIC
/begin CHARACTERISTIC UDKP1VOMI "min. Offsetfehler für DK-Poti-1-Verstärker" VALUE 0x8157F2 KwSw 5.004090 spg_sw_q0p001222 -5.004090 0.00 FORMAT "%8.6" /end CHARACTERISTIC
/begin CHARACTERISTIC UDKP1VOSC "unt. Grenze für ob. Abgleichpkt. DK-Poti 1" VALUE 0x8157F4 KwUw 4.995117 spg_uw_q0p00488 0.00 4.995117 FORMAT "%8.6" /end CHARACTERISTIC
/begin CHARACTERISTIC UDKP1VUSC "ob. Grenze für unt. Abgleichpkt. DK-Poti 1" VALUE 0x8157F6 KwUw 4.995117 spg_uw_q0p00488 0.00 4.995117 FORMAT "%8.6" /end CHARACTERISTIC
/begin CHARACTERISTIC UDKP1VVMA "ob. Wert Verstärkungsfehler für Verstärker" VALUE 0x8157F8 KwUw 7.996094 fak_q0p0039 0.00 7.996094 FORMAT "%8.6" /end CHARACTERISTIC
/begin CHARACTERISTIC UDKP1VVMI "unt. Wert Verstärkungsfehler für Verstärker" VALUE 0x8157FA KwUw 7.996094 fak_q0p0039 0.00 7.996094 FORMAT "%8.6" /end CHARACTERISTIC
/begin CHARACTERISTIC UDKP2AMAX "max. Spannung DK-Poti 2 am unteren DK-Anschlag" VALUE 0x8157FC KwUw 5.004090 spg_uw_q0p001222 0.00 5.004090 FORMAT "%8.6" /end CHARACTERISTIC
/begin CHARACTERISTIC UDKP2AMIN "min. Spannung DK-Poti 2 am unteren DK-Anschlag" VALUE 0x8157FE KwUw 5.004090 spg_uw_q0p001222 0.00 5.004090 FORMAT "%8.6" /end CHARACTERISTIC
/begin CHARACTERISTIC UDKP2AURI "Spannung DK-Poti 2 am unt. DK-Anschlag, Initial. Wert" VALUE 0x815800 KwUw 5.004090 spg_uw_q0p001222 0.00 5.004090 FORMAT "%8.6" /end CHARACTERISTIC
/begin CHARACTERISTIC UDKPALOS "Spannungsoffset zur Erkennung des Loslösens" VALUE 0x815802 KwUw 0.2004080 spg_uw_q0p001222 0.00 0.2004080 FORMAT "%9.7" /end CHARACTERISTIC
/begin CHARACTERISTIC UDKPAOFF "Spannungsoffset am unteren Anschlag" VALUE 0x815804 KwUw 0.05010200 spg_uw_q0p001222 0.00 0.05010200 FORMAT "%10.8" /end CHARACTERISTIC
/begin CHARACTERISTIC UDKPATMX "max. möglicher Offset der temp. UMA-Adaption" VALUE 0x815806 KwUw 5.004090 spg_uw_q0p001222 0.00 5.004090 FORMAT "%8.6" /end CHARACTERISTIC
/begin CHARACTERISTIC UPVGNENN "Nennwert für DV-E Potiversorgungsspannung" VALUE 0x81B3E0 KwUw 65535.00 dez 0.00 65535.00 FORMAT "%8.2" /end CHARACTERISTIC
/begin CHARACTERISTIC VARAU "minimale Fahrzeuggeschwindigkeit für ARA - Funktion" VALUE 0x810093 KwUb 317.5 fak_ub_b318p75 0.00 317.5 FORMAT "%5.1" /end CHARACTERISTIC
/begin CHARACTERISTIC VBGFGRAQ "Geschwindigkeit Bereichsgrenze bei Aquaplaningerkennung" VALUE 0x81584C KwUw 511.9922 vfzg_uw_b512 0.00 511.9922 FORMAT "%8.4" /end CHARACTERISTIC
/begin CHARACTERISTIC VFGRMAX "Maximal zulässige Geschwindigkeit im FGR-Betrieb" VALUE 0x81584E KwUw 511.9922 vfzg_uw_b512 0.00 511.9922 FORMAT "%8.4" /end CHARACTERISTIC
/begin CHARACTERISTIC VFGRMIN "Minimal zulässige Geschwindigkeit im FGR-Betrieb" VALUE 0x815850 KwUw 511.9922 vfzg_uw_b512 0.00 511.9922 FORMAT "%8.4" /end CHARACTERISTIC
/begin CHARACTERISTIC VMINLR "Geschwindigkeitschwelle für Bereich Low Range" VALUE 0x817934 KwUw 511.9922 vfzg_uw_b512 0.00 511.9922 FORMAT "%8.4" /end CHARACTERISTIC
/begin CHARACTERISTIC VMINLRO "Geschwindigkeitschwelle für Bereich Low Range deaktivieren" VALUE 0x817936 KwUw 511.9922 vfzg_uw_b512 0.00 511.9922 FORMAT "%8.4" /end CHARACTERISTIC
/begin CHARACTERISTIC VMNANSKL "minimale Fahrzeuggeschwindigkeit für Ansteuerung Ansaugklappe" VALUE 0x81A86A KwUb 318.8 vfzg_ub_q1p25 0.00 318.8 FORMAT "%5.1" /end CHARACTERISTIC
/begin CHARACTERISTIC VREGLMAX "Maximal zulässige Sollgeschwindigkeit für FGR" VALUE 0x815852 KwUw 511.9922 vfzg_uw_b512 0.00 511.9922 FORMAT "%8.4" /end CHARACTERISTIC
/begin CHARACTERISTIC VREGLMIN "Minimal zulässige Sollgeschwindigkeit für FGR" VALUE 0x815854 KwUw 511.9922 vfzg_uw_b512 0.00 511.9922 FORMAT "%8.4" /end CHARACTERISTIC
/begin CHARACTERISTIC VSAA "Geschwindigkeitsschwelle für SA-Drehzahlanhebung" VALUE 0x81001D KwUb 318.8 vfzg_ub_q1p25 0.00 318.8 FORMAT "%5.1" /end CHARACTERISTIC
/begin CHARACTERISTIC VTUMTAT "Schwelle Fahrzeuggeschwindigkeit für TANS -> Umgebungstemperatur" VALUE 0x819B17 KwUb 318.8 vfzg_ub_q1p25 0.00 318.8 FORMAT "%5.1" /end CHARACTERISTIC
/begin CHARACTERISTIC WDKBEWS "Schwelle zur DK-Bewegungserkennung (I-Klein)" VALUE 0x8142C4 KwSw 1599.976 relDK_q0p02441 -800.0000 799.9756 FORMAT "%8.4" /end CHARACTERISTIC
/begin CHARACTERISTIC WDKFMAON "min. Schwelle Freigabe der mult. Adaption" CURVE 0x8190C0 KlAUbSstUbWUb 100.0 relDK_ub_b100 0.00 100.0 FORMAT "%5.1"
 /begin AXIS_DESCR STD_AXIS nmot nmot_ub_q40 4 0.00 10200. FORMAT "%5.0" DEPOSIT ABSOLUTE /end AXIS_DESCR
/end CHARACTERISTIC
/begin CHARACTERISTIC WDKFMAUN "max. Schwelle Freigabe der multi. Adaption" CURVE 0x8190C9 KlAUbSstUbWUb 100.0 relDK_ub_b100 0.00 100.0 FORMAT "%5.1"
 /begin AXIS_DESCR STD_AXIS nmot nmot_ub_q40 4 0.00 10200. FORMAT "%5.0" DEPOSIT ABSOLUTE /end AXIS_DESCR
/end CHARACTERISTIC
/begin CHARACTERISTIC WDKFPRZ1 "Abschaltschwelle DK-Istwert für DV-E-Rückstellfederprüfung" VALUE 0x815808 KwUw 100.0000 relDK_uw_b100 0.00 100.0000 FORMAT "%8.4" /end CHARACTERISTIC
/begin CHARACTERISTIC WDKFPRZ2 "Prüfschwelle DK-Istwert für DV-E-Rückstellfederprüfung" VALUE 0x81580A KwUw 100.0000 relDK_uw_b100 0.00 100.0000 FORMAT "%8.4" /end CHARACTERISTIC
/begin CHARACTERISTIC WDKMSON "min. Schwelle Freigabe der addi. Adaption" CURVE 0x8190D2 KlAUbSstUbWUb 100.0 relDK_ub_b100 0.00 100.0 FORMAT "%5.1"
 /begin AXIS_DESCR STD_AXIS nmot nmot_ub_q40 4 0.00 10200. FORMAT "%5.0" DEPOSIT ABSOLUTE /end AXIS_DESCR
/end CHARACTERISTIC
/begin CHARACTERISTIC WDKNLPMA "oberer erlaubter Istwert für NLP-Stellung" VALUE 0x81580C KwUw 100.0000 relDK_uw_b100 0.00 100.0000 FORMAT "%8.4" /end CHARACTERISTIC
/begin CHARACTERISTIC WDKNLPMI "unterer erlaubter Istwert für NLP-Stellung" VALUE 0x81580E KwUw 100.0000 relDK_uw_b100 0.00 100.0000 FORMAT "%8.4" /end CHARACTERISTIC
/begin CHARACTERISTIC WDKNLPTOL "zulässige DK-Winkel-Toleranz des NLP" VALUE 0x8142C6 KwUw 100.0000 relDK_uw_b100 0.00 100.0000 FORMAT "%8.4" /end CHARACTERISTIC
/begin CHARACTERISTIC WDKREIB "Haftreibungsanteil der DK für I-Klein" VALUE 0x810130 KwUb 0.9961 fak_ub_b1 0.00 0.9961 /end CHARACTERISTIC
/begin CHARACTERISTIC WDKSFPR "DK-Sollwert für DV-E-Rückstellfederprüfung" VALUE 0x815810 KwUw 100.0000 relDK_uw_b100 0.00 100.0000 FORMAT "%8.4" /end CHARACTERISTIC
/begin CHARACTERISTIC WDKSTFEIN "Schwelle zur Stationaritätserkennung (verstärkter Bereich)" VALUE 0x8142C8 KwSw 1599.976 relDK_q0p02441 -800.0000 799.9756 FORMAT "%8.4" /end CHARACTERISTIC
/begin CHARACTERISTIC WDKSTGROB "Schwelle zur Stationaritätserkennung (unverstärkter Bereich)" VALUE 0x8142CA KwSw 1599.976 relDK_q0p02441 -800.0000 799.9756 FORMAT "%8.4" /end CHARACTERISTIC
/begin CHARACTERISTIC WDKSTMUMA "DK-Winkel-Schwelle für temporäre UMA-Adaption" VALUE 0x815812 KwUw 100.0000 relDK_uw_b100 0.00 100.0000 FORMAT "%8.4" /end CHARACTERISTIC
/begin CHARACTERISTIC WDKVLN "Drosselklappenwinkelschwelle für Vollasterkennung" CURVE 0x811EC6 KlAUbSstUbWUb 100.0 rel_ub_b100 0.00 100.0 FORMAT "%5.1"
 /begin AXIS_DESCR STD_AXIS nmot nmot_ub_q40 14 0.00 10200. FORMAT "%5.0" DEPOSIT ABSOLUTE /end AXIS_DESCR
/end CHARACTERISTIC
/begin CHARACTERISTIC WESSTO "Offsetwinkel Einspritzung für Schnellstart" VALUE 0x814005 DI__Kwub__________ 717.3 WQ720 0.00 717.3 FORMAT "%5.1" /end CHARACTERISTIC
/begin CHARACTERISTIC WMABGKH "Faktor für Wärmemengenkorrektur bei Katheizen für Taupunktende" VALUE 0x819B18 KwUb 0.9961 fak_ub_b1 0.00 0.9961 /end CHARACTERISTIC
/begin CHARACTERISTIC WMABGKH2 "Faktor für Wärmemengenkorrektur bei Katheizen für Taupunktende Bank2" VALUE 0x819B19 KwUb 0.9961 fak_ub_b1 0.00 0.9961 /end CHARACTERISTIC
/begin CHARACTERISTIC WPEDFMX "Fahrpedalschwelle für PWG-Bremspedal Plausibilisierung" VALUE 0x814300 KwUw 100.0000 relPED_uw_b100 0.00 100.0000 FORMAT "%8.4" /end CHARACTERISTIC
/begin CHARACTERISTIC ZATMAML "Zeitkonstante fuer Abgastemperaturmodell" CURVE 0x81B2B6 GklWUw 13107.0000 zk200msxs_uw_b13107 0.200003052 13107.2000 FORMAT "%10.4"
 /begin AXIS_DESCR COM_AXIS ml_w m_uw_b6553p5 7 0.00 6553.500 AXIS_PTS_REF SML07TMUW /end AXIS_DESCR
/end CHARACTERISTIC
/begin CHARACTERISTIC ZATMAML2 "Zeitkonstante fuer Abgastemperaturmodell Bank2" CURVE 0x81B2C4 GklWUw 13107.0000 zk200msxs_uw_b13107 0.200003052 13107.2000 FORMAT "%10.4"
 /begin AXIS_DESCR COM_AXIS ml_w m_uw_b6553p5 7 0.00 6553.500 AXIS_PTS_REF SML07TMUW /end AXIS_DESCR
/end CHARACTERISTIC
/begin CHARACTERISTIC ZATMKML "Zeitkonstante fuer Katalysatortemperaturmodell - Kat-Temperatur tkatm" CURVE 0x81B2D2 GklWUw 13107.0000 zk200msxs_uw_b13107 0.200003052 13107.2000 FORMAT "%10.4"
 /begin AXIS_DESCR COM_AXIS ml_w m_uw_b6553p5 7 0.00 6553.500 AXIS_PTS_REF SML07TMUW /end AXIS_DESCR
/end CHARACTERISTIC
/begin CHARACTERISTIC ZATMKML2 "Zeitkonstante fuer Katalysatortemperaturmodell - Kat-Temperatur Bank2" CURVE 0x81B2E0 GklWUw 13107.0000 zk200msxs_uw_b13107 0.200003052 13107.2000 FORMAT "%10.4"
 /begin AXIS_DESCR COM_AXIS ml_w m_uw_b6553p5 7 0.00 6553.500 AXIS_PTS_REF SML07TMUW /end AXIS_DESCR
/end CHARACTERISTIC
/begin CHARACTERISTIC ZATMRML "Zeitkonstante fuer Abgastemperaturmodell - Rohrwandtemperatur" CURVE 0x81B2EE GklWUw 13107.0000 zk200msxs_uw_b13107 0.200003052 13107.2000 FORMAT "%10.4"
 /begin AXIS_DESCR COM_AXIS ml_w m_uw_b6553p5 7 0.00 6553.500 AXIS_PTS_REF SML07TMUW /end AXIS_DESCR
/end CHARACTERISTIC
/begin CHARACTERISTIC ZATMRML2 "Zeitkonstante fuer Abgastemperaturmodell - Rohrwandtemperatur Bank2" CURVE 0x81B2FC GklWUw 13107.0000 zk200msxs_uw_b13107 0.200003052 13107.2000 FORMAT "%10.4"
 /begin AXIS_DESCR COM_AXIS ml_w m_uw_b6553p5 7 0.00 6553.500 AXIS_PTS_REF SML07TMUW /end AXIS_DESCR
/end CHARACTERISTIC
/begin CHARACTERISTIC ZKHABB "Zeitkonstante für Abbruch-Tiefpass Katheizen" VALUE 0x81A40B KwUb 25.4996 zk100msxs_ub_b25p5 0.100392 25.6000 FORMAT "%7.4" /end CHARACTERISTIC
/begin CHARACTERISTIC ZKLAMKH "Zeitkonstante Lambda-Motor-Soll bei Katheizen" VALUE 0x815D3C KwUw 655.350000 zk10msxs_uw_b655 0.0100001526 655.360000 FORMAT "%10.6" /end CHARACTERISTIC
/begin CHARACTERISTIC ZKLAMKH2 "Zeitkonstante Lambda-Motor-Soll für Fzg. ohne Kat" VALUE 0x815D3E KwUw 655.350000 zk10msxs_uw_b655 0.0100001526 655.360000 FORMAT "%10.6" /end CHARACTERISTIC
/begin CHARACTERISTIC ZKMSDK "Zeitkonstante schnelle Massenstromadaption" CURVE 0x813BB2 KlAUwSstUwWUw 7.812269 mk10ms_uw_q2p384e5n 0.00 7.812269 FORMAT "%8.6"
 /begin AXIS_DESCR STD_AXIS pspvdk_w fak_uw_b2 8 0.00 1.999969 FORMAT "%8.6" DEPOSIT ABSOLUTE /end AXIS_DESCR
/end CHARACTERISTIC
/begin CHARACTERISTIC ZKUBDLR "DLR, Zeitkonstante für Filterung von Ubatt" VALUE 0x81971F KwUb 0.4980 fak_ub_b0p5 0.00 0.4980 /end CHARACTERISTIC
/begin CHARACTERISTIC ZKURU "Zeitkonstante Filterung Differenz nmot zu vfzg -Quotient" VALUE 0x8157AC KwUw 1309.98001 zk20msxs_uw_b1310 0.0199893187 1310.00000 FORMAT "%10.5" /end CHARACTERISTIC
/begin CHARACTERISTIC ZKWDKSPT1 "Zeitkonstante für Prädiktion DK-Winkel aus Sollwert" VALUE 0x810131 KwUb 0.6973 fak_q0p00273 0.00 0.6973 /end CHARACTERISTIC
/begin CHARACTERISTIC ZNGAR "Zeitkonstante für Drehzahlgradient AR" VALUE 0x813E48 KwUw 655.350000 zk10msxs_uw_b655 0.0100001526 655.360000 FORMAT "%10.6" /end CHARACTERISTIC
/begin CHARACTERISTIC ZNOSTMX "Anzahl Zündung=ein ohne Erreichen von Startende für kein EKP-Vorlauf" VALUE 0x812B78 KwUb 255.0 dez 0.00 255.0 FORMAT "%5.1" /end CHARACTERISTIC
/begin CHARACTERISTIC ZTPREL "Anzahl Zähne während der Starterkennung" VALUE 0x811AE5 KwUb 40.00 dez 0.00 40.00 FORMAT "%5.2" /end CHARACTERISTIC
/begin MEASUREMENT AansklBits "" UBYTE dez 1 100 0 255 FORMAT "%5.1" ECU_ADDRESS 0x380D7F /end MEASUREMENT
/begin MEASUREMENT abmf "Festeinspritzausblendmuster" UBYTE dez 1 100 0 255 FORMAT "%5.1" ECU_ADDRESS 0x3809A3 /end MEASUREMENT
/begin MEASUREMENT abo "Anzahl Starts mit Benzin im Öl" UBYTE dez 1 100 0 255 FORMAT "%5.1" ECU_ADDRESS 0x38311F /end MEASUREMENT
/begin MEASUREMENT ADC_Urefsp1_w "" UWORD spg_uw_b5 1 100 0 319.995 FORMAT "%8.4" ECU_ADDRESS 0x380F3C /end MEASUREMENT
/begin MEASUREMENT ADC_Urefsp2_w "" UWORD spg_uw_b5 1 100 0 319.995 FORMAT "%8.4" ECU_ADDRESS 0x380F3E /end MEASUREMENT
/begin MEASUREMENT ADC_Uspoti1_w "" UWORD spg_uw_b5 1 100 0 319.995 FORMAT "%8.4" ECU_ADDRESS 0x380F40 /end MEASUREMENT
/begin MEASUREMENT ADC_Uspoti2_w "" UWORD spg_uw_b5 1 100 0 319.995 FORMAT "%8.4" ECU_ADDRESS 0x380F42 /end MEASUREMENT
/begin MEASUREMENT AEKPintbits "" UBYTE dez 1 100 0 255 FORMAT "%5.1" ECU_ADDRESS 0x383160 /end MEASUREMENT
/begin MEASUREMENT aleNvBits "" UBYTE dez 1 100 0 255 FORMAT "%5.1" ECU_ADDRESS 0x3830EF /end MEASUREMENT
/begin MEASUREMENT anznmax "Anzahl NMAX-Überschreitungen" UBYTE dez 1 100 0 255 FORMAT "%5.1" ECU_ADDRESS 0x382FDF /end MEASUREMENT
/begin MEASUREMENT anzpbr_w "Anzahl Ereignisse PWG-Bremspedal Plausibilisierung" UWORD dez 1 100 0 65535 FORMAT "%8.2" ECU_ADDRESS 0x383A0A /end MEASUREMENT
/begin MEASUREMENT anztid "Differenz Einspritzzeahler im Berechnungsraster" UBYTE dez 1 100 0 255 FORMAT "%5.1" ECU_ADDRESS 0x380D3D /end MEASUREMENT
/begin MEASUREMENT ATMbits "" UBYTE dez 1 100 0 255 FORMAT "%5.1" ECU_ADDRESS 0x3830F5 /end MEASUREMENT
/begin MEASUREMENT BBFGRlokBits "" UBYTE dez 1 100 0 255 FORMAT "%5.1" ECU_ADDRESS 0x380C6F /end MEASUREMENT
/begin MEASUREMENT BBKHZlokBits "" UWORD dez 1 100 0 65535 FORMAT "%8.2" ECU_ADDRESS 0x382326 /end MEASUREMENT
/begin MEASUREMENT BblorNvBits "" UBYTE dez 1 100 0 255 FORMAT "%5.1" ECU_ADDRESS 0x383161 /end MEASUREMENT
/begin MEASUREMENT BBSAWElokbits "" UBYTE dez 1 100 0 255 FORMAT "%5.1" ECU_ADDRESS 0x380B52 /end MEASUREMENT
/begin MEASUREMENT bgcvn_bits "" UBYTE dez 1 100 0 255 FORMAT "%5.1" ECU_ADDRESS 0x380BED /end MEASUREMENT
/begin MEASUREMENT BGDVEintbits "" UBYTE dez 1 100 0 255 FORMAT "%5.1" ECU_ADDRESS 0x38310F /end MEASUREMENT
/begin MEASUREMENT BGKVbits "" UBYTE dez 1 100 0 255 FORMAT "%5.1" ECU_ADDRESS 0x380D3E /end MEASUREMENT
/begin MEASUREMENT B_abgle "Bedingung: Fehler beim Verstärkerabgleich" UWORD B_TRUE 1 100 0 1 BIT_MASK 0x1 FORMAT "%13.11" ECU_ADDRESS 0xFD92 /end MEASUREMENT
/begin MEASUREMENT B_abor "Bedigung Anzahl Starts mit Benzin im Öl für reduzierte LRA" UWORD B_TRUE 1 100 0 1 BIT_MASK 0x80 FORMAT "%13.11" ECU_ADDRESS 0xFD98 /end MEASUREMENT
/begin MEASUREMENT B_accarm "Bedingung rev. Abschaltung durch DME" UWORD B_TRUE 1 100 0 1 BIT_MASK 0x400 FORMAT "%13.11" ECU_ADDRESS 0xFD94 /end MEASUREMENT
/begin MEASUREMENT B_accnor "Bedingung ACC zeigt keine Reaktion auf Abschaltbedingungen" UWORD B_TRUE 1 100 0 1 BIT_MASK 0x800 FORMAT "%13.11" ECU_ADDRESS 0xFD94 /end MEASUREMENT
/begin MEASUREMENT B_accsrg "Bedingung: Zustandssprung Standby nach Regelung genehmigt" UWORD B_TRUE 1 100 0 1 BIT_MASK 0x1000 FORMAT "%13.11" ECU_ADDRESS 0xFD94 /end MEASUREMENT
/begin MEASUREMENT B_acctgo "Bedingung Timer go" UWORD B_TRUE 1 100 0 1 BIT_MASK 0x2000 FORMAT "%13.11" ECU_ADDRESS 0xFD94 /end MEASUREMENT
/begin MEASUREMENT B_adcInjact "" UWORD B_TRUE 1 100 0 1 BIT_MASK 0x40 FORMAT "%13.11" ECU_ADDRESS 0xFD40 /end MEASUREMENT
/begin MEASUREMENT B_ale "Bedingung Motorabstellposition erkannt" UBYTE B_TRUE 1 100 0 1 BIT_MASK 0x1 FORMAT "%13.11" ECU_ADDRESS 0x3830EF /end MEASUREMENT
/begin MEASUREMENT B_anskl "Bedingung Ansteuerung Ansaugklappe" UBYTE B_TRUE 1 100 0 1 BIT_MASK 0x1 FORMAT "%13.11" ECU_ADDRESS 0x380D7F /end MEASUREMENT
/begin MEASUREMENT B_ap "" UWORD B_TRUE 1 100 0 1 BIT_MASK 0x100 FORMAT "%13.11" ECU_ADDRESS 0xFD78 /end MEASUREMENT
/begin MEASUREMENT B_ar "Antiruckeleingriff aktiv" UWORD B_TRUE 1 100 0 1 BIT_MASK 0x4 FORMAT "%13.11" ECU_ADDRESS 0xFD52 /end MEASUREMENT
/begin MEASUREMENT B_ar_help "" UWORD B_TRUE 1 100 0 1 BIT_MASK 0x8 FORMAT "%13.11" ECU_ADDRESS 0xFD52 /end MEASUREMENT
/begin MEASUREMENT B_atmst "Bedingung Startwert tabgmst,tkatmst berechnet" UWORD B_TRUE 1 100 0 1 BIT_MASK 0x40 FORMAT "%13.11" ECU_ADDRESS 0xFD7A /end MEASUREMENT
/begin MEASUREMENT B_atmst2 "Bedingung Startwert tabgmst, tkatmst berechnet Bank2" UWORD B_TRUE 1 100 0 1 BIT_MASK 0x80 FORMAT "%13.11" ECU_ADDRESS 0xFD7A /end MEASUREMENT
/begin MEASUREMENT B_atmtpa "Bedingung Taupunkt vor Kat ueberschritten" UWORD B_TRUE 1 100 0 1 BIT_MASK 0x20 FORMAT "%13.11" ECU_ADDRESS 0xFD2E /end MEASUREMENT
/begin MEASUREMENT B_atmtpa2 "Bedingung Taupunkt2 vor Kat ueberschritten" UWORD B_TRUE 1 100 0 1 BIT_MASK 0x40 FORMAT "%13.11" ECU_ADDRESS 0xFD2E /end MEASUREMENT
/begin MEASUREMENT B_atmtpf "Bedingung Taupunkt vor Kat überschritten (last trip)" UBYTE B_TRUE 1 100 0 1 BIT_MASK 0x4 FORMAT "%13.11" ECU_ADDRESS 0x3830F5 /end MEASUREMENT
/begin MEASUREMENT B_atmtpf2 "Bedingung Taupunkt vor Kat überschritten (last trip) Bank2" UBYTE B_TRUE 1 100 0 1 BIT_MASK 0x8 FORMAT "%13.11" ECU_ADDRESS 0x3830F5 /end MEASUREMENT
/begin MEASUREMENT B_atmtpk "Bedingung Taupunkt hinter Kat ueberschritten" UWORD B_TRUE 1 100 0 1 BIT_MASK 0x80 FORMAT "%13.11" ECU_ADDRESS 0xFD2E /end MEASUREMENT
/begin MEASUREMENT B_atmtpk2 "Bedingung Taupunkt2 hinter Kat ueberschritten" UWORD B_TRUE 1 100 0 1 BIT_MASK 0x100 FORMAT "%13.11" ECU_ADDRESS 0xFD2E /end MEASUREMENT
/begin MEASUREMENT B_atmtpl "Bedingung Taupunkt hinter Kat überschritten (last trip)" UBYTE B_TRUE 1 100 0 1 BIT_MASK 0x1 FORMAT "%13.11" ECU_ADDRESS 0x3830F5 /end MEASUREMENT
/begin MEASUREMENT B_atmtpl2 "Bedingung Taupunkt hinter Kat überschritten (last trip) Bank2" UBYTE B_TRUE 1 100 0 1 BIT_MASK 0x2 FORMAT "%13.11" ECU_ADDRESS 0x3830F5 /end MEASUREMENT
/begin MEASUREMENT B_bevab "Bedingung EV-Abschaltung auf Bank/Bank1" UWORD B_TRUE 1 100 0 1 BIT_MASK 0x100 FORMAT "%13.11" ECU_ADDRESS 0xFD2A /end MEASUREMENT
/begin MEASUREMENT B_bevab2 "Bedingung EV-Abschaltung auf Bank2" UWORD B_TRUE 1 100 0 1 BIT_MASK 0x200 FORMAT "%13.11" ECU_ADDRESS 0xFD2A /end MEASUREMENT
/begin MEASUREMENT B_calib2 "" UBYTE B_TRUE 1 100 0 1 BIT_MASK 0x4 FORMAT "%13.11" ECU_ADDRESS 0x380BED /end MEASUREMENT
/begin MEASUREMENT B_cksbrdy "Checksummemberechnung ist fertig (ready)" UBYTE B_TRUE 1 100 0 1 BIT_MASK 0x1 FORMAT "%13.11" ECU_ADDRESS 0x380BED /end MEASUREMENT
/begin MEASUREMENT B_cksbrdy2 "2. Checksummemberechnung ist fertig (ready)" UBYTE B_TRUE 1 100 0 1 BIT_MASK 0x2 FORMAT "%13.11" ECU_ADDRESS 0x380BED /end MEASUREMENT
/begin MEASUREMENT B_dcdisfr "Bedingung: Disable DV-E-Endstufe durch den Funktionsrechner" UWORD B_TRUE 1 100 0 1 BIT_MASK 0x80 FORMAT "%13.11" ECU_ADDRESS 0xFD42 /end MEASUREMENT
/begin MEASUREMENT B_dcdisr "Bedingung: DV-E-Endstufenabschaltung wird angefordert" UWORD B_TRUE 1 100 0 1 BIT_MASK 0x400 FORMAT "%13.11" ECU_ADDRESS 0xFD44 /end MEASUREMENT
/begin MEASUREMENT B_dkaden "Bedingung: DK-Sollwert aus DK-Adaption und -Prüfung verwenden" UWORD B_TRUE 1 100 0 1 BIT_MASK 0x800 FORMAT "%13.11" ECU_ADDRESS 0xFD44 /end MEASUREMENT
/begin MEASUREMENT B_dkbew "Bedingung: DK hat sich bewegt" UWORD B_TRUE 1 100 0 1 BIT_MASK 0x100 FORMAT "%13.11" ECU_ADDRESS 0xFD42 /end MEASUREMENT
/begin MEASUREMENT B_dkuevab "Bedingung Ev-Abschaltung bei unplausibler DK" UWORD B_TRUE 1 100 0 1 BIT_MASK 0x400 FORMAT "%13.11" ECU_ADDRESS 0xFD2A /end MEASUREMENT
/begin MEASUREMENT B_dlrbe "Bedingung: DLR-Stellbereich wurde überschritten" UWORD B_TRUE 1 100 0 1 BIT_MASK 0x200 FORMAT "%13.11" ECU_ADDRESS 0xFD42 /end MEASUREMENT
/begin MEASUREMENT B_dlrien "Bedingung: keine temp. Begrenzung des I-Anteils im DLR durchführen" UWORD B_TRUE 1 100 0 1 BIT_MASK 0x1000 FORMAT "%13.11" ECU_ADDRESS 0xFD44 /end MEASUREMENT
/begin MEASUREMENT B_dlrikla "Bedingung: DLR, I-Klein aktiv" UWORD B_TRUE 1 100 0 1 BIT_MASK 0x400 FORMAT "%13.11" ECU_ADDRESS 0xFD42 /end MEASUREMENT
/begin MEASUREMENT B_dlriklst "Bedingung: Erster Durchlauf I-Klein nach Start" UWORD B_TRUE 1 100 0 1 BIT_MASK 0x800 FORMAT "%13.11" ECU_ADDRESS 0xFD42 /end MEASUREMENT
/begin MEASUREMENT B_dlrparc "Bedingung: Sollgrößensprung steht an" UWORD B_TRUE 1 100 0 1 BIT_MASK 0x1000 FORMAT "%13.11" ECU_ADDRESS 0xFD42 /end MEASUREMENT
/begin MEASUREMENT B_dlrpide "Bedingung: Fehler, DLR-Stellbereich am Anschlag" UWORD B_TRUE 1 100 0 1 BIT_MASK 0x2000 FORMAT "%13.11" ECU_ADDRESS 0xFD42 /end MEASUREMENT
/begin MEASUREMENT B_dlrspid "Bedingung: DLR, Vorzeichen der Summe der PID-Anteile, =1: positiv, =0: negativ" UWORD B_TRUE 1 100 0 1 BIT_MASK 0x4000 FORMAT "%13.11" ECU_ADDRESS 0xFD42 /end MEASUREMENT
/begin MEASUREMENT B_dlrumzu "Bedingung: NLP-Umladen zugelassen" UWORD B_TRUE 1 100 0 1 BIT_MASK 0x8000 FORMAT "%13.11" ECU_ADDRESS 0xFD42 /end MEASUREMENT
/begin MEASUREMENT B_dnsll "Bedingung SA-Drehzahl-Hysterese DNSLL" UBYTE B_TRUE 1 100 0 1 BIT_MASK 0x1 FORMAT "%13.11" ECU_ADDRESS 0x380B52 /end MEASUREMENT
/begin MEASUREMENT B_dslvh "Bedingung Ladedrucksensor vorhanden" UWORD B_TRUE 1 100 0 1 BIT_MASK 0x40 FORMAT "%13.11" ECU_ADDRESS 0xFD3E /end MEASUREMENT
/begin MEASUREMENT B_dssv "Bedingung Saugrohr-Drucksensor vorhanden als Hauptlastsensor" UWORD B_TRUE 1 100 0 1 BIT_MASK 0x80 FORMAT "%13.11" ECU_ADDRESS 0xFD26 /end MEASUREMENT
/begin MEASUREMENT B_dveada "Bedingung: DV-E-Adaption sperrt Einspritzung" UWORD B_TRUE 1 100 0 1 BIT_MASK 0x2000 FORMAT "%13.11" ECU_ADDRESS 0xFD44 /end MEASUREMENT
/begin MEASUREMENT B_dveese "Bedingung: DV-E-Endstufen-Fehler" UWORD B_TRUE 1 100 0 1 BIT_MASK 0x1 FORMAT "%13.11" ECU_ADDRESS 0xFD44 /end MEASUREMENT
/begin MEASUREMENT B_dveesh "Bedingung: DV-E-Enstufen-Heilung" UWORD B_TRUE 1 100 0 1 BIT_MASK 0x2 FORMAT "%13.11" ECU_ADDRESS 0xFD44 /end MEASUREMENT
/begin MEASUREMENT B_ekp "Freigabe der EKP-Versorgung" UWORD B_TRUE 1 100 0 1 BIT_MASK 0x200 FORMAT "%13.11" ECU_ADDRESS 0xFDE0 /end MEASUREMENT
/begin MEASUREMENT B_ekpd "Bedingung EKP Dauerbetrieb" UBYTE B_TRUE 1 100 0 1 BIT_MASK 0x8 FORMAT "%13.11" ECU_ADDRESS 0x380D7B /end MEASUREMENT
/begin MEASUREMENT B_ekpn "Bedingung EKP-Einschaltbedingung Drehzahl erfüllt" UBYTE B_TRUE 1 100 0 1 BIT_MASK 0x10 FORMAT "%13.11" ECU_ADDRESS 0x380D7B /end MEASUREMENT
/begin MEASUREMENT B_ekpubn "Bedingung EKP-Einschaltbedingung UBatt-Einbruch und Zahnsignal erfüllt" UBYTE B_TRUE 1 100 0 1 BIT_MASK 0x20 FORMAT "%13.11" ECU_ADDRESS 0x380D7B /end MEASUREMENT
/begin MEASUREMENT B_ekpvl "Bedingung EKP-Vorlauf" UBYTE B_TRUE 1 100 0 1 BIT_MASK 0x40 FORMAT "%13.11" ECU_ADDRESS 0x380D7B /end MEASUREMENT
/begin MEASUREMENT B_evasel "Status alle für DASE relevant. lokalen Einspritzventile d. SG werden angesteuert" UWORD B_TRUE 1 100 0 1 BIT_MASK 0x800 FORMAT "%13.11" ECU_ADDRESS 0xFD2A /end MEASUREMENT
/begin MEASUREMENT B_evloc "Status alle lokalen Einspritzventile werden angesteuert, = B_EVTOT bei einen SG" UWORD B_TRUE 1 100 0 1 BIT_MASK 0x1000 FORMAT "%13.11" ECU_ADDRESS 0xFD2A /end MEASUREMENT
/begin MEASUREMENT B_fgrab "FGR-/ACC-Abschaltung aus der Funktion" UWORD B_TRUE 1 100 0 1 BIT_MASK 0x8 FORMAT "%13.11" ECU_ADDRESS 0xFD96 /end MEASUREMENT
/begin MEASUREMENT B_fgraext "Bedingung: FGR-Abschaltung durch externe Anforderung ASC/DSC" UBYTE B_TRUE 1 100 0 1 BIT_MASK 0x8 FORMAT "%13.11" ECU_ADDRESS 0x380C6F /end MEASUREMENT
/begin MEASUREMENT B_fgrai "Bedingung FGR-Abschaltung irreversibel" UWORD B_TRUE 1 100 0 1 BIT_MASK 0x20 FORMAT "%13.11" ECU_ADDRESS 0xFD50 /end MEASUREMENT
/begin MEASUREMENT B_fgral "Bedingung FGR-Abschaltung langsam" UBYTE B_TRUE 1 100 0 1 BIT_MASK 0x1 FORMAT "%13.11" ECU_ADDRESS 0x380C6F /end MEASUREMENT
/begin MEASUREMENT B_fgrars "Bedingung: FGR-Abschaltung reversibel schnell" UBYTE B_TRUE 1 100 0 1 BIT_MASK 0x2 FORMAT "%13.11" ECU_ADDRESS 0x380C6F /end MEASUREMENT
/begin MEASUREMENT B_fgras "Bedingung: FGR-Abschaltung schnell" UWORD B_TRUE 1 100 0 1 BIT_MASK 0x40 FORMAT "%13.11" ECU_ADDRESS 0xFD50 /end MEASUREMENT
/begin MEASUREMENT B_fgrenv "Bedingung FGR-Regelung aktiv (Enable) vorläufig" UWORD B_TRUE 1 100 0 1 BIT_MASK 0x10 FORMAT "%13.11" ECU_ADDRESS 0xFD96 /end MEASUREMENT
/begin MEASUREMENT B_fgres "Bedingung FGR-Einschaltung" UBYTE B_TRUE 1 100 0 1 BIT_MASK 0x4 FORMAT "%13.11" ECU_ADDRESS 0x380C6F /end MEASUREMENT
/begin MEASUREMENT B_fgresv "Bedingung FGR-Einschaltgeschwindigkeit erreicht" UWORD B_TRUE 1 100 0 1 BIT_MASK 0x20 FORMAT "%13.11" ECU_ADDRESS 0xFD96 /end MEASUREMENT
/begin MEASUREMENT B_fkmsmn "schnelle Massenstromadaption fkmsdks im unteren Anschlag" UWORD B_TRUE 1 100 0 1 BIT_MASK 0x80 FORMAT "%13.11" ECU_ADDRESS 0xFD3E /end MEASUREMENT
/begin MEASUREMENT B_fkmsmx "schnelle Massenstromadaption fkmsdks im oberen Anschlag" UWORD B_TRUE 1 100 0 1 BIT_MASK 0x100 FORMAT "%13.11" ECU_ADDRESS 0xFD3E /end MEASUREMENT
/begin MEASUREMENT B_fkpvmn "langsame Massenstromadaption fkpvdk im unteren Anschlag" UWORD B_TRUE 1 100 0 1 BIT_MASK 0x200 FORMAT "%13.11" ECU_ADDRESS 0xFD3E /end MEASUREMENT
/begin MEASUREMENT B_fkpvmx "langsame Massenstromadaption fkpvdk im oberen Anschlag" UWORD B_TRUE 1 100 0 1 BIT_MASK 0x400 FORMAT "%13.11" ECU_ADDRESS 0xFD3E /end MEASUREMENT
/begin MEASUREMENT B_fprakt "DK-Rückstellfeder-Prüfung aktiv" UWORD B_TRUE 1 100 0 1 BIT_MASK 0x2 FORMAT "%13.11" ECU_ADDRESS 0xFD92 /end MEASUREMENT
/begin MEASUREMENT B_fprrdy "DK-Rückstellfeder-Prüfung beendet" UWORD B_TRUE 1 100 0 1 BIT_MASK 0x4 FORMAT "%13.11" ECU_ADDRESS 0xFD92 /end MEASUREMENT
/begin MEASUREMENT B_fprzab "Bedingung: DV-E-Rückstellfederprüfung Abbruch, Feder schließt nicht" UWORD B_TRUE 1 100 0 1 BIT_MASK 0x8 FORMAT "%13.11" ECU_ADDRESS 0xFD92 /end MEASUREMENT
/begin MEASUREMENT B_fprze "Bedingung: Fehler in der DV-E-Rückstellfederprüfung" UWORD B_TRUE 1 100 0 1 BIT_MASK 0x10 FORMAT "%13.11" ECU_ADDRESS 0xFD92 /end MEASUREMENT
/begin MEASUREMENT B_fprzok "Bedingung: DV-E-Rückstellfederprüfung i.O." UWORD B_TRUE 1 100 0 1 BIT_MASK 0x20 FORMAT "%13.11" ECU_ADDRESS 0xFD92 /end MEASUREMENT
/begin MEASUREMENT B_fprzvb "Bedingung: DV-E-Rückstellfederprüfung verboten" UWORD B_TRUE 1 100 0 1 BIT_MASK 0x40 FORMAT "%13.11" ECU_ADDRESS 0xFD92 /end MEASUREMENT
/begin MEASUREMENT B_fraoan "Anforderung TEV schnell schließen zur Aktivierung der Gemischadaption" UWORD B_TRUE 1 100 0 1 BIT_MASK 0x100 FORMAT "%13.11" ECU_ADDRESS 0xFD98 /end MEASUREMENT
/begin MEASUREMENT B_gap "Bedingung Gemischadaptionsphase aktiv" UWORD B_TRUE 1 100 0 1 BIT_MASK 0x200 FORMAT "%13.11" ECU_ADDRESS 0xFD98 /end MEASUREMENT
/begin MEASUREMENT B_gwhs "Bedingung Gangwechsel bei Handschalter" UWORD B_TRUE 1 100 0 1 BIT_MASK 0x2000 FORMAT "%13.11" ECU_ADDRESS 0xFD88 /end MEASUREMENT
/begin MEASUREMENT B_hfmv "Bedingung HFM vorhanden" UWORD B_TRUE 1 100 0 1 BIT_MASK 0x100 FORMAT "%13.11" ECU_ADDRESS 0xFD26 /end MEASUREMENT
/begin MEASUREMENT B_iklrest "Bedingung: Retriggerung I-Klein" UWORD B_TRUE 1 100 0 1 BIT_MASK 0x4 FORMAT "%13.11" ECU_ADDRESS 0xFD44 /end MEASUREMENT
/begin MEASUREMENT B_iklstar "Bedingung: I-Klein soll starten" UWORD B_TRUE 1 100 0 1 BIT_MASK 0x8 FORMAT "%13.11" ECU_ADDRESS 0xFD44 /end MEASUREMENT
/begin MEASUREMENT B_imlprini "Initialisierung imlpr/imlpr_w" UWORD B_TRUE 1 100 0 1 BIT_MASK 0x400 FORMAT "%13.11" ECU_ADDRESS 0x382326 /end MEASUREMENT
/begin MEASUREMENT B_iniar "Bedingung Initialisierung der AR-Funktion" UWORD B_TRUE 1 100 0 1 BIT_MASK 0x10 FORMAT "%13.11" ECU_ADDRESS 0xFD52 /end MEASUREMENT
/begin MEASUREMENT B_intzwv "Bedingung ZW-Verstellung durch MD-Struktur aktiv" UWORD B_TRUE 1 100 0 1 BIT_MASK 0x1 FORMAT "%13.11" ECU_ADDRESS 0xFD52 /end MEASUREMENT
/begin MEASUREMENT B_kh "Bedingung Kat-Heizung" UWORD B_TRUE 1 100 0 1 BIT_MASK 0x10 FORMAT "%13.11" ECU_ADDRESS 0xFD2A /end MEASUREMENT
/begin MEASUREMENT B_kha "Anforderung Katheizen" UWORD B_TRUE 1 100 0 1 BIT_MASK 0x80 FORMAT "%13.11" ECU_ADDRESS 0xFDBE /end MEASUREMENT
/begin MEASUREMENT B_khab "Bedingung Katheizen Abbruch" UWORD B_TRUE 1 100 0 1 BIT_MASK 0x100 FORMAT "%13.11" ECU_ADDRESS 0xFDBE /end MEASUREMENT
/begin MEASUREMENT B_khares "Bedingung Rücksetzen von Bit B_kha" UWORD B_TRUE 1 100 0 1 BIT_MASK 0x80 FORMAT "%13.11" ECU_ADDRESS 0x382326 /end MEASUREMENT
/begin MEASUREMENT B_khaset "Bedingung Setzen von Bit B_kha" UWORD B_TRUE 1 100 0 1 BIT_MASK 0x40 FORMAT "%13.11" ECU_ADDRESS 0x382326 /end MEASUREMENT
/begin MEASUREMENT B_kherr "Fehler bedingte Sperrbedingung für Bit B_kh" UWORD B_TRUE 1 100 0 1 BIT_MASK 0x200 FORMAT "%13.11" ECU_ADDRESS 0x382326 /end MEASUREMENT
/begin MEASUREMENT B_khll "Bedingung Katheizen Leerlauf (Abbruchbedingung)" UWORD B_TRUE 1 100 0 1 BIT_MASK 0x8 FORMAT "%13.11" ECU_ADDRESS 0x382326 /end MEASUREMENT
/begin MEASUREMENT B_khlle "Bedingung Leerlauf während Katheizen verlassen" UWORD B_TRUE 1 100 0 1 BIT_MASK 0x1 FORMAT "%13.11" ECU_ADDRESS 0x382326 /end MEASUREMENT
/begin MEASUREMENT B_khllmx "Bedingung max. Katheitzeit im Leerlauf erreicht" UWORD B_TRUE 1 100 0 1 BIT_MASK 0x2 FORMAT "%13.11" ECU_ADDRESS 0x382326 /end MEASUREMENT
/begin MEASUREMENT B_khn "Bedingung Katheiz-Drehzahl" UWORD B_TRUE 1 100 0 1 BIT_MASK 0x4 FORMAT "%13.11" ECU_ADDRESS 0x382326 /end MEASUREMENT
/begin MEASUREMENT B_khres "Bedingung Rücksetzen von Bit B_kh" UWORD B_TRUE 1 100 0 1 BIT_MASK 0x20 FORMAT "%13.11" ECU_ADDRESS 0x382326 /end MEASUREMENT
/begin MEASUREMENT B_khset "Bedingung Setzen von Bit B_kh" UWORD B_TRUE 1 100 0 1 BIT_MASK 0x10 FORMAT "%13.11" ECU_ADDRESS 0x382326 /end MEASUREMENT
/begin MEASUREMENT B_khstc "von Temperaturen oder Abstellzeit abhängige Freigabe Kat-Heizen" UWORD B_TRUE 1 100 0 1 BIT_MASK 0x800 FORMAT "%13.11" ECU_ADDRESS 0x382326 /end MEASUREMENT
/begin MEASUREMENT B_kurn "Bedingung Kupplung rutscht negativ" UWORD B_TRUE 1 100 0 1 BIT_MASK 0x100 FORMAT "%13.11" ECU_ADDRESS 0xFD88 /end MEASUREMENT
/begin MEASUREMENT B_kurp "Bedingung Kupplung rutscht positiv" UWORD B_TRUE 1 100 0 1 BIT_MASK 0x200 FORMAT "%13.11" ECU_ADDRESS 0xFD88 /end MEASUREMENT
/begin MEASUREMENT B_kvta "Bedingung verbrauchter Kraftstoff groesser max. Tankinhalt" UBYTE B_TRUE 1 100 0 1 BIT_MASK 0x1 FORMAT "%13.11" ECU_ADDRESS 0x380D3E /end MEASUREMENT
/begin MEASUREMENT B_kw "Bedingung Kat warmhalten" UWORD B_TRUE 1 100 0 1 BIT_MASK 0x20 FORMAT "%13.11" ECU_ADDRESS 0xFD2A /end MEASUREMENT
/begin MEASUREMENT B_lowra "Bedingung Zwischengelege für Low Range zugeschaltet" UBYTE B_TRUE 1 100 0 1 BIT_MASK 0x1 FORMAT "%13.11" ECU_ADDRESS 0x383161 /end MEASUREMENT
/begin MEASUREMENT B_lowrapp "Bedingung umschalten Fahrpedalcharateristik bei Applikation" UWORD B_TRUE 1 100 0 1 BIT_MASK 0x10 FORMAT "%13.11" ECU_ADDRESS 0xFDE2 /end MEASUREMENT
/begin MEASUREMENT B_lrnakt "Lernaktiv Bit" UWORD B_TRUE 1 100 0 1 BIT_MASK 0x80 FORMAT "%13.11" ECU_ADDRESS 0xFD92 /end MEASUREMENT
/begin MEASUREMENT B_lrnerf "Lernerfolg Bit" UBYTE B_TRUE 1 100 0 1 BIT_MASK 0x8 FORMAT "%13.11" ECU_ADDRESS 0x38310F /end MEASUREMENT
/begin MEASUREMENT B_lrnfg "Lernfreigabe Bit" UWORD B_TRUE 1 100 0 1 BIT_MASK 0x100 FORMAT "%13.11" ECU_ADDRESS 0xFD92 /end MEASUREMENT
/begin MEASUREMENT B_lrnrdy "Lernen ist beendet" UWORD B_TRUE 1 100 0 1 BIT_MASK 0x4000 FORMAT "%13.11" ECU_ADDRESS 0xFD44 /end MEASUREMENT
/begin MEASUREMENT B_lrntesa "Bedingung: UMA-Lernen u. Verst.abgl wegen Tester-Anford. aktiviert" UWORD B_TRUE 1 100 0 1 BIT_MASK 0x200 FORMAT "%13.11" ECU_ADDRESS 0xFD92 /end MEASUREMENT
/begin MEASUREMENT B_lrnvb "Lernverbot Bit" UWORD B_TRUE 1 100 0 1 BIT_MASK 0x400 FORMAT "%13.11" ECU_ADDRESS 0xFD92 /end MEASUREMENT
/begin MEASUREMENT B_lrnws "Lernwertspeicherung Bit" UBYTE B_TRUE 1 100 0 1 BIT_MASK 0x1 FORMAT "%13.11" ECU_ADDRESS 0x38310F /end MEASUREMENT
/begin MEASUREMENT B_mflai "Bedingung FGR-ACC-Abschaltung irrev." UWORD B_TRUE 1 100 0 1 BIT_MASK 0x4000 FORMAT "%13.11" ECU_ADDRESS 0xFD94 /end MEASUREMENT
/begin MEASUREMENT B_mflal "Bedingung FGR-ACC-Abschaltung langsam" UWORD B_TRUE 1 100 0 1 BIT_MASK 0x8000 FORMAT "%13.11" ECU_ADDRESS 0xFD94 /end MEASUREMENT
/begin MEASUREMENT B_mflar "Bedingung FGR-Abschaltung rev." UWORD B_TRUE 1 100 0 1 BIT_MASK 0x1 FORMAT "%13.11" ECU_ADDRESS 0xFD96 /end MEASUREMENT
/begin MEASUREMENT B_mflas "Bedingung FGR-ACC-Abschaltung schnell" UWORD B_TRUE 1 100 0 1 BIT_MASK 0x2 FORMAT "%13.11" ECU_ADDRESS 0xFD96 /end MEASUREMENT
/begin MEASUREMENT B_mflen "Bedingung FGR-ACC-Regelung aktiv" UWORD B_TRUE 1 100 0 1 BIT_MASK 0x4 FORMAT "%13.11" ECU_ADDRESS 0xFD96 /end MEASUREMENT
/begin MEASUREMENT B_miext "Bedingung externer Momenteneingriff" UWORD B_TRUE 1 100 0 1 BIT_MASK 0x2 FORMAT "%13.11" ECU_ADDRESS 0xFD52 /end MEASUREMENT
/begin MEASUREMENT B_mlsu "Bedingung mslu nicht größer 0" UWORD B_TRUE 1 100 0 1 BIT_MASK 0x100 FORMAT "%13.11" ECU_ADDRESS 0x382326 /end MEASUREMENT
/begin MEASUREMENT B_nlpe "Bedingung: Fehler in NLP-Prüfung u. -Lernen" UWORD B_TRUE 1 100 0 1 BIT_MASK 0x800 FORMAT "%13.11" ECU_ADDRESS 0xFD92 /end MEASUREMENT
/begin MEASUREMENT B_nlperf "Dauer-RAM, Bedingung: NLP-Erfassung erfolgreich" UBYTE B_TRUE 1 100 0 1 BIT_MASK 0x2 FORMAT "%13.11" ECU_ADDRESS 0x38310F /end MEASUREMENT
/begin MEASUREMENT B_nlperft "Dauer-RAM, Bedingung: NLP-Erfassung teilweise erfolgreich, temp. Zustand" UBYTE B_TRUE 1 100 0 1 BIT_MASK 0x4 FORMAT "%13.11" ECU_ADDRESS 0x38310F /end MEASUREMENT
/begin MEASUREMENT B_nlpne "Bedingung: Bei gefordertem DK-Notluftfahren wurde NLP nicht erreicht" UWORD B_TRUE 1 100 0 1 BIT_MASK 0x10 FORMAT "%13.11" ECU_ADDRESS 0xFD44 /end MEASUREMENT
/begin MEASUREMENT B_nlpnew "Bedingung: NLP-Position ist noch nicht bekannt" UWORD B_TRUE 1 100 0 1 BIT_MASK 0x1000 FORMAT "%13.11" ECU_ADDRESS 0xFD92 /end MEASUREMENT
/begin MEASUREMENT B_nlpreq "Bedingung: NLP-Lernen anfordern" UWORD B_TRUE 1 100 0 1 BIT_MASK 0x2000 FORMAT "%13.11" ECU_ADDRESS 0xFD92 /end MEASUREMENT
/begin MEASUREMENT B_nsub "Bedingung für Solldrehzahlanhebung bei niedriger Batteriespannung" UWORD B_TRUE 1 100 0 1 BIT_MASK 0x80 FORMAT "%13.11" ECU_ADDRESS 0xFD88 /end MEASUREMENT
/begin MEASUREMENT B_pvl1 "Bedingung Pumpenvorlauf bei Systemen mit Uhr" UBYTE B_TRUE 1 100 0 1 BIT_MASK 0x1 FORMAT "%13.11" ECU_ADDRESS 0x380D7B /end MEASUREMENT
/begin MEASUREMENT B_pvl2 "Bedingung Pumpenvorlauf bei Systemen ohne Uhr" UBYTE B_TRUE 1 100 0 1 BIT_MASK 0x2 FORMAT "%13.11" ECU_ADDRESS 0x380D7B /end MEASUREMENT
/begin MEASUREMENT B_pvlnl "Bedingung EKP-Vorlauf aus Nachlaufzeitüberschreitung" UBYTE B_TRUE 1 100 0 1 BIT_MASK 0x1 FORMAT "%13.11" ECU_ADDRESS 0x383160 /end MEASUREMENT
/begin MEASUREMENT B_sab "Bedingung Schubabschaltebereitschaft" UWORD B_TRUE 1 100 0 1 BIT_MASK 0x400 FORMAT "%13.11" ECU_ADDRESS 0xFD24 /end MEASUREMENT
/begin MEASUREMENT B_sabt "Bedingung Schubabschaltebereitschaft" UBYTE B_TRUE 1 100 0 1 BIT_MASK 0x2 FORMAT "%13.11" ECU_ADDRESS 0x380B52 /end MEASUREMENT
/begin MEASUREMENT B_skaevab "Bedingung Ev-Abschaltung durch Sicherheitskraftstoffabschaltung aktiv" UWORD B_TRUE 1 100 0 1 BIT_MASK 0x2000 FORMAT "%13.11" ECU_ADDRESS 0xFD2A /end MEASUREMENT
/begin MEASUREMENT B_st "Bedingung Start" UWORD B_TRUE 1 100 0 1 BIT_MASK 0x1 FORMAT "%13.11" ECU_ADDRESS 0xFD48 /end MEASUREMENT
/begin MEASUREMENT B_stend "Bedingung Startende erreicht" UWORD B_TRUE 1 100 0 1 BIT_MASK 0x2 FORMAT "%13.11" ECU_ADDRESS 0xFD48 /end MEASUREMENT
/begin MEASUREMENT B_stndnl "Bedingung Beginn SG-Nachlauf oder Startende (1->0)" UWORD B_TRUE 1 100 0 1 BIT_MASK 0x100 FORMAT "%13.11" ECU_ADDRESS 0xFD7A /end MEASUREMENT
/begin MEASUREMENT B_tanshys "" UBYTE B_TRUE 1 100 0 1 BIT_MASK 0x2 FORMAT "%13.11" ECU_ADDRESS 0x380D7F /end MEASUREMENT
/begin MEASUREMENT B_tehbxf "Bedingung Beladungsintegrator ftead am Maximalanschlag, gefiltert" UWORD B_TRUE 1 100 0 1 BIT_MASK 0x400 FORMAT "%13.11" ECU_ADDRESS 0xFD98 /end MEASUREMENT
/begin MEASUREMENT B_tep "Bedingung Tankentlüftungsphase" UWORD B_TRUE 1 100 0 1 BIT_MASK 0x800 FORMAT "%13.11" ECU_ADDRESS 0xFD98 /end MEASUREMENT
/begin MEASUREMENT B_tepi "Bedingung TE-Phase intern aktiv" UWORD B_TRUE 1 100 0 1 BIT_MASK 0x1000 FORMAT "%13.11" ECU_ADDRESS 0xFD98 /end MEASUREMENT
/begin MEASUREMENT B_tepzus "Bedingung zusätzliche Tankentlüftungsphase" UWORD B_TRUE 1 100 0 1 BIT_MASK 0x2000 FORMAT "%13.11" ECU_ADDRESS 0xFD98 /end MEASUREMENT
/begin MEASUREMENT B_tesstp "Bedingung Tankentlüftung schnell stoppen" UWORD B_TRUE 1 100 0 1 BIT_MASK 0x4000 FORMAT "%13.11" ECU_ADDRESS 0xFD98 /end MEASUREMENT
/begin MEASUREMENT B_tezstp "Bedingung Tankentlüftung zwang stoppen" UWORD B_TRUE 1 100 0 1 BIT_MASK 0x8000 FORMAT "%13.11" ECU_ADDRESS 0xFD98 /end MEASUREMENT
/begin MEASUREMENT B_timsa "Bedingung Integrator für multip. Adaption freigegeben" UWORD B_TRUE 1 100 0 1 BIT_MASK 0x800 FORMAT "%13.11" ECU_ADDRESS 0xFD3E /end MEASUREMENT
/begin MEASUREMENT B_timsall "Bedingung Integrator für additive Adaption freigegeben" UWORD B_TRUE 1 100 0 1 BIT_MASK 0x1000 FORMAT "%13.11" ECU_ADDRESS 0xFD3E /end MEASUREMENT
/begin MEASUREMENT B_tpvl "Bedingung Pumpenvorlauf der Länge TPVL Sekunden" UBYTE B_TRUE 1 100 0 1 BIT_MASK 0x4 FORMAT "%13.11" ECU_ADDRESS 0x380D7B /end MEASUREMENT
/begin MEASUREMENT B_trkh "Bedingung Katheizen, Thermoreaktor wirksam" UWORD B_TRUE 1 100 0 1 BIT_MASK 0x200 FORMAT "%13.11" ECU_ADDRESS 0xFDBE /end MEASUREMENT
/begin MEASUREMENT B_tteae "Bedingung Umschaltung auf lange TE-Phase" UWORD B_TRUE 1 100 0 1 BIT_MASK 0x1 FORMAT "%13.11" ECU_ADDRESS 0xFD9A /end MEASUREMENT
/begin MEASUREMENT B_tzarni "Bedingung Wartezeit nach AR Initialisierung abgelaufen" UWORD B_TRUE 1 100 0 1 BIT_MASK 0x20 FORMAT "%13.11" ECU_ADDRESS 0xFD52 /end MEASUREMENT
/begin MEASUREMENT B_ubdve "Bedingung: Batteriespannung für DV-E-Ansteuerung i.O." UWORD B_TRUE 1 100 0 1 BIT_MASK 0x20 FORMAT "%13.11" ECU_ADDRESS 0xFD44 /end MEASUREMENT
/begin MEASUREMENT B_ubpvg "Bedingung Batteriespannung ausreichend für 5V-Potiversorgung" UWORD B_TRUE 1 100 0 1 BIT_MASK 0x40 FORMAT "%13.11" ECU_ADDRESS 0xFD44 /end MEASUREMENT
/begin MEASUREMENT B_ub_ok "Batteriespannung o.k." UWORD B_TRUE 1 100 0 1 BIT_MASK 0x80 FORMAT "%13.11" ECU_ADDRESS 0xFD44 /end MEASUREMENT
/begin MEASUREMENT B_umae "Bedingung: Fehler beim UMA-Lernen" UWORD B_TRUE 1 100 0 1 BIT_MASK 0x4000 FORMAT "%13.11" ECU_ADDRESS 0xFD92 /end MEASUREMENT
/begin MEASUREMENT B_umaerf "Bedingung: UMA-Lernen erfolgreich" UWORD B_TRUE 1 100 0 1 BIT_MASK 0x8000 FORMAT "%13.11" ECU_ADDRESS 0xFD92 /end MEASUREMENT
/begin MEASUREMENT B_umardr "Bedingung: UMA-Lernwert ins Dauer-RAM übernommen" UWORD B_TRUE 1 100 0 1 BIT_MASK 0x1 FORMAT "%13.11" ECU_ADDRESS 0xFD94 /end MEASUREMENT
/begin MEASUREMENT B_umauab "Bedingung: UMA-Lernen während Urinitialisierung abgebrochen (SKA)" UWORD B_TRUE 1 100 0 1 BIT_MASK 0x2 FORMAT "%13.11" ECU_ADDRESS 0xFD94 /end MEASUREMENT
/begin MEASUREMENT B_umkehr "" UWORD B_TRUE 1 100 0 1 BIT_MASK 0x200 FORMAT "%13.11" ECU_ADDRESS 0xFD78 /end MEASUREMENT
/begin MEASUREMENT B_upuew "Bedingung Umschaltung auf Pedalüberweg" UWORD B_TRUE 1 100 0 1 BIT_MASK 0x4 FORMAT "%13.11" ECU_ADDRESS 0xFDC4 /end MEASUREMENT
/begin MEASUREMENT B_vl "Bedingung Vollast" UWORD B_TRUE 1 100 0 1 BIT_MASK 0x8 FORMAT "%13.11" ECU_ADDRESS 0xFD48 /end MEASUREMENT
/begin MEASUREMENT B_wdksauf "Bedingung: DLR, Sollsprung in Richtung AUF" UWORD B_TRUE 1 100 0 1 BIT_MASK 0x100 FORMAT "%13.11" ECU_ADDRESS 0xFD44 /end MEASUREMENT
/begin MEASUREMENT B_wdksive "Bedingung: Fehler im Vergleich DK-Winkel-Sollwert/-Istwert" UWORD B_TRUE 1 100 0 1 BIT_MASK 0x200 FORMAT "%13.11" ECU_ADDRESS 0xFD44 /end MEASUREMENT
/begin MEASUREMENT CALIBID1 "" UBYTE dez 1 100 0 255 FORMAT "%5.1" ARRAY_SIZE 7 ECU_ADDRESS 0x380BEE /end MEASUREMENT
/begin MEASUREMENT CALIBID2 "Calibration ID 2 zur SG Identifikation für Mode $09" UBYTE dez 1 100 0 255 FORMAT "%5.1" ARRAY_SIZE 7 ECU_ADDRESS 0x3830E8 /end MEASUREMENT
/begin MEASUREMENT cvn "auszugebende Checksumme (CVN) entsprechend SAE J1979 Mode $09" UBYTE dez 1 100 0 255 FORMAT "%5.1" ARRAY_SIZE 4 ECU_ADDRESS 0x380BF5 /end MEASUREMENT
/begin MEASUREMENT cvn2 "zweite auszugebende Checksumme (CVN) entsprechend SAE J1979 Mode $09" UBYTE dez 1 100 0 255 FORMAT "%5.1" ARRAY_SIZE 4 ECU_ADDRESS 0x380BF9 /end MEASUREMENT
/begin MEASUREMENT dekpub "Differenz der Batteriespannung zwischen zwei Messungen bis EKP-Dauerbetrieb" UBYTE spg_ubatt 1 100 0 24.021 FORMAT "%5.2" ECU_ADDRESS 0x380D7C /end MEASUREMENT
/begin MEASUREMENT dilb "Integratoreingangswert für Ladebilanz Batterie" SWORD dez 1 100 -32768 32767 FORMAT "%8.2" ECU_ADDRESS 0x38139E /end MEASUREMENT
/begin MEASUREMENT dklagerc "Fehlerzähler DK-Lageüberwachung" UBYTE t20msxs_ub_b5p1 1 100 0 5.1 FORMAT "%5.3" ECU_ADDRESS 0x380A4B /end MEASUREMENT
/begin MEASUREMENT dkpstg_w "Steigung DK-Poti (% DK / V)" UWORD rel_uw_b40 1 100 0 39.9994 FORMAT "%8.5" ECU_ADDRESS 0xF88C /end MEASUREMENT
/begin MEASUREMENT dlrd "DLR, D-Parameter" UBYTE relDK_q4 1 100 0 1020 FORMAT "%5.0" ECU_ADDRESS 0xF89C /end MEASUREMENT
/begin MEASUREMENT dlri "DLR, I-Parameter" UBYTE relDK_q0p0625 1 100 0 15.9375 FORMAT "%5.2" ECU_ADDRESS 0xF89D /end MEASUREMENT
/begin MEASUREMENT dlriamax "DLR, maximal möglicher I-Anteil" UWORD rel_q0p1957 1 100 0 12824.9 FORMAT "%8.2" ECU_ADDRESS 0xF8A2 /end MEASUREMENT
/begin MEASUREMENT dlriant_w "DLR, I-Anteil, highword von dlriant_l" SWORD rel_sw_q0p1953 1 100 -6400 6399.8 FORMAT "%8.3" ECU_ADDRESS 0x3813A6 /end MEASUREMENT
/begin MEASUREMENT dlriklst_w "Vorladewert I-Kleinanteil" SWORD rel_q0p1957 1 100 -6412.52 6412.33 FORMAT "%8.3" ECU_ADDRESS 0x3813A8 /end MEASUREMENT
/begin MEASUREMENT dlrikl_w "DLR, I-Kleinanteil" SWORD rel_q0p1957 1 100 -6412.52 6412.33 FORMAT "%8.3" ECU_ADDRESS 0xF8A4 /end MEASUREMENT
/begin MEASUREMENT dlrkomp "DLR, Faktor Kreisverstärkung" UBYTE fak_ub_b2 1 100 0 1.99219 FORMAT "%5.3" ECU_ADDRESS 0xF89E /end MEASUREMENT
/begin MEASUREMENT dlrmxt "timer für DLR im UMA in der Begrenzung" UBYTE t50msxs_q0p05 1 100 0 12.75 FORMAT "%5.2" ECU_ADDRESS 0x380C54 /end MEASUREMENT
/begin MEASUREMENT dlrndif_w "Istwert aktuell - Istwert letzter für D-Anteil des DLR" SWORD relDK_q0p02441 1 100 -800 799.976 FORMAT "%8.4" ECU_ADDRESS 0xF8A6 /end MEASUREMENT
/begin MEASUREMENT dlrp "DLR, P-Parameter" UBYTE relDK_q1 1 100 0 255 FORMAT "%5.1" ECU_ADDRESS 0xF89F /end MEASUREMENT
/begin MEASUREMENT dlrpidc "Fehlerzähler DLR-Stellbereichsüberwachung" UWORD t10msxs_uw_b655p35 1 100 0 655.35 FORMAT "%8.4" ECU_ADDRESS 0x3813AA /end MEASUREMENT
/begin MEASUREMENT dlrspid_w "DLR für DV-E: Summe der PID-Anteile" UWORD rel_uw_b100 1 100 0 99.9985 FORMAT "%8.5" ECU_ADDRESS 0xF8A8 /end MEASUREMENT
/begin MEASUREMENT dmar_w "Delta Drehmoment antiruckel" SWORD rel_sw_b100 1 100 -100 99.9969 FORMAT "%8.4" ECU_ADDRESS 0xFA60 /end MEASUREMENT
/begin MEASUREMENT dniar_w "Delta-Drehzahl bei Initialisierung AR-Drehzahl" SWORD nmot_sw_q0p25 1 100 -8192 8191.75 FORMAT "%8.3" ECU_ADDRESS 0x380E3A /end MEASUREMENT
/begin MEASUREMENT dnsa "Zeitabhängige Schubhysterese" UBYTE nmot_ub_q40 1 100 0 10200 FORMAT "%5.0" ECU_ADDRESS 0x380B53 /end MEASUREMENT
/begin MEASUREMENT dnvquotf_w "Gefilterte Differenz Drehzahl/Geschwindigkeitsquotient" SWORD qnv_sw_q0p0078 1 100 -256 255.992 FORMAT "%8.4" ECU_ADDRESS 0x3813A0 /end MEASUREMENT
/begin MEASUREMENT dnvquot_w "Differenz Drehzahl/Geschwindigkeitsquotient" SWORD qnv_sw_q0p0078 1 100 -256 255.992 FORMAT "%8.4" ECU_ADDRESS 0x3813A2 /end MEASUREMENT
/begin MEASUREMENT dpus_w "Delta Druck Umgebung Saugrohr" SWORD p_sw_q0p078 1 100 -2560 2559.92 FORMAT "%8.3" ECU_ADDRESS 0x38221A /end MEASUREMENT
/begin MEASUREMENT drllad_w "Dynamikanteil der relativen Füllung rl bei Laderdynamik" SWORD rel_sw_q0p0234 1 100 -768 767.977 FORMAT "%8.4" ECU_ADDRESS 0x381128 /end MEASUREMENT
/begin MEASUREMENT dveesc "Entprellzähler für DV-E-Endstufe" UBYTE t10msxs_ub_b2p55 1 100 0 2.55 FORMAT "%5.3" ECU_ADDRESS 0x380A4C /end MEASUREMENT
/begin MEASUREMENT dwdkdlr_w "Differenz-DK-Winkel Sollwert - Istwert (wdkdlr_w - wdkba_w)" SWORD relDK_q0p02441 1 100 -800 799.976 FORMAT "%8.4" ECU_ADDRESS 0xF8AA /end MEASUREMENT
/begin MEASUREMENT dwdks_kge "Änderung des Drosselklappen-Sollwinkels, Betrag für Kennlinieneingang" UWORD relDK_uw_b100 1 100 0 100 FORMAT "%8.4" ECU_ADDRESS 0x3813AC /end MEASUREMENT
/begin MEASUREMENT eevx "EV Fehlerbyte" UBYTE dez 1 100 0 255 FORMAT "%5.1" ECU_ADDRESS 0x3809A4 /end MEASUREMENT
/begin MEASUREMENT etazabas "Ist-Zylinderausblendungswirkungsgrad (ohne ext. Ausblendungsanforderung)" UBYTE rel_ub_b127p5 1 100 0 127.5 FORMAT "%5.1" ECU_ADDRESS 0x380A3B /end MEASUREMENT
/begin MEASUREMENT etazwimt "Ist_Zündwinkelwirkungsgrad für ATM gemittelt (200 ms)" UBYTE rel_ub_b127p5 1 100 0 127.5 FORMAT "%5.1" ECU_ADDRESS 0x380C03 /end MEASUREMENT
/begin MEASUREMENT evrbgn "Ev Nr. bei Beginn der Ev-Abschaltung über Momentenreduzierung" UBYTE dez 1 100 0 255 FORMAT "%5.1" ECU_ADDRESS 0x3809A5 /end MEASUREMENT
/begin MEASUREMENT evrbgn_one "Ev Nr -1 bei Beginn der Ev-Abschaltung zur Adressierung von REDABM" UBYTE dez 1 100 0 255 FORMAT "%5.1" ECU_ADDRESS 0x3809A6 /end MEASUREMENT
/begin MEASUREMENT evz_ags "Einspritzausblendmuster gesamt von einem oder 2 SG" UBYTE dez 1 100 0 255 FORMAT "%5.1" ECU_ADDRESS 0x3809A7 /end MEASUREMENT
/begin MEASUREMENT evz_aus "Einspritzausblendmuster" UBYTE dez 1 100 0 255 FORMAT "%5.1" ECU_ADDRESS 0xFA4A /end MEASUREMENT
/begin MEASUREMENT evz_austot "Einspritzausblendmuster total" UBYTE dez 1 100 0 255 FORMAT "%5.1" ECU_ADDRESS 0xFA4B /end MEASUREMENT
/begin MEASUREMENT fdar "Verstärkungsfaktor des AR-Eingriffs" UBYTE fak_ub_b3p125 1 100 0 3.11279 FORMAT "%5.3" ECU_ADDRESS 0x380A1C /end MEASUREMENT
/begin MEASUREMENT fgrstatu "Status Fahrgeschwindigkeitsregler (unverzögert)" UBYTE dez 1 100 0 255 FORMAT "%5.1" ECU_ADDRESS 0x380C6B /end MEASUREMENT
/begin MEASUREMENT fgr_stat "Status Fahrgeschwindigkeitsregler" UBYTE dez 1 100 0 255 FORMAT "%5.1" ECU_ADDRESS 0x380C6C /end MEASUREMENT
/begin MEASUREMENT fkhab "Faktor Katheizen zur Abregelung" UBYTE fak_ub_b1 1 100 0 0.996094 ECU_ADDRESS 0x380CAB /end MEASUREMENT
/begin MEASUREMENT fkmsdka_w "Korrekturfaktor schneller Massenstromausgleich" UWORD fak_uw_b4 1 100 0 3.99994 FORMAT "%8.6" ECU_ADDRESS 0x38302C /end MEASUREMENT
/begin MEASUREMENT fkmsdks_w "Korrekturfaktor schneller Massenstromabgleich" UWORD fak_uw_b4 1 100 0 3.99994 FORMAT "%8.6" ECU_ADDRESS 0x38302E /end MEASUREMENT
/begin MEASUREMENT fkmsdk_w "Korrekturfaktor Massenstrom Nebenfüllungssignal" UWORD fak_uw_b4 1 100 0 3.99994 FORMAT "%8.6" ECU_ADDRESS 0x383030 /end MEASUREMENT
/begin MEASUREMENT flakh "Faktor Lambda-Steuerung bei Katheizen" UBYTE fak_ub_b1 1 100 0 0.996094 ECU_ADDRESS 0x380CAC /end MEASUREMENT
/begin MEASUREMENT flamkh "Faktor Aufregelung Lambda-Motor-Soll bei Katheizen" UBYTE fak_ub_b1 1 100 0 0.996094 ECU_ADDRESS 0x380CAD /end MEASUREMENT
/begin MEASUREMENT flrar "Verstärkungsfaktor zum Nachbilden der externen Last" UBYTE fak_ub_b16 1 100 0 15.9375 FORMAT "%5.2" ECU_ADDRESS 0x380A1D /end MEASUREMENT
/begin MEASUREMENT fmdkh "Faktor Steuerung Drehmomentreserve für Katheizen" UBYTE fak_ub_b1 1 100 0 0.996094 ECU_ADDRESS 0x380CAE /end MEASUREMENT
/begin MEASUREMENT fmdkhtns_w "" UWORD fak_uw_b1 1 100 0 0.999985 FORMAT "%9.7" ECU_ADDRESS 0x382328 /end MEASUREMENT
/begin MEASUREMENT fmiacc_w "Faktor rel. zu ind. Moment" UWORD rel_uw_b200 1 100 0 199.997 FORMAT "%8.4" ECU_ADDRESS 0x382496 /end MEASUREMENT
/begin MEASUREMENT fprstep_c "Schrittzähler DK-Rückstellfeder-Prüfung" UBYTE dez 1 100 0 255 FORMAT "%5.1" ECU_ADDRESS 0x380C55 /end MEASUREMENT
/begin MEASUREMENT fprtim_c "Zeitzähler DK-Rückstellfeder-Prüfung" UBYTE t10msxs_ub_b2p55 1 100 0 2.55 FORMAT "%5.3" ECU_ADDRESS 0x380C56 /end MEASUREMENT
/begin MEASUREMENT fpvdk "Korrekturfaktor Druck vor Drosselklappe" UBYTE fak_ub_b4 1 100 0 3.98438 FORMAT "%5.3" ECU_ADDRESS 0xF85A /end MEASUREMENT
/begin MEASUREMENT fpvdk_w "Korrekturfaktor Druck vor Drosselklappe 16-Bit" UWORD fak_uw_b4 1 100 0 3.99994 FORMAT "%8.6" ECU_ADDRESS 0xF9E0 /end MEASUREMENT
/begin MEASUREMENT frhodk_w "Faktor Luftdichtekorrektur für DK-Durchfluß f(Ansauglufttemp.,Höhe) 16 Bit" UWORD fak_uw_b2 1 100 0 1.99997 FORMAT "%8.6" ECU_ADDRESS 0x38112A /end MEASUREMENT
/begin MEASUREMENT frkte "Faktor Umrechnung rel. Kraftstoffmasse rk effekt. Einspritzzeit te" UBYTE rkti_sy 1 100 0 0.544 ECU_ADDRESS 0x380B02 /end MEASUREMENT
/begin MEASUREMENT gangi "Ist-Gang" UBYTE dez 1 100 0 255 FORMAT "%5.1" ECU_ADDRESS 0x380B05 /end MEASUREMENT
/begin MEASUREMENT ilb "Integratorausgangswert für Ladebilanz Batterie" SWORD dez 1 100 -32768 32767 FORMAT "%8.2" ECU_ADDRESS 0x383A08 /end MEASUREMENT
/begin MEASUREMENT imlatm "integr. Luftmassenfluss ab Motorstart bis Max.wert" UBYTE m_ub_b23p3 1 100 0 23.2107 FORMAT "%5.2" ECU_ADDRESS 0x380C04 /end MEASUREMENT
/begin MEASUREMENT imlatm_w "integr. Luftmassenfluss ab Startende bis max. Wert, (Word)" UWORD m_uw_b23p3 1 100 0 23.3013 FORMAT "%8.5" ECU_ADDRESS 0x381162 /end MEASUREMENT
/begin MEASUREMENT imlbbo "Integrator Luftmasse für Erkennung Benzin im Öl" UBYTE m_ub_b23p3 1 100 0 23.2107 FORMAT "%5.2" ECU_ADDRESS 0x380C8D /end MEASUREMENT
/begin MEASUREMENT imlbbo_w "" UWORD m_uw_b23p3 1 100 0 23.3013 FORMAT "%8.5" ECU_ADDRESS 0x382220 /end MEASUREMENT
/begin MEASUREMENT imlpr "Relatives Luftmassenintegral bei Katheizung" UBYTE fak_ub_b1 1 100 0 0.996094 ECU_ADDRESS 0x380CAF /end MEASUREMENT
/begin MEASUREMENT imlpr_w "Relatives Luftmassenintegral bei Katheizung (word)" UWORD fak_uw_b1 1 100 0 0.999985 FORMAT "%9.7" ECU_ADDRESS 0x38232A /end MEASUREMENT
/begin MEASUREMENT iUipoti1_w "ADC-Wert incl. Kanalnummer Drosselklappen-Istwert-Poti 1" UWORD DEZ 1 100 0 65535 FORMAT "%8.2" ECU_ADDRESS 0xF8EC /end MEASUREMENT
/begin MEASUREMENT iUipoti2_w "ADC-Wert incl. Kanalnummer Drosselklappen-Istwert-Poti 2" UWORD DEZ 1 100 0 65535 FORMAT "%8.2" ECU_ADDRESS 0xF8E8 /end MEASUREMENT
/begin MEASUREMENT iUrefsp1_w "ADC-Wert incl. Kanalnummer, 5 Volt-Referenzspannung" UWORD DEZ 1 100 0 65535 FORMAT "%8.2" ECU_ADDRESS 0xF8D6 /end MEASUREMENT
/begin MEASUREMENT iUspoti1_w "ADC-Wert incl. Kanalnummer, Sollwertpoti 1" UWORD DEZ 1 100 0 65535 FORMAT "%8.2" ECU_ADDRESS 0xF8DE /end MEASUREMENT
/begin MEASUREMENT iUspoti2_w "ADC-Wert incl. Kanalnummer, Sollwertpoti 2" UWORD DEZ 1 100 0 65535 FORMAT "%8.2" ECU_ADDRESS 0xF8DC /end MEASUREMENT
/begin MEASUREMENT iwmatm2_w "Wärmemenge für Kondenswasser-Taupunktende Abgas/Kat (word) bank2" UWORD q_uw_q0p45 1 100 0 29695.5 FORMAT "%8.2" ECU_ADDRESS 0x381164 /end MEASUREMENT
/begin MEASUREMENT iwmatm_w "Wärmemenge für Kondenswasser-Taupunktende Abgas/Kat (word)" UWORD q_uw_q0p45 1 100 0 29695.5 FORMAT "%8.2" ECU_ADDRESS 0x381166 /end MEASUREMENT
/begin MEASUREMENT kifz_w "Verstärkung des Fahrzeugmodells" UWORD fak_uw_b4864 1 100 0 4863.93 FORMAT "%8.3" ECU_ADDRESS 0x38134A /end MEASUREMENT
/begin MEASUREMENT klaf_kge "Kenngrößensource für KLAF" UWORD fak_uw_q0p001 1 100 0 65.535 FORMAT "%8.5" ECU_ADDRESS 0x38112C /end MEASUREMENT
/begin MEASUREMENT kmstmil_w "Zurückgelegte Fahrstrecke mit MIL on" UWORD s_q1_km 1 100 0 65535 FORMAT "%8.2" ECU_ADDRESS 0x3839FC /end MEASUREMENT
/begin MEASUREMENT kmstnmax "Bezugspunkt beim Auftreten der Überdrehzahl" UWORD km_uw_q10 1 100 0 655350 FORMAT "%8.1" ECU_ADDRESS 0x383A02 /end MEASUREMENT
/begin MEASUREMENT kmstpbr_w "Bezugspunkt beim Auftreten der PWG-Bremspedal Plausibilisierung" UWORD km_uw_q10 1 100 0 655350 FORMAT "%8.1" ECU_ADDRESS 0x383A0C /end MEASUREMENT
/begin MEASUREMENT kmst_w "Zurückgelegte Fahrstrecke seit Powerfail" UWORD s_q6_km 1 100 0 393210 FORMAT "%8.1" ECU_ADDRESS 0x3839FE /end MEASUREMENT
/begin MEASUREMENT kvb_w "verbrauchter Kraftstoff" UWORD vol_q3p90625Em3_l 1 100 0 255.996 FORMAT "%8.4" ECU_ADDRESS 0x382662 /end MEASUREMENT
/begin MEASUREMENT lokBits_Aekp "" UBYTE dez 1 100 0 255 FORMAT "%5.1" ECU_ADDRESS 0x380D7B /end MEASUREMENT
/begin MEASUREMENT lrnstep_c "Zähler für Lerndauer eines Lernsteps" UBYTE dez 1 100 0 255 FORMAT "%5.1" ECU_ADDRESS 0x380C57 /end MEASUREMENT
/begin MEASUREMENT lrntim_c "Zeitzähler für Wartezeit in den Lernschritten" UBYTE t20msxs_ub_b5p1 1 100 0 5.1 FORMAT "%5.3" ECU_ADDRESS 0x380C58 /end MEASUREMENT
/begin MEASUREMENT lrnvb_c "Lernverbotszähler (Wartezeit)" UWORD t20msxs_uw_q0p02 1 100 0 1310.7 FORMAT "%8.3" ECU_ADDRESS 0x38207C /end MEASUREMENT
/begin MEASUREMENT lrnvb_zt "Zielwert der Lernverbotszeit" UWORD t20msxs_uw_q0p02 1 100 0 1310.7 FORMAT "%8.3" ECU_ADDRESS 0x38207E /end MEASUREMENT
/begin MEASUREMENT mdbes_w "Beschleunigungsmoment" SWORD rel_sw_b100 1 100 -100 99.9969 FORMAT "%8.4" ECU_ADDRESS 0x38134C /end MEASUREMENT
/begin MEASUREMENT mdindlm "indiziertes Motormoment; Rückmeldung an Getriebesteuerung" UWORD rel_uw_b100 1 100 0 99.9985 FORMAT "%8.5" ECU_ADDRESS 0xF8CA /end MEASUREMENT
/begin MEASUREMENT migs_w "Indiziertes Soll-Motormoment GS für schnellen Eingriff" UWORD rel_uw_b100 1 100 0 99.9985 FORMAT "%8.5" ECU_ADDRESS 0x38102E /end MEASUREMENT
/begin MEASUREMENT miint1_w "Berechnetes Ist-Moment;interne Eingriffe mit AR, LLR, MDBEG" UWORD rel_uw_b100 1 100 0 99.9985 FORMAT "%8.5" ECU_ADDRESS 0x381042 /end MEASUREMENT
/begin MEASUREMENT miint2_w "Berechnetes Ist-Moment; Begrenzung auf mizwmn" UWORD rel_uw_b100 1 100 0 99.9985 FORMAT "%8.5" ECU_ADDRESS 0x381044 /end MEASUREMENT
/begin MEASUREMENT miint3_w "Berechnetes Ist-Moment; Begrenzung auf mibas, miszul" UWORD rel_uw_b100 1 100 0 99.9985 FORMAT "%8.5" ECU_ADDRESS 0x381046 /end MEASUREMENT
/begin MEASUREMENT miintv_w "Berechnetes Ist-Moment;interne Eingriffe ohne AR, LLR, MDBEG" UWORD rel_uw_b100 1 100 0 99.9985 FORMAT "%8.5" ECU_ADDRESS 0x381048 /end MEASUREMENT
/begin MEASUREMENT miint_w "Berechnetes Ist-Moment mit allen internen Eingriffen" UWORD rel_uw_b100 1 100 0 99.9985 FORMAT "%8.5" ECU_ADDRESS 0xF8CC /end MEASUREMENT
/begin MEASUREMENT mkar_w "Berechnetes Kupplungsmoment für Antiruckelfunktion" SWORD rel_sw_b100 1 100 -100 99.9969 FORMAT "%8.4" ECU_ADDRESS 0x38134E /end MEASUREMENT
/begin MEASUREMENT mlast_w "geschätztes Lastmoment" SWORD rel_sw_b100 1 100 -100 99.9969 FORMAT "%8.4" ECU_ADDRESS 0x381350 /end MEASUREMENT
/begin MEASUREMENT mlbb "Luftmassenfluß gefiltert (Byte), Bank1 bezogen" UBYTE m_ub_b1020 1 100 0 1020 FORMAT "%5.0" ECU_ADDRESS 0x380C3E /end MEASUREMENT
/begin MEASUREMENT mlbb2 "Luftmassenfluß gefiltert (Byte), Bank2 bezogen" UBYTE m_ub_b1020 1 100 0 1020 FORMAT "%5.0" ECU_ADDRESS 0x380C3F /end MEASUREMENT
/begin MEASUREMENT mlbb2_w "Luftmassenfluß gefiltert (Word), Bank2 bezogen" UWORD m_uw_b6553p5 1 100 0 6553.5 FORMAT "%8.3" ECU_ADDRESS 0x3812A6 /end MEASUREMENT
/begin MEASUREMENT mlbb_w "Luftmassenfluß gefiltert (Word), Bank1 bezogen" UWORD m_uw_b6553p5 1 100 0 6553.5 FORMAT "%8.3" ECU_ADDRESS 0x3812A8 /end MEASUREMENT
/begin MEASUREMENT mlsu "Soll-Luftmasse für Katheizen" UBYTE m_ub_b5p8 1 100 0 5.80267 FORMAT "%5.3" ECU_ADDRESS 0x380CAA /end MEASUREMENT
/begin MEASUREMENT mracc_w "Relativer Momentenwunsch von ACC" UWORD rel_uw_b200 1 100 0 199.997 FORMAT "%8.4" ECU_ADDRESS 0x382498 /end MEASUREMENT
/begin MEASUREMENT msabg "Abgasmassenfluß gefiltert, Bank 1" UBYTE m_ub_b1020 1 100 0 1020 FORMAT "%5.0" ECU_ADDRESS 0x380C40 /end MEASUREMENT
/begin MEASUREMENT msabg2 "Abgasmassenfluß gefiltert, Bank 2" UBYTE m_ub_b1020 1 100 0 1020 FORMAT "%5.0" ECU_ADDRESS 0x380C41 /end MEASUREMENT
/begin MEASUREMENT msabg2_w "Abgasmassenfluß gefiltert (Word), Bank 2" UWORD m_uw_b6553p5 1 100 0 6553.5 FORMAT "%8.3" ECU_ADDRESS 0x3812AA /end MEASUREMENT
/begin MEASUREMENT msabg_w "Abgasmassenstrom gefiltert (Word), Bank 1" UWORD m_uw_b6553p5 1 100 0 6553.5 FORMAT "%8.3" ECU_ADDRESS 0x3812AC /end MEASUREMENT
/begin MEASUREMENT msdif_w "Massenstromdifferenz mshfm_w - msdk_w" SWORD m_sw_q0p1 1 100 -3276.8 3276.7 FORMAT "%8.3" ECU_ADDRESS 0x38112E /end MEASUREMENT
/begin MEASUREMENT msdkalm_w "Massenstrom über Drosselklappe (abgeglichen mit HFM Signal)" UWORD m_uw_b6553p5 1 100 0 6553.5 FORMAT "%8.3" ECU_ADDRESS 0x381130 /end MEASUREMENT
/begin MEASUREMENT msdkue_w "Massenstrom über Drosselklappe überkritisch (word)" UWORD m_uw_b6553p5 1 100 0 6553.5 FORMAT "%8.3" ECU_ADDRESS 0x381132 /end MEASUREMENT
/begin MEASUREMENT msdk_w "Massenstrom über Drosselklappe (word)" UWORD m_uw_b6553p5 1 100 0 6553.5 FORMAT "%8.3" ECU_ADDRESS 0xF9E2 /end MEASUREMENT
/begin MEASUREMENT msndko_w "normierter Leckluftmassenstrom über Drosselklappe (word)" UWORD m_uw_b6553p5 1 100 0 6553.5 FORMAT "%8.3" ECU_ADDRESS 0x383032 /end MEASUREMENT
/begin MEASUREMENT msndk_w "normierter Massenstrom über Drosselklappe (word)" UWORD m_uw_b6553p5 1 100 0 6553.5 FORMAT "%8.3" ECU_ADDRESS 0x381134 /end MEASUREMENT
/begin MEASUREMENT msntev_w "gewünschter normierter, überkritischer Massenstrom TEV" UWORD m_uw_b25p6 1 100 0 25.5996 FORMAT "%8.5" ECU_ADDRESS 0x381248 /end MEASUREMENT
/begin MEASUREMENT msnwdk_kge "" UWORD rel_uw_b100 1 100 0 99.9985 FORMAT "%8.5" ECU_ADDRESS 0x381136 /end MEASUREMENT
/begin MEASUREMENT mss_w "Massenstrom vom Sensor (Auswahl zwischen mshfm_w und ml_w)" UWORD m_uw_b6553p5 1 100 0 6553.5 FORMAT "%8.3" ECU_ADDRESS 0x381138 /end MEASUREMENT
/begin MEASUREMENT ndar_w "Differenzdrehzahl für Momenteneingriff" SWORD nmot_sw_q0p25 1 100 -8192 8191.75 FORMAT "%8.3" ECU_ADDRESS 0x381352 /end MEASUREMENT
/begin MEASUREMENT ndfdif_w "Gradient aus AR-Differenzdrehzahl" SWORD nmot_sw_q0p25 1 100 -8192 8191.75 FORMAT "%8.3" ECU_ADDRESS 0x380E3C /end MEASUREMENT
/begin MEASUREMENT ndfil_w "gefilterte Differenzdrehzahl" SWORD nmot_sw_q0p25 1 100 -8192 8191.75 FORMAT "%8.3" ECU_ADDRESS 0x381354 /end MEASUREMENT
/begin MEASUREMENT ndiff_w "Differenzdrehzahl für LFR-HS-Verstärkungen" SWORD nmot_sw_q0p25 1 100 -8192 8191.75 FORMAT "%8.3" ECU_ADDRESS 0x381356 /end MEASUREMENT
/begin MEASUREMENT nfskh "Leerlaufdrehzahl Fahrstufe bei Katheizen" UBYTE nmot_ub_q10 1 100 0 2550 FORMAT "%5.0" ECU_ADDRESS 0x380CB0 /end MEASUREMENT
/begin MEASUREMENT ngfar_w "gefilterter Drehzahlgradient AR-Funktion" SWORD nmotg_sw_q0p39 1 100 -12800.2 12799.8 FORMAT "%8.2" ECU_ADDRESS 0x380E3E /end MEASUREMENT
/begin MEASUREMENT nllkh "Leerlaufdrehzahl bei Katheizen" UBYTE nmot_ub_q10 1 100 0 2550 FORMAT "%5.0" ECU_ADDRESS 0x380CB1 /end MEASUREMENT
/begin MEASUREMENT nlp1tim "Zeitzähler für Wartezeit 1 im NLP-Lernen" UBYTE t10msxs_ub_b2p55 1 100 0 2.55 FORMAT "%5.3" ECU_ADDRESS 0x380C59 /end MEASUREMENT
/begin MEASUREMENT nlp2tim "Zeitzähler für Wartezeit 2 im NLP-Lernen" UBYTE t10msxs_ub_b2p55 1 100 0 2.55 FORMAT "%5.3" ECU_ADDRESS 0x380C5A /end MEASUREMENT
/begin MEASUREMENT nmax_w "Drehzahlgrenze ohne Berücksichtigung von Drosselklappen-Fehlern" UWORD nmot_uw_q0p15625 1 100 0 10239.8 FORMAT "%8.2" ECU_ADDRESS 0x383A04 /end MEASUREMENT
/begin MEASUREMENT nmod_w "Motordrehzahl aus Modell" UWORD nmot_uw_q0p25 1 100 0 16383.8 FORMAT "%8.2" ECU_ADDRESS 0x381358 /end MEASUREMENT
/begin MEASUREMENT nsa "Drehzahl Schub" UBYTE nmot_ub_q40 1 100 0 10200 FORMAT "%5.0" ECU_ADDRESS 0x380B54 /end MEASUREMENT
/begin MEASUREMENT nslb "Nsoll Korrektur von Ladebilanz Batterie" UBYTE nmot_ub_q10 1 100 0 2550 FORMAT "%5.0" ECU_ADDRESS 0x380C42 /end MEASUREMENT
/begin MEASUREMENT nvquot_w "Quotient Motordrehzahl nmot / Fahrgeschwindigkeit vfzg" UWORD qnv_uw_b512 1 100 0 511.992 FORMAT "%8.4" ECU_ADDRESS 0x38207A /end MEASUREMENT
/begin MEASUREMENT nwe "Wiedereinsetzdrehzahl" UBYTE nmot_ub_q40 1 100 0 10200 FORMAT "%5.0" ECU_ADDRESS 0x380B55 /end MEASUREMENT
/begin MEASUREMENT pses_w "Saugrohrdruck über Verstellsystem korrigiert" UWORD p_uw_q0p039 1 100 0 2559.96 FORMAT "%8.3" ECU_ADDRESS 0x38221C /end MEASUREMENT
/begin MEASUREMENT pspvdb_w "Quotient Saugrohrduck/Druck vor DK begrenzt (word)" UWORD fak_uw_b2 1 100 0 1.99997 FORMAT "%8.6" ECU_ADDRESS 0x38113A /end MEASUREMENT
/begin MEASUREMENT pspvdk_w "Quotient Saugrohrdruck/Druck vor Drosselklappe (word)" UWORD fak_uw_b2 1 100 0 1.99997 FORMAT "%8.6" ECU_ADDRESS 0xF9E4 /end MEASUREMENT
/begin MEASUREMENT pvdk "Druck vor Drosselklappe" UBYTE p_ub_q10 1 100 0 2550 FORMAT "%5.0" ECU_ADDRESS 0xF85B /end MEASUREMENT
/begin MEASUREMENT pvdk_w "Druck vor Drosselklappe 16-Bit" UWORD p_uw_q0p039 1 100 0 2559.96 FORMAT "%8.3" ECU_ADDRESS 0xF9E6 /end MEASUREMENT
/begin MEASUREMENT redbas "Basis-Reduzierstufe" UBYTE dez 1 100 0 255 FORMAT "%5.1" ECU_ADDRESS 0xFA4C /end MEASUREMENT
/begin MEASUREMENT redist "Ist-Reduzierstufe" UBYTE dez 1 100 0 255 FORMAT "%5.1" ECU_ADDRESS 0xFA4D /end MEASUREMENT
/begin MEASUREMENT redsolr "Realisierte Reduzierstufe" UBYTE dez 1 100 0 255 FORMAT "%5.1" ECU_ADDRESS 0x3809A8 /end MEASUREMENT
/begin MEASUREMENT redsol_one "Berechnete Soll-Reduzierstufe - 1 zur Adress. von REDABM" UBYTE dez 1 100 0 255 FORMAT "%5.1" ECU_ADDRESS 0x3809A9 /end MEASUREMENT
/begin MEASUREMENT rldvs_w "relative Luftfüllung durch Drosselventile am Saugrohr 16-Bit" UWORD rel_uw_q0p0234 1 100 0 1535.98 FORMAT "%8.3" ECU_ADDRESS 0x38113C /end MEASUREMENT
/begin MEASUREMENT rlroh_w "relative Luftfüllung: Rohwert vom Lastsensor (word)" UWORD rel_uw_q0p0234 1 100 0 1535.98 FORMAT "%8.3" ECU_ADDRESS 0xF9E8 /end MEASUREMENT
/begin MEASUREMENT tabgm "Abgastemperatur vor Kat aus Modell" UBYTE temp_ub_q5_o50 1 100 -50 1225 FORMAT "%5.0" ECU_ADDRESS 0x3809B2 /end MEASUREMENT
/begin MEASUREMENT tabgm2 "Abgastemperatur vor Kat aus Modell Bank2" UBYTE temp_ub_q5_o50 1 100 -50 1225 FORMAT "%5.0" ECU_ADDRESS 0x3809B3 /end MEASUREMENT
/begin MEASUREMENT tabgm2_w "Abgastemperatur vor Kat aus Modell (Word) Bank2" UWORD temp_uw_q0p0195_o50 1 100 -50 1229.98 FORMAT "%8.3" ECU_ADDRESS 0x381168 /end MEASUREMENT
/begin MEASUREMENT tabgmab "Abgastemperatur beim Abstellen des Motors" UBYTE temp_ub_q5_o50 1 100 -50 1225 FORMAT "%5.0" ECU_ADDRESS 0x3830F6 /end MEASUREMENT
/begin MEASUREMENT tabgmab2 "Abgastemperatur beim Abstellen des Motors (Modell) Bank2" UBYTE temp_ub_q5_o50 1 100 -50 1225 FORMAT "%5.0" ECU_ADDRESS 0x3830F7 /end MEASUREMENT
/begin MEASUREMENT tabgmst "Abgastemperatur bei Motorstart" UBYTE temp_ub_q5_o50 1 100 -50 1225 FORMAT "%5.0" ECU_ADDRESS 0x380C05 /end MEASUREMENT
/begin MEASUREMENT tabgmst2 "Abgastemperatur bei Motorstart Bank2" UBYTE temp_ub_q5_o50 1 100 -50 1225 FORMAT "%5.0" ECU_ADDRESS 0x380C06 /end MEASUREMENT
/begin MEASUREMENT tabgm_w "Abgastemperatur vor Kat aus Modell (Word)" UWORD temp_uw_q0p0195_o50 1 100 -50 1229.98 FORMAT "%8.3" ECU_ADDRESS 0x38116A /end MEASUREMENT
/begin MEASUREMENT taccreakmx "Timer für ACC-Abschaltreaktion bei DME-Abbruchbedingung" UBYTE t20msxs_ub_q0p02 1 100 0 5.1 FORMAT "%5.3" ECU_ADDRESS 0x380C6D /end MEASUREMENT
/begin MEASUREMENT tateout "ausgegebenes Tastverhältnis für Tankentlüftungsventil" UBYTE rel_ub_b99p6 1 100 0 99.6094 FORMAT "%5.2" ECU_ADDRESS 0xFA38 /end MEASUREMENT
/begin MEASUREMENT tatesoll "gewünschtes Soll-Tastverhältnis Tankentlüftungsventil" UBYTE rel_ub_b99p6 1 100 0 99.6094 FORMAT "%5.2" ECU_ADDRESS 0xFA39 /end MEASUREMENT
/begin MEASUREMENT tatmkf "Abgastemperatur vor Kat aus Kennfeld KFTATM" UBYTE temp_ub_q5_o50 1 100 -50 1225 FORMAT "%5.0" ECU_ADDRESS 0x380C07 /end MEASUREMENT
/begin MEASUREMENT tatmkf2 "Abgastemperatur vor Kat aus Kennfeld KFTATM Bank2" UBYTE temp_ub_q5_o50 1 100 -50 1225 FORMAT "%5.0" ECU_ADDRESS 0x380C08 /end MEASUREMENT
/begin MEASUREMENT tatmsta "Abgastemperatur vor Kat aus Modell stationär" UBYTE temp_ub_q5_o50 1 100 -50 1225 FORMAT "%5.0" ECU_ADDRESS 0x380C09 /end MEASUREMENT
/begin MEASUREMENT tatmsta2 "Abgastemperatur vor Kat aus Modell stationär Bank2" UBYTE temp_ub_q5_o50 1 100 -50 1225 FORMAT "%5.0" ECU_ADDRESS 0x380C0A /end MEASUREMENT
/begin MEASUREMENT tatu "Ansaugluft- oder Umgebungstemperatur" UBYTE temp_ub_q0p75_o48 1 100 -48 143.25 FORMAT "%5.1" ECU_ADDRESS 0x380C0B /end MEASUREMENT
/begin MEASUREMENT tephc "Phasenzähler Grundadaption / Tankentlüftung" UWORD t100msxs_uw_b6553p6 1 100 0 6553.5 FORMAT "%8.3" ECU_ADDRESS 0x382226 /end MEASUREMENT
/begin MEASUREMENT tevper "Periodendauer bei Ansteuerung Tankentlüftungsventil" UBYTE t500usxms_ub_q0p5 1 100 0 127.5 FORMAT "%5.1" ECU_ADDRESS 0x380B2C /end MEASUREMENT
/begin MEASUREMENT tkatm "Katalysatortemperatur aus Modell" UBYTE temp_ub_q5_o50 1 100 -50 1225 FORMAT "%5.0" ECU_ADDRESS 0x3809B4 /end MEASUREMENT
/begin MEASUREMENT tkatm2 "Katalysatortemperatur aus Modell,  Bank2" UBYTE temp_ub_q5_o50 1 100 -50 1225 FORMAT "%5.0" ECU_ADDRESS 0x3809B5 /end MEASUREMENT
/begin MEASUREMENT tkatm2_w "Katalysatortemperatur aus Modell (Word) Bank2" UWORD temp_uw_q0p0195_o50 1 100 -50 1229.98 FORMAT "%8.3" ECU_ADDRESS 0x38116C /end MEASUREMENT
/begin MEASUREMENT tkatmab "Abgastemperatur hinter Kat beim Abstellen des Motors (Modell)" UBYTE temp_ub_q5_o50 1 100 -50 1225 FORMAT "%5.0" ECU_ADDRESS 0x3830F8 /end MEASUREMENT
/begin MEASUREMENT tkatmab2 "Abgastemperatur hinter Kat beim Abstellen des Motors (Modell) Bank2" UBYTE temp_ub_q5_o50 1 100 -50 1225 FORMAT "%5.0" ECU_ADDRESS 0x3830F9 /end MEASUREMENT
/begin MEASUREMENT tkatmst "Katalysatortemperatur Modell Startwert = f(Abstellwert, Abstellzeit)" UBYTE temp_ub_q5_o50 1 100 -50 1225 FORMAT "%5.0" ECU_ADDRESS 0x380C0C /end MEASUREMENT
/begin MEASUREMENT tkatmst2 "Katalysatortemperatur Modell Startwert = f(Abstellwert,Abstellzeit) Bank2" UBYTE temp_ub_q5_o50 1 100 -50 1225 FORMAT "%5.0" ECU_ADDRESS 0x380C0D /end MEASUREMENT
/begin MEASUREMENT tkatm_w "Katalysatortemperatur aus Modell (Word)" UWORD temp_uw_q0p0195_o50 1 100 -50 1229.98 FORMAT "%8.3" ECU_ADDRESS 0x38116E /end MEASUREMENT
/begin MEASUREMENT tkatsa "" UBYTE temp_ub_q5_o50 1 100 -50 1225 FORMAT "%5.0" ECU_ADDRESS 0x380B56 /end MEASUREMENT
/begin MEASUREMENT tloop "Ringzähler für Zeitdifferenzmessungen" UBYTE t1sxs_ub_b255 1 100 0 255 FORMAT "%5.1" ECU_ADDRESS 0x380C5B /end MEASUREMENT
/begin MEASUREMENT tmpumast "Status für temporäre UMA-Adaption" UBYTE dez 1 100 0 255 FORMAT "%5.1" ECU_ADDRESS 0x380C5C /end MEASUREMENT
/begin MEASUREMENT tnse_w "Zeitzähler ab Startende (16bit)" UWORD t100msxs_uw_b6553p5 1 100 0 6553.5 FORMAT "%8.3" ECU_ADDRESS 0x382660 /end MEASUREMENT
/begin MEASUREMENT tnst_w "Zeit nach Startende" UWORD t10msxs_uw_b655p35 1 100 0 655.35 FORMAT "%8.4" ECU_ADDRESS 0x3813DC /end MEASUREMENT
/begin MEASUREMENT ttmumad "Zeitdifferenz für temoräre UMA-Adaption" UBYTE t1sxs_ub_b255 1 100 0 255 FORMAT "%5.1" ECU_ADDRESS 0x380C5D /end MEASUREMENT
/begin MEASUREMENT tvrnr "Verzögerungszeit bis zum wirklichen Ev-Abschaltende" UBYTE dez 1 100 0 255 FORMAT "%5.1" ECU_ADDRESS 0x3809AA /end MEASUREMENT
/begin MEASUREMENT tvu_w "Batteriespannungskorrektur" UWORD tinjection_sy 1 100 0 209.712 FORMAT "%8.4" ECU_ADDRESS 0x3811B8 /end MEASUREMENT
/begin MEASUREMENT tzarni "Zeitzähler AR nach Initialisierung" UBYTE t10msxs_ub_b2p55 1 100 0 2.55 FORMAT "%5.3" ECU_ADDRESS 0x380A1E /end MEASUREMENT
/begin MEASUREMENT udimfgr "Spannung zum umsetzen der Dimminformation" UBYTE spg_ub_b5 1 100 0 4.98047 FORMAT "%5.3" ECU_ADDRESS 0x380AB3 /end MEASUREMENT
/begin MEASUREMENT udknlp1 "Spannung DK-Poti 1 im NLP" UWORD spg_uw_q0p001222 1 100 0 80.0838 FORMAT "%8.5" ECU_ADDRESS 0x382080 /end MEASUREMENT
/begin MEASUREMENT udknlp1r "Dauer-RAM: Spannung DK-Poti 1 im NLP" UWORD spg_uw_q0p001222 1 100 0 80.0838 FORMAT "%8.5" ECU_ADDRESS 0x383A0E /end MEASUREMENT
/begin MEASUREMENT udknlp2 "Spannung DK-Poti 2 im NLP" UWORD spg_uw_q0p001222 1 100 0 80.0838 FORMAT "%8.5" ECU_ADDRESS 0x382082 /end MEASUREMENT
/begin MEASUREMENT udknlp2r "Dauer-RAM: Spannung DK-Poti 2 im NLP" UWORD spg_uw_q0p001222 1 100 0 80.0838 FORMAT "%8.5" ECU_ADDRESS 0x383A10 /end MEASUREMENT
/begin MEASUREMENT udkp1a "Spannung Drosselklappen-Poti 1 am (unteren) Anschlag" UBYTE spg_ub_b5 1 100 0 4.98047 FORMAT "%5.3" ECU_ADDRESS 0x380C5E /end MEASUREMENT
/begin MEASUREMENT udkp1aalt "temp. Spannung DK-Poti 1 am unteren DK-Anschlag" UWORD spg_uw_q0p001222 1 100 0 80.0838 FORMAT "%8.5" ECU_ADDRESS 0x382084 /end MEASUREMENT
/begin MEASUREMENT udkp1asr_w "Dauer-RAM: Spannung DK-Poti 1 am unteren DK-Anschlag, stationärer Anteil" UWORD spg_uw_q0p001222 1 100 0 80.0838 FORMAT "%8.5" ECU_ADDRESS 0x383A12 /end MEASUREMENT
/begin MEASUREMENT udkp1as_w "Spannung DK-Poti 1 am unteren Anschlag, stationärer Anteil" UWORD spg_uw_q0p001222 1 100 0 80.0838 FORMAT "%8.5" ECU_ADDRESS 0x382086 /end MEASUREMENT
/begin MEASUREMENT udkp1a_w "Spannung DK-Poti 1 am unteren Anschlag" UWORD spg_uw_q0p001222 1 100 0 80.0838 FORMAT "%8.5" ECU_ADDRESS 0xF88E /end MEASUREMENT
/begin MEASUREMENT udkp1rob "realer DK-Poti-1-Wert am ob. Abgleichpkt." UWORD spg_uw_q0p00488 1 100 0 319.995 FORMAT "%8.4" ECU_ADDRESS 0x382088 /end MEASUREMENT
/begin MEASUREMENT udkp1run "realer DK-Poti-1-Wert am unt. Abgleichpkt." UWORD spg_uw_q0p00488 1 100 0 319.995 FORMAT "%8.4" ECU_ADDRESS 0x38208A /end MEASUREMENT
/begin MEASUREMENT udkp1sv "Maximalwert DK-Poti 1 für Verwendung des verstärkten Signals" UBYTE spg_ub_b5 1 100 0 4.98047 FORMAT "%5.3" ECU_ADDRESS 0xF850 /end MEASUREMENT
/begin MEASUREMENT udkp1vor "Dauer-RAM: Spannungsoffset bei DK-Poti-1-Verstärkung" SWORD spg_sw_q0p001222 1 100 -40.0425 40.0413 FORMAT "%8.5" ECU_ADDRESS 0x383A14 /end MEASUREMENT
/begin MEASUREMENT udkp1vou "Diagnose: 8 Bit Kopie von udkp1vo_w als Umweltgröße" SBYTE spg_q0p00977 1 100 -1.25 1.24023 FORMAT "%5.3" ECU_ADDRESS 0x380C50 /end MEASUREMENT
/begin MEASUREMENT udkp1vo_w "Spannungsoffset Verstärker DK-Poti 1" SWORD spg_sw_q0p001222 1 100 -40.0425 40.0413 FORMAT "%8.5" ECU_ADDRESS 0xF890 /end MEASUREMENT
/begin MEASUREMENT udkp1vrob "realer verstärkter DK-Poti-1-Wert am ob. Abgleichpkt." UWORD spg_uw_q0p00488 1 100 0 319.995 FORMAT "%8.4" ECU_ADDRESS 0x38208C /end MEASUREMENT
/begin MEASUREMENT udkp1vrun "realer verstärkter DK-Poti-1-Wert am unt. Abgleichpkt." UWORD spg_uw_q0p00488 1 100 0 319.995 FORMAT "%8.4" ECU_ADDRESS 0x38208E /end MEASUREMENT
/begin MEASUREMENT udkp1vv "Diagnose: 8 Bit Kopie von udkp1vv_w als Umweltgröße" UBYTE spg_q0p03125 1 100 0 7.96875 FORMAT "%5.3" ECU_ADDRESS 0x380C51 /end MEASUREMENT
/begin MEASUREMENT udkp1vvr "Dauer-RAM: Verstärkung bei DK-Poti-1-Verstärkung" UWORD fak_q0p0039 1 100 0 255.996 FORMAT "%8.4" ECU_ADDRESS 0x383A16 /end MEASUREMENT
/begin MEASUREMENT udkp1vv_w "Verstärkung DK-Poti 1" UWORD fak_q0p0039 1 100 0 255.996 FORMAT "%8.4" ECU_ADDRESS 0xF892 /end MEASUREMENT
/begin MEASUREMENT udkp1v_w "Verstärkte Spannung DK-Poti 1" UWORD spg_uw_q0p00488 1 100 0 319.995 FORMAT "%8.4" ECU_ADDRESS 0xFA02 /end MEASUREMENT
/begin MEASUREMENT udkp1_w "Spannung DK-Poti 1" UWORD spg_uw_q0p001222 1 100 0 80.0838 FORMAT "%8.5" ECU_ADDRESS 0xFA04 /end MEASUREMENT
/begin MEASUREMENT udkp2a "Spannung Drosselklappen-Poti 2 am (unteren) Anschlag" UBYTE spg_ub_b5 1 100 0 4.98047 FORMAT "%5.3" ECU_ADDRESS 0x380C5F /end MEASUREMENT
/begin MEASUREMENT udkp2aalt "temp. Spannung DK-Poti 2 am unteren DK-Anschlag" UWORD spg_uw_q0p001222 1 100 0 80.0838 FORMAT "%8.5" ECU_ADDRESS 0x382090 /end MEASUREMENT
/begin MEASUREMENT udkp2asr_w "Dauer-RAM: Spannung DK-Poti 2 am unteren DK-Anschlag, stationärer Anteil" UWORD spg_uw_q0p001222 1 100 0 80.0838 FORMAT "%8.5" ECU_ADDRESS 0x383A18 /end MEASUREMENT
/begin MEASUREMENT udkp2as_w "Spannung DK-Poti 2 am unteren Anschlag, stationärer Anteil" UWORD spg_uw_q0p001222 1 100 0 80.0838 FORMAT "%8.5" ECU_ADDRESS 0x383A1A /end MEASUREMENT
/begin MEASUREMENT udkp2a_w "Spannung DK-Poti 2 am unteren Anschlag" UWORD spg_uw_q0p001222 1 100 0 80.0838 FORMAT "%8.5" ECU_ADDRESS 0xF894 /end MEASUREMENT
/begin MEASUREMENT udkp2_w "Spannung DK-Poti 2" UWORD spg_uw_q0p001222 1 100 0 80.0838 FORMAT "%8.5" ECU_ADDRESS 0xFA06 /end MEASUREMENT
/begin MEASUREMENT udkpat_w "temporärer UEA-Offset des DK-Poti" UWORD spg_uw_q0p001222 1 100 0 80.0838 FORMAT "%8.5" ECU_ADDRESS 0x382092 /end MEASUREMENT
/begin MEASUREMENT udst_w "Ausgangsspannung Tankdrucksensor nach AD-Wandler" UWORD spg_uw_b5 1 100 0 319.995 FORMAT "%8.4" ECU_ADDRESS 0x380F44 /end MEASUREMENT
/begin MEASUREMENT udsu_w "Spannung Umgebungsdrucksensor (word 10-Bit von ADC)" UWORD spg_uw_b5 1 100 0 319.995 FORMAT "%8.4" ECU_ADDRESS 0x380F46 /end MEASUREMENT
/begin MEASUREMENT uevges "Übersetzungsverhältnis gesamt" UBYTE fak_q0p1 1 100 0 25.5 FORMAT "%5.2" ECU_ADDRESS 0x380C4F /end MEASUREMENT
/begin MEASUREMENT uhfm_w "HFM-Spannung" UWORD spg_uw_q0p00488 1 100 0 319.995 FORMAT "%8.4" ECU_ADDRESS 0xFA08 /end MEASUREMENT
/begin MEASUREMENT uhsh "Spannung an der Heizerendstufe hinter Kat" UBYTE spg_ub_b5 1 100 0 4.98047 FORMAT "%5.3" ECU_ADDRESS 0x380B2F /end MEASUREMENT
/begin MEASUREMENT uhsh2 "Spannung an der Heizerendstufe 2 hinter Kat" UBYTE spg_ub_b5 1 100 0 4.98047 FORMAT "%5.3" ECU_ADDRESS 0x380B30 /end MEASUREMENT
/begin MEASUREMENT uhsv "Spannung an der Heizerendstufe vor Kat" UBYTE spg_ub_b5 1 100 0 4.98047 FORMAT "%5.3" ECU_ADDRESS 0x380B31 /end MEASUREMENT
/begin MEASUREMENT uhsv2 "Spannung an der Heizerendstufe 2 vor Kat" UBYTE spg_ub_b5 1 100 0 4.98047 FORMAT "%5.3" ECU_ADDRESS 0x380B32 /end MEASUREMENT
/begin MEASUREMENT umsrln_w "Umrechnungsfaktor Füllung in Massenstrom" UWORD m_uw_q0p0005 1 100 0 32.7675 FORMAT "%8.5" ECU_ADDRESS 0xF9EA /end MEASUREMENT
/begin MEASUREMENT usp1plaus "" UBYTE spg_ub_b5 1 100 0 4.98047 FORMAT "%5.3" ECU_ADDRESS 0x380AB4 /end MEASUREMENT
/begin MEASUREMENT uuptes10ms_w "" UWORD spg_q0p00488 1 100 0 319.995 FORMAT "%8.4" ECU_ADDRESS 0x380F48 /end MEASUREMENT
/begin MEASUREMENT uushk2_w "ADC-Spannung Lambdasonde hinter Katalysator Bank2 (Word)" UWORD spg_uw_q0p00488 1 100 0 319.995 FORMAT "%8.4" ECU_ADDRESS 0xFA0A /end MEASUREMENT
/begin MEASUREMENT uushk_w "ADC-Spannung Lambdasonde hinter Katalysator (Word)" UWORD spg_uw_q0p00488 1 100 0 319.995 FORMAT "%8.4" ECU_ADDRESS 0xFA0C /end MEASUREMENT
/begin MEASUREMENT uusvk2_w "ADC-Spannung Lambdasonde vor Katalysator 2 (Word)" UWORD spg_uw_q0p00488 1 100 0 319.995 FORMAT "%8.4" ECU_ADDRESS 0xFA0E /end MEASUREMENT
/begin MEASUREMENT uusvk_w "ADC-Spannung Lambdasonde vor Katalysator (Word)" UWORD spg_uw_q0p00488 1 100 0 319.995 FORMAT "%8.4" ECU_ADDRESS 0xFA10 /end MEASUREMENT
/begin MEASUREMENT vsks_w "Volumenstrom Kraftstoff in L/s" UWORD vol_q5p96Em8_l 1 100 0 0.00390619 FORMAT "%11.9" ECU_ADDRESS 0x382664 /end MEASUREMENT
/begin MEASUREMENT wdkada_w "Sollwert DK-Winkel, aus DV-E Adaption- und Prüffunktion" UWORD relDK_uw_b100 1 100 0 100 FORMAT "%8.4" ECU_ADDRESS 0x3813B4 /end MEASUREMENT
/begin MEASUREMENT wdkbab_w "wdkba_w begrenzt (Minimalauswahl zwischen wdkba_w und wdkugd_w)" UWORD rel_uw_b100 1 100 0 99.9985 FORMAT "%8.5" ECU_ADDRESS 0x38113E /end MEASUREMENT
/begin MEASUREMENT wdkdlr_w "Sollwert DK-Winkel in 12 Bit-Auflösung" UWORD relDK_q0p02441 1 100 0 1599.98 FORMAT "%8.3" ECU_ADDRESS 0xF8AC /end MEASUREMENT
/begin MEASUREMENT wdknlp "Diagnose: 8 Bit Kopie von wdknlp_w als Umweltgröße" UBYTE relDK_q0p3922 1 100 0 100 FORMAT "%5.1" ECU_ADDRESS 0x380C52 /end MEASUREMENT
/begin MEASUREMENT wdknlpr "Diagnose: 8 Bit Kopie von wdknlpr_w als Umweltgröße" UBYTE relDK_q0p3922 1 100 0 100 FORMAT "%5.1" ECU_ADDRESS 0x380C53 /end MEASUREMENT
/begin MEASUREMENT wdknlpr_w "Dauer-RAM: Sollwert DK-Winkel in NLP-Stellung, bez. auf UMA" UWORD relDK_uw_b100 1 100 0 100 FORMAT "%8.4" ECU_ADDRESS 0x383A1C /end MEASUREMENT
/begin MEASUREMENT wdknlp_w "DK-Winkel der Notluftposition" UWORD relDK_uw_b100 1 100 0 100 FORMAT "%8.4" ECU_ADDRESS 0x3813B6 /end MEASUREMENT
/begin MEASUREMENT wdksfi_w "aus wdks_w prädizierter DK-Winkel" SWORD relDK_q0p02441 1 100 -800 799.976 FORMAT "%8.4" ECU_ADDRESS 0x3813AE /end MEASUREMENT
/begin MEASUREMENT wdkvabob "DK-Sollwert für oberen Abgleichpunkt" UWORD relDK_uw_b100 1 100 0 100 FORMAT "%8.4" ECU_ADDRESS 0x382094 /end MEASUREMENT
/begin MEASUREMENT wdkvabub "DK-Sollwert für unteren Abgleichpunkt" UWORD relDK_uw_b100 1 100 0 100 FORMAT "%8.4" ECU_ADDRESS 0x382096 /end MEASUREMENT
/begin MEASUREMENT wtans "A/D-Wert für tans" UBYTE spg_ub_b5 1 100 0 4.98047 FORMAT "%5.3" ECU_ADDRESS 0x380AB5 /end MEASUREMENT
/begin MEASUREMENT wtka "A/D-Wert für TKA (Temperatur Kühlerausgang)" UBYTE spg_ub_b5 1 100 0 4.98047 FORMAT "%5.3" ECU_ADDRESS 0x380AB6 /end MEASUREMENT
/begin MEASUREMENT wtmot "A/D-Wert für tmot" UBYTE spg_ub_b5 1 100 0 4.98047 FORMAT "%5.3" ECU_ADDRESS 0x380AB7 /end MEASUREMENT
/begin MEASUREMENT wtmr "A/D-Wert für tmr" UBYTE spg_ub_b5 1 100 0 4.98047 FORMAT "%5.3" ECU_ADDRESS 0x380AB8 /end MEASUREMENT
/begin MEASUREMENT wtol "A/D-Wert für (Motor-) Oeltemperatur" UBYTE spg_ub_b5 1 100 0 4.98047 FORMAT "%5.3" ECU_ADDRESS 0x380AB9 /end MEASUREMENT
/begin MEASUREMENT wtsg "Wert Temperatur Steuergerät" UBYTE spg_ub_b5 1 100 0 4.98047 FORMAT "%5.3" ECU_ADDRESS 0x380ABA /end MEASUREMENT
/begin MEASUREMENT wub "Batteriespannung; vom AD-Wandler erfaßter Wert" UBYTE spg_ubatt 1 100 0 24.021 FORMAT "%5.2" ECU_ADDRESS 0x380ABB /end MEASUREMENT
/begin MEASUREMENT wub_w "Batteriespannung; vom AD-Wandler erfaßter Wert (16Bit aus 10Bit-Erfassung)" UWORD spg_ubatt_w 1 100 0 1542.37 FORMAT "%8.3" ECU_ADDRESS 0x380F4A /end MEASUREMENT
/begin MEASUREMENT zaaccpos "Zustandsautomat Positionsflag" UBYTE dez 1 100 0 255 FORMAT "%5.1" ECU_ADDRESS 0x380C6E /end MEASUREMENT
/begin MEASUREMENT znostend "Anzahl Zündung=ein ohne Erreichen von Startende" UBYTE dez 1 100 0 255 FORMAT "%5.1" ECU_ADDRESS 0x38315F /end MEASUREMENT
/begin MEASUREMENT zwmatm "Zähler für ATM-Wiederholstart und Faktor für Wärmemengen-Schwellen" UBYTE dez 1 100 0 255 FORMAT "%5.1" ECU_ADDRESS 0x3830FA /end MEASUREMENT
/begin MEASUREMENT zwmatm2 "Zähler für ATM-Wiederholstart und Faktor für Wärmemengen-Schwellen Bank2" UBYTE dez 1 100 0 255 FORMAT "%5.1" ECU_ADDRESS 0x3830FB /end MEASUREMENT
/begin MEASUREMENT zwmatmf "Zähler für ATM-Wiederholstart und Faktor für Wärmemengen-Schwellwert upstream" UBYTE dez 1 100 0 255 FORMAT "%5.1" ECU_ADDRESS 0x3830FC /end MEASUREMENT
/begin MEASUREMENT zwmatmf2 "Zähler für ATM-Wiederholst.und Faktor für Wärmemengen-Schwellw. upstream Bank2" UBYTE dez 1 100 0 255 FORMAT "%5.1" ECU_ADDRESS 0x3830FD /end MEASUREMENT
/begin MEASUREMENT zylale "Zylindernummer für Auslauferkennung" UBYTE dez 1 100 0 255 FORMAT "%5.1" ECU_ADDRESS 0x3830F0 /end MEASUREMENT
/begin MEASUREMENT zylstp "Zylindernummer der aktuellen Startposition" UBYTE dez 1 100 0 255 FORMAT "%5.1" ECU_ADDRESS 0x3830F1 /end MEASUREMENT
/begin MEASUREMENT zylsync "" UBYTE DEZ 1 100 0 255 FORMAT "%5.1" ECU_ADDRESS 0x38003F /end MEASUREMENT
/begin MEASUREMENT zylvirt "Stand Zylinderzähler vor Umsynchronisation aus Schnellstart" UBYTE DEZ 1 100 0 255 FORMAT "%5.1" ECU_ADDRESS 0x38003D /end MEASUREMENT
/begin MEASUREMENT zzale "Zahnzähler Auslauferkennung" UBYTE dez 1 100 0 255 FORMAT "%5.1" ECU_ADDRESS 0x3830F2 /end MEASUREMENT
/begin MEASUREMENT zzbank "Zylinderzuordnung zu Einspritzbänken" UBYTE dez 1 100 0 255 FORMAT "%5.1" ECU_ADDRESS 0x38092F /end MEASUREMENT
/begin MEASUREMENT zzrale "Zahnzähler Rückpendelerkennung im Auslauf" UBYTE dez 1 100 0 255 FORMAT "%5.1" ECU_ADDRESS 0x3830F3 /end MEASUREMENT
/begin MEASUREMENT zzstp "Zahnzähler der aktuellen Startposition" UBYTE dez 1 100 0 255 FORMAT "%5.1" ECU_ADDRESS 0x3830F4 /end MEASUREMENT
/begin MEASUREMENT zzsync "" UBYTE DEZ 1 100 0 255 FORMAT "%5.1" ECU_ADDRESS 0x38003E /end MEASUREMENT
/begin MEASUREMENT zzvirt "virtueller Zahnzähler im Start bis zur Synchronisation" UBYTE DEZ 1 100 0 255 FORMAT "%5.1" ECU_ADDRESS 0x38003C /end MEASUREMENT
/begin FUNCTION AANSKL "Ansteuerung Ansaugklappe" /begin DEF_CHARACTERISTIC DRLANSKL DTAANSKL KFANSKL TAANSKTU VMNANSKL /end DEF_CHARACTERISTIC /begin REF_CHARACTERISTIC /end REF_CHARACTERISTIC /begin IN_MEASUREMENT B_btanskl nmot rl tans tnst_w tumg vfzg /end IN_MEASUREMENT /begin OUT_MEASUREMENT AansklBits B_anskl B_tanshys /end OUT_MEASUREMENT /begin LOC_MEASUREMENT /end LOC_MEASUREMENT /begin SUB_FUNCTION /end SUB_FUNCTION /end FUNCTION
/begin FUNCTION ADC "" /begin DEF_CHARACTERISTIC /end DEF_CHARACTERISTIC /begin REF_CHARACTERISTIC /end REF_CHARACTERISTIC /begin IN_MEASUREMENT /end IN_MEASUREMENT
 /begin OUT_MEASUREMENT ADC_Urefsp1_w ADC_Urefsp2_w ADC_Uspoti1_w ADC_Uspoti2_w B_adcInjact iUipoti1_w iUipoti2_w iUrefsp1_w iUspoti1_w iUspoti2_w udimfgr udst_w udsu_w uhsh uhsh2 uhsv uhsv2 usp1plaus uuptes10ms_w wtans wtka wtmot wtmr wtol wtsg wub wub_w /end OUT_MEASUREMENT
 /begin LOC_MEASUREMENT /end LOC_MEASUREMENT
 /begin SUB_FUNCTION /end SUB_FUNCTION
/end FUNCTION
/begin FUNCTION ADC_HW "" /begin DEF_CHARACTERISTIC /end DEF_CHARACTERISTIC /begin REF_CHARACTERISTIC _STETLR /end REF_CHARACTERISTIC /begin IN_MEASUREMENT /end IN_MEASUREMENT
 /begin OUT_MEASUREMENT udkp1v_w udkp1_w udkp2_w uhfm_w uushk2_w uushk_w uusvk2_w uusvk_w /end OUT_MEASUREMENT
 /begin LOC_MEASUREMENT /end LOC_MEASUREMENT
 /begin SUB_FUNCTION /end SUB_FUNCTION
/end FUNCTION
/begin FUNCTION ADVE "Ansteuerung der DV-E mit dem DLR"
 /begin DEF_CHARACTERISTIC DANTGESWNV DANTGESWV DANTSCHWNV DANTSCHWV DKLAGERT DLRDWDKSS1 DLRDWDKSS2 DLRIAMAX DLRIKLPAR DLRININI DLRKDONLP0 DLRKDUNLP0 DLRKDUNLP1 DLRKDUNLP2 DLRKIONLP0 DLRKIUNLP0 DLRKIUNLP1 DLRKIUNLP2 DLRKPONLP0 DLRKPUNLP0 DLRKPUNLP1 DLRKPUNLP2 DLRKREIS DLRKREISST DLRNLPD DLRPID1T DLRPID2T DLRPIDMAX DLRPIDMIN DLRUBSOLL DLRUMABAND DLRUMAIINI DVEEST DWDKSBAMX DWDKSIKLS KDLRIDDVE TDKLAGDE WDKBEWS WDKNLPTOL WDKREIB WDKSTFEIN WDKSTGROB ZKUBDLR ZKWDKSPT1 /end DEF_CHARACTERISTIC
 /begin REF_CHARACTERISTIC /end REF_CHARACTERISTIC
 /begin IN_MEASUREMENT B_dcdisr B_dkaden B_dknolu B_dkpiu B_i_ska_um B_lrnrdy B_pwf B_st B_wdk1v dwdks_w ub wdkada_w wdkba_w wdknlp_w wdks_w /end IN_MEASUREMENT
 /begin OUT_MEASUREMENT B_dcdisfr B_dlrbe B_dlrparc B_dlrpide B_dlrspid B_dlrumzu B_nlpne B_ubpvg B_ub_ok B_wdksive dlrspid_w /end OUT_MEASUREMENT
 /begin LOC_MEASUREMENT B_dkbew B_dlrikla B_dlriklst B_dveese B_dveesh B_iklrest B_iklstar B_ubdve B_wdksauf dklagerc dlrd dlri dlriamax dlriant_w dlriklst_w dlrikl_w dlrkomp dlrndif_w dlrp dlrpidc dveesc dwdkdlr_w dwdks_kge wdkdlr_w wdksfi_w /end LOC_MEASUREMENT
 /begin SUB_FUNCTION /end SUB_FUNCTION
/end FUNCTION
/begin FUNCTION AEKP "Ausgabe EKP-Ansteuerung" /begin DEF_CHARACTERISTIC TAPVLTM TNLEKPVL TPVL TZMIN UBSTS ZNOSTMX /end DEF_CHARACTERISTIC /begin REF_CHARACTERISTIC /end REF_CHARACTERISTIC
 /begin IN_MEASUREMENT B_airbag B_nachlend B_nmin B_st B_stend B_uhrrsec swOffDlBits tabst_w tmotab tnachl_w ub /end IN_MEASUREMENT
 /begin OUT_MEASUREMENT B_ekp /end OUT_MEASUREMENT
 /begin LOC_MEASUREMENT AEKPintbits B_ekpd B_ekpn B_ekpubn B_ekpvl B_pvl1 B_pvl2 B_pvlnl B_tpvl dekpub lokBits_Aekp znostend /end LOC_MEASUREMENT
 /begin SUB_FUNCTION /end SUB_FUNCTION
/end FUNCTION
/begin FUNCTION AES "Ausgabe Einspritzung" /begin DEF_CHARACTERISTIC CWPKAPP FRLFSDP KRKTE PSAPES TVUB /end DEF_CHARACTERISTIC /begin REF_CHARACTERISTIC /end REF_CHARACTERISTIC /begin IN_MEASUREMENT ps_w pu_w ub vsfpses /end IN_MEASUREMENT /begin OUT_MEASUREMENT frkte tvu_w /end OUT_MEASUREMENT /begin LOC_MEASUREMENT dpus_w pses_w /end LOC_MEASUREMENT /begin SUB_FUNCTION /end SUB_FUNCTION /end FUNCTION
/begin FUNCTION AEVAB "Ausgabe Einspritzung Ev-Ausblendung" /begin DEF_CHARACTERISTIC NMXSKA REDABM /end DEF_CHARACTERISTIC /begin REF_CHARACTERISTIC _EVMB _EVMB2 _EVOFS _REDMX _TWO_ZYLZA _ZYLMASK _ZYLZA /end REF_CHARACTERISTIC
 /begin IN_MEASUREMENT B_dknolu B_dkpu B_dveada B_faevz B_i_ska_um B_nmaxd devoff flgtiab nmot redsol zzyl /end IN_MEASUREMENT
 /begin OUT_MEASUREMENT abmf B_bevab B_bevab2 B_evasel B_evloc evz_ags evz_aus evz_austot redbas redist /end OUT_MEASUREMENT
 /begin LOC_MEASUREMENT B_dkuevab B_skaevab eevx evrbgn evrbgn_one redsolr redsol_one tvrnr zzbank /end LOC_MEASUREMENT
 /begin SUB_FUNCTION /end SUB_FUNCTION
/end FUNCTION
/begin FUNCTION ALE "Auslauferkennung" /begin DEF_CHARACTERISTIC TMESP TRD ZTPREL /end DEF_CHARACTERISTIC /begin REF_CHARACTERISTIC /end REF_CHARACTERISTIC /begin IN_MEASUREMENT B_stend tmot ttooth10msCtr zzyl /end IN_MEASUREMENT /begin OUT_MEASUREMENT aleNvBits B_ale /end OUT_MEASUREMENT /begin LOC_MEASUREMENT B_ap B_umkehr zylale zylstp zzale zzrale zzstp /end LOC_MEASUREMENT /begin SUB_FUNCTION /end SUB_FUNCTION /end FUNCTION
/begin FUNCTION ALEOLD "" /begin DEF_CHARACTERISTIC WESSTO /end DEF_CHARACTERISTIC /begin REF_CHARACTERISTIC /end REF_CHARACTERISTIC /begin IN_MEASUREMENT /end IN_MEASUREMENT /begin OUT_MEASUREMENT zylsync zylvirt zzsync zzvirt /end OUT_MEASUREMENT /begin LOC_MEASUREMENT /end LOC_MEASUREMENT /begin SUB_FUNCTION /end SUB_FUNCTION /end FUNCTION
/begin FUNCTION AMUENE "Abspeicherung von Motorüberdrehzahlereignissen" /begin DEF_CHARACTERISTIC NUEMAX /end DEF_CHARACTERISTIC /begin REF_CHARACTERISTIC /end REF_CHARACTERISTIC /begin IN_MEASUREMENT B_pwf kmstand nmot_w /end IN_MEASUREMENT /begin OUT_MEASUREMENT anznmax kmstnmax nmax_w /end OUT_MEASUREMENT /begin LOC_MEASUREMENT /end LOC_MEASUREMENT /begin SUB_FUNCTION /end SUB_FUNCTION /end FUNCTION
/begin FUNCTION ARMD "Momentenbasierte Antiruckelfunktion"
 /begin DEF_CHARACTERISTIC A0 A1 A2 B1 B2 DMDAROG DMDARUG DNARAO DNFILO DNIARNG DVFZAR FLRAG FLRAWG FLRHG FRARAG FRARAWG FRARHG KIFZGAG KIFZGAWG KIFZGHG NARA NARASTG NARLL NTAREIN TAREIN TMAR TMARSTM TZSPINI VARAU ZNGAR /end DEF_CHARACTERISTIC
 /begin REF_CHARACTERISTIC SGA07MDUB /end REF_CHARACTERISTIC
 /begin IN_MEASUREMENT B_asrext B_autget B_kuppl B_kurn B_kurp B_ll B_mdein B_miext B_msrext B_sa B_stend B_wk B_wkr esst_sga07mdub gangi mdverl_w mifa_w misolv_w ngas_w nmot nmot_w tmot tmst vfzg /end IN_MEASUREMENT
 /begin OUT_MEASUREMENT B_ar B_ar_help dmar_w ngfar_w /end OUT_MEASUREMENT
 /begin LOC_MEASUREMENT B_iniar B_tzarni dniar_w fdar flrar kifz_w mdbes_w mkar_w mlast_w ndar_w ndfdif_w ndfil_w ndiff_w nmod_w tzarni /end LOC_MEASUREMENT
 /begin SUB_FUNCTION /end SUB_FUNCTION
/end FUNCTION
/begin FUNCTION ATEV "Ansteuerung Tankentlüftungsventil (Periodendauer)" /begin DEF_CHARACTERISTIC KFTEVP TATEGMX TATEMSN TTEVUB /end DEF_CHARACTERISTIC /begin REF_CHARACTERISTIC /end REF_CHARACTERISTIC /begin IN_MEASUREMENT B_dtes B_evloc msntevo_w msteo_w mstesoll_w nmot tadtea ub /end IN_MEASUREMENT /begin OUT_MEASUREMENT tateout tatesoll tevper /end OUT_MEASUREMENT /begin LOC_MEASUREMENT msntev_w /end LOC_MEASUREMENT /begin SUB_FUNCTION /end SUB_FUNCTION /end FUNCTION
/begin FUNCTION ATM "Abgastemperaturmodell"
 /begin DEF_CHARACTERISTIC ATMABKA ATMABKA2 ATMABKK ATMABKK2 ATMTANS DTUMTAT FATMRML FATMRML2 FATMVM FWMABGW FWMABGW2 FWMKATW FWMKATW2 IMTUMTAT KFATMLA KFATMLA2 KFATMLAE KFATMLAE2 KFATMZW KFATMZW2 KFATMZWE KFTATM KFTATM2 KFWMABG KFWMABG2 KFWMKAT KFWMKAT2 NTUMTAT TABGMEX TASTBFA TATMKH TATMKH2 TATMKW TATMSA TATMSTI TATMTMOT TATMTP TATMWMK TKSTBFA TUMTAIT VTUMTAT WMABGKH WMABGKH2 ZATMAML ZATMAML2 ZATMKML ZATMKML2 ZATMRML ZATMRML2 /end DEF_CHARACTERISTIC
 /begin REF_CHARACTERISTIC SEZ06TMUB SLX06TMUW SLY06TMUW SML06TMUB SML07TMUW ST107TMUB ST207TMUB ST307TMUB ST407TMUB STM05TMUB STS06TMUW /end REF_CHARACTERISTIC
 /begin IN_MEASUREMENT B_etum B_faatm B_kh B_kw B_nmot B_pwf B_sa B_st B_stend B_tfu B_trkh esst_sez06tmub esst_slx06tmuw esst_sly06tmuw esst_sml06tmub esst_sml07tmuw esst_st107tmub esst_st207tmub esst_st307tmub esst_st407tmub esst_stm05tmub esst_sts06tmuw etazwist lamsons2_w lamsons_w ml ml_w nmot rl tabst_w tans tmot tmst tumg vfzg /end IN_MEASUREMENT
 /begin OUT_MEASUREMENT ATMbits B_atmtpa B_atmtpa2 B_atmtpk B_atmtpk2 imlatm imlatm_w iwmatm2_w iwmatm_w tabgm tabgm2 tabgm2_w tabgm_w tkatm tkatm2 tkatm2_w tkatm_w zwmatm zwmatm2 zwmatmf zwmatmf2 /end OUT_MEASUREMENT
 /begin LOC_MEASUREMENT B_atmst B_atmst2 B_atmtpf B_atmtpf2 B_atmtpl B_atmtpl2 B_stndnl etazwimt tabgmab tabgmab2 tabgmst tabgmst2 tatmkf tatmkf2 tatmsta tatmsta2 tatu tkatmab tkatmab2 tkatmst tkatmst2 /end LOC_MEASUREMENT
 /begin SUB_FUNCTION /end SUB_FUNCTION
/end FUNCTION
/begin FUNCTION BBACC "Ein.- und Ausschaltbedingungen ACC (Adaptiv Cruise Control)" /begin DEF_CHARACTERISTIC TACCMXRMP TACCREAKX TACCSRG TVFGRSTAT /end DEF_CHARACTERISTIC /begin REF_CHARACTERISTIC /end REF_CHARACTERISTIC
 /begin IN_MEASUREMENT acc_stat B_acc B_accdef B_accdme B_brems B_dkpu B_fgr B_fgrai B_fgral B_fgras B_fgrat B_fgren B_fgrhsa B_fgrkf B_fgrtbe B_fgrtse B_fgrtwa B_fgrver B_fs B_mdacc B_nmax gangi mrfgr_w mrped_w stat_md_e /end IN_MEASUREMENT
 /begin OUT_MEASUREMENT B_mflai B_mflal B_mflar B_mflas B_mflen fgr_stat /end OUT_MEASUREMENT
 /begin LOC_MEASUREMENT B_accarm B_accnor B_accsrg B_acctgo fgrstatu taccreakmx zaaccpos /end LOC_MEASUREMENT
 /begin SUB_FUNCTION /end SUB_FUNCTION
/end FUNCTION
/begin FUNCTION bbbo "Betriebsbereich Erkennung Benzin im Öl" /begin DEF_CHARACTERISTIC ABOLRAR ABOMX IMLKS TMSKS /end DEF_CHARACTERISTIC /begin REF_CHARACTERISTIC /end REF_CHARACTERISTIC /begin IN_MEASUREMENT B_pwf B_stend ml_w tmst /end IN_MEASUREMENT /begin OUT_MEASUREMENT abo B_abor imlbbo imlbbo_w /end OUT_MEASUREMENT /begin LOC_MEASUREMENT /end LOC_MEASUREMENT /begin SUB_FUNCTION /end SUB_FUNCTION /end FUNCTION
/begin FUNCTION BBFGR "Ein- und Ausschaltbedingungen Fahrgeschwindigkeitsregler"
 /begin DEF_CHARACTERISTIC BFGRO BFGRU CWBBFGR CWBFGROF DVAQUGMX DVAQUKMX DVFGREO DVFGREU DVIVZMX DVZVIMX GAFGRO GAFGRU NFGRMAX TDVIVZ TDVZVI TFGRAQU TFGRASCOF TFGRBREOF TFGRDSCOF TFGRUEOB TFGRUM TFGRUNUB VBGFGRAQ VFGRMAX VFGRMIN VREGLMAX VREGLMIN /end DEF_CHARACTERISTIC
 /begin REF_CHARACTERISTIC TFGRARLG /end REF_CHARACTERISTIC
 /begin IN_MEASUREMENT bfzglfgr B_acc B_asc_reg B_asr B_asrext B_brems B_dknolu B_dkpiu B_dsc_reg B_evfzgv1 B_fgr B_fgrabz B_fgrat B_fgren B_fgrhe B_fgrhsa B_fgrkf B_fgrtbe B_fgrtse B_fgrtve B_fgrtwa B_fgr_um B_gwhs B_hdc B_kuppl B_lowra B_msrext B_pwgnotfr gangi nmot vfgrrf_w vfgr_w vziel_w /end IN_MEASUREMENT
 /begin OUT_MEASUREMENT B_fgrab B_fgrai B_fgras B_fgrenv B_fgresv /end OUT_MEASUREMENT
 /begin LOC_MEASUREMENT BBFGRlokBits B_fgraext B_fgral B_fgrars B_fgres /end LOC_MEASUREMENT
 /begin SUB_FUNCTION /end SUB_FUNCTION
/end FUNCTION
/begin FUNCTION BBGANG "Betriebsbereich Gang"
 /begin DEF_CHARACTERISTIC IGESGA NGANGMIN NVQUOT1O NVQUOT1U NVQUOT2O NVQUOT2U NVQUOT3O NVQUOT3U NVQUOT4O NVQUOT4U NVQUOT5O NVQUOT5U NVQUOT6O NVQUOT6U /end DEF_CHARACTERISTIC
 /begin REF_CHARACTERISTIC /end REF_CHARACTERISTIC
 /begin IN_MEASUREMENT B_autget B_vnull gangauti nmot_w vfzg_w /end IN_MEASUREMENT
 /begin OUT_MEASUREMENT B_gwhs gangi nvquot_w uevges /end OUT_MEASUREMENT
 /begin LOC_MEASUREMENT /end LOC_MEASUREMENT
 /begin SUB_FUNCTION /end SUB_FUNCTION
/end FUNCTION
/begin FUNCTION BBKHZ "Betriebsbereich motorisches Katheizen"
 /begin DEF_CHARACTERISTIC BTRKHTMS CWKHZ DTKATMN DTKH DTMABKH FHOKH FKHABMN FKHLA FKHLA2 FKHMD FTMLAKH IMLKHMX IMLKHTMS KTNDMRKH MLKHMX MLSUS MLSUS2 NFSKHM NFSKHM2 NLLKHM NLLKHM2 NLLKT TABSTKH TKATMN TKATW TKHABB TKHFSAB TKHLL TKHLLAB TKHLLMX TKHLLMX2 TKHMX TMSLOF TNSDMRKH ZKHABB ZKLAMKH ZKLAMKH2 /end DEF_CHARACTERISTIC
 /begin REF_CHARACTERISTIC STM04__UB /end REF_CHARACTERISTIC
 /begin IN_MEASUREMENT B_dsla B_fa B_fasla B_fs B_hag B_katfz B_ll B_lmsslof B_msloff B_nmot B_nokatfz B_slkhof B_slpoff B_slsfz B_st B_stend B_wst esst_stm04__ub fho_w imlatm_w ml tabst_w tans tkatm tmot tmotab tmst tnst_w /end IN_MEASUREMENT
 /begin OUT_MEASUREMENT B_kh B_kha B_khab B_kw B_trkh fkhab flakh flamkh fmdkh imlpr imlpr_w nfskh nllkh /end OUT_MEASUREMENT
 /begin LOC_MEASUREMENT BBKHZlokBits B_imlprini B_khares B_khaset B_kherr B_khll B_khlle B_khllmx B_khn B_khres B_khset B_khstc B_mlsu fmdkhtns_w mlsu /end LOC_MEASUREMENT
 /begin SUB_FUNCTION /end SUB_FUNCTION
/end FUNCTION
/begin FUNCTION BBKURU "Betriebsbereich Erkennung Kupplung rutscht" /begin DEF_CHARACTERISTIC IKURUN IKURUP TVKURU ZKURU /end DEF_CHARACTERISTIC /begin REF_CHARACTERISTIC SGA07MDUB /end REF_CHARACTERISTIC /begin IN_MEASUREMENT B_kuppl esst_sga07mdub gangi nvquot_w /end IN_MEASUREMENT /begin OUT_MEASUREMENT B_kurn B_kurp dnvquotf_w dnvquot_w /end OUT_MEASUREMENT /begin LOC_MEASUREMENT /end LOC_MEASUREMENT /begin SUB_FUNCTION /end SUB_FUNCTION /end FUNCTION
/begin FUNCTION BBLOR "Betriebsbereich Getriebeuntersetzung Low Range" /begin DEF_CHARACTERISTIC CWLOWR VMINLR VMINLRO /end DEF_CHARACTERISTIC /begin REF_CHARACTERISTIC /end REF_CHARACTERISTIC /begin IN_MEASUREMENT B_acttxucp B_lorcalc B_lorplaus B_lowr B_txucp vfzg_w /end IN_MEASUREMENT /begin OUT_MEASUREMENT BblorNvBits B_lowra B_lowrapp /end OUT_MEASUREMENT /begin LOC_MEASUREMENT /end LOC_MEASUREMENT /begin SUB_FUNCTION /end SUB_FUNCTION /end FUNCTION
/begin FUNCTION BBPEDBR "Plausibilisierung Fahrpedalwert/Bremspedal; Dokumentation" /begin DEF_CHARACTERISTIC TWPEDBR WPEDFMX /end DEF_CHARACTERISTIC /begin REF_CHARACTERISTIC /end REF_CHARACTERISTIC /begin IN_MEASUREMENT B_bl B_br B_nmot B_pwf kmstand wped_w /end IN_MEASUREMENT /begin OUT_MEASUREMENT anzpbr_w kmstpbr_w /end OUT_MEASUREMENT /begin LOC_MEASUREMENT /end LOC_MEASUREMENT /begin SUB_FUNCTION /end SUB_FUNCTION /end FUNCTION
/begin FUNCTION BBSAWE "Betriebsbereich Schubabschalten/Wiedereinsetzen"
 /begin DEF_CHARACTERISTIC DNSAH DNSAL DNSLL DNVSA DNWEK DVSA ENASAG KFTVSA KFTVSALR KFTVSAM KFTVSAMLR NGDNSA NWEM NWENG TKATSAN TVSATM VSAA /end DEF_CHARACTERISTIC
 /begin REF_CHARACTERISTIC SNM08__UB STM05SAUB /end REF_CHARACTERISTIC
 /begin IN_MEASUREMENT B_cvt B_dash B_dsls B_falls B_kh B_koe B_kuppl B_ll B_lowra B_sacvt B_savfgr B_stend esst_snm08__ub esst_stm05saub gangi ngfil nmot tkatm tmot tmst vfzg /end IN_MEASUREMENT
 /begin OUT_MEASUREMENT B_sab /end OUT_MEASUREMENT
 /begin LOC_MEASUREMENT BBSAWElokbits B_dnsll B_sabt dnsa nsa nwe tkatsa /end LOC_MEASUREMENT
 /begin SUB_FUNCTION /end SUB_FUNCTION
/end FUNCTION
/begin FUNCTION BBSTART "Betriebsbedingungen: Start" /begin DEF_CHARACTERISTIC NNST /end DEF_CHARACTERISTIC /begin REF_CHARACTERISTIC /end REF_CHARACTERISTIC /begin IN_MEASUREMENT /end IN_MEASUREMENT /begin OUT_MEASUREMENT /end OUT_MEASUREMENT /begin LOC_MEASUREMENT /end LOC_MEASUREMENT /begin SUB_FUNCTION /end SUB_FUNCTION /end FUNCTION
/begin FUNCTION BBSTT "Betriebsbereich: Start" /begin DEF_CHARACTERISTIC NNSTA NSTNM /end DEF_CHARACTERISTIC /begin REF_CHARACTERISTIC /end REF_CHARACTERISTIC /begin IN_MEASUREMENT B_nmot nmot tans tmot /end IN_MEASUREMENT /begin OUT_MEASUREMENT B_st B_stend tnse_w tnst_w /end OUT_MEASUREMENT /begin LOC_MEASUREMENT /end LOC_MEASUREMENT /begin SUB_FUNCTION /end SUB_FUNCTION /end FUNCTION
/begin FUNCTION BBTEGA "Phasensteuerung für Tankentlüftung und Gemischadaption"
 /begin DEF_CHARACTERISTIC DFTEDS FTEADZU FTEDS TATELL TMSNOGA TTE TTEAE TTEBSTP TTEGA TTEGAI TTEGAZO TTEGAZU TTEINI TTEMN TTEPRIO TTEZAO TTEZAU /end DEF_CHARACTERISTIC
 /begin REF_CHARACTERISTIC /end REF_CHARACTERISTIC
 /begin IN_MEASUREMENT B_dldpte B_dmtltz B_dtes B_edkvs B_edkvs2 B_frao B_gae B_gaefra B_gaefra2 B_gasp B_grdst B_ll B_lr B_lr2 B_nmot B_te B_teabb B_tehbx B_teza ftead_w tans tmst tnse_w /end IN_MEASUREMENT
 /begin OUT_MEASUREMENT B_fraoan B_gap B_tep /end OUT_MEASUREMENT
 /begin LOC_MEASUREMENT B_tehbxf B_tepi B_tepzus B_tesstp B_tezstp B_tteae tephc /end LOC_MEASUREMENT
 /begin SUB_FUNCTION /end SUB_FUNCTION
/end FUNCTION
/begin FUNCTION BBVL "Betriebsbereich Vollast" /begin DEF_CHARACTERISTIC WDKVLN /end DEF_CHARACTERISTIC /begin REF_CHARACTERISTIC /end REF_CHARACTERISTIC /begin IN_MEASUREMENT B_dkunb nmot wdkba /end IN_MEASUREMENT /begin OUT_MEASUREMENT B_vl /end OUT_MEASUREMENT /begin LOC_MEASUREMENT /end LOC_MEASUREMENT /begin SUB_FUNCTION /end SUB_FUNCTION /end FUNCTION
/begin FUNCTION BGCVN "Berechnete Größe Calibration Verification Number CVN" /begin DEF_CHARACTERISTIC /end DEF_CHARACTERISTIC /begin REF_CHARACTERISTIC /end REF_CHARACTERISTIC /begin IN_MEASUREMENT B_m9cvn B_m9cvnclr B_pwf /end IN_MEASUREMENT /begin OUT_MEASUREMENT bgcvn_bits B_cksbrdy B_cksbrdy2 CALIBID1 CALIBID2 cvn cvn2 /end OUT_MEASUREMENT /begin LOC_MEASUREMENT B_calib2 /end LOC_MEASUREMENT /begin SUB_FUNCTION /end SUB_FUNCTION /end FUNCTION
/begin FUNCTION BGDVE "Größen für DV-E-Ansteuerung aus Lern- und Prüfroutinen"
 /begin DEF_CHARACTERISTIC DKPSTGMIN DLRPIDSTMN DUDKNLPO DUDKNLPU DUDKPTMP FPRAT FPRMT FPRNMAX FPRTIM1_T FPRTIM2_T LRNST1_T LRNST3_T LRNST7_T LRNST9_T LRNVB_T LRNVB_TDI NLPST1T NLPST2T TDKNLPE TDLRPIDMX TMSUTMUMA TTMUMASTA UANAUFRP UANNMAX UANPEDMAX UANPIDMIN UANPIDMINA UANUATS UANZURP UAN_O_MT UAN_STORE UAN_U_MT UB_UANL UDKNLP1N UDKNLP2N UDKP1AMAX UDKP1AMIN UDKP1AURI UDKP1DUS UDKP1NHUB UDKP1VID UDKP1VOMA UDKP1VOMI UDKP1VOSC UDKP1VUSC UDKP1VVMA UDKP1VVMI UDKP2AMAX UDKP2AMIN UDKP2AURI UDKPALOS UDKPAOFF UDKPATMX UPVGNENN WDKFPRZ1 WDKFPRZ2 WDKNLPMA WDKNLPMI WDKSFPR WDKSTMUMA /end DEF_CHARACTERISTIC
 /begin REF_CHARACTERISTIC DUDKP1HY /end REF_CHARACTERISTIC
 /begin IN_MEASUREMENT B_dcdisfr B_dknolu B_dknot B_dkpiu B_dlrspid B_i_ska_um B_lrndia B_pwf B_wdk2sel dlrspid_w nmotll tans tmot tnachl_w ub udkp1v_w udkp1_w udkp2_w vfzg wdkba_w wdks_w wped /end IN_MEASUREMENT
 /begin OUT_MEASUREMENT B_dcdisr B_dkaden B_dlrien B_dveada B_fprzab B_lrnakt B_umauab dkpstg_w dlrmxt tloop tmpumast ttmumad udkp1a udkp1asr_w udkp1as_w udkp1a_w udkp1sv udkp1vou udkp1vo_w udkp1vv udkp1vv_w udkp2a udkp2asr_w udkp2as_w udkp2a_w udkpat_w wdkada_w wdknlp wdknlpr wdknlp_w /end OUT_MEASUREMENT
 /begin LOC_MEASUREMENT BGDVEintbits B_abgle B_fprakt B_fprrdy B_fprze B_fprzok B_fprzvb B_lrnerf B_lrnfg B_lrnrdy B_lrntesa B_lrnvb B_lrnws B_nlpe B_nlperf B_nlperft B_nlpnew B_nlpreq B_umae B_umaerf B_umardr fprstep_c fprtim_c lrnstep_c lrntim_c lrnvb_c lrnvb_zt nlp1tim nlp2tim udknlp1 udknlp1r udknlp2 udknlp2r udkp1aalt udkp1rob udkp1run udkp1vor udkp1vrob udkp1vrun udkp1vvr udkp2aalt wdknlpr_w wdkvabob wdkvabub /end LOC_MEASUREMENT
 /begin SUB_FUNCTION /end SUB_FUNCTION
/end FUNCTION
/begin FUNCTION BGKMST "Berechnete Größe: Kilometerstand" /begin DEF_CHARACTERISTIC /end DEF_CHARACTERISTIC /begin REF_CHARACTERISTIC /end REF_CHARACTERISTIC /begin IN_MEASUREMENT B_ins2cok B_kmmil B_pwf fcmEnd FCMTab kmstand vfzg_u /end IN_MEASUREMENT /begin OUT_MEASUREMENT kmstmil_w kmst_w /end OUT_MEASUREMENT /begin LOC_MEASUREMENT /end LOC_MEASUREMENT /begin SUB_FUNCTION /end SUB_FUNCTION /end FUNCTION
/begin FUNCTION BGKV "Berechnungsgroesse verbrauchter Kraftstoff" /begin DEF_CHARACTERISTIC /end DEF_CHARACTERISTIC /begin REF_CHARACTERISTIC FSTTMX KUMSRL /end REF_CHARACTERISTIC /begin IN_MEASUREMENT anzti rk2_w rkte_w rk_w /end IN_MEASUREMENT /begin OUT_MEASUREMENT BGKVbits B_kvta kvb_w vsks_w /end OUT_MEASUREMENT /begin LOC_MEASUREMENT anztid /end LOC_MEASUREMENT /begin SUB_FUNCTION /end SUB_FUNCTION /end FUNCTION
/begin FUNCTION BGLBZ "Berechnete Größe Ladebilanz der Batterie"
 /begin DEF_CHARACTERISTIC DILBN DILBST DITNS ILBHYSO ILBHYSU ILBINI ILBMN ILBMX KFDILU NSUBO NSUBU /end DEF_CHARACTERISTIC
 /begin REF_CHARACTERISTIC /end REF_CHARACTERISTIC
 /begin IN_MEASUREMENT B_fs B_kl15 B_ll B_pwf B_stend B_tns nmot nmotll nsllm tumg ub vfzg /end IN_MEASUREMENT
 /begin OUT_MEASUREMENT B_nsub dilb ilb nslb /end OUT_MEASUREMENT
 /begin LOC_MEASUREMENT /end LOC_MEASUREMENT
 /begin SUB_FUNCTION /end SUB_FUNCTION
/end FUNCTION
/begin FUNCTION BGMDLM "Berechnete Größe Motormoment mit Momenteneingriffen" /begin DEF_CHARACTERISTIC /end DEF_CHARACTERISTIC /begin REF_CHARACTERISTIC CWZWVMX _REDMX /end REF_CHARACTERISTIC
 /begin IN_MEASUREMENT B_allzwe B_dash B_fil B_msr dmar_w dmllr_w dmrkt_w mibas_w mibgr_w miext_w mifa_w miist_w mims_w minmx_w miszul_w mivmx_w mizsol_w mizwmn_w redbas synchroCtr /end IN_MEASUREMENT
 /begin OUT_MEASUREMENT B_intzwv B_miext mdindlm miint1_w miint2_w miint3_w miintv_w miint_w /end OUT_MEASUREMENT
 /begin LOC_MEASUREMENT etazabas /end LOC_MEASUREMENT
 /begin SUB_FUNCTION /end SUB_FUNCTION
/end FUNCTION
/begin FUNCTION BGMIGS "Momentenbegrenzung aus Anforderung Automatikgetriebe" /begin DEF_CHARACTERISTIC MDIAGMX MDITXUMX /end DEF_CHARACTERISTIC /begin REF_CHARACTERISTIC MDIMX /end REF_CHARACTERISTIC /begin IN_MEASUREMENT B_autget B_gts B_txuget miges_w migsrc_w mitxu_w /end IN_MEASUREMENT /begin OUT_MEASUREMENT migs_w /end OUT_MEASUREMENT /begin LOC_MEASUREMENT /end LOC_MEASUREMENT /begin SUB_FUNCTION /end SUB_FUNCTION /end FUNCTION
/begin FUNCTION BGMRACC "Berechnete Größe relatives ACC-Moment" /begin DEF_CHARACTERISTIC /end DEF_CHARACTERISTIC /begin REF_CHARACTERISTIC KFMRMI /end REF_CHARACTERISTIC /begin IN_MEASUREMENT B_acc miacc_w mimax_w mimin_w mimxl1_w nmot_w /end IN_MEASUREMENT /begin OUT_MEASUREMENT mracc_w /end OUT_MEASUREMENT /begin LOC_MEASUREMENT B_upuew fmiacc_w /end LOC_MEASUREMENT /begin SUB_FUNCTION /end SUB_FUNCTION /end FUNCTION
/begin FUNCTION BGMSABG "Berechnung Abgasmassenstrom - bankabhängig" /begin DEF_CHARACTERISTIC /end DEF_CHARACTERISTIC /begin REF_CHARACTERISTIC /end REF_CHARACTERISTIC /begin IN_MEASUREMENT ml ml_w msl msl2 /end IN_MEASUREMENT /begin OUT_MEASUREMENT mlbb mlbb2 mlbb2_w mlbb_w msabg msabg2 msabg2_w msabg_w /end OUT_MEASUREMENT /begin LOC_MEASUREMENT /end LOC_MEASUREMENT /begin SUB_FUNCTION /end SUB_FUNCTION /end FUNCTION
/begin FUNCTION BGMSZS "Berechnungsgröße Massenströme zum Saugrohr"
 /begin DEF_CHARACTERISTIC DFKMSMN DFKMSMX DFKPVMN DFKPVMX FKMSDKMN FKMSDKMX FKPVDKE FKPVDKMN FKPVDKMX KFMSNWDK KIMSA KIMSALL KLAF KUMSRL KVLAD LADFIL MLFKMSDK MSALLMN MSALLMX MSLG NMSNDKO PSPVDKUGN RLNOT TIMSA TIMSALL TMFKMSDKA WDKFMAON WDKFMAUN WDKMSON ZKMSDK /end DEF_CHARACTERISTIC
 /begin REF_CHARACTERISTIC _TURBO /end REF_CHARACTERISTIC
 /begin IN_MEASUREMENT B_hfm B_ll B_nmot B_pwf fpvdkds_w ftvdk ml_w mshfm_w mste nmot nmot_w ps_w pu_w pvdkds_w tmot wdkba wdkba_w wdkugd_w /end IN_MEASUREMENT
 /begin OUT_MEASUREMENT B_dslvh B_dssv B_fkmsmn B_fkmsmx B_fkpvmn B_fkpvmx B_hfmv B_timsa B_timsall fkmsdka_w fkmsdks_w fkmsdk_w fpvdk fpvdk_w frhodk_w msdif_w msdkalm_w msdk_w msndko_w msndk_w mss_w pspvdb_w pspvdk_w pvdk pvdk_w rldvs_w rlroh_w umsrln_w /end OUT_MEASUREMENT
 /begin LOC_MEASUREMENT drllad_w klaf_kge msdkue_w msnwdk_kge wdkbab_w /end LOC_MEASUREMENT
 /begin SUB_FUNCTION /end SUB_FUNCTION
/end FUNCTION
/begin COMPU_METHOD bfzg_sb_q0p217 "" RAT_FUNC "%6.3" "m/s^2" COEFFS 0 1 0 0 0 0.217 /end COMPU_METHOD
/begin COMPU_METHOD B_TRUE "boolsche Zustände, positive Logik" TAB_VERB "%6.3" "" COMPU_TAB_REF B_TRUE /end COMPU_METHOD
/begin COMPU_VTAB B_TRUE "boolsche Zustände, positive Logik" TAB_VERB 2 0 "----" 1 "TRUE" /end COMPU_VTAB
/begin COMPU_METHOD DEZ "1 : 1 Umrechnug (dez/hex)" RAT_FUNC "%6.2" "" COEFFS 0 1 0 0 0 1 /end COMPU_METHOD
/begin COMPU_METHOD dez "1 : 1 Umrechnug (dez/hex)" RAT_FUNC "%6.2" "" COEFFS 0 1 0 0 0 1 /end COMPU_METHOD
/begin COMPU_METHOD fak_q0p00273 "" RAT_FUNC "%6.4" "-" COEFFS 0 256 0 0 0 0.7 /end COMPU_METHOD
/begin COMPU_METHOD fak_q0p0039 "" RAT_FUNC "%6.4" "-" COEFFS 0 256 0 0 0 1 /end COMPU_METHOD
/begin COMPU_METHOD fak_q0p1 "" RAT_FUNC "%6.3" "" COEFFS 0 1 0 0 0 0.1 /end COMPU_METHOD
/begin COMPU_METHOD fak_sw_b0p0625 "" RAT_FUNC "%8.7" "-" COEFFS 0 65536 0 0 0 0.125 /end COMPU_METHOD
/begin COMPU_METHOD fak_sw_b2 "" RAT_FUNC "%7.6" "-" COEFFS 0 65536 0 0 0 4 /end COMPU_METHOD
/begin COMPU_METHOD fak_sw_b64 "" RAT_FUNC "%6.4" "-" COEFFS 0 65536 0 0 0 128 /end COMPU_METHOD
/begin COMPU_METHOD fak_ub_b0p5 "" RAT_FUNC "%6.4" "-" COEFFS 0 256 0 0 0 0.5 /end COMPU_METHOD
/begin COMPU_METHOD fak_ub_b1 "" RAT_FUNC "%6.4" "-" COEFFS 0 256 0 0 0 1 /end COMPU_METHOD
/begin COMPU_METHOD fak_ub_b16 "" RAT_FUNC "%6.4" "-" COEFFS 0 256 0 0 0 16 /end COMPU_METHOD
/begin COMPU_METHOD fak_ub_b2 "" RAT_FUNC "%6.4" "-" COEFFS 0 256 0 0 0 2 /end COMPU_METHOD
/begin COMPU_METHOD fak_ub_b318p75 "" RAT_FUNC "%6.2" "-" COEFFS 0 256 0 0 0 318.75 /end COMPU_METHOD
/begin COMPU_METHOD fak_ub_b3p125 "" RAT_FUNC "%6.4" "%/Upm" COEFFS 0 2048 0 0 0 25 /end COMPU_METHOD
/begin COMPU_METHOD fak_ub_b4 "" RAT_FUNC "%6.4" "-" COEFFS 0 256 0 0 0 4 /end COMPU_METHOD
/begin COMPU_METHOD fak_uw_b1 "" RAT_FUNC "%7.6" "-" COEFFS 0 65536 0 0 0 1 /end COMPU_METHOD
/begin COMPU_METHOD fak_uw_b16 "" RAT_FUNC "%6.5" "-" COEFFS 0 65536 0 0 0 16 /end COMPU_METHOD
/begin COMPU_METHOD fak_uw_b2 "" RAT_FUNC "%7.6" "-" COEFFS 0 65536 0 0 0 2 /end COMPU_METHOD
/begin COMPU_METHOD fak_uw_b4 "" RAT_FUNC "%7.6" "-" COEFFS 0 65536 0 0 0 4 /end COMPU_METHOD
/begin COMPU_METHOD fak_uw_b4864 "" RAT_FUNC "%6.4" "-" COEFFS 0 65536 0 0 0 4864 /end COMPU_METHOD
/begin COMPU_METHOD fak_uw_q0p001 "" RAT_FUNC "%6.5" "" COEFFS 0 65536 0 0 0 65.536 /end COMPU_METHOD
/begin COMPU_METHOD km_uw_q10 "" RAT_FUNC "%6.1" "km" COEFFS 0 1 0 0 0 10 /end COMPU_METHOD
/begin COMPU_METHOD kumsrl_ub_b0p002 "" RAT_FUNC "%8.7" "(kg/h)/((1/min)*%)" COEFFS 0 128000 0 0 0 1 /end COMPU_METHOD
/begin COMPU_METHOD mk10ms_uw_q2p384e5n "" RAT_FUNC "%6.5" "h(kg*s)" COEFFS 0 41943 0 0 0 10 /end COMPU_METHOD
/begin COMPU_METHOD m_sw_q0p1 "" RAT_FUNC "%6.3" "kg/h" COEFFS 0 1 0 0 0 0.1 /end COMPU_METHOD
/begin COMPU_METHOD m_ub_b0p166 "" RAT_FUNC "%6.5" "1/s" COEFFS 0 255 0 0 0 0.166 /end COMPU_METHOD
/begin COMPU_METHOD m_ub_b1020 "" RAT_FUNC "%6.2" "kg/h" COEFFS 0 1 0 0 0 4 /end COMPU_METHOD
/begin COMPU_METHOD m_ub_b23p3 "" RAT_FUNC "%6.3" "kg" COEFFS 0 2812.5 0 0 0 256 /end COMPU_METHOD
/begin COMPU_METHOD m_ub_b5p8 "" RAT_FUNC "%6.4" "kg" COEFFS 0 5625 0 0 0 128 /end COMPU_METHOD
/begin COMPU_METHOD m_ub_q0p0415 "" RAT_FUNC "%6.4" "kg/(h*s)" COEFFS 0 1 0 0 0 0.0415 /end COMPU_METHOD
/begin COMPU_METHOD m_ub_q0p1 "" RAT_FUNC "%6.3" "kg/h" COEFFS 0 256 0 0 0 25.6 /end COMPU_METHOD
/begin COMPU_METHOD m_uw_b23p3 "" RAT_FUNC "%6.5" "kg" COEFFS 0 2812.5 0 0 0 1 /end COMPU_METHOD
/begin COMPU_METHOD m_uw_b25p6 "" RAT_FUNC "%6.5" "kg/h" COEFFS 0 65536 0 0 0 25.6 /end COMPU_METHOD
/begin COMPU_METHOD m_uw_b6553p5 "" RAT_FUNC "%6.3" "kg/h" COEFFS 0 1 0 0 0 0.1 /end COMPU_METHOD
/begin COMPU_METHOD m_uw_q0p0005 "" RAT_FUNC "%6.5" "kg/h" COEFFS 0 1 0 0 0 0.0005 /end COMPU_METHOD
/begin COMPU_METHOD nmotg_sb_q100 "" RAT_FUNC "%6.0" "U/min/s" COEFFS 0 1 0 0 0 100 /end COMPU_METHOD
/begin COMPU_METHOD nmotg_sw_q0p15625 "" RAT_FUNC "%6.3" "U/min/s" COEFFS 0 1 0 0 0 0.15625 /end COMPU_METHOD
/begin COMPU_METHOD nmotg_sw_q0p39 "" RAT_FUNC "%6.3" "U/min/s" COEFFS 0 1 0 0 0 0.39063 /end COMPU_METHOD
/begin COMPU_METHOD nmot_sw_q0p25 "" RAT_FUNC "%6.3" "U/min" COEFFS 0 1 0 0 0 0.25 /end COMPU_METHOD
/begin COMPU_METHOD nmot_ub_q10 "" RAT_FUNC "%6.1" "U/min" COEFFS 0 1 0 0 0 10 /end COMPU_METHOD
/begin COMPU_METHOD nmot_ub_q40 "" RAT_FUNC "%6.1" "Upm" COEFFS 0 1 0 0 0 40 /end COMPU_METHOD
/begin COMPU_METHOD nmot_uw_q0p15625 "" RAT_FUNC "%6.3" "U/min" COEFFS 0 6.4 0 0 0 1 /end COMPU_METHOD
/begin COMPU_METHOD nmot_uw_q0p25 "" RAT_FUNC "%6.3" "U/min" COEFFS 0 1 0 0 0 0.25 /end COMPU_METHOD
/begin COMPU_METHOD NQ1_W "Drehzahlquantisierung 1.000[Upm]" RAT_FUNC "%6.2" "Upm" COEFFS 0 1 0 0 0 1 /end COMPU_METHOD
/begin COMPU_METHOD p_sw_q0p078 "" RAT_FUNC "%6.4" "hPa" COEFFS 0 65536 0 0 0 5120 /end COMPU_METHOD
/begin COMPU_METHOD p_ub_q10 "" RAT_FUNC "%6.1" "hPa" COEFFS 0 1 0 0 0 10 /end COMPU_METHOD
/begin COMPU_METHOD p_uw_q0p039 "" RAT_FUNC "%6.4" "hPa" COEFFS 0 256 0 0 0 10 /end COMPU_METHOD
/begin COMPU_METHOD qnv_sw_q0p0078 "" RAT_FUNC "%6.4" "(U/min) / (km/h)" COEFFS 0 65536 0 0 0 512 /end COMPU_METHOD
/begin COMPU_METHOD qnv_uw_b512 "" RAT_FUNC "%6.4" "(U/min) / (km/h)" COEFFS 0 65536 0 0 0 512 /end COMPU_METHOD
/begin COMPU_METHOD q_uw_q0p45 "" RAT_FUNC "%6.3" "kJ" COEFFS 0 65536 0 0 0 29696 /end COMPU_METHOD
/begin COMPU_METHOD relDK_q0p00152 "" RAT_FUNC "%6.4" "%DK" COEFFS 0 65536 0 0 0 100 /end COMPU_METHOD
/begin COMPU_METHOD relDK_q0p02441 "" RAT_FUNC "%6.4" "% DK" COEFFS 0 65536 0 0 0 1600 /end COMPU_METHOD
/begin COMPU_METHOD relDK_q0p0625 "" RAT_FUNC "%6.4" "%PWM/%DK" COEFFS 0 16 0 0 0 1 /end COMPU_METHOD
/begin COMPU_METHOD relDK_q0p3922 "" RAT_FUNC "%6.3" "% DK" COEFFS 0 255 0 0 0 100 /end COMPU_METHOD
/begin COMPU_METHOD relDK_q1 "" RAT_FUNC "%6.2" "%PWM/%DK" COEFFS 0 1 0 0 0 1 /end COMPU_METHOD
/begin COMPU_METHOD relDK_q4 "" RAT_FUNC "%6.2" "%PWM/%DK" COEFFS 0 1 0 0 0 4 /end COMPU_METHOD
/begin COMPU_METHOD relDK_ub_b100 "" RAT_FUNC "%6.3" "% DK" COEFFS 0 255 0 0 0 100 /end COMPU_METHOD
/begin COMPU_METHOD relDK_uw_b100 "" RAT_FUNC "%6.4" "% DK" COEFFS 0 65535 0 0 0 100 /end COMPU_METHOD
/begin COMPU_METHOD relPED_uw_b100 "" RAT_FUNC "%6.4" "% PED" COEFFS 0 65535 0 0 0 100 /end COMPU_METHOD
/begin COMPU_METHOD rel_q0p1957 "" RAT_FUNC "%6.3" "%" COEFFS 0 511 0 0 0 100 /end COMPU_METHOD
/begin COMPU_METHOD rel_sw_b100 "" RAT_FUNC "%6.4" "%" COEFFS 0 32768 0 0 0 100 /end COMPU_METHOD
/begin COMPU_METHOD rel_sw_q0p0234 "" RAT_FUNC "%6.4" "%/seg" COEFFS 0 32 0 0 0 0.75 /end COMPU_METHOD
/begin COMPU_METHOD rel_sw_q0p1953 "" RAT_FUNC "%6.3" "%" COEFFS 0 65536 0 0 0 12800 /end COMPU_METHOD
/begin COMPU_METHOD rel_ub_b100 "" RAT_FUNC "%6.3" "%" COEFFS 0 255 0 0 0 100 /end COMPU_METHOD
/begin COMPU_METHOD rel_ub_b127p5 "" RAT_FUNC "%6.3" "%" COEFFS 0 2 0 0 0 1 /end COMPU_METHOD
/begin COMPU_METHOD rel_ub_b2p0 "" RAT_FUNC "%6.4" "%" COEFFS 0 256 0 0 0 2 /end COMPU_METHOD
/begin COMPU_METHOD rel_ub_b99p6 "" RAT_FUNC "%6.3" "%" COEFFS 0 256 0 0 0 100 /end COMPU_METHOD
/begin COMPU_METHOD rel_ub_q0p75 "" RAT_FUNC "%6.3" "%" COEFFS 0 1 0 0 0 0.75 /end COMPU_METHOD
/begin COMPU_METHOD rel_uw_b100 "" RAT_FUNC "%6.4" "%" COEFFS 0 65536 0 0 0 100 /end COMPU_METHOD
/begin COMPU_METHOD rel_uw_b200 "" RAT_FUNC "%6.4" "%" COEFFS 0 65536 0 0 0 200 /end COMPU_METHOD
/begin COMPU_METHOD rel_uw_b40 "" RAT_FUNC "%6.5" "%" COEFFS 0 65536 0 0 0 40 /end COMPU_METHOD
/begin COMPU_METHOD rel_uw_q0p0234 "" RAT_FUNC "%6.4" "%" COEFFS 0 32 0 0 0 0.75 /end COMPU_METHOD
/begin COMPU_METHOD rkti_sy "" RAT_FUNC "%6.4" "ms/%" COEFFS 0 468.75 0 0 0 1 /end COMPU_METHOD
/begin COMPU_METHOD spg_q0p00488 "" RAT_FUNC "%6.4" "V" COEFFS 0 1024 0 0 0 5 /end COMPU_METHOD
/begin COMPU_METHOD spg_q0p00977 "" RAT_FUNC "%6.4" "V" COEFFS 0 256 0 0 0 2.5 /end COMPU_METHOD
/begin COMPU_METHOD spg_q0p03125 "" RAT_FUNC "%6.4" "V" COEFFS 0 256 0 0 0 8 /end COMPU_METHOD
/begin COMPU_METHOD spg_sw_q0p001222 "" RAT_FUNC "%6.4" "V" COEFFS 0 1 0 0 0 0.001222 /end COMPU_METHOD
/begin COMPU_METHOD spg_ubatt "" RAT_FUNC "%6.3" "V" COEFFS 0 1 0 0 0 0.0942 /end COMPU_METHOD
/begin COMPU_METHOD spg_ubatt_w "" RAT_FUNC "%6.4" "V" COEFFS 0 1 0 0 0 0.023535 /end COMPU_METHOD
/begin COMPU_METHOD spg_ub_b5 "" RAT_FUNC "%6.4" "V" COEFFS 0 256 0 0 0 5 /end COMPU_METHOD
/begin COMPU_METHOD spg_uw_b5 "" RAT_FUNC "%6.4" "V" COEFFS 0 1024 0 0 0 5 /end COMPU_METHOD
/begin COMPU_METHOD spg_uw_q0p001222 "" RAT_FUNC "%6.4" "V" COEFFS 0 1 0 0 0 0.001222 /end COMPU_METHOD
/begin COMPU_METHOD spg_uw_q0p00488 "" RAT_FUNC "%6.4" "V" COEFFS 0 1024 0 0 0 5 /end COMPU_METHOD
/begin COMPU_METHOD s_q1_km "" RAT_FUNC "%6.2" "km" COEFFS 0 1 0 0 0 1 /end COMPU_METHOD
/begin COMPU_METHOD s_q6_km "" RAT_FUNC "%6.2" "km" COEFFS 0 1 0 0 0 6 /end COMPU_METHOD
/begin COMPU_METHOD t100msxs_ub_b25p5 "" RAT_FUNC "%6.3" "s" COEFFS 0 1 0 0 0 0.1 /end COMPU_METHOD
/begin COMPU_METHOD t100msxs_uw_b6553p5 "" RAT_FUNC "%6.3" "s" COEFFS 0 1 0 0 0 0.1 /end COMPU_METHOD
/begin COMPU_METHOD t100msxs_uw_b6553p6 "" RAT_FUNC "%6.3" "s" COEFFS 0 10 0 0 0 1 /end COMPU_METHOD
/begin COMPU_METHOD t10msxs_ub_b2p55 "" RAT_FUNC "%6.4" "s" COEFFS 0 1 0 0 0 0.01 /end COMPU_METHOD
/begin COMPU_METHOD t10msxs_uw_b655p35 "" RAT_FUNC "%6.4" "s" COEFFS 0 1 0 0 0 0.01 /end COMPU_METHOD
/begin COMPU_METHOD t1sxs_ub_b255 "" RAT_FUNC "%6.2" "s" COEFFS 0 1 0 0 0 1 /end COMPU_METHOD
/begin COMPU_METHOD t1sxs_uw_b65535 "" RAT_FUNC "%6.2" "s" COEFFS 0 1 0 0 0 1 /end COMPU_METHOD
/begin COMPU_METHOD t1sxs_uw_q1 "" RAT_FUNC "%6.2" "s" COEFFS 0 1 0 0 0 1 /end COMPU_METHOD
/begin COMPU_METHOD t200msxs_ub_b51 "" RAT_FUNC "%6.3" "s" COEFFS 0 1 0 0 0 0.2 /end COMPU_METHOD
/begin COMPU_METHOD t20msxs_ub_b5p1 "" RAT_FUNC "%6.4" "s" COEFFS 0 1 0 0 0 0.02 /end COMPU_METHOD
/begin COMPU_METHOD t20msxs_ub_q0p02 "" RAT_FUNC "%6.4" "s" COEFFS 0 50 0 0 0 1 /end COMPU_METHOD
/begin COMPU_METHOD t20msxs_uw_q0p02 "" RAT_FUNC "%6.4" "s" COEFFS 0 1 0 0 0 0.02 /end COMPU_METHOD
/begin COMPU_METHOD t500usxms_ub_q0p5 "" RAT_FUNC "%6.3" "ms" COEFFS 0 1 0 0 0 0.5 /end COMPU_METHOD
/begin COMPU_METHOD t50msxs_q0p05 "" RAT_FUNC "%6.4" "s" COEFFS 0 1 0 0 0 0.05 /end COMPU_METHOD
/begin COMPU_METHOD temp_q5 "" RAT_FUNC "%6.2" "Grad C" COEFFS 0 1 0 0 0 5 /end COMPU_METHOD
/begin COMPU_METHOD temp_ub_b191p25 "" RAT_FUNC "%6.3" "Grad C" COEFFS 0 1 0 0 0 0.75 /end COMPU_METHOD
/begin COMPU_METHOD temp_ub_q0p75_o48 "" RAT_FUNC "%6.2" "Grad C" COEFFS 0 1 48 0 0 0.75 /end COMPU_METHOD
/begin COMPU_METHOD temp_ub_q5_o50 "" RAT_FUNC "%6.2" "Grad C" COEFFS 0 1 50 0 0 5 /end COMPU_METHOD
/begin COMPU_METHOD temp_uw_q0p0195_o50 "" RAT_FUNC "%6.2" "Grad C" COEFFS 0 256 12800 0 0 5 /end COMPU_METHOD
/begin COMPU_METHOD tinjection_sy "" RAT_FUNC "%6.4" "ms" COEFFS 0 312.5 0 0 0 1 /end COMPU_METHOD
/begin COMPU_METHOD vfzg_ub_q1p25 "" RAT_FUNC "%6.2" "km/h" COEFFS 0 1 0 0 0 1.25 /end COMPU_METHOD
/begin COMPU_METHOD vfzg_uw_b512 "" RAT_FUNC "%6.4" "km/h" COEFFS 0 65536 0 0 0 512 /end COMPU_METHOD
/begin COMPU_METHOD vol_q3p90625Em3_l "" RAT_FUNC "%6.4" "L" COEFFS 0 65536 0 0 0 256 /end COMPU_METHOD
/begin COMPU_METHOD vol_q5p96Em8_l "" RAT_FUNC "%10.9" "L" COEFFS 0 65536 0 0 0 0.00390625 /end COMPU_METHOD
/begin COMPU_METHOD WQ720 "Kurbelwellenwinkel - Quantisierung" RAT_FUNC "%6.2" "grad KW" COEFFS 0 1 0 0 0 2.813 /end COMPU_METHOD
/begin COMPU_METHOD zk100msxs_ub_b25p5 "" RAT_FUNC "%6.3" "s" COEFFS 0 0 256 0 10 0 /end COMPU_METHOD
/begin COMPU_METHOD zk10msxs_uw_b655 "" RAT_FUNC "%10.4" "s" COEFFS 0 0 65536 0 100 0 /end COMPU_METHOD
/begin COMPU_METHOD zk200msxs_uw_b13107 "" RAT_FUNC "%10.2" "s" COEFFS 0 0 13107.2 0 1 0 /end COMPU_METHOD
/begin COMPU_METHOD zk20msxs_uw_b1310 "" RAT_FUNC "%10.3" "s" COEFFS 0 0 1310 0 1 0 /end COMPU_METHOD
/begin RECORD_LAYOUT DI__Kwub__________ FNC_VALUES 1 UBYTE COLUMN_DIR DIRECT /end RECORD_LAYOUT
/begin RECORD_LAYOUT DI__Kwuw__________ FNC_VALUES 1 UWORD COLUMN_DIR DIRECT /end RECORD_LAYOUT
/begin RECORD_LAYOUT FkfNoShNoOffWUb FNC_VALUES 1 UBYTE COLUMN_DIR DIRECT /end RECORD_LAYOUT
/begin RECORD_LAYOUT FklWUb FNC_VALUES 1 UBYTE COLUMN_DIR DIRECT /end RECORD_LAYOUT
/begin RECORD_LAYOUT FklWUw FNC_VALUES 1 UWORD COLUMN_DIR DIRECT /end RECORD_LAYOUT
/begin RECORD_LAYOUT GkfWSb FNC_VALUES 1 SBYTE COLUMN_DIR DIRECT /end RECORD_LAYOUT
/begin RECORD_LAYOUT GkfWUb FNC_VALUES 1 UBYTE COLUMN_DIR DIRECT /end RECORD_LAYOUT
/begin RECORD_LAYOUT GkfWUw FNC_VALUES 1 UWORD COLUMN_DIR DIRECT /end RECORD_LAYOUT
/begin RECORD_LAYOUT GklWSw FNC_VALUES 1 SWORD COLUMN_DIR DIRECT /end RECORD_LAYOUT
/begin RECORD_LAYOUT GklWUb FNC_VALUES 1 UBYTE COLUMN_DIR DIRECT /end RECORD_LAYOUT
/begin RECORD_LAYOUT GklWUw FNC_VALUES 1 UWORD COLUMN_DIR DIRECT /end RECORD_LAYOUT
/begin RECORD_LAYOUT KfAxUbAyUbSstxUbSstyUbWSb NO_AXIS_PTS_X 1 UBYTE NO_AXIS_PTS_Y 2 UBYTE AXIS_PTS_X 3 UBYTE INDEX_INCR DIRECT AXIS_PTS_Y 4 UBYTE INDEX_INCR DIRECT FNC_VALUES 5 SBYTE COLUMN_DIR DIRECT /end RECORD_LAYOUT
/begin RECORD_LAYOUT KfAxUbAyUbSstxUbSstyUbWUb NO_AXIS_PTS_X 1 UBYTE NO_AXIS_PTS_Y 2 UBYTE AXIS_PTS_X 3 UBYTE INDEX_INCR DIRECT AXIS_PTS_Y 4 UBYTE INDEX_INCR DIRECT FNC_VALUES 5 UBYTE COLUMN_DIR DIRECT /end RECORD_LAYOUT
/begin RECORD_LAYOUT KfAxUwAyUwSstxUwSstyUwWUw NO_AXIS_PTS_X 1 UWORD NO_AXIS_PTS_Y 2 UWORD AXIS_PTS_X 3 UWORD INDEX_INCR DIRECT AXIS_PTS_Y 4 UWORD INDEX_INCR DIRECT FNC_VALUES 5 UWORD COLUMN_DIR DIRECT /end RECORD_LAYOUT
/begin RECORD_LAYOUT KlASwSstSwWSw NO_AXIS_PTS_X 1 SWORD AXIS_PTS_X 2 SWORD INDEX_INCR DIRECT FNC_VALUES 3 SWORD COLUMN_DIR DIRECT /end RECORD_LAYOUT
/begin RECORD_LAYOUT KlAUbSstSbWUb NO_AXIS_PTS_X 1 UBYTE AXIS_PTS_X 2 SBYTE INDEX_INCR DIRECT FNC_VALUES 3 UBYTE COLUMN_DIR DIRECT /end RECORD_LAYOUT
/begin RECORD_LAYOUT KlAUbSstUbWSb NO_AXIS_PTS_X 1 UBYTE AXIS_PTS_X 2 UBYTE INDEX_INCR DIRECT FNC_VALUES 3 SBYTE COLUMN_DIR DIRECT /end RECORD_LAYOUT
/begin RECORD_LAYOUT KlAUbSstUbWUb NO_AXIS_PTS_X 1 UBYTE AXIS_PTS_X 2 UBYTE INDEX_INCR DIRECT FNC_VALUES 3 UBYTE COLUMN_DIR DIRECT /end RECORD_LAYOUT
/begin RECORD_LAYOUT KlAUbSstUbWUw NO_AXIS_PTS_X 1 UBYTE AXIS_PTS_X 2 UBYTE INDEX_INCR DIRECT FNC_VALUES 3 UWORD COLUMN_DIR DIRECT /end RECORD_LAYOUT
/begin RECORD_LAYOUT KlAUwSstSwWUw NO_AXIS_PTS_X 1 UWORD AXIS_PTS_X 2 SWORD INDEX_INCR DIRECT FNC_VALUES 3 UWORD COLUMN_DIR DIRECT /end RECORD_LAYOUT
/begin RECORD_LAYOUT KlAUwSstUwWUw NO_AXIS_PTS_X 1 UWORD AXIS_PTS_X 2 UWORD INDEX_INCR DIRECT FNC_VALUES 3 UWORD COLUMN_DIR DIRECT /end RECORD_LAYOUT
/begin RECORD_LAYOUT KwbUb FNC_VALUES 1 UBYTE COLUMN_DIR DIRECT /end RECORD_LAYOUT
/begin RECORD_LAYOUT KwSb FNC_VALUES 1 SBYTE COLUMN_DIR DIRECT /end RECORD_LAYOUT
/begin RECORD_LAYOUT KwSw FNC_VALUES 1 SWORD COLUMN_DIR DIRECT /end RECORD_LAYOUT
/begin RECORD_LAYOUT KwUb FNC_VALUES 1 UBYTE COLUMN_DIR DIRECT /end RECORD_LAYOUT
/begin RECORD_LAYOUT KwUw FNC_VALUES 1 UWORD COLUMN_DIR DIRECT /end RECORD_LAYOUT
/begin RECORD_LAYOUT SstAUbSstUb NO_AXIS_PTS_X 1 UBYTE AXIS_PTS_X 2 UBYTE INDEX_INCR DIRECT /end RECORD_LAYOUT
/begin RECORD_LAYOUT SstAUwSstUw NO_AXIS_PTS_X 1 UWORD AXIS_PTS_X 2 UWORD INDEX_INCR DIRECT /end RECORD_LAYOUT
/end MODULE
/end PROJECT
