ASAP2_VERSION 1 3
/begin PROJECT _7211165 "195"
/begin HEADER "" VERSION "_7211165" PROJECT_NO _7211165 /end HEADER
/begin MODULE DIM ""
/begin MOD_COMMON "" BYTE_ORDER MSB_LAST ALIGNMENT_BYTE 1 ALIGNMENT_WORD 2 ALIGNMENT_LONG 2 /end MOD_COMMON
/begin CHARACTERISTIC AUFW100M "" VALUE 0x811FFE KwUb 5100. t20usxus_q20 0.00 5100. FORMAT "%5.0" /end CHARACTERISTIC
/begin CHARACTERISTIC AUFW10MS "" VALUE 0x811FFF KwUb 5100. t20usxus_q20 0.00 5100. FORMAT "%5.0" /end CHARACTERISTIC
/begin CHARACTERISTIC AUFW20MS "" VALUE 0x812000 KwUb 5100. t20usxus_q20 0.00 5100. FORMAT "%5.0" /end CHARACTERISTIC
/begin CHARACTERISTIC AUFWSYNC "" VALUE 0x812001 KwUb 5100. t20usxus_q20 0.00 5100. FORMAT "%5.0" /end CHARACTERISTIC
/begin CHARACTERISTIC CDAGR "Codewort DAGR abschalten (EURO-Codierung), CD..=0 -> keine Diagnose" VALUE 0x811FEA KwUb 255.0 dez 0.00 255.0 FORMAT "%5.1" /end CHARACTERISTIC
/begin CHARACTERISTIC CDDMTL "Codewort DMTL-Diagnose einschalten (EURO-Codierung), CD..=0 -> keine Dia" VALUE 0x811FEB KwUb 255.0 dez 0.00 255.0 FORMAT "%5.1" /end CHARACTERISTIC
/begin CHARACTERISTIC CDEFST "Codewort DFSTT abschalten (EURO-Codierung), CD..=0 -> keine Diagnose" VALUE 0x811FEC KwUb 255.0 dez 0.00 255.0 FORMAT "%5.1" /end CHARACTERISTIC
/begin CHARACTERISTIC CDFALSH "Codewort Funktionsanforderung Lambdasonde hinter Kat" VALUE 0x81244F KwUb 255.0 dez 0.00 255.0 FORMAT "%5.1" /end CHARACTERISTIC
/begin CHARACTERISTIC CDFALSH2 "Codewort Funktionsanforderung Lambdasonde hinter Kat 2" VALUE 0x812450 KwUb 255.0 dez 0.00 255.0 FORMAT "%5.1" /end CHARACTERISTIC
/begin CHARACTERISTIC CDHSH "Codewort Heizerdiagnose hinter Kat (CDHSH = 0  => keine Diagnose)" VALUE 0x811FED KwUb 255.0 dez 0.00 255.0 FORMAT "%5.1" /end CHARACTERISTIC
/begin CHARACTERISTIC CDHSV "Codewort Heizerdiagnose vor Kat im (CDHSV = 0  => keine Diagnose)" VALUE 0x811FEE KwUb 255.0 dez 0.00 255.0 FORMAT "%5.1" /end CHARACTERISTIC
/begin CHARACTERISTIC CDLLR "Codewort DLLR abschalten (EURO-Codierung), CD..=0 -> keine Diagnose" VALUE 0x811FEF KwUb 255.0 dez 0.00 255.0 FORMAT "%5.1" /end CHARACTERISTIC
/begin CHARACTERISTIC CDLSA "Codewort Lambdasondenalterungsdiagnose, Konfig.-byte, für Applikationszwecke" VALUE 0x811FF0 KwUb 255.0 dez 0.00 255.0 FORMAT "%5.1" /end CHARACTERISTIC
/begin CHARACTERISTIC CDLSH "Codewort Sondendiagnose hinter Kat im OBDII-Mode (invers: Europa-Mode)" VALUE 0x811FF1 KwUb 255.0 dez 0.00 255.0 FORMAT "%5.1" /end CHARACTERISTIC
/begin CHARACTERISTIC CDLSV "Codewort Sondendiagnose vor KAT im OBDII-Mode" VALUE 0x811FF2 KwUb 255.0 dez 0.00 255.0 FORMAT "%5.1" /end CHARACTERISTIC
/begin CHARACTERISTIC CDMD "Codewort DMD abschalten (EURO-Codierung), CD..=0 -> keine Diagnose" VALUE 0x811FF3 KwUb 255.0 dez 0.00 255.0 FORMAT "%5.1" /end CHARACTERISTIC
/begin CHARACTERISTIC CDNWS "Codewort DNWS abschalten (EURO-Codierung), CD..=0 -> keine Diagnose" VALUE 0x811FF4 KwUb 255.0 dez 0.00 255.0 FORMAT "%5.1" /end CHARACTERISTIC
/begin CHARACTERISTIC CDSLS "Euro-Byte für Diagnose Sekundärluft-System" VALUE 0x811FF5 KwUb 255.0 dez 0.00 255.0 FORMAT "%5.1" /end CHARACTERISTIC
/begin CHARACTERISTIC CDSWE "Codewort DSWE abschalten (EURO-Codierung), CD..=0 -> keine Diagnose" VALUE 0x812451 KwUb 255.0 dez 0.00 255.0 FORMAT "%5.1" /end CHARACTERISTIC
/begin CHARACTERISTIC CNFMDVER "Codewort zur Konfiguration von MDVER" VALUE 0x81A5A9 KwUb 255.0 dez 0.00 255.0 FORMAT "%5.1" /end CHARACTERISTIC
/begin CHARACTERISTIC CREDSTU "Codewort für Reduzierstufe ein/aus" VALUE 0x81000C KwUb 255.0 dez 0.00 255.0 FORMAT "%5.1" /end CHARACTERISTIC
/begin CHARACTERISTIC CWCVT "" VALUE 0x812452 KwUb 255.0 dez 0.00 255.0 FORMAT "%5.1" /end CHARACTERISTIC
/begin CHARACTERISTIC CWDKAT "Codewort Katalysator-Diagnose im OBDII-Mode (invers: Europa-Mode)" VALUE 0x811FF6 KwUb 255.0 dez 0.00 255.0 FORMAT "%5.1" /end CHARACTERISTIC
/begin CHARACTERISTIC CWDKVS "Codeword DKVS aktiv/inaktiv, CD..=0 -> keine Diagnose" VALUE 0x811FF7 KwUb 255.0 dez 0.00 255.0 FORMAT "%5.1" /end CHARACTERISTIC
/begin CHARACTERISTIC CWDMFAB "Codewort Sw-Schalter für Änderungsbegrenzung" VALUE 0x811EE3 KwUb 255.0 DEZ 0.00 255.0 FORMAT "%5.1" /end CHARACTERISTIC
/begin CHARACTERISTIC CWDTES "Codewort Tankentlüftungsdiagnose abschalten (EURO-Codierung), CD..=0 ->keine Dia" VALUE 0x811FF8 KwUb 255.0 dez 0.00 255.0 FORMAT "%5.1" /end CHARACTERISTIC
/begin CHARACTERISTIC CWERFIL "Codewort zur Auswahl Filtervar. für die Ausgabe von AS.-Fehler an das Scan Tool" VALUE 0x811FF9 KwUb 255.0 dez 0.00 255.0 FORMAT "%5.1" /end CHARACTERISTIC
/begin CHARACTERISTIC CWFASL "Codewort: Testereingriff Sekundärluftdiagnose" VALUE 0x819755 KwUb 255.0 dez 0.00 255.0 FORMAT "%5.1" /end CHARACTERISTIC
/begin CHARACTERISTIC CWKONABG "Codewort für Konfiguration Abgasbehandlung" VALUE 0x81A6F3 KwUb 255.0 dez 0.00 255.0 FORMAT "%5.1" /end CHARACTERISTIC
/begin CHARACTERISTIC CWKONLS "Codewort für Konfiguration Lambda Sonden" VALUE 0x81A6F4 KwUb 255.0 dez 0.00 255.0 FORMAT "%5.1" /end CHARACTERISTIC
/begin CHARACTERISTIC CWMDAPP "Codewort Applikation ohne Drehmomentfunktionen" VALUE 0x810180 KwUb 255.0 dez 0.00 255.0 FORMAT "%5.1" /end CHARACTERISTIC
/begin CHARACTERISTIC CWMDKOG "Codewort MDKOG: Zündwinkelspätverstellung bei Unterdruckbegrenzung" VALUE 0x81016F KwUb 255.0 dez 0.00 255.0 FORMAT "%5.1" /end CHARACTERISTIC
/begin CHARACTERISTIC CWMDWAN "Codewort für Drehmomentaufnahme des Wandlers" VALUE 0x811E89 KwUb 255.0 dez 0.00 255.0 FORMAT "%5.1" /end CHARACTERISTIC
/begin CHARACTERISTIC CWNOCINS "Codewort kein CAN fähiges Kombiinstrument verbaut" VALUE 0x81A6F5 KwUb 255.0 dez 0.00 255.0 FORMAT "%5.1" /end CHARACTERISTIC
/begin CHARACTERISTIC CWNSABG "Codewort Einstellen Leerlauf-Solldrehzahl mit Diagnosetester" VALUE 0x81A6F6 KwUb 255.0 dez 0.00 255.0 FORMAT "%5.1" /end CHARACTERISTIC
/begin CHARACTERISTIC CWOBD "Codewort für Konfiguration OBD Zertifikationsnachweis" VALUE 0x811FFA KwUb 255.0 dez 0.00 255.0 FORMAT "%5.1" /end CHARACTERISTIC
/begin CHARACTERISTIC CWPWF "Codewort Powerfail" VALUE 0x81A6F8 KwUb 255.0 dez 0.00 255.0 FORMAT "%5.1" /end CHARACTERISTIC
/begin CHARACTERISTIC CWSACVT "" VALUE 0x812453 KwUb 255.0 dez 0.00 255.0 FORMAT "%5.1" /end CHARACTERISTIC
/begin CHARACTERISTIC CWSCTMDE "Codewort zum abschalten bestimmter Scan Tool Modes/Services (Bit=0 ->  Mode aus)" VALUE 0x81A6F7 KwUb 255.0 dez 0.00 255.0 FORMAT "%5.1" /end CHARACTERISTIC
/begin CHARACTERISTIC CWSLS "Codewort für Sekundärluftsystem" VALUE 0x811FFB KwUb 255.0 dez 0.00 255.0 FORMAT "%5.1" /end CHARACTERISTIC
/begin CHARACTERISTIC CWSLSOF "Codewort für Sekundärluftsystem; Konfiguration SLS" VALUE 0x819756 KwUb 255.0 dez 0.00 255.0 FORMAT "%5.1" /end CHARACTERISTIC
/begin CHARACTERISTIC CWSTA "Codewort für Ansteuerung Start-Relais - Automatik" VALUE 0x81243F KwUb 255.0 dez 0.00 255.0 FORMAT "%5.1" /end CHARACTERISTIC
/begin CHARACTERISTIC CWTEZW "Codewort Zündwinkeleingriff bei TEV-Prüfung" VALUE 0x810170 KwUb 255.0 dez 0.00 255.0 FORMAT "%5.1" /end CHARACTERISTIC
/begin CHARACTERISTIC CWTF "Codewort für Konfiguration Temperaturfühler" VALUE 0x811FFC KwUb 255.0 dez 0.00 255.0 FORMAT "%5.1" /end CHARACTERISTIC
/begin CHARACTERISTIC CWUHR "Codewort für Uhr" VALUE 0x811FFD KwUb 255.0 dez 0.00 255.0 FORMAT "%5.1" /end CHARACTERISTIC
/begin CHARACTERISTIC CWZWE "Codewort ZW-Eingriffe für MD-Struktur aktiv" VALUE 0x810008 KwUb 255.0 dez 0.00 255.0 FORMAT "%5.1" /end CHARACTERISTIC
/begin CHARACTERISTIC CWZWVMX "Codewort Zündwinkeleingriff bei VMAX-Begrenzung" VALUE 0x810009 KwUb 255.0 dez 0.00 255.0 FORMAT "%5.1" /end CHARACTERISTIC
/begin CHARACTERISTIC CW_FANWH "" VALUE 0x812454 KwUb 255.0 dez 0.00 255.0 FORMAT "%5.1" /end CHARACTERISTIC
/begin CHARACTERISTIC DLSDHK "Dämpfung PT2-Filter Lastschlagdämpfung bei hohem Kupplungsmoment" VALUE 0x816070 KwUw 1.999969 fak_uw_b2 0.00 1.999969 FORMAT "%8.6" /end CHARACTERISTIC
/begin CHARACTERISTIC DLSDHKLR "Dämpfung PT2 Lastschlagdämpfung bei hohem Kupplungsmoment; Low Range" VALUE 0x816072 KwUw 1.999969 fak_uw_b2 0.00 1.999969 FORMAT "%8.6" /end CHARACTERISTIC
/begin CHARACTERISTIC DMADFK "Maximal adaptierbares Delta-Verlustmoment pro Adaptionsphase Fahrst.+Kompr." VALUE 0x81A5BB KwUb 24.90 rel_ub_b24p9 0.00 24.90 FORMAT "%5.2" /end CHARACTERISTIC
/begin CHARACTERISTIC DMADFS "Maximal adaptierbares Delta-Verlustmoment pro Adaptionsphase mit Fahrstufe ein" VALUE 0x81A5BC KwUb 24.90 rel_ub_b24p9 0.00 24.90 FORMAT "%5.2" /end CHARACTERISTIC
/begin CHARACTERISTIC DMADKO "Maximal adaptierbares Delta-Verlustmoment pro Adaptionsphase Kompr.ein" VALUE 0x81A5BD KwUb 24.90 rel_ub_b24p9 0.00 24.90 FORMAT "%5.2" /end CHARACTERISTIC
/begin CHARACTERISTIC DMADLL "Maximal adaptierbares Delta-Verlustmoment pro Adaptionsphase ohne Last" VALUE 0x81A5BE KwUb 24.90 rel_ub_b24p9 0.00 24.90 FORMAT "%5.2" /end CHARACTERISTIC
/begin CHARACTERISTIC DMADMNFK "Minimal adaptierbares Delta-Verlustmoment Fahrstufe eingelegt + Kompressor ein" VALUE 0x81A5BF KwUb 24.90 rel_ub_bn24p9 -24.90 0.00 FORMAT "%5.2" /end CHARACTERISTIC
/begin CHARACTERISTIC DMADMNFS "Minimal adaptierbares Delta-Verlustmoment Fahrstufe eingelegt" VALUE 0x81A5C0 KwUb 24.90 rel_ub_bn24p9 -24.90 0.00 FORMAT "%5.2" /end CHARACTERISTIC
/begin CHARACTERISTIC DMADMNKO "Minimal adaptierbares Delta-Verlustmoment Klimakompressor ein" VALUE 0x81A5C1 KwUb 24.90 rel_ub_bn24p9 -24.90 0.00 FORMAT "%5.2" /end CHARACTERISTIC
/begin CHARACTERISTIC DMADMNLL "Minimal adaptierbares Delta-Verlustmoment ohne Last" VALUE 0x81A5C2 KwUb 24.90 rel_ub_bn24p9 -24.90 0.00 FORMAT "%5.2" /end CHARACTERISTIC
/begin CHARACTERISTIC DMADMXFK "Maximal adaptierbares Delta-Verlustmoment Farstufe + Klimakompressor ein" VALUE 0x81A5C3 KwUb 24.90 rel_ub_b24p9 0.00 24.90 FORMAT "%5.2" /end CHARACTERISTIC
/begin CHARACTERISTIC DMADMXFS "Maximal adaptierbares Delta-Verlustmoment Farstufe ein" VALUE 0x81A5C4 KwUb 24.90 rel_ub_b24p9 0.00 24.90 FORMAT "%5.2" /end CHARACTERISTIC
/begin CHARACTERISTIC DMADMXKO "Maximal adaptierbares Delta-Verlustmoment Klimakompressor ein" VALUE 0x81A5C5 KwUb 24.90 rel_ub_b24p9 0.00 24.90 FORMAT "%5.2" /end CHARACTERISTIC
/begin CHARACTERISTIC DMADMXLL "Maximal adaptierbares Delta-Verlustmoment ohne Last" VALUE 0x81A5C6 KwUb 24.90 rel_ub_b24p9 0.00 24.90 FORMAT "%5.2" /end CHARACTERISTIC
/begin CHARACTERISTIC DMAUFN "Delta-Moment Aufregelung nach Drehmomenteingriff" CURVE 0x81A8B8 KlAUwSstUwWUw 99.99847 rel_uw_b100 0.00 99.99847 FORMAT "%8.5"
 /begin AXIS_DESCR STD_AXIS nmot_w nmot_uw_q0p25 8 0.00 16383.75 FORMAT "%8.2" DEPOSIT ABSOLUTE /end AXIS_DESCR
/end CHARACTERISTIC
/begin CHARACTERISTIC DMDKOE "Anfangswert Momentenfilter bei Klimakompressor Einschalten" CURVE 0x81A5C9 KlAUbSstUbWUb 49.73 rel_ub_b49p725 0.00 49.73 FORMAT "%5.2"
 /begin AXIS_DESCR STD_AXIS nmot nmot_ub_q40 6 0.00 10200. FORMAT "%5.0" DEPOSIT ABSOLUTE /end AXIS_DESCR
/end CHARACTERISTIC
/begin CHARACTERISTIC DMDNSM "Delta Moment zur Nachstartkompensation" CURVE 0x81A5AA KlAUbSstUbWUb 99.61 rel_ub_b99p6 0.00 99.61 FORMAT "%5.2"
 /begin AXIS_DESCR STD_AXIS tmot temp_ub_q0p75_o48 8 -48.00 143.3 FORMAT "%5.1" DEPOSIT ABSOLUTE /end AXIS_DESCR
/end CHARACTERISTIC
/begin CHARACTERISTIC DMDPUG "delta Moment Dashpotende" CURVE 0x81C000 GklWSw 199.9969 rel_sw_b100 -100.0000 99.99695 FORMAT "%8.4" /begin AXIS_DESCR COM_AXIS gangi dez 8 0.00 255.0 AXIS_PTS_REF SGA08MDUB /end AXIS_DESCR /end CHARACTERISTIC
/begin CHARACTERISTIC DMDPUGLR "delta Moment Dashpotende bei Low Range Betrieb" CURVE 0x81C010 GklWSw 199.9969 rel_sw_b100 -100.0000 99.99695 FORMAT "%8.4" /begin AXIS_DESCR COM_AXIS gangi dez 8 0.00 255.0 AXIS_PTS_REF SGA08MDUB /end AXIS_DESCR /end CHARACTERISTIC
/begin CHARACTERISTIC DMIFSAWE "Schwelle bei mimin-Sprung für Rücksetzen von B_fil" VALUE 0x816074 KwUw 99.99695 rel_uw_b100 0.001525879 99.99847 FORMAT "%8.5" /end CHARACTERISTIC
/begin CHARACTERISTIC DMLSDUG "Delta Moment Ende Lastschlagdämpfung" CURVE 0x81C020 GklWSw 199.9969 rel_sw_b100 -100.0000 99.99695 FORMAT "%8.4" /begin AXIS_DESCR COM_AXIS gangi dez 8 0.00 255.0 AXIS_PTS_REF SGA08MDUB /end AXIS_DESCR /end CHARACTERISTIC
/begin CHARACTERISTIC DMLSDULR "Delta Moment Ende Lastschlagdämpfung bei Low Range" CURVE 0x81C030 GklWSw 199.9969 rel_sw_b100 -100.0000 99.99695 FORMAT "%8.4" /begin AXIS_DESCR COM_AXIS gangi dez 8 0.00 255.0 AXIS_PTS_REF SGA08MDUB /end AXIS_DESCR /end CHARACTERISTIC
/begin CHARACTERISTIC DMOFK "LLR Adaptionsoffset bei FK" VALUE 0x81BBDC KwSw 199.9969 rel_sw_b100 -100.0000 99.99695 FORMAT "%8.4" /end CHARACTERISTIC
/begin CHARACTERISTIC DMOFS "LLR Adaptionsoffset bei FS" VALUE 0x81BBDE KwSw 199.9969 rel_sw_b100 -100.0000 99.99695 FORMAT "%8.4" /end CHARACTERISTIC
/begin CHARACTERISTIC DMOKO "LLR Adaptionsoffset bei KO" VALUE 0x81BBE0 KwSw 199.9969 rel_sw_b100 -100.0000 99.99695 FORMAT "%8.4" /end CHARACTERISTIC
/begin CHARACTERISTIC DMOLL "LLR Adaptionsoffset bei LL" VALUE 0x81BBE2 KwSw 199.9969 rel_sw_b100 -100.0000 99.99695 FORMAT "%8.4" /end CHARACTERISTIC
/begin CHARACTERISTIC DMRKHO "obere Hytereseschwelle Katheiz-Momentenreserve mit ZW-Eingriff" VALUE 0x810171 KwUb 99.61 rel_ub_b99p6 0.00 99.61 FORMAT "%5.2" /end CHARACTERISTIC
/begin CHARACTERISTIC DMRKHU "Untere Hytereseschwelle Katheiz-Momentenreserve mit ZW-Eingriff" VALUE 0x810172 KwUb 99.61 rel_ub_b99p6 0.00 99.61 FORMAT "%5.2" /end CHARACTERISTIC
/begin CHARACTERISTIC DNMAXHG "gangabhängige Hystherese für harte Drehzahlbegrenzung" CURVE 0x812ED2 GklWUw 16383.75 nmot_uw_q0p25 0.00 16383.75 FORMAT "%8.2" /begin AXIS_DESCR COM_AXIS gangi dez 7 0.00 255.0 AXIS_PTS_REF SGA07MDUB /end AXIS_DESCR /end CHARACTERISTIC
/begin CHARACTERISTIC DNMAXLR "Hysterese für harte Drehzahlbegrenzung bei Low Range" VALUE 0x81A874 KwUw 16383.75 nmot_uw_q0p25 0.00 16383.75 FORMAT "%8.2" /end CHARACTERISTIC
/begin CHARACTERISTIC DPSLV "minimale Druckdifferenz Sekundärluftventi" VALUE 0x819757 KwUb 1275. p_ub_q5 0.00 1275. FORMAT "%5.0" /end CHARACTERISTIC
/begin CHARACTERISTIC DTMABMS "Hysterese für Motorschutz mit Momentenreduzierung aktiv" VALUE 0x81A6E3 KwUb 191.3 temp_sb_q0p75 0.00 191.3 FORMAT "%5.1" /end CHARACTERISTIC
/begin CHARACTERISTIC DZWETA "Deltazündwinkel aus Wirkungsgrad" CURVE 0x810466 FklWSb 191.3 zw_sb_q0p75 -96.00 95.25 FORMAT "%5.2"
 /begin AXIS_DESCR FIX_AXIS etazws rel_ub_b127p5 201 0.00 100.0 FORMAT "%5.1" FIX_AXIS_PAR 0 0 201 /end AXIS_DESCR
/end CHARACTERISTIC
/begin CHARACTERISTIC FABMDKO "Anfangsfaktor Klimakompressor-Lastabregelung" VALUE 0x81A5D6 KwUb 7.969 fak_ub_b8 0.00 7.969 FORMAT "%5.3" /end CHARACTERISTIC
/begin CHARACTERISTIC FABMDWA "Faktor zur Absteuerung des Wandlermoments abhängig von nturb/nsol" CURVE 0x811E8A KlAUbSstUbWUb 0.9961 fak_ub_b1 0.00 0.9961
 /begin AXIS_DESCR STD_AXIS qntns fak_ub_b8 6 0.00 7.969 FORMAT "%5.3" DEPOSIT ABSOLUTE /end AXIS_DESCR
/end CHARACTERISTIC
/begin CHARACTERISTIC FKKVS "Korrekturfaktor Kraftstoffversorgungssystem" MAP 0x81AA04 KfAxUbAyUbSstxUbSstyUwWUw 1.999969 fak_uw_b2 0.00 1.999969 FORMAT "%8.6"
 /begin AXIS_DESCR STD_AXIS nmot nmot_ub_q40 10 0.00 10200. FORMAT "%5.0" DEPOSIT ABSOLUTE /end AXIS_DESCR
 /begin AXIS_DESCR STD_AXIS tevfa_w_kge tinjection_sy 10 0.00 209.7120 FORMAT "%8.4" DEPOSIT ABSOLUTE /end AXIS_DESCR
/end CHARACTERISTIC
/begin CHARACTERISTIC FMDWAT "Faktor zur Berechnung des Wandlermoments abh. von der Öltemperatur des Wandlers" CURVE 0x81A63B GklWUb 0.0001199 fak_ub_q4p7Em7 0.00 0.0001199 FORMAT "%9.7"
 /begin AXIS_DESCR COM_AXIS twan temp_ub_q0p75_o48 6 -48.00 143.3 AXIS_PTS_REF STW06MDUB /end AXIS_DESCR
/end CHARACTERISTIC
/begin CHARACTERISTIC FMIHGN "Wichtungsfaktor Momentenbegrenzung bei Schaltgetriebeschutz" CURVE 0x81A696 KlAUbSstUbWUb 1.992 rel_ub_b2p0 0.00 1.992 FORMAT "%5.3"
 /begin AXIS_DESCR STD_AXIS nmot nmot_ub_q40 8 0.00 10200. FORMAT "%5.0" DEPOSIT ABSOLUTE /end AXIS_DESCR
/end CHARACTERISTIC
/begin CHARACTERISTIC FMIVL "Faktor Korrektur maximales Moment bei VL" VALUE 0x811EF6 KwUb 1.992 fak_ub_b2 0.00 1.992 FORMAT "%5.3" /end CHARACTERISTIC
/begin CHARACTERISTIC FMLVFZG "Korrekturfaktor E-Lüfter-Tastverhältnis aus vfzg" CURVE 0x81A641 KlAUbSstUbWUb 0.9961 fak_ub_b1 0.00 0.9961
 /begin AXIS_DESCR STD_AXIS vfzg vfzg_ub_q1p25 10 0.00 318.8 FORMAT "%5.1" DEPOSIT ABSOLUTE /end AXIS_DESCR
/end CHARACTERISTIC
/begin CHARACTERISTIC FMSL "Faktor Korrektur Sekundärluftmasse" VALUE 0x819758 KwUb 1.992 fak_ub_b2 0.00 1.992 FORMAT "%5.3" /end CHARACTERISTIC
/begin CHARACTERISTIC FMSL2 "Faktor Korrektur Sekundärluftmasse, Bank 2" VALUE 0x819759 KwUb 1.992 fak_ub_b2 0.00 1.992 FORMAT "%5.3" /end CHARACTERISTIC
/begin CHARACTERISTIC FMSLOFF "Schwelle Ausräumen der Sekundärluft beendet" VALUE 0x81975A KwUb 0.9961 fak_ub_b1 0.00 0.9961 /end CHARACTERISTIC
/begin CHARACTERISTIC FMSRHOL "Dichtekorrektur der Sekundärluftmasse" CURVE 0x81AC62 KlAUwSstUwWUw 1.999969 fak_uw_b2 0.00 1.999969 FORMAT "%8.6"
 /begin AXIS_DESCR STD_AXIS frhol_w fak_uw_b2 4 0.00 1.999969 FORMAT "%8.6" DEPOSIT ABSOLUTE /end AXIS_DESCR
/end CHARACTERISTIC
/begin CHARACTERISTIC FMSTMOT "tmot- Korrektur der Sekundärluftmasse" CURVE 0x81975B KlAUbSstUbWUb 1.992 fak_ub_b2 0.00 1.992 FORMAT "%5.3"
 /begin AXIS_DESCR STD_AXIS tmot temp_ub_q0p75_o48 8 -48.00 143.3 FORMAT "%5.1" DEPOSIT ABSOLUTE /end AXIS_DESCR
/end CHARACTERISTIC
/begin CHARACTERISTIC FNRAD "Faktor zwischen Raddrehzahl und Geschwindigkeit f(Radumfang)" VALUE 0x811E97 KwUb 15.94 fak_ub_b16 0.00 15.94 FORMAT "%5.2" /end CHARACTERISTIC
/begin CHARACTERISTIC FNSTABNV "Faktor zur Drehzahlstabilisierung durch Drehmoment" CURVE 0x815D7A KlAUwSstUwWUw 7.999878 fak_uw_b8 0.00 7.999878 FORMAT "%8.6"
 /begin AXIS_DESCR STD_AXIS nver_w fak_uw_b8 6 0.00 7.999878 FORMAT "%8.6" DEPOSIT ABSOLUTE /end AXIS_DESCR
/end CHARACTERISTIC
/begin CHARACTERISTIC FPMSTM "Temperaturabhängiger P-Faktor bei Motorschutz" CURVE 0x81BC10 KlAUbSstUbWUw 100.0000 reltemp_q0p001526 0.00 100.0000 FORMAT "%8.4"
 /begin AXIS_DESCR STD_AXIS dtmuems temp_sb_q0p75 6 0.00 191.3 FORMAT "%5.1" DEPOSIT ABSOLUTE /end AXIS_DESCR
/end CHARACTERISTIC
/begin CHARACTERISTIC FPMSTME "Temperaturabhängiger P-Faktor für Motorschutz bei externer Anforderung" CURVE 0x81BC24 KlAUbSstUbWUw 100.0000 reltemp_q0p001526 0.00 100.0000 FORMAT "%8.4"
 /begin AXIS_DESCR STD_AXIS dtmuems temp_sb_q0p75 6 0.00 191.3 FORMAT "%5.1" DEPOSIT ABSOLUTE /end AXIS_DESCR
/end CHARACTERISTIC
/begin CHARACTERISTIC FRLVTM "Korrekturfaktor max. Volumenstrom bei offener Drosselklappe" CURVE 0x811EF7 KlAUbSstUbWUb 1.992 fak_ub_b2 0.00 1.992 FORMAT "%5.3"
 /begin AXIS_DESCR STD_AXIS tmot temp_ub_q0p75_o48 5 -48.00 143.3 FORMAT "%5.1" DEPOSIT ABSOLUTE /end AXIS_DESCR
/end CHARACTERISTIC
/begin CHARACTERISTIC IMLSLMN "min. Verhältnisfaktor psum_w/mlsu für Einschaltung SLS" VALUE 0x81976C KwUb 0.9961 fak_ub_b1 0.00 0.9961 /end CHARACTERISTIC
/begin CHARACTERISTIC IMLSLMX "max. Verhältnisfaktor psum_w/mlsu für Einschaltung SLS" VALUE 0x81976D KwUb 0.9961 fak_ub_b1 0.00 0.9961 /end CHARACTERISTIC
/begin CHARACTERISTIC IMLSLSA "Schwelle Luftmassenintegral für Anfang Sekundärluft im Abgas" VALUE 0x81AC74 KwUw 4660.267 m_uw_b4660 0.00 4660.267 FORMAT "%8.3" /end CHARACTERISTIC
/begin CHARACTERISTIC IMLSLSE "Schwelle Luftmassenintegral für Ende Sekundärluft im Abgas" VALUE 0x81AC76 KwUw 4660.267 m_uw_b4660 0.00 4660.267 FORMAT "%8.3" /end CHARACTERISTIC
/begin CHARACTERISTIC KDMLDOLR "Delta Moment Auslösung Lastschlagdämpfung bei Low Range" MAP 0x816076 GkfWSw 199.9969 rel_sw_b100 -100.0000 99.99695 FORMAT "%8.4" /begin AXIS_DESCR COM_AXIS gangi dez 8 0.00 255.0 AXIS_PTS_REF SGA08MDUB /end AXIS_DESCR
 /begin AXIS_DESCR COM_AXIS mkfanb_w rel_sw_b100 6 -100.0000 99.99695 AXIS_PTS_REF SMK06MDSW /end AXIS_DESCR
/end CHARACTERISTIC
/begin CHARACTERISTIC KFDLSD "Dämpfung PT2-Filter Lastschlagdämpfung" MAP 0x81C040 GkfWUw 1.999969 fak_uw_b2 0.00 1.999969 FORMAT "%8.6" /begin AXIS_DESCR COM_AXIS gangi dez 8 0.00 255.0 AXIS_PTS_REF SGA08MDUB /end AXIS_DESCR
 /begin AXIS_DESCR COM_AXIS nmot_w nmot_uw_q0p25 6 0.00 16383.75 AXIS_PTS_REF SNM06MDUW /end AXIS_DESCR
/end CHARACTERISTIC
/begin CHARACTERISTIC KFDLSDLR "Dämpfung PT2-Filter Lastschlagdämpfung in Low Range" MAP 0x81C0A0 GkfWUw 1.999969 fak_uw_b2 0.00 1.999969 FORMAT "%8.6" /begin AXIS_DESCR COM_AXIS gangi dez 8 0.00 255.0 AXIS_PTS_REF SGA08MDUB /end AXIS_DESCR
 /begin AXIS_DESCR COM_AXIS nmot_w nmot_uw_q0p25 6 0.00 16383.75 AXIS_PTS_REF SNM06MDUW /end AXIS_DESCR
/end CHARACTERISTIC
/begin CHARACTERISTIC KFDMDPLR "Delta Moment Dashpotauslösung bei Low Range Betrieb" MAP 0x8160D6 GkfWSw 199.9969 rel_sw_b100 -100.0000 99.99695 FORMAT "%8.4" /begin AXIS_DESCR COM_AXIS gangi dez 8 0.00 255.0 AXIS_PTS_REF SGA08MDUB /end AXIS_DESCR
 /begin AXIS_DESCR COM_AXIS mkfanb_w rel_sw_b100 6 -100.0000 99.99695 AXIS_PTS_REF SMK06MDSW /end AXIS_DESCR
/end CHARACTERISTIC
/begin CHARACTERISTIC KFDMDPO "Delta Moment Dashpotauslösung" MAP 0x816136 GkfWSw 199.9969 rel_sw_b100 -100.0000 99.99695 FORMAT "%8.4" /begin AXIS_DESCR COM_AXIS gangi dez 8 0.00 255.0 AXIS_PTS_REF SGA08MDUB /end AXIS_DESCR
 /begin AXIS_DESCR COM_AXIS mkfanb_w rel_sw_b100 6 -100.0000 99.99695 AXIS_PTS_REF SMK06MDSW /end AXIS_DESCR
/end CHARACTERISTIC
/begin CHARACTERISTIC KFDMLSDO "Delta Moment Auslösung Lastschlagdämpfung" MAP 0x816196 GkfWSw 199.9969 rel_sw_b100 -100.0000 99.99695 FORMAT "%8.4" /begin AXIS_DESCR COM_AXIS gangi dez 8 0.00 255.0 AXIS_PTS_REF SGA08MDUB /end AXIS_DESCR
 /begin AXIS_DESCR COM_AXIS mkfanb_w rel_sw_b100 6 -100.0000 99.99695 AXIS_PTS_REF SMK06MDSW /end AXIS_DESCR
/end CHARACTERISTIC
/begin CHARACTERISTIC KFFMSML "Abgasgegendruckkorrektur der Sekundärluftmasse" MAP 0x81976E KfAxUbAyUbSstxUbSstyUbWUb 1.992 fak_ub_b2 0.00 1.992 FORMAT "%5.3"
 /begin AXIS_DESCR STD_AXIS nmot nmot_ub_q40 8 0.00 10200. FORMAT "%5.0" DEPOSIT ABSOLUTE /end AXIS_DESCR
 /begin AXIS_DESCR STD_AXIS rl rel_ub_q0p75 8 0.00 191.3 FORMAT "%5.1" DEPOSIT ABSOLUTE /end AXIS_DESCR
/end CHARACTERISTIC
/begin CHARACTERISTIC KFMDKO "Drehmomentaufnahme Klimakompressor" MAP 0x81A5D7 KfAxUbAyUbSstxUbSstyUbWUb 49.73 rel_ub_b49p725 0.00 49.73 FORMAT "%5.2"
 /begin AXIS_DESCR STD_AXIS nmot nmot_ub_q40 6 0.00 10200. FORMAT "%5.0" DEPOSIT ABSOLUTE /end AXIS_DESCR
 /begin AXIS_DESCR STD_AXIS kopwm rel_ub_b99p6 6 0.00 99.61 FORMAT "%5.2" DEPOSIT ABSOLUTE /end AXIS_DESCR
/end CHARACTERISTIC
/begin CHARACTERISTIC KFMDKOG "Drehmomentaufnahme geregelter Klimakompressor" MAP 0x81A609 KfAxUbAyUbSstxUbSstyUbWUb 49.73 rel_ub_b49p725 0.00 49.73 FORMAT "%5.2"
 /begin AXIS_DESCR STD_AXIS nmot nmot_ub_q40 6 0.00 10200. FORMAT "%5.0" DEPOSIT ABSOLUTE /end AXIS_DESCR
 /begin AXIS_DESCR STD_AXIS mdkog md_ub_q1 6 0.00 255.0 FORMAT "%5.1" DEPOSIT ABSOLUTE /end AXIS_DESCR
/end CHARACTERISTIC
/begin CHARACTERISTIC KFMDS "Schleppmoment Drehzahl- und Lastabhängigkeit" MAP 0x815D94 KfAxUwAyUwSstxUwSstyUwWUw 99.99847 rel_uw_b100 0.00 99.99847 FORMAT "%8.5"
 /begin AXIS_DESCR STD_AXIS nmot_w nmot_uw_q0p25 10 0.00 16383.75 FORMAT "%8.2" DEPOSIT ABSOLUTE /end AXIS_DESCR
 /begin AXIS_DESCR STD_AXIS rl_w rel_uw_q0p0234 12 0.00 1535.977 FORMAT "%8.3" DEPOSIT ABSOLUTE /end AXIS_DESCR
/end CHARACTERISTIC
/begin CHARACTERISTIC KFMDST "Startmoment" MAP 0x815EB6 KfAxUbAyUbSstxUbSstyUwWUw 199.9969 rel_uw_b200 0.00 199.9969 FORMAT "%8.4"
 /begin AXIS_DESCR STD_AXIS tmot temp_ub_q0p75_o48 8 -48.00 143.3 FORMAT "%5.1" DEPOSIT ABSOLUTE /end AXIS_DESCR
 /begin AXIS_DESCR STD_AXIS qnst_w fak_uw_b2 8 0.00 1.999969 FORMAT "%8.6" DEPOSIT ABSOLUTE /end AXIS_DESCR
/end CHARACTERISTIC
/begin CHARACTERISTIC KFMILSD "Startwert indiziertes Moment für Lastschlagdämpfung" MAP 0x81C100 GkfWUw 99.99847 rel_uw_b100 0.00 99.99847 FORMAT "%8.5" /begin AXIS_DESCR COM_AXIS gangi dez 8 0.00 255.0 AXIS_PTS_REF SGA08MDUB /end AXIS_DESCR
 /begin AXIS_DESCR COM_AXIS nmot_w nmot_uw_q0p25 6 0.00 16383.75 AXIS_PTS_REF SNM06MDUW /end AXIS_DESCR
/end CHARACTERISTIC
/begin CHARACTERISTIC KFMIMR "Kennfeld fuer Momentenüberhöhung im Pedalüberweg" MAP 0x8161F6 KfAxUwAyUwSstxUwSstyUwWUw 199.9969 rel_uw_b200 0.00 199.9969 FORMAT "%8.4"
 /begin AXIS_DESCR STD_AXIS nmot_w nmot_uw_q0p25 16 0.00 16383.75 FORMAT "%8.2" DEPOSIT ABSOLUTE /end AXIS_DESCR
 /begin AXIS_DESCR STD_AXIS mrfa_w rel_uw_b200 6 0.00 199.9969 FORMAT "%8.4" DEPOSIT ABSOLUTE /end AXIS_DESCR
/end CHARACTERISTIC
/begin CHARACTERISTIC KFMIRED1 "Kennfeld Abregelmoment für NMAX Regelung" MAP 0x81A876 KfAxUbAyUbSstxUwSstyUbWUb 99.61 rel_ub_b99p6 0.00 99.61 FORMAT "%5.2"
 /begin AXIS_DESCR STD_AXIS miist_w rel_uw_b100 4 0.00 99.99847 FORMAT "%8.5" DEPOSIT ABSOLUTE /end AXIS_DESCR
 /begin AXIS_DESCR STD_AXIS gangi dez 6 0.00 255.0 FORMAT "%5.1" DEPOSIT ABSOLUTE /end AXIS_DESCR
/end CHARACTERISTIC
/begin CHARACTERISTIC KFMIRL "Kennfeld für Berechnung Sollfüllung" MAP 0x812EF0 KfAxUwAyUwSstxUwSstyUwWUw 1535.977 rel_uw_q0p0234 0.00 1535.977 FORMAT "%8.3"
 /begin AXIS_DESCR STD_AXIS nmot_w nmot_uw_q0p25 16 0.00 16383.75 FORMAT "%8.2" DEPOSIT ABSOLUTE /end AXIS_DESCR
 /begin AXIS_DESCR STD_AXIS misopl1_w rel_uw_b100 16 0.00 99.99847 FORMAT "%8.5" DEPOSIT ABSOLUTE /end AXIS_DESCR
/end CHARACTERISTIC
/begin CHARACTERISTIC KFMIZUFIL "Zulässiges indiziertes Moment zur Momentenbegrenzung vor Filter" MAP 0x811F19 GkfWUb 99.61 rel_ub_b99p6 0.00 99.61 FORMAT "%5.2"
 /begin AXIS_DESCR COM_AXIS wped relPED_ub_b100 8 0.00 100.0 AXIS_PTS_REF SWP08OPUB /end AXIS_DESCR
 /begin AXIS_DESCR COM_AXIS nmot nmot_ub_q40 8 0.00 10200. AXIS_PTS_REF SNM08OPUB /end AXIS_DESCR
/end CHARACTERISTIC
/begin CHARACTERISTIC KFMIZUNS "Zulässiges Moment bei Nachstartaufweitung" MAP 0x811F59 GkfWUb 99.61 rel_ub_b99p6 0.00 99.61 FORMAT "%5.2"
 /begin AXIS_DESCR COM_AXIS wped relPED_ub_b100 8 0.00 100.0 AXIS_PTS_REF SWP08OPUB /end AXIS_DESCR
 /begin AXIS_DESCR COM_AXIS nmot nmot_ub_q40 8 0.00 10200. AXIS_PTS_REF SNM08OPUB /end AXIS_DESCR
/end CHARACTERISTIC
/begin CHARACTERISTIC KFMIZUOF "Zulässiges indiziertes Moment zur Momentenbegrenzung" MAP 0x811F99 GkfWUb 99.61 rel_ub_b99p6 0.00 99.61 FORMAT "%5.2"
 /begin AXIS_DESCR COM_AXIS mizuvfil rel_ub_b99p6 8 0.00 99.61 AXIS_PTS_REF SMO08OPUB /end AXIS_DESCR
 /begin AXIS_DESCR COM_AXIS nmot nmot_ub_q40 8 0.00 10200. AXIS_PTS_REF SNM08OPUB /end AXIS_DESCR
/end CHARACTERISTIC
/begin CHARACTERISTIC KFMRMI "Kennfeld für Momentenüberhöhung im Pedalüberweg rel. in ind. Moment" MAP 0x8162E6 KfAxUwAyUwSstxUwSstyUwWUw 175.5829 rel_uw_b200 24.41406 199.9969 FORMAT "%8.4"
 /begin AXIS_DESCR STD_AXIS nmot_w nmot_uw_q0p25 16 0.00 16383.75 FORMAT "%8.2" DEPOSIT ABSOLUTE /end AXIS_DESCR
 /begin AXIS_DESCR STD_AXIS fmil_w rel_uw_b200 6 0.00 199.9969 FORMAT "%8.4" DEPOSIT ABSOLUTE /end AXIS_DESCR
/end CHARACTERISTIC
/begin CHARACTERISTIC KFMTOL1 "Kennfeld zu Initialisierung Modelltemperaturanteil aus tmot" MAP 0x819BF1 KfAxUbAyUbSstxUbSstyUbWUb 191.3 temp_ub_q0p75_o48 -48.00 143.3 FORMAT "%5.1"
 /begin AXIS_DESCR STD_AXIS m_tolab temp_ub_q0p75_o48 6 -48.00 143.3 FORMAT "%5.1" DEPOSIT ABSOLUTE /end AXIS_DESCR
 /begin AXIS_DESCR STD_AXIS abtim_b t1sxs_uw_q16 6 0.00 4080. FORMAT "%5.0" DEPOSIT ABSOLUTE /end AXIS_DESCR
/end CHARACTERISTIC
/begin CHARACTERISTIC KFMTOL2 "Kennfeld Filtereingang Modelltemperaturanteil aus n_mot und rl" MAP 0x819C23 KfAxUbAyUbSstxUbSstyUbWUb 191.3 temp_ub_q0p75_o48 -48.00 143.3 FORMAT "%5.1"
 /begin AXIS_DESCR STD_AXIS nmot nmot_ub_q40 6 0.00 10200. FORMAT "%5.0" DEPOSIT ABSOLUTE /end AXIS_DESCR
 /begin AXIS_DESCR STD_AXIS rl rel_ub_q0p75 6 0.00 191.3 FORMAT "%5.1" DEPOSIT ABSOLUTE /end AXIS_DESCR
/end CHARACTERISTIC
/begin CHARACTERISTIC KFMTOL3 "Kennfeld Filtereingang Modelltemperaturanteil aus tumg und vfz" MAP 0x819C55 KfAxUbAyUbSstxUbSstyUbWUb 191.3 temp_ub_q0p75_o48 -48.00 143.3 FORMAT "%5.1"
 /begin AXIS_DESCR STD_AXIS tumg temp_ub_q0p75_o48 6 -48.00 143.3 FORMAT "%5.1" DEPOSIT ABSOLUTE /end AXIS_DESCR
 /begin AXIS_DESCR STD_AXIS vfzg vfzg_ub_q1p25 6 0.00 318.8 FORMAT "%5.1" DEPOSIT ABSOLUTE /end AXIS_DESCR
/end CHARACTERISTIC
/begin CHARACTERISTIC KFPED "Relatives Fahrerwunschmoment aus Fahrpedal" MAP 0x8163D6 KfAxUwAyUwSstxUwSstyUwWUw 199.9969 rel_uw_b200 0.00 199.9969 FORMAT "%8.4"
 /begin AXIS_DESCR STD_AXIS wped_w relPED_uw_b100 16 0.00 100.0000 FORMAT "%8.4" DEPOSIT ABSOLUTE /end AXIS_DESCR
 /begin AXIS_DESCR STD_AXIS nmot_w nmot_uw_q0p25 8 0.00 16383.75 FORMAT "%8.2" DEPOSIT ABSOLUTE /end AXIS_DESCR
/end CHARACTERISTIC
/begin CHARACTERISTIC KFPEDU "Pedalkennfeld (MR) für Betriebsbereich mit langsamer Fahrzeuggeschwindigkeit" MAP 0x81650A KfAxUwAyUwSstxUwSstyUwWUw 199.9969 rel_uw_b200 0.00 199.9969 FORMAT "%8.4"
 /begin AXIS_DESCR STD_AXIS wped_w relPED_uw_b100 16 0.00 100.0000 FORMAT "%8.4" DEPOSIT ABSOLUTE /end AXIS_DESCR
 /begin AXIS_DESCR STD_AXIS nmot_w nmot_uw_q0p25 8 0.00 16383.75 FORMAT "%8.2" DEPOSIT ABSOLUTE /end AXIS_DESCR
/end CHARACTERISTIC
/begin CHARACTERISTIC KFWPFGR "Inverses Pedalkennfeld für FGR-Betrieb" MAP 0x81C160 KfAxUwAyUwSstxUwSstyUwWUw 99.99847 rel_uw_b100 0.00 99.99847 FORMAT "%8.5"
 /begin AXIS_DESCR STD_AXIS mrfgr_w rel_uw_b200 16 0.00 199.9969 FORMAT "%8.4" DEPOSIT ABSOLUTE /end AXIS_DESCR
 /begin AXIS_DESCR STD_AXIS nmot_w nmot_uw_q0p25 8 0.00 16383.75 FORMAT "%8.2" DEPOSIT ABSOLUTE /end AXIS_DESCR
/end CHARACTERISTIC
/begin CHARACTERISTIC KFZDASH "Zeitkonstante PT1-Filter Dashpot" MAP 0x81C294 GkfWUw 655.350000 zk10msxs_uw_b655 0.0100001526 655.360000 FORMAT "%10.6" /begin AXIS_DESCR COM_AXIS gangi dez 8 0.00 255.0 AXIS_PTS_REF SGA08MDUB /end AXIS_DESCR
 /begin AXIS_DESCR COM_AXIS nmot_w nmot_uw_q0p25 6 0.00 16383.75 AXIS_PTS_REF SNM06MDUW /end AXIS_DESCR
/end CHARACTERISTIC
/begin CHARACTERISTIC KFZDSHLR "Zeitkonstante PT1-Filter Dashpot bei Low Range Betrieb" MAP 0x81C2F4 GkfWUw 655.350000 zk10msxs_uw_b655 0.0100001526 655.360000 FORMAT "%10.6" /begin AXIS_DESCR COM_AXIS gangi dez 8 0.00 255.0 AXIS_PTS_REF SGA08MDUB /end AXIS_DESCR
 /begin AXIS_DESCR COM_AXIS nmot_w nmot_uw_q0p25 6 0.00 16383.75 AXIS_PTS_REF SNM06MDUW /end AXIS_DESCR
/end CHARACTERISTIC
/begin CHARACTERISTIC KFZLSD "Zeitkonstante PT2-Filter Lastschlagdämpfung" MAP 0x81C354 GkfWUw 655.350000 zk10msxs_uw_b655 0.0100001526 655.360000 FORMAT "%10.6" /begin AXIS_DESCR COM_AXIS gangi dez 8 0.00 255.0 AXIS_PTS_REF SGA08MDUB /end AXIS_DESCR
 /begin AXIS_DESCR COM_AXIS nmot_w nmot_uw_q0p25 6 0.00 16383.75 AXIS_PTS_REF SNM06MDUW /end AXIS_DESCR
/end CHARACTERISTIC
/begin CHARACTERISTIC KFZLSDLR "Zeitkonstante PT2-Filter Lastschlagdämpfung bei Low Range" MAP 0x81C3B4 GkfWUw 655.350000 zk10msxs_uw_b655 0.0100001526 655.360000 FORMAT "%10.6" /begin AXIS_DESCR COM_AXIS gangi dez 8 0.00 255.0 AXIS_PTS_REF SGA08MDUB /end AXIS_DESCR
 /begin AXIS_DESCR COM_AXIS nmot_w nmot_uw_q0p25 6 0.00 16383.75 AXIS_PTS_REF SNM06MDUW /end AXIS_DESCR
/end CHARACTERISTIC
/begin CHARACTERISTIC KMILSDLR "Startwert indiziertes Moment für Lastschlagdämpfung; Low range" MAP 0x81C414 GkfWUw 99.99847 rel_uw_b100 0.00 99.99847 FORMAT "%8.5" /begin AXIS_DESCR COM_AXIS gangi dez 8 0.00 255.0 AXIS_PTS_REF SGA08MDUB /end AXIS_DESCR
 /begin AXIS_DESCR COM_AXIS nmot_w nmot_uw_q0p25 6 0.00 16383.75 AXIS_PTS_REF SNM06MDUW /end AXIS_DESCR
/end CHARACTERISTIC
/begin CHARACTERISTIC MDHYEZ "Momenten-Hysterese bei Entscheidung der Zylinderausblendung" VALUE 0x81000D KwUb 99.61 rel_ub_b99p6 0.00 99.61 FORMAT "%5.2" /end CHARACTERISTIC
/begin CHARACTERISTIC MDHYST "Hysterese bei der Begrenzung des Sollmoments (Ebene 1 Überwachungskonzept)" VALUE 0x81400C KwUw 99.99847 rel_uw_b100 0.00 99.99847 FORMAT "%8.5" /end CHARACTERISTIC
/begin CHARACTERISTIC MDIMX "Maximales indiziertes Motormoment" VALUE 0x810166 KwUb 99.61 rel_ub_b99p6 0.00 99.61 FORMAT "%5.2" /end CHARACTERISTIC
/begin CHARACTERISTIC MDMSMIN "zulässiges begrenztes Moment bei Motorschutz" CURVE 0x815F5A KlAUwSstUwWUw 99.99847 rel_uw_b100 0.00 99.99847 FORMAT "%8.5"
 /begin AXIS_DESCR STD_AXIS nmot_w nmot_uw_q0p25 6 0.00 16383.75 FORMAT "%8.2" DEPOSIT ABSOLUTE /end AXIS_DESCR
/end CHARACTERISTIC
/begin CHARACTERISTIC MDSL "Momentenanforderung der Servolenkung" VALUE 0x811E87 KwUb 49.73 rel_ub_b49p725 0.00 49.73 FORMAT "%5.2" /end CHARACTERISTIC
/begin CHARACTERISTIC MDSM "Schleppmoment Temperaturanteil" CURVE 0x81BBD0 GklWUw 99.99847 rel_uw_b100 0.00 99.99847 FORMAT "%8.5"
 /begin AXIS_DESCR COM_AXIS tmot temp_ub_q0p75_o48 6 -48.00 143.3 AXIS_PTS_REF STM06__UB /end AXIS_DESCR
/end CHARACTERISTIC
/begin CHARACTERISTIC MIHGSLG "Drehmomentbegrenzung für Schaltgetriebeschutz" CURVE 0x811EE5 KlAUbSstUbWUb 99.61 rel_ub_b99p6 0.00 99.61 FORMAT "%5.2"
 /begin AXIS_DESCR STD_AXIS gangi dez 7 0.00 255.0 FORMAT "%5.1" DEPOSIT ABSOLUTE /end AXIS_DESCR
/end CHARACTERISTIC
/begin CHARACTERISTIC MKLSDO "Kupplungsmoment-Schwelle für Parameterumschaltung LSD" VALUE 0x81663E KwSw 199.9969 rel_sw_b100 -100.0000 99.99695 FORMAT "%8.4" /end CHARACTERISTIC
/begin CHARACTERISTIC MLSLMX "max. Motor-Luftmasse für Sekundärlufteinblasung" VALUE 0x8197C0 KwUb 1020. m_ub_b1020 0.00 1020. FORMAT "%5.0" /end CHARACTERISTIC
/begin CHARACTERISTIC MRFALLO "Obere Leerlaufschwelle des relativen Fahrerwunschmoments" VALUE 0x816640 KwUw 199.9969 rel_uw_b200 0.00 199.9969 FORMAT "%8.4" /end CHARACTERISTIC
/begin CHARACTERISTIC MRFALLU "Untere Leerlaufschwelle des relativen Fahrerwunschmoments" VALUE 0x816642 KwUw 199.9969 rel_uw_b200 0.00 199.9969 FORMAT "%8.4" /end CHARACTERISTIC
/begin CHARACTERISTIC MRFUEMXN "Kennlinie max. ereichbares Fahrerwunschmoment für Pedalüberweg" CURVE 0x816644 KlAUwSstUwWUw 199.9969 rel_uw_b200 0.00 199.9969 FORMAT "%8.4"
 /begin AXIS_DESCR STD_AXIS nmot_w nmot_uw_q0p25 6 0.00 16383.75 FORMAT "%8.2" DEPOSIT ABSOLUTE /end AXIS_DESCR
/end CHARACTERISTIC
/begin CHARACTERISTIC MSLUB "Sekundärluftmasse abhängig von der Batteriespannung" CURVE 0x8197C1 KlAUbSstUbWUb 102.0 m_ub_q0p4 0.00 102.0 FORMAT "%5.1"
 /begin AXIS_DESCR STD_AXIS ubf spg_ubatt 8 0.00 24.02 FORMAT "%5.2" DEPOSIT ABSOLUTE /end AXIS_DESCR
/end CHARACTERISTIC
/begin CHARACTERISTIC NASNOT "Drehzahlschwelle für ASR-Verbot wegen Abwürgeschutz" VALUE 0x81000A KwUb 2560. nmot_ub_q40 0.00 2560. FORMAT "%5.0" /end CHARACTERISTIC
/begin CHARACTERISTIC NGFSAWE "Schwelle Drehzahlgradient für Sperrung Filter SA/WE" VALUE 0x81665E KwSw 25599.94 nmotg_sw_q0p39 -12800.16 12799.77 FORMAT "%8.2" /end CHARACTERISTIC
/begin CHARACTERISTIC NGHGS "Drehzahlgradient für gangabhängige Momentenbegrenzung" VALUE 0x815F50 KwSw 25599.94 nmotg_sw_q0p39 -12800.16 12799.77 FORMAT "%8.2" /end CHARACTERISTIC
/begin CHARACTERISTIC NKUPZWEO "Obere Drehzahl-Hytereseschwelle für KUP-ZW-Eingriffe" VALUE 0x810173 KwUb 10200. nmot_ub_q40 0.00 10200. FORMAT "%5.0" /end CHARACTERISTIC
/begin CHARACTERISTIC NKUPZWEU "Untere Drehzahl-Hytereseschwelle für KUP-ZW-Eingriffe" VALUE 0x810174 KwUb 10200. nmot_ub_q40 0.00 10200. FORMAT "%5.0" /end CHARACTERISTIC
/begin CHARACTERISTIC NLLZWEO "Obere  Drehzahl-Hytereseschwelle für LL-ZW-Eingriffe" VALUE 0x810175 KwUb 10200. nmot_ub_q40 0.00 10200. FORMAT "%5.0" /end CHARACTERISTIC
/begin CHARACTERISTIC NLLZWEU "Untere Drehzahl-Hytereseschwelle für LL-ZW-Eingriffe" VALUE 0x810176 KwUb 10200. nmot_ub_q40 0.00 10200. FORMAT "%5.0" /end CHARACTERISTIC
/begin CHARACTERISTIC NLSDZWEO "Obere Drehzahl-Hytereseschwelle für LSD-ZW-Eingriffe" VALUE 0x810177 KwUb 10200. nmot_ub_q40 0.00 10200. FORMAT "%5.0" /end CHARACTERISTIC
/begin CHARACTERISTIC NLSDZWEU "Untere Drehzahl-Hytereseschwelle für LSD-ZW-Eingriffe" VALUE 0x810178 KwUb 10200. nmot_ub_q40 0.00 10200. FORMAT "%5.0" /end CHARACTERISTIC
/begin CHARACTERISTIC NMAX "Drehzahlbegrenzung" VALUE 0x814302 KwUw 16383.75 nmot_uw_q0p25 0.00 16383.75 FORMAT "%8.2" /end CHARACTERISTIC
/begin CHARACTERISTIC NMAXLR "Drehzahlbegrenzung bei Low Range Betrieb" VALUE 0x812EE0 KwUw 16383.75 nmot_uw_q0p25 0.00 16383.75 FORMAT "%8.2" /end CHARACTERISTIC
/begin CHARACTERISTIC NMAXPG "gangabhängiges P-Glied bei NMAX Regelung" CURVE 0x810420 GklWUb 0.9961 relnmot_q0p0039 0.00 0.9961 /begin AXIS_DESCR COM_AXIS gangi dez 7 0.00 255.0 AXIS_PTS_REF SGA07MDUB /end AXIS_DESCR /end CHARACTERISTIC
/begin CHARACTERISTIC NMAXPLR "P-Glied bei NMAX-Regelung und Low Range Betrieb" VALUE 0x819000 KwUb 0.9961 relnmot_q0p0039 0.00 0.9961 /end CHARACTERISTIC
/begin CHARACTERISTIC NMXDAEF "Maximaldrehzahl bei Drosselklappen-Antrieb-Ersatzbetrieb" CURVE 0x810427 KlAUbSstUbWUb 10200. nmot_ub_q40 0.00 10200. FORMAT "%5.0"
 /begin AXIS_DESCR STD_AXIS wped relPED_ub_b100 6 0.00 100.0 FORMAT "%5.1" DEPOSIT ABSOLUTE /end AXIS_DESCR
/end CHARACTERISTIC
/begin CHARACTERISTIC NMXDKPU "Maximaldrehzahl bei Sicherheitskraftstoffabschaltung (SKA)" VALUE 0x814304 KwUw 16383.75 nmot_uw_q0p25 0.00 16383.75 FORMAT "%8.2" /end CHARACTERISTIC
/begin CHARACTERISTIC NSAUE1 "Schubabschneidedrehzahl für Momentenbegrenzung Ebene 1" VALUE 0x811FE7 KwUb 10200. nmot_ub_q40 0.00 10200. FORMAT "%5.0" /end CHARACTERISTIC
/begin CHARACTERISTIC NSTART "Motordrehzahlschwelle für Unterdrehzahl-Ausstieg bei Nachstartaufweitung" VALUE 0x811FD9 KwUb 10200. nmot_ub_q40 0.00 10200. FORMAT "%5.0" /end CHARACTERISTIC
/begin CHARACTERISTIC NSTEND "Motordrehzahlschwelle für Start Ende bei Nachstartaufweitung" VALUE 0x811FDA KwUb 10200. nmot_ub_q40 0.00 10200. FORMAT "%5.0" /end CHARACTERISTIC
/begin CHARACTERISTIC NSTMXM "Drehzahlschwelle für Startende autom. Start f(TMOT)" CURVE 0x812440 KlAUbSstUbWUb 10200. nmot_ub_q40 0.00 10200. FORMAT "%5.0"
 /begin AXIS_DESCR STD_AXIS tmot temp_ub_q0p75_o48 6 -48.00 143.3 FORMAT "%5.1" DEPOSIT ABSOLUTE /end AXIS_DESCR
/end CHARACTERISTIC
/begin CHARACTERISTIC NSWO "Drehzahlschwelle Umschaltg. zur Rechenzeitersparnis" VALUE 0x812455 KwUb 10200. nmot_ub_q40 0.00 10200. FORMAT "%5.0" /end CHARACTERISTIC
/begin CHARACTERISTIC NSWO1 "Drehzahlschwelle 1 Umschaltg. zur Rechenzeitersparnis" VALUE 0x812456 KwUb 10200. nmot_ub_q40 0.00 10200. FORMAT "%5.0" /end CHARACTERISTIC
/begin CHARACTERISTIC NSWO3 "" VALUE 0x812457 KwUb 10200. nmot_ub_q40 0.00 10200. FORMAT "%5.0" /end CHARACTERISTIC
/begin CHARACTERISTIC NWEUE1 "Wiedereinsetzdrehzahl bei Momentenbegrenzung Ebene 1" VALUE 0x811FE8 KwUb 10200. nmot_ub_q40 0.00 10200. FORMAT "%5.0" /end CHARACTERISTIC
/begin CHARACTERISTIC REDHYOC "Hysterese der Reduzierstufe bei größerer Soll-Reduzierstufe als Ist-Wert" VALUE 0x81000E KwSb 5.100 rel_sb_q0p02 -2.560 2.540 FORMAT "%5.3" /end CHARACTERISTIC
/begin CHARACTERISTIC REDHYUC "Hysterese der Reduzierstufe bei kleinerer Soll-Reduzierstufe als Ist-Wert" VALUE 0x81000F KwSb 5.100 rel_sb_q0p02 -2.560 2.540 FORMAT "%5.3" /end CHARACTERISTIC
/begin CHARACTERISTIC REDZEM "Schwelle zwischen Zündeingriff und Einspritzausblendung" CURVE 0x81A6D8 KlAUbSstUbWUb 255.0 dez 0.00 255.0 FORMAT "%5.1"
 /begin AXIS_DESCR STD_AXIS tmot temp_ub_q0p75_o48 5 -48.00 143.3 FORMAT "%5.1" DEPOSIT ABSOLUTE /end AXIS_DESCR
/end CHARACTERISTIC
/begin CHARACTERISTIC RLMNN "Kennlinie minimale Füllung" CURVE 0x810442 GklWUb 191.3 rel_ub_q0p75 0.00 191.3 FORMAT "%5.1"
 /begin AXIS_DESCR COM_AXIS nmot nmot_ub_q40 12 0.00 10200. AXIS_PTS_REF SNM12FEUB /end AXIS_DESCR
/end CHARACTERISTIC
/begin CHARACTERISTIC RLMNSAN "Kennlinie minimale Füllung im Schub" CURVE 0x81044E GklWUb 191.3 rel_ub_q0p75 0.00 191.3 FORMAT "%5.1"
 /begin AXIS_DESCR COM_AXIS nmot nmot_ub_q40 12 0.00 10200. AXIS_PTS_REF SNM12FEUB /end AXIS_DESCR
/end CHARACTERISTIC
/begin CHARACTERISTIC RLNORM "" VALUE 0x812458 KwUb 24.90 fak_ub_q0p09765 0.00 24.90 FORMAT "%5.2" /end CHARACTERISTIC
/begin CHARACTERISTIC RLVMXN "Maximaler Volumenstrom bei offener Drosselklappe" CURVE 0x811F02 KlAUbSstUbWUb 191.3 rel_ub_q0p75 0.00 191.3 FORMAT "%5.1"
 /begin AXIS_DESCR STD_AXIS nmot nmot_ub_q40 11 0.00 10200. FORMAT "%5.0" DEPOSIT ABSOLUTE /end AXIS_DESCR
/end CHARACTERISTIC
/begin AXIS_PTS SAN12ESUW "SST-Verteilung für den begrenzten Einspritzzähler anztib_w" 0x8156C6 anztib_w SstAUwSstUw 65535.00 dez 12 0.00 65535.00 FORMAT "%8.2" DEPOSIT ABSOLUTE /end AXIS_PTS
/begin AXIS_PTS SDK10TEUB "wdkba abhängige Stützstellen (Anzahl 10)" 0x819812 wdkba SstAUbSstUb 100.0 relDK_ub_b100 10 0.00 100.0 FORMAT "%5.1" DEPOSIT ABSOLUTE /end AXIS_PTS
/begin AXIS_PTS SET08LDUB "" 0x81197D etazwist SstAUbSstUb 127.5 rel_ub_b127p5 8 0.00 127.5 FORMAT "%5.1" DEPOSIT ABSOLUTE /end AXIS_PTS
/begin AXIS_PTS SEZ06TMUB "Stützstellenverteilung, Zündwinkelwirkungsgrad" 0x81981D etazwimt SstAUbSstUb 127.5 rel_ub_b127p5 6 0.00 127.5 FORMAT "%5.1" DEPOSIT ABSOLUTE /end AXIS_PTS
/begin AXIS_PTS SFR05TEUB "frmit abhängige Stützstellen (Anzahl 5)" 0x819824 frmit SstAUbSstUb 1.992 fak_ub_b2 5 0.00 1.992 FORMAT "%5.3" DEPOSIT ABSOLUTE /end AXIS_PTS
/begin AXIS_PTS SGA07MDUB "" 0x811986 gangi SstAUbSstUb 255.0 dez 7 0.00 255.0 FORMAT "%5.1" DEPOSIT ABSOLUTE /end AXIS_PTS
/begin AXIS_PTS SGA08MDUB "Stützstellenverteilung Ist Gang 8 Sst." 0x81198E gangi SstAUbSstUb 255.0 dez 8 0.00 255.0 FORMAT "%5.1" DEPOSIT ABSOLUTE /end AXIS_PTS
/begin AXIS_PTS SKS06ESUB "SST-Verteilung für den Startadaptionsfaktor kstaa" 0x811997 kstaa SstAUbSstUb 1.992 fak_ub_b2 6 0.00 1.992 FORMAT "%5.3" DEPOSIT ABSOLUTE /end AXIS_PTS
/begin AXIS_PTS SLX06TMUW "Stützstellenverteilung, Lambdasoll" 0x81B114 lamsons_w SstAUwSstUw 15.99976 fak_uw_b16 6 0.00 15.99976 FORMAT "%8.5" DEPOSIT ABSOLUTE /end AXIS_PTS
/begin AXIS_PTS SLY06TMUW "Stützstellenverteilung, Lambdasoll Bank2" 0x81B122 lamsons2_w SstAUwSstUw 15.99976 fak_uw_b16 6 0.00 15.99976 FORMAT "%8.5" DEPOSIT ABSOLUTE /end AXIS_PTS
/begin AXIS_PTS SMK06MDSW "Rover" 0x816660 mkfanb_w SstASwSstSw 199.9969 rel_sw_b100 6 -100.0000 99.99695 FORMAT "%8.4" DEPOSIT ABSOLUTE /end AXIS_PTS
/begin AXIS_PTS SML05DKUB "Stützstellenvert. Luftmasse" 0x81199E ml SstAUbSstUb 1020. m_ub_b1020 5 0.00 1020. FORMAT "%5.0" DEPOSIT ABSOLUTE /end AXIS_PTS
/begin AXIS_PTS SML05LKUB "5 Stützstellen für ?" 0x8119A4 ml SstAUbSstUb 1020. m_ub_b1020 5 0.00 1020. FORMAT "%5.0" DEPOSIT ABSOLUTE /end AXIS_PTS
/begin AXIS_PTS SML05TMUW "Stützstellenverteilung, Luftmasse, 5 Stützstellen" 0x81B130 ml_w SstAUwSstUw 6553.500 m_uw_b6553p5 5 0.00 6553.500 FORMAT "%8.3" DEPOSIT ABSOLUTE /end AXIS_PTS
/begin AXIS_PTS SML06TEUB "ml abhängige Stützstellen (Anzahl 6)" 0x81982A ml SstAUbSstUb 1020. m_ub_b1020 6 0.00 1020. FORMAT "%5.0" DEPOSIT ABSOLUTE /end AXIS_PTS
/begin AXIS_PTS SML06TMUB "Stützstellenverteilung, Luftmasse, 6 Stützstellen" 0x819831 ml SstAUbSstUb 1020. m_ub_b1020 6 0.00 1020. FORMAT "%5.0" DEPOSIT ABSOLUTE /end AXIS_PTS
/begin AXIS_PTS SML07TMUB "" 0x819838 ml SstAUbSstUb 1020. m_ub_b1020 7 0.00 1020. FORMAT "%5.0" DEPOSIT ABSOLUTE /end AXIS_PTS
/begin AXIS_PTS SML07TMUW "Stützstellenverteilung, Luftmasse, 7 Stützstellen" 0x81B13C ml_w SstAUwSstUw 6553.500 m_uw_b6553p5 7 0.00 6553.500 FORMAT "%8.3" DEPOSIT ABSOLUTE /end AXIS_PTS
/begin AXIS_PTS SML08LHUB "ml abhängige Stützstellen (Anzahl 8)" 0x819840 ml SstAUbSstUb 1020. m_ub_b1020 8 0.00 1020. FORMAT "%5.0" DEPOSIT ABSOLUTE /end AXIS_PTS
/begin AXIS_PTS SMO08OPUB "Stützstellenverteilung für zulässiges Moment mizuvfil" 0x811FDB mizuvfil SstAUbSstUb 99.61 rel_ub_b99p6 8 0.00 99.61 FORMAT "%5.2" DEPOSIT ABSOLUTE /end AXIS_PTS
/begin AXIS_PTS SNG06LLSB "Stützstellenverteilung Drehzahlgradient, 6 Sst." 0x8119AA ngfil SstAUbSstSb 25500. nmotg_sb_q100 6 -12800. 12700. FORMAT "%5.0" DEPOSIT ABSOLUTE /end AXIS_PTS
/begin AXIS_PTS SNM05DKUB "Stützstellenvert. nmot" 0x8119B1 nmot SstAUbSstUb 10200. nmot_ub_q40 5 0.00 10200. FORMAT "%5.0" DEPOSIT ABSOLUTE /end AXIS_PTS
/begin AXIS_PTS SNM05TMUB "" 0x819849 nmot SstAUbSstUb 10200. nmot_ub_q40 5 0.00 10200. FORMAT "%5.0" DEPOSIT ABSOLUTE /end AXIS_PTS
/begin AXIS_PTS SNM06LHUB "6 Stützstellen Drehzahl für ?" 0x81984F nmot SstAUbSstUb 10200. nmot_ub_q40 6 0.00 10200. FORMAT "%5.0" DEPOSIT ABSOLUTE /end AXIS_PTS
/begin AXIS_PTS SNM06LLUB "Sützstellenverteilung für Motordrehzahl" 0x8119B7 nmot SstAUbSstUb 10200. nmot_ub_q40 6 0.00 10200. FORMAT "%5.0" DEPOSIT ABSOLUTE /end AXIS_PTS
/begin AXIS_PTS SNM06MDUW "Rover" 0x81B14C nmot_w SstAUwSstUw 16383.75 nmot_uw_q0p25 6 0.00 16383.75 FORMAT "%8.2" DEPOSIT ABSOLUTE /end AXIS_PTS
/begin AXIS_PTS SNM07ESUB "Stützstellenverteilung Drehzahl, 7 Sst." 0x819856 nmot SstAUbSstUb 10200. nmot_ub_q40 7 0.00 10200. FORMAT "%5.0" DEPOSIT ABSOLUTE /end AXIS_PTS
/begin AXIS_PTS SNM07LRUB "7 Drehzahlstützstellen für ?" 0x8119BE nmot SstAUbSstUb 10200. nmot_ub_q40 7 0.00 10200. FORMAT "%5.0" DEPOSIT ABSOLUTE /end AXIS_PTS
/begin AXIS_PTS SNM08DMUB "SST-Verteilung in DMD, 8 Drehzahl-SST" 0x8119C6 nmot SstAUbSstUb 10200. nmot_ub_q40 8 0.00 10200. FORMAT "%5.0" DEPOSIT ABSOLUTE /end AXIS_PTS
/begin AXIS_PTS SNM08FEUB "Stützstellenverteilung Drehzahl, 08 Sst., Füllungseingriffe" 0x8119CF nmot SstAUbSstUb 10200. nmot_ub_q40 8 0.00 10200. FORMAT "%5.0" DEPOSIT ABSOLUTE /end AXIS_PTS
/begin AXIS_PTS SNM08KRUW "Stützstellenverteilung Drehzahl, 8 Sst." 0x81B15A nmot_w SstAUwSstUw 16383.75 nmot_uw_q0p25 8 0.00 16383.75 FORMAT "%8.2" DEPOSIT ABSOLUTE /end AXIS_PTS
/begin AXIS_PTS SNM08LDUB "Stützstellenverteilung für Ladedruckregelung" 0x8119D8 nmot SstAUbSstUb 10200. nmot_ub_q40 8 0.00 10200. FORMAT "%5.0" DEPOSIT ABSOLUTE /end AXIS_PTS
/begin AXIS_PTS SNM08LDUW "Stützstellenverteilung für Ladedruckregelung" 0x8156E0 nmot_w SstAUwSstUw 16383.75 nmot_uw_q0p25 8 0.00 16383.75 FORMAT "%8.2" DEPOSIT ABSOLUTE /end AXIS_PTS
/begin AXIS_PTS SNM08LHUB "nmot abhängige Stützstellen (Anzahl 8)" 0x81985E nmot SstAUbSstUb 10200. nmot_ub_q40 8 0.00 10200. FORMAT "%5.0" DEPOSIT ABSOLUTE /end AXIS_PTS
/begin AXIS_PTS SNM08OPUB "Stützstellenverteilung für Motordrehzahl nmot" 0x8119E1 nmot SstAUbSstUb 10200. nmot_ub_q40 8 0.00 10200. FORMAT "%5.0" DEPOSIT ABSOLUTE /end AXIS_PTS
/begin AXIS_PTS SNM08__UB "Stützstellenverteilung Drehzahl, 8 Sst." 0x8119EA nmot SstAUbSstUb 10200. nmot_ub_q40 8 0.00 10200. FORMAT "%5.0" DEPOSIT ABSOLUTE /end AXIS_PTS
/begin AXIS_PTS SNM10TEUB "nmot abhängige Stützstellen (Anzahl 10)" 0x819867 nmot SstAUbSstUb 10200. nmot_ub_q40 10 0.00 10200. FORMAT "%5.0" DEPOSIT ABSOLUTE /end AXIS_PTS
/begin AXIS_PTS SNM10__UB "Stützstellenverteilung Drehzahl, 10 Sst." 0x8119F3 nmot SstAUbSstUb 10200. nmot_ub_q40 10 0.00 10200. FORMAT "%5.0" DEPOSIT ABSOLUTE /end AXIS_PTS
/begin AXIS_PTS SNM12ESUB "SST-Verteilung für die Motordrehzahl nmot" 0x8119FE nmot SstAUbSstUb 10200. nmot_ub_q40 12 0.00 10200. FORMAT "%5.0" DEPOSIT ABSOLUTE /end AXIS_PTS
/begin AXIS_PTS SNM12FEUB "Stützstellen für WDKSMX, WDKUGDN" 0x811A0B nmot SstAUbSstUb 10200. nmot_ub_q40 12 0.00 10200. FORMAT "%5.0" DEPOSIT ABSOLUTE /end AXIS_PTS
/begin AXIS_PTS SNM16FEUW "" 0x8156F2 nmot_w SstAUwSstUw 16383.75 nmot_uw_q0p25 16 0.00 16383.75 FORMAT "%8.2" DEPOSIT ABSOLUTE /end AXIS_PTS
/begin AXIS_PTS SNM16KRUB "Stützstellenverteilung Drehzahl, 16 Sst." 0x819872 nmot SstAUbSstUb 10200. nmot_ub_q40 16 0.00 10200. FORMAT "%5.0" DEPOSIT ABSOLUTE /end AXIS_PTS
/begin AXIS_PTS SNM16LDUB "Stützstellenverteilung für Ladedruckregelung" 0x811A18 nmot SstAUbSstUb 10200. nmot_ub_q40 16 0.00 10200. FORMAT "%5.0" DEPOSIT ABSOLUTE /end AXIS_PTS
/begin AXIS_PTS SNM16OPUW "Stützstellenverteilung Drehzahl" 0x815714 nmot_w SstAUwSstUw 16383.75 nmot_uw_q0p25 16 0.00 16383.75 FORMAT "%8.2" DEPOSIT ABSOLUTE /end AXIS_PTS
/begin AXIS_PTS SNM16ZUUB "Stützstellenverteilung Drehzahl, 16 Sst." 0x811A29 nmot SstAUbSstUb 10200. nmot_ub_q40 16 0.00 10200. FORMAT "%5.0" DEPOSIT ABSOLUTE /end AXIS_PTS
/begin AXIS_PTS SNM24ZUUB "Stützstellenverteilung Drehzahl, 24 Sst." 0x811A3A nmot SstAUbSstUb 10200. nmot_ub_q40 24 0.00 10200. FORMAT "%5.0" DEPOSIT ABSOLUTE /end AXIS_PTS
/begin AXIS_PTS SPL08LDUB "Stützstellenverteilung für Ladedruckregelung" 0x811A53 plsol SstAUbSstUb 2550. p_ub_q10 8 0.00 2550. FORMAT "%5.0" DEPOSIT ABSOLUTE /end AXIS_PTS
/begin AXIS_PTS SRL03ZUUB "Stützstellenverteilung relative Füllung, 3 Sst." 0x811A5C rl SstAUbSstUb 191.3 rel_ub_q0p75 3 0.00 191.3 FORMAT "%5.1" DEPOSIT ABSOLUTE /end AXIS_PTS
/begin AXIS_PTS SRL04KRUB "Stützstellenverteilung relative Füllung, 4 Sst." 0x819883 rl SstAUbSstUb 191.3 rel_ub_q0p75 4 0.00 191.3 FORMAT "%5.1" DEPOSIT ABSOLUTE /end AXIS_PTS
/begin AXIS_PTS SRL05TMUB "" 0x819888 rl SstAUbSstUb 191.3 rel_ub_q0p75 5 0.00 191.3 FORMAT "%5.1" DEPOSIT ABSOLUTE /end AXIS_PTS
/begin AXIS_PTS SRL06LHUB "6 Füllungsstützstellen für ?" 0x811A60 rl SstAUbSstUb 191.3 rel_ub_q0p75 6 0.00 191.3 FORMAT "%5.1" DEPOSIT ABSOLUTE /end AXIS_PTS
/begin AXIS_PTS SRL06LRUB "6 Füllungsstützstellen für ?" 0x811A67 rl SstAUbSstUb 191.3 rel_ub_q0p75 6 0.00 191.3 FORMAT "%5.1" DEPOSIT ABSOLUTE /end AXIS_PTS
/begin AXIS_PTS SRL08DMUB "SST-Verteilung in DMD, 8 Last-SST" 0x811A6E rl SstAUbSstUb 191.3 rel_ub_q0p75 8 0.00 191.3 FORMAT "%5.1" DEPOSIT ABSOLUTE /end AXIS_PTS
/begin AXIS_PTS SRL12ESUB "Sst-Verteilung für die relative Füllung rl" 0x811A77 rl SstAUbSstUb 191.3 rel_ub_q0p75 12 0.00 191.3 FORMAT "%5.1" DEPOSIT ABSOLUTE /end AXIS_PTS
/begin AXIS_PTS SRL12ZUUB "Stützstellenverteilung relative Luftfüllung, 12 St." 0x811A84 rl SstAUbSstUb 191.3 rel_ub_q0p75 12 0.00 191.3 FORMAT "%5.1" DEPOSIT ABSOLUTE /end AXIS_PTS
/begin AXIS_PTS SRL16ZUUB "Stützstellenverteilung relative Füllung, 16 Sst." 0x811A91 rl SstAUbSstUb 191.3 rel_ub_q0p75 16 0.00 191.3 FORMAT "%5.1" DEPOSIT ABSOLUTE /end AXIS_PTS
/begin AXIS_PTS ST107TMUB "Stützstellenverteilung, Starttemperatur an Sonde vorne" 0x81988E tabgmst SstAUbSstUb 1275. temp_ub_q5_o50 7 -50.00 1225. FORMAT "%5.0" DEPOSIT ABSOLUTE /end AXIS_PTS
/begin AXIS_PTS ST207TMUB "Stützstellenverteilung, Starttemperatur an Sonde vorne, Bank2" 0x819896 tabgmst2 SstAUbSstUb 1275. temp_ub_q5_o50 7 -50.00 1225. FORMAT "%5.0" DEPOSIT ABSOLUTE /end AXIS_PTS
/begin AXIS_PTS ST307TMUB "Stützstellenverteilung, Starttemperatur an Sonde hinten" 0x81989E tkatmst SstAUbSstUb 1275. temp_ub_q5_o50 7 -50.00 1225. FORMAT "%5.0" DEPOSIT ABSOLUTE /end AXIS_PTS
/begin AXIS_PTS ST407TMUB "Stützstellenverteilung, Starttemperatur an Sonde hinten, Bank2" 0x8198A6 tkatmst2 SstAUbSstUb 1275. temp_ub_q5_o50 7 -50.00 1225. FORMAT "%5.0" DEPOSIT ABSOLUTE /end AXIS_PTS
/begin AXIS_PTS STA06ESUB "SST-Verteilung für die Ansauglufttemperatur" 0x8198AE tans SstAUbSstUb 191.3 temp_ub_q0p75_o48 6 -48.00 143.3 FORMAT "%5.1" DEPOSIT ABSOLUTE /end AXIS_PTS
/begin AXIS_PTS STA06__UB "Stützstellenverteilung Ansauglufttemperatur, 6 Sst." 0x8198B5 tans SstAUbSstUb 191.3 temp_ub_q0p75_o48 6 -48.00 143.3 FORMAT "%5.1" DEPOSIT ABSOLUTE /end AXIS_PTS
/begin AXIS_PTS STA08LDUB "Stützstellenverteilung für Ladedruckregelung" 0x811AA2 tans SstAUbSstUb 191.3 temp_ub_q0p75_o48 8 -48.00 143.3 FORMAT "%5.1" DEPOSIT ABSOLUTE /end AXIS_PTS
/begin AXIS_PTS STM04MSUW "" 0x815736 tmot SstAUwSstUw 49151.25 temp_ub_q0p75_o48 4 -48.00000 49103.25 FORMAT "%8.2" DEPOSIT ABSOLUTE /end AXIS_PTS
/begin AXIS_PTS STM04SAUB "Stützstellenverteilung Motortemperatur, 4 Sst." 0x811AAB tmot SstAUbSstUb 191.3 temp_ub_q0p75_o48 4 -48.00 143.3 FORMAT "%5.1" DEPOSIT ABSOLUTE /end AXIS_PTS
/begin AXIS_PTS STM04__UB "" 0x8198BC tmot SstAUbSstUb 191.3 temp_ub_q0p75_o48 4 -48.00 143.3 FORMAT "%5.1" DEPOSIT ABSOLUTE /end AXIS_PTS
/begin AXIS_PTS STM05SAUB "Stützstellenverteilung" 0x8198C1 tmot SstAUbSstUb 191.3 temp_ub_q0p75_o48 5 -48.00 143.3 FORMAT "%5.1" DEPOSIT ABSOLUTE /end AXIS_PTS
/begin AXIS_PTS STM05TMUB "Stützstellenverteilung, Motorstarttemperatur" 0x81B16C tmst SstAUwSstUw 49151.25 temp_ub_q0p75_o48 5 -48.00000 49103.25 FORMAT "%8.2" DEPOSIT ABSOLUTE /end AXIS_PTS
/begin AXIS_PTS STM06LLUB "Stützstellenverteilung Motortemperatur, 6 Sst." 0x8198C7 tmot SstAUbSstUb 191.3 temp_ub_q0p75_o48 6 -48.00 143.3 FORMAT "%5.1" DEPOSIT ABSOLUTE /end AXIS_PTS
/begin AXIS_PTS STM06__UB "Stützstellenverteilung Motortemperatur, 6 Sst." 0x8198CE tmot SstAUbSstUb 191.3 temp_ub_q0p75_o48 6 -48.00 143.3 FORMAT "%5.1" DEPOSIT ABSOLUTE /end AXIS_PTS
/begin AXIS_PTS STM08DMUB "8 Motortemperaturstützstellen für DMD" 0x8198D5 tmot SstAUbSstUb 191.3 temp_ub_q0p75_o48 8 -48.00 143.3 FORMAT "%5.1" DEPOSIT ABSOLUTE /end AXIS_PTS
/begin AXIS_PTS STM08LEUB "8 Motortemperaturstützstellen für ?" 0x8198DE tmot SstAUbSstUb 191.3 temp_ub_q0p75_o48 8 -48.00 143.3 FORMAT "%5.1" DEPOSIT ABSOLUTE /end AXIS_PTS
/begin AXIS_PTS STM08__UB "Stützstellenverteilung Motortemperatur, 8 Sst." 0x8198E7 tmot SstAUbSstUb 191.3 temp_ub_q0p75_o48 8 -48.00 143.3 FORMAT "%5.1" DEPOSIT ABSOLUTE /end AXIS_PTS
/begin AXIS_PTS STM09ESUB "Stützstellenverteilung Motortemperatur, 9 Sst." 0x8198F0 tmot SstAUbSstUb 191.3 temp_ub_q0p75_o48 9 -48.00 143.3 FORMAT "%5.1" DEPOSIT ABSOLUTE /end AXIS_PTS
/begin AXIS_PTS STM12ESUB "SST-Verteilung für die Motortemperatur tmot" 0x8198FA tmot SstAUbSstUb 191.3 temp_ub_q0p75_o48 12 -48.00 143.3 FORMAT "%5.1" DEPOSIT ABSOLUTE /end AXIS_PTS
/begin AXIS_PTS STN12ESUB "" 0x819907 tans SstAUbSstUb 191.3 temp_ub_q0p75_o48 12 -48.00 143.3 FORMAT "%5.1" DEPOSIT ABSOLUTE /end AXIS_PTS
/begin AXIS_PTS STS06TMUW "Stützstellenverteilung, Abgasmassenfluß" 0x81B178 tabst_w SstAUwSstUw 65535.00 t1sxs_uw_q1 6 0.00 65535.00 FORMAT "%8.2" DEPOSIT ABSOLUTE /end AXIS_PTS
/begin AXIS_PTS STS08ESUB "SST-Verteilung für Motorstarttemperatur" 0x819914 tmst SstAUbSstUb 191.3 temp_ub_q0p75_o48 8 -48.00 143.3 FORMAT "%5.1" DEPOSIT ABSOLUTE /end AXIS_PTS
/begin AXIS_PTS STS12ESUB "SST-Verteilung für Motorstarttemperatur" 0x811AB0 tmst SstAUbSstUb 191.3 temp_ub_q0p75_o48 12 -48.00 143.3 FORMAT "%5.1" DEPOSIT ABSOLUTE /end AXIS_PTS
/begin AXIS_PTS STU05TMUB "Stützstellenverteilung, Ersatz-Umgebungstemperatur" 0x81991D tatu SstAUbSstUb 191.3 temp_ub_q0p75_o48 5 -48.00 143.3 FORMAT "%5.1" DEPOSIT ABSOLUTE /end AXIS_PTS
/begin AXIS_PTS STW06MDUB "6 twan-Stützstellen für ?" 0x819923 twan SstAUbSstUb 191.3 temp_ub_q0p75_o48 6 -48.00 143.3 FORMAT "%5.1" DEPOSIT ABSOLUTE /end AXIS_PTS
/begin AXIS_PTS SUB06__UB "Stützstellenvert. Batteriespannung, 6 Sst." 0x81992A ub SstAUbSstUb 24.02 spg_ubatt 6 0.00 24.02 FORMAT "%5.2" DEPOSIT ABSOLUTE /end AXIS_PTS
/begin AXIS_PTS SVR08LDUB "" 0x811ABD vrlsol SstAUbSstUb 99.61 rel_ub_b99p6 8 0.00 99.61 FORMAT "%5.2" DEPOSIT ABSOLUTE /end AXIS_PTS
/begin AXIS_PTS SWD06KRSW "Stützstellenverteilung DK-Winkel, 6 Sst." 0x81B186 wdkba_w SstASwSstSw 1599.976 relDK_q0p02441 6 -800.0000 799.9756 FORMAT "%8.4" DEPOSIT ABSOLUTE /end AXIS_PTS
/begin AXIS_PTS SWN10FEUB "" 0x811AC6 wnwue SstAUbSstUb 127.500 wkw_ub_q0p5 10 0.00 127.500 DEPOSIT ABSOLUTE /end AXIS_PTS
/begin AXIS_PTS SWP08LDUB "" 0x811AD1 wped SstAUbSstUb 100.0 relPED_ub_b100 8 0.00 100.0 FORMAT "%5.1" DEPOSIT ABSOLUTE /end AXIS_PTS
/begin AXIS_PTS SWP08OPUB "Stützstellenverteilung für Pedalstellung wped" 0x811ADA wped SstAUbSstUb 100.0 relPED_ub_b100 8 0.00 100.0 FORMAT "%5.1" DEPOSIT ABSOLUTE /end AXIS_PTS
/begin CHARACTERISTIC TALUNL "Tastverhältnis für EC-Lüfternachlaufsteuerung bei 10 Hz" VALUE 0x811EC3 KwUb 100.0 rel_ub_b100 0.00 100.0 FORMAT "%5.1" /end CHARACTERISTIC
/begin CHARACTERISTIC TAMHYS "Tastverhältnis E-Lüfter Hysterese" VALUE 0x811EC4 KwUb 100.0 rel_ub_b100 0.00 100.0 FORMAT "%5.1" /end CHARACTERISTIC
/begin CHARACTERISTIC TAMLAC "Anforderung E-Lüfter-Tastverhältnis von Klimaanlage" CURVE 0x81A656 KlAUbSstUbWUb 100.0 rel_ub_b100 0.00 100.0 FORMAT "%5.1"
 /begin AXIS_DESCR STD_AXIS stmlac dez 10 0.00 255.0 FORMAT "%5.1" DEPOSIT ABSOLUTE /end AXIS_DESCR
/end CHARACTERISTIC
/begin CHARACTERISTIC TAMLSMN "Minimales Tastverhältnis Ansteuerung Motorlüfter" VALUE 0x81A66B KwUb 100.0 rel_ub_b100 0.00 100.0 FORMAT "%5.1" /end CHARACTERISTIC
/begin CHARACTERISTIC TAMLSMX "Maximales Tastverhältnis Ansteuerung Motorlüfter" VALUE 0x81A66C KwUb 100.0 rel_ub_b100 0.00 100.0 FORMAT "%5.1" /end CHARACTERISTIC
/begin CHARACTERISTIC TAMLSNH "Anforderung E-Lüfter-Tastverhältnis nach Hysterese" CURVE 0x81A66D KlAUbSstUbWUb 100.0 rel_ub_b100 0.00 100.0 FORMAT "%5.1"
 /begin AXIS_DESCR STD_AXIS tamlnhk rel_ub_b100 8 0.00 100.0 FORMAT "%5.1" DEPOSIT ABSOLUTE /end AXIS_DESCR
/end CHARACTERISTIC
/begin CHARACTERISTIC TAMLTKA "Anforderung E-Lüfter-Tastverhältnis aus Kühlerausgangstemperatur" CURVE 0x81A67E KlAUbSstUbWUb 100.0 rel_ub_b100 0.00 100.0 FORMAT "%5.1"
 /begin AXIS_DESCR STD_AXIS tka temp_ub_q0p75_o48 10 -48.00 143.3 FORMAT "%5.1" DEPOSIT ABSOLUTE /end AXIS_DESCR
/end CHARACTERISTIC
/begin CHARACTERISTIC TAMLU "Unempfindlichkeitsschwelle E-Lüfter-Tastverhältnis" VALUE 0x811EC5 KwUb 100.0 rel_ub_b100 0.00 100.0 FORMAT "%5.1" /end CHARACTERISTIC
/begin CHARACTERISTIC TANMX "Maximale Zeit für Automatik-Start" VALUE 0x815FF4 KwUw 655.3500 t10msxs_uw_b655p35 0.00 655.3500 FORMAT "%8.4" /end CHARACTERISTIC
/begin CHARACTERISTIC TANSMN "Ansauglufttemperaturschwelle zur Nachstartaufweitung" VALUE 0x811FE4 KwUb 191.3 temp_ub_q0p75_o48 -48.00 143.3 FORMAT "%5.1" /end CHARACTERISTIC
/begin CHARACTERISTIC TASLSO "obere Ansauglufttemperaturschwelle für Sekundärluftsystem" VALUE 0x8197D2 KwUb 191.3 temp_ub_q0p75_o48 -48.00 143.3 FORMAT "%5.1" /end CHARACTERISTIC
/begin CHARACTERISTIC TASLSU "untere Ansauglufttemperaturschwelle für Sekundärluftsystem" VALUE 0x8197D3 KwUb 191.3 temp_ub_q0p75_o48 -48.00 143.3 FORMAT "%5.1" /end CHARACTERISTIC
/begin CHARACTERISTIC TDDSLA "Dauer Sekundärlufteinblasung für Adaptionsphase" VALUE 0x8197D4 KwUb 25.50 t100msxs_ub_b25p5 0.00 25.50 FORMAT "%5.2" /end CHARACTERISTIC
/begin CHARACTERISTIC TDMFBSA "Zeitkonstante PT1-Filter beim Schubabschalten" VALUE 0x81666E KwUw 655.350000 zk10msxs_uw_b655 0.0100001526 655.360000 FORMAT "%10.6" /end CHARACTERISTIC
/begin CHARACTERISTIC TDMFBWE "Zeitkonstante PT1-Filter beim weichen Wiedereinsetzen" VALUE 0x816670 KwUw 655.350000 zk10msxs_uw_b655 0.0100001526 655.360000 FORMAT "%10.6" /end CHARACTERISTIC
/begin CHARACTERISTIC TDSLKT "Dauer Kurztest Sekundärluftdiagnose für Massenmessung" VALUE 0x8197D5 KwUb 25.50 t100msxs_ub_b25p5 0.00 25.50 FORMAT "%5.2" /end CHARACTERISTIC
/begin CHARACTERISTIC TEMIN "minimales TE" VALUE 0x814260 KwUw 209.7120 tinjection_sy 0.00 209.7120 FORMAT "%8.4" /end CHARACTERISTIC
/begin CHARACTERISTIC TFMIZU "Filterzeitkonstante zur Filterung des zulässigen Moments" VALUE 0x815F56 KwUw 655.350000 zk10msxs_uw_b655 0.0100001526 655.360000 FORMAT "%10.6" /end CHARACTERISTIC
/begin CHARACTERISTIC TLMSSLAB "Entprellzeit für Abbruch Sekundärluftanfettung" VALUE 0x8197D6 KwUb 25.40 t100msxs_ub_b25p5 0.1000 25.50 FORMAT "%5.2" /end CHARACTERISTIC
/begin CHARACTERISTIC TLMSSLMX "Maximale Zeit für Sekundärluftanfettung im Leerlauf" VALUE 0x8197D7 KwUb 255.0 t100msxs_ub_b255 0.00 255.0 FORMAT "%5.1" /end CHARACTERISTIC
/begin CHARACTERISTIC TMDMAD "Motortemperaturschwelle für Freigabe der Adaption des Verlustmoments" VALUE 0x81A5C7 KwUb 191.3 temp_ub_q0p75_o48 -48.00 143.3 FORMAT "%5.1" /end CHARACTERISTIC
/begin CHARACTERISTIC TMFASLMN "Motortemperaturschwelle Testeranforderung Sekundärluftdiagnose" VALUE 0x8197D8 KwUb 191.3 temp_ub_q0p75_o48 -48.00 143.3 FORMAT "%5.1" /end CHARACTERISTIC
/begin CHARACTERISTIC TMMSX "Motortemperaturschwelle Überhitzungsschutz" VALUE 0x81A6E4 KwUb 191.3 temp_ub_q0p75_o48 -48.00 143.3 FORMAT "%5.1" /end CHARACTERISTIC
/begin CHARACTERISTIC TMNSMN "Motortemperaturschwelle für die Nachstartaufweitung" VALUE 0x811FE5 KwUb 191.3 temp_ub_q0p75_o48 -48.00 143.3 FORMAT "%5.1" /end CHARACTERISTIC
/begin CHARACTERISTIC TMSSLO "obere Starttemperaturschwelle für Sekundärluft" VALUE 0x8197D9 KwUb 191.3 temp_ub_q0p75_o48 -48.00 143.3 FORMAT "%5.1" /end CHARACTERISTIC
/begin CHARACTERISTIC TMSSLSTO "obere Temperaturschwelle für Sekundärluft im Start" VALUE 0x8197DA KwUb 191.3 temp_ub_q0p75_o48 -48.00 143.3 FORMAT "%5.1" /end CHARACTERISTIC
/begin CHARACTERISTIC TMSSLSTU "untere Temperaturschwelle für Sekundärluft im Start" VALUE 0x8197DB KwUb 191.3 temp_ub_q0p75_o48 -48.00 143.3 FORMAT "%5.1" /end CHARACTERISTIC
/begin CHARACTERISTIC TMSSLU "untere Starttemperaturschwelle für Sekundärluft" VALUE 0x8197DC KwUb 191.3 temp_ub_q0p75_o48 -48.00 143.3 FORMAT "%5.1" /end CHARACTERISTIC
/begin CHARACTERISTIC TMSTKA "Zulässige Tmot von Temperatur Kühleraustritt für Überhitzungsschutz" CURVE 0x81A6E5 KlAUbSstUbWUb 191.3 temp_ub_q0p75_o48 -48.00 143.3 FORMAT "%5.1"
 /begin AXIS_DESCR STD_AXIS tka temp_ub_q0p75_o48 6 -48.00 143.3 FORMAT "%5.1" DEPOSIT ABSOLUTE /end AXIS_DESCR
/end CHARACTERISTIC
/begin CHARACTERISTIC TMVER "Entprellzeit zur Erkennung einer dauerhaften Momentenbegrenzung" VALUE 0x81A870 KwUw 65535.00 t1sxs_uw_b65535 0.00 65535.00 FORMAT "%8.2" /end CHARACTERISTIC
/begin CHARACTERISTIC TNLSGMN "Minimale Zeit für SG-Nachlauf" VALUE 0x81BC38 KwUw 6553.300 t100msxs_uw_b6553p6 0.2000000 6553.500 FORMAT "%8.3" /end CHARACTERISTIC
/begin CHARACTERISTIC TNLSGMX "Maximale Zeit für SG-Nachlauf" VALUE 0x81BC3A KwUw 6553.500 t100msxs_uw_b6553p6 0.00 6553.500 FORMAT "%8.3" /end CHARACTERISTIC
/begin CHARACTERISTIC TNMXPRG "gangabhängiger Drehzahl-Prädiktionshorizont für NMAX-Regelung" CURVE 0x810434 GklWUb 2.550 t10msxs_ub_b2p55 0.00 2.550 FORMAT "%5.3" /begin AXIS_DESCR COM_AXIS gangi dez 7 0.00 255.0 AXIS_PTS_REF SGA07MDUB /end AXIS_DESCR /end CHARACTERISTIC
/begin CHARACTERISTIC TNMXPRLR "Drehzahl-Prädiktionshorizont für NMAX-Regelung bei Low Range" VALUE 0x819001 KwUb 2.550 t10msxs_ub_b2p55 0.00 2.550 FORMAT "%5.3" /end CHARACTERISTIC
/begin CHARACTERISTIC TNSC "Nachstartüberwachungszeit" VALUE 0x815F58 KwUw 1310.700 t20msxs_uw_q0p02 0.00 1310.700 FORMAT "%8.3" /end CHARACTERISTIC
/begin CHARACTERISTIC TNSOF "Entprellzeit zur Abschaltung der Nachstartaufweitung" VALUE 0x811FE6 KwUb 5.100 t20msxs_ub_b5p1 0.00 5.100 FORMAT "%5.3" /end CHARACTERISTIC
/begin CHARACTERISTIC TPAST "Entprellzeit für automatischen Start" VALUE 0x81244D KwUb 2.550 t10msxs_ub_b2p55 0.00 2.550 FORMAT "%5.3" /end CHARACTERISTIC
/begin CHARACTERISTIC TPNSMD "Prüfzeit nach Startende für Diagnose Momentenbegrenzung" VALUE 0x81A872 KwUw 65535.00 t1sxs_uw_b65535 0.00 65535.00 FORMAT "%8.2" /end CHARACTERISTIC
/begin CHARACTERISTIC TSLABB "Verweilzeit für Sekundärluft- Abbruchbedingung" VALUE 0x8197DD KwUb 25.40 t100msxs_ub_b25p5 0.1000 25.50 FORMAT "%5.2" /end CHARACTERISTIC
/begin CHARACTERISTIC TSLPMN "Mindesteinschaltdauer der Sekundärluftpumpe" VALUE 0x8197DE KwUb 25.40 t100msxs_ub_b25p5 0.1000 25.50 FORMAT "%5.2" /end CHARACTERISTIC
/begin CHARACTERISTIC TSLUBST "Entprellzeit für Sekundärluft ein im Start bei UBSLSTMN" VALUE 0x8197DF KwUb 25.50 t100msxs_ub_b25p5 0.00 25.50 FORMAT "%5.2" /end CHARACTERISTIC
/begin CHARACTERISTIC TSTA "Wartezeit bis Erkennung blockierter Motor" VALUE 0x815FF6 KwUw 655.3500 t10msxs_uw_b655p35 0.00 655.3500 FORMAT "%8.4" /end CHARACTERISTIC
/begin CHARACTERISTIC TSTSV "Vorzögerungszeit nach S_kl50 1->0 ( Starterabwurf )" VALUE 0x81244E KwUb 2.550 t10msxs_ub_b2p55 0.00 2.550 FORMAT "%5.3" /end CHARACTERISTIC
/begin CHARACTERISTIC TVDSLOFF "Zeitverzögerung Schließen Sekundärluftventil bei Adaption/Kurztrip" VALUE 0x8197E0 KwUb 25.50 t100msxs_ub_b25p5 0.00 25.50 FORMAT "%5.2" /end CHARACTERISTIC
/begin CHARACTERISTIC TVFSAM "Temperaturabhängige Verzögerungszeit für Fahrstufe AUS" CURVE 0x811E98 GklWUb 5.100 t20msxs_ub_b5p1 0.00 5.100 FORMAT "%5.3"
 /begin AXIS_DESCR COM_AXIS twan temp_ub_q0p75_o48 6 -48.00 143.3 AXIS_PTS_REF STW06MDUB /end AXIS_DESCR
/end CHARACTERISTIC
/begin CHARACTERISTIC TVFSAWE "Verzögerungszeit für Rücksetzen von B_fil" VALUE 0x811EE4 KwUb 2.540 t10msxs_ub_b2p55 0.01000 2.550 FORMAT "%5.3" /end CHARACTERISTIC
/begin CHARACTERISTIC TVFSEM "Temperaturabhängige Verzögerungszeit für Fahrstufe EIN" CURVE 0x811E9E GklWUb 5.100 t20msxs_ub_b5p1 0.00 5.100 FORMAT "%5.3"
 /begin AXIS_DESCR COM_AXIS twan temp_ub_q0p75_o48 6 -48.00 143.3 AXIS_PTS_REF STW06MDUB /end AXIS_DESCR
/end CHARACTERISTIC
/begin CHARACTERISTIC TVFUE "Verzögerungszeit für den Aufbau der Füllung" VALUE 0x811EA4 KwUb 1.992 fak_ub_b2 0.00 1.992 FORMAT "%5.3" /end CHARACTERISTIC
/begin CHARACTERISTIC TVSLVOFF "Zeitverzögerung Schließen Sekundärluftventil" VALUE 0x8197E1 KwUb 25.50 t100msxs_ub_b25p5 0.00 25.50 FORMAT "%5.2" /end CHARACTERISTIC
/begin CHARACTERISTIC TVSLVON "Zeitverzögerung Öffnen Sekundärluftventil" VALUE 0x8197E2 KwUb 25.40 t100msxs_ub_b25p5 0.1000 25.50 FORMAT "%5.2" /end CHARACTERISTIC
/begin CHARACTERISTIC TWDMAD "Wartezeit bis Freigabe der Adaption des Verlustmoments" VALUE 0x81A5C8 KwUb 51.00 t200msxs_ub_b51 0.00 51.00 FORMAT "%5.2" /end CHARACTERISTIC
/begin CHARACTERISTIC UBNLMN "Minimale Batterie-Sollspannung" VALUE 0x81A6F2 KwUb 24.02 spg_ubatt 0.00 24.02 FORMAT "%5.2" /end CHARACTERISTIC
/begin CHARACTERISTIC UBSLMN "min. Spannung für Sekundärluft ein" VALUE 0x8197E3 KwUb 24.02 spg_ubatt 0.00 24.02 FORMAT "%5.2" /end CHARACTERISTIC
/begin CHARACTERISTIC UBSLMX "max. Spannung für Sekundärluft ein" VALUE 0x8197E4 KwUb 24.02 spg_ubatt 0.00 24.02 FORMAT "%5.2" /end CHARACTERISTIC
/begin CHARACTERISTIC UBSLSTMN "min.Spannung für Sekundärluft ein im Start" VALUE 0x8197E5 KwUb 24.02 spg_ubatt 0.00 24.02 FORMAT "%5.2" /end CHARACTERISTIC
/begin CHARACTERISTIC UEVERG "Übersetzungsverhältnis abh. vom eingelegten Gang" CURVE 0x811EA5 KlAUbSstUbWUb 15.94 fak_ub_b16 0.00 15.94 FORMAT "%5.2"
 /begin AXIS_DESCR STD_AXIS gangi dez 14 0.00 255.0 FORMAT "%5.1" DEPOSIT ABSOLUTE /end AXIS_DESCR
/end CHARACTERISTIC
/begin CHARACTERISTIC UKWNMAXG "gangabhängiger NW-Umdrehungszähler für NMAX Regelung" CURVE 0x812EE2 GklWUw 65535.00 dez 0.00 65535.00 FORMAT "%8.2" /begin AXIS_DESCR COM_AXIS gangi dez 7 0.00 255.0 AXIS_PTS_REF SGA07MDUB /end AXIS_DESCR /end CHARACTERISTIC
/begin CHARACTERISTIC UWNMAXLR "NW-Umdrehungszähler für NMAX Regelung bei Low Range" VALUE 0x81A89E KwUw 65535.00 dez 0.00 65535.00 FORMAT "%8.2" /end CHARACTERISTIC
/begin CHARACTERISTIC VKUPZWEO "Obere vfzg-Hytereseschwelle für KUP-ZW-Eingriffe" VALUE 0x810179 KwUb 318.8 vfzg_ub_q1p25 0.00 318.8 FORMAT "%5.1" /end CHARACTERISTIC
/begin CHARACTERISTIC VKUPZWEU "Untere vfzg-Hytereseschwelle für KUP-ZW-Eingriffe" VALUE 0x81017A KwUb 318.8 vfzg_ub_q1p25 0.00 318.8 FORMAT "%5.1" /end CHARACTERISTIC
/begin CHARACTERISTIC VLLZWEO "Obere vfzg-Hytereseschwelle für LL-ZW-Eingriffe" VALUE 0x81017B KwUb 318.8 vfzg_ub_q1p25 0.00 318.8 FORMAT "%5.1" /end CHARACTERISTIC
/begin CHARACTERISTIC VLLZWEU "Untere vfzg-Hytereseschwelle für LL-ZW-Eingriffe" VALUE 0x81017C KwUb 318.8 vfzg_ub_q1p25 0.00 318.8 FORMAT "%5.1" /end CHARACTERISTIC
/begin CHARACTERISTIC VLSDZWEO "Obere vfzg-Hytereseschwelle für LSD-ZW-Eingriffe" VALUE 0x81017D KwUb 318.8 vfzg_ub_q1p25 0.00 318.8 FORMAT "%5.1" /end CHARACTERISTIC
/begin CHARACTERISTIC VLSDZWEU "Untere vfzg-Hytereseschwelle für LSD-ZW-Eingriffe" VALUE 0x81017E KwUb 318.8 vfzg_ub_q1p25 0.00 318.8 FORMAT "%5.1" /end CHARACTERISTIC
/begin CHARACTERISTIC VSLS "Schwelle Fahrzeuggeschwindigkeit für SLS ein" VALUE 0x8197E6 KwUb 318.8 vfzg_ub_q1p25 0.00 318.8 FORMAT "%5.1" /end CHARACTERISTIC
/begin CHARACTERISTIC WPUE1MX "maximal zulässiger Winkel Fahrpedal für Schubabschneiden aus Ebene 1" VALUE 0x811FE9 KwUb 100.0 relPED_ub_b100 0.00 100.0 FORMAT "%5.1" /end CHARACTERISTIC
/begin CHARACTERISTIC ZETABASN "Tiefpaßfilterzeitkonstante für etabas_w" CURVE 0x81045A GklWUb 2.54000 zk10msxs_ub_b2p55 0.0100000 2.55000 FORMAT "%7.5"
 /begin AXIS_DESCR COM_AXIS nmot nmot_ub_q40 12 0.00 10200. AXIS_PTS_REF SNM12FEUB /end AXIS_DESCR
/end CHARACTERISTIC
/begin CHARACTERISTIC ZFLMSSL "Zeitkonstante Gemischanteil Sekundärluft" VALUE 0x8197E7 KwUb 25.4996 zk100msxs_ub_b25p5 0.100392 25.6000 FORMAT "%7.4" /end CHARACTERISTIC
/begin CHARACTERISTIC ZFMDVERL "Zeitkonstante für Filterung Verlustmoment" VALUE 0x81009D KwUb 5.08000 zk20msxs_ub_b5p1 0.0200000 5.10000 FORMAT "%7.5" /end CHARACTERISTIC
/begin CHARACTERISTIC ZINMAXG "gangabhängige I-Steigung für NMAX-Regelung" CURVE 0x81043B GklWUb 2.54000 zk10msxs_ub_b2p55 0.0100000 2.55000 FORMAT "%7.5" /begin AXIS_DESCR COM_AXIS gangi dez 7 0.00 255.0 AXIS_PTS_REF SGA07MDUB /end AXIS_DESCR /end CHARACTERISTIC
/begin CHARACTERISTIC ZINMAXLR "I-Steigung für NMAX-Regelung bei Low Range Betrieb" VALUE 0x819002 KwUb 2.54000 zk10msxs_ub_b2p55 0.0100000 2.55000 FORMAT "%7.5" /end CHARACTERISTIC
/begin CHARACTERISTIC ZKDMADFK "Zeitkonstante für Adaption des Verlustmoments Fahrstufe und Kompressor ein" VALUE 0x81BBE4 KwUw 816.000000 zk200msxs_uw_b13107 3.20000000 819.200000 FORMAT "%10.6" /end CHARACTERISTIC
/begin CHARACTERISTIC ZKDMADFS "Zeitkonstante für Adaption des Verlustmoments Fahrstufe ein" VALUE 0x81BBE6 KwUw 816.000000 zk200msxs_uw_b13107 3.20000000 819.200000 FORMAT "%10.6" /end CHARACTERISTIC
/begin CHARACTERISTIC ZKDMADKO "Zeitkonstante für Adaption des Verlustmoments Klimakompressor ein" VALUE 0x81BBE8 KwUw 816.000000 zk200msxs_uw_b13107 3.20000000 819.200000 FORMAT "%10.6" /end CHARACTERISTIC
/begin CHARACTERISTIC ZKDMADLL "Zeitkonstante für Adaption des Verlustmoments ohne Last" VALUE 0x81BBEA KwUw 816.000000 zk200msxs_uw_b13107 3.20000000 819.200000 FORMAT "%10.6" /end CHARACTERISTIC
/begin CHARACTERISTIC ZKMDKO "Zeitkonstante Klimakompressor-Lastabregelung" VALUE 0x811E88 KwUb 5.08000 zk20msxs_ub_b5p1 0.0200000 5.10000 FORMAT "%7.5" /end CHARACTERISTIC
/begin CHARACTERISTIC ZKMDWA "Zeitkonstante Drehmomentaufnahme des Wandlers" VALUE 0x811EC2 KwUb 5.08000 zk20msxs_ub_b5p1 0.0200000 5.10000 FORMAT "%7.5" /end CHARACTERISTIC
/begin CHARACTERISTIC ZKSLPOFF "Zeitkonstante Runterlauf Sekundärluftgebläse" VALUE 0x8197E8 KwUb 25.4996 zk100msxs_ub_b25p5 0.100392 25.6000 FORMAT "%7.4" /end CHARACTERISTIC
/begin CHARACTERISTIC ZKSLPON "Zeitkonstante Hochlauf Sekundärluftgebläse" VALUE 0x8197E9 KwUb 25.4996 zk100msxs_ub_b25p5 0.100392 25.6000 FORMAT "%7.4" /end CHARACTERISTIC
/begin CHARACTERISTIC ZKSLSOFF "Zeitkonstante Ausräumen der Sekundärluft nach Ventil schließen" VALUE 0x8197EA KwUb 25.4996 zk100msxs_ub_b25p5 0.100392 25.6000 FORMAT "%7.4" /end CHARACTERISTIC
/begin CHARACTERISTIC ZKSLSON "Zeitkonstante Einbringen der Sekundärluft nach Ventil öffnen" VALUE 0x8197EB KwUb 25.4996 zk100msxs_ub_b25p5 0.100392 25.6000 FORMAT "%7.4" /end CHARACTERISTIC
/begin CHARACTERISTIC ZLSDHK "Zeitkonstante PT2-Filter Lastschlagdämpfung bei hohem Kupplungsmoment" VALUE 0x816672 KwUw 655.350000 zk10msxs_uw_b655 0.0100001526 655.360000 FORMAT "%10.6" /end CHARACTERISTIC
/begin CHARACTERISTIC ZLSDHKLR "Zeitkonstante PT2 Lastschlagdämpfung bei hohem Kupplungsmoment Low Range" VALUE 0x816674 KwUw 655.350000 zk10msxs_uw_b655 0.0100001526 655.360000 FORMAT "%10.6" /end CHARACTERISTIC
/begin CHARACTERISTIC ZMDNS "Zeitkonstante zur Abrgelung des Nachstart-Momentenoffset" VALUE 0x815EB4 KwUw 52.3800107 zk20msxs_uw_b1310 0.0199893187 52.4000000 FORMAT "%10.7" /end CHARACTERISTIC
/begin CHARACTERISTIC ZMIBGR "Zeitkonstante für Faktor gangabh. Momentenbegrenzung" VALUE 0x815F52 KwUw 3276.75000 zk50msxs_uw_b3276p8 0.0500007630 3276.80000 FORMAT "%10.5" /end CHARACTERISTIC
/begin CHARACTERISTIC ZNGHGS "Zeitkonstante Tiefpaß für Drehzahlgradient" VALUE 0x815F54 KwUw 655.350000 zk10msxs_uw_b655 0.0100001526 655.360000 FORMAT "%10.6" /end CHARACTERISTIC
/begin CHARACTERISTIC Z_OEL1 "Zeitkonstante Modelltemperaturanteil aus tmot" VALUE 0x81B3DA KwUw 99.99847 rel_uw_b100 0.00 99.99847 FORMAT "%8.5" /end CHARACTERISTIC
/begin CHARACTERISTIC Z_OEL2 "Zeitkonstante Modelltemperaturanteil aus n_mot und rl" VALUE 0x81B3DC KwUw 99.99847 rel_uw_b100 0.00 99.99847 FORMAT "%8.5" /end CHARACTERISTIC
/begin CHARACTERISTIC Z_OEL3 "Zeitkonstante Modelltemperaturanteil aus tumg und vfz" VALUE 0x81B3DE KwUw 99.99847 rel_uw_b100 0.00 99.99847 FORMAT "%8.5" /end CHARACTERISTIC
/begin MEASUREMENT abtim_b "Abstellzeit" UBYTE t1sxs_uw_q16 1 100 0 4080 FORMAT "%5.0" ECU_ADDRESS 0x380C4A /end MEASUREMENT
/begin MEASUREMENT anzkwu_w "Anzahl KW-Umdrehungen" UWORD dez 1 100 0 65535 FORMAT "%8.2" ECU_ADDRESS 0xFA34 /end MEASUREMENT
/begin MEASUREMENT B_abstnl "Bedingung Abstellzeitermittlung über SG-Nachlauf" UWORD B_TRUE 1 100 0 1 BIT_MASK 0x80 FORMAT "%13.11" ECU_ADDRESS 0xFDC4 /end MEASUREMENT
/begin MEASUREMENT B_adwfk "Bedingung Adaptionswert Fahrstufe und Kompressor ein verwenden" UWORD B_TRUE 1 100 0 1 BIT_MASK 0x80 FORMAT "%13.11" ECU_ADDRESS 0xFDC0 /end MEASUREMENT
/begin MEASUREMENT B_adwfs "Bedingung Adaptionswert Fahrstufe ein verwenden" UWORD B_TRUE 1 100 0 1 BIT_MASK 0x100 FORMAT "%13.11" ECU_ADDRESS 0xFDC0 /end MEASUREMENT
/begin MEASUREMENT B_adwko "Bedingung Adaptionswert Klimakompressor ein verwenden" UWORD B_TRUE 1 100 0 1 BIT_MASK 0x200 FORMAT "%13.11" ECU_ADDRESS 0xFDC0 /end MEASUREMENT
/begin MEASUREMENT B_allzw "" UWORD B_TRUE 1 100 0 1 BIT_MASK 0x20 FORMAT "%13.11" ECU_ADDRESS 0xFD22 /end MEASUREMENT
/begin MEASUREMENT B_allzwe "Bedingung zw-Verstellung durch MD-Struktur aktiv (LL,DASH,LSD,KUP)" UWORD B_TRUE 1 100 0 1 BIT_MASK 0x40 FORMAT "%13.11" ECU_ADDRESS 0xFD22 /end MEASUREMENT
/begin MEASUREMENT B_asr "Bedingung für ASR aktiv" UWORD B_TRUE 1 100 0 1 BIT_MASK 0x80 FORMAT "%13.11" ECU_ADDRESS 0xFD22 /end MEASUREMENT
/begin MEASUREMENT B_auakt "Bedingung Abgasuntersuchung aktiv" UWORD B_TRUE 1 100 0 1 BIT_MASK 0x100 FORMAT "%13.11" ECU_ADDRESS 0xFDC4 /end MEASUREMENT
/begin MEASUREMENT B_blkfb "MIL-Ansteuerung blinkend fremdbestimmt durch externes SG" UBYTE B_TRUE 1 100 0 1 BIT_MASK 0x4 FORMAT "%13.11" ECU_ADDRESS 0x382FFC /end MEASUREMENT
/begin MEASUREMENT B_bm "Bedingung Bezugsmarke erkannt" UWORD B_TRUE 1 100 0 1 BIT_MASK 0x40 FORMAT "%13.11" ECU_ADDRESS 0xFD4A /end MEASUREMENT
/begin MEASUREMENT B_cdagr "Funktion über Codewort CDAGR freigegeben" UWORD B_TRUE 1 100 0 1 BIT_MASK 0x8000 FORMAT "%13.11" ECU_ADDRESS 0x38104A /end MEASUREMENT
/begin MEASUREMENT B_cddmtl "Funktionfreigabe per Codewort" UWORD B_TRUE 1 100 0 1 BIT_MASK 0x200 FORMAT "%13.11" ECU_ADDRESS 0xFDC4 /end MEASUREMENT
/begin MEASUREMENT B_cdfst "Füllstandsgeberdiagnose über Euro-Codewort CDEFST freigeben" UWORD B_TRUE 1 100 0 1 BIT_MASK 0x400 FORMAT "%13.11" ECU_ADDRESS 0xFDC4 /end MEASUREMENT
/begin MEASUREMENT B_cdhsh "Funktion über Codewort CDHSH freigegeben" UWORD B_TRUE 1 100 0 1 BIT_MASK 0x80 FORMAT "%13.11" ECU_ADDRESS 0x38104A /end MEASUREMENT
/begin MEASUREMENT B_cdhsv "Funktion über Codewort CDHSV freigegeben" UWORD B_TRUE 1 100 0 1 BIT_MASK 0x40 FORMAT "%13.11" ECU_ADDRESS 0x38104A /end MEASUREMENT
/begin MEASUREMENT B_cdkat "Funktion über Codewort CDKAT freigegeben" UWORD B_TRUE 1 100 0 1 BIT_MASK 0x100 FORMAT "%13.11" ECU_ADDRESS 0x38104A /end MEASUREMENT
/begin MEASUREMENT B_cdkvs "Funktion über Codewort CDKVS freigegeben" UWORD B_TRUE 1 100 0 1 BIT_MASK 0x800 FORMAT "%13.11" ECU_ADDRESS 0x38104A /end MEASUREMENT
/begin MEASUREMENT B_cdlash "Funktion über Codewort CDLASH freigegeben" UWORD B_TRUE 1 100 0 1 BIT_MASK 0x40 FORMAT "%13.11" ECU_ADDRESS 0x38104C /end MEASUREMENT
/begin MEASUREMENT B_cdlatp "Funktion über Codewort CDLATP freigegeben" UWORD B_TRUE 1 100 0 1 BIT_MASK 0x10 FORMAT "%13.11" ECU_ADDRESS 0x38104C /end MEASUREMENT
/begin MEASUREMENT B_cdlatv "Funktion über Codewort CDLATV freigeben" UWORD B_TRUE 1 100 0 1 BIT_MASK 0x20 FORMAT "%13.11" ECU_ADDRESS 0x38104C /end MEASUREMENT
/begin MEASUREMENT B_cdldp "Funktion über Codewort CDLDP freigegeben" UWORD B_TRUE 1 100 0 1 BIT_MASK 0x4000 FORMAT "%13.11" ECU_ADDRESS 0x38104A /end MEASUREMENT
/begin MEASUREMENT B_cdllr "Funktion über Codewort CDLLR freigegeben" UWORD B_TRUE 1 100 0 1 BIT_MASK 0x8 FORMAT "%13.11" ECU_ADDRESS 0x38104C /end MEASUREMENT
/begin MEASUREMENT B_cdlsa "Funktion über Codewort CDLSA freigegeben" UWORD B_TRUE 1 100 0 1 BIT_MASK 0x20 FORMAT "%13.11" ECU_ADDRESS 0x38104A /end MEASUREMENT
/begin MEASUREMENT B_cdlsh "Funktion über Codewort CDLSH freigegeben" UWORD B_TRUE 1 100 0 1 BIT_MASK 0x10 FORMAT "%13.11" ECU_ADDRESS 0x38104A /end MEASUREMENT
/begin MEASUREMENT B_cdlsv "Funktion über Codewort CDLSV freigegeben" UWORD B_TRUE 1 100 0 1 BIT_MASK 0x8 FORMAT "%13.11" ECU_ADDRESS 0x38104A /end MEASUREMENT
/begin MEASUREMENT B_cdmd "Funktion über Codewort CDMD freigegeben" UWORD B_TRUE 1 100 0 1 BIT_MASK 0x1 FORMAT "%13.11" ECU_ADDRESS 0x38104A /end MEASUREMENT
/begin MEASUREMENT B_cdnws "Funktion über Codewort CDNWS freigegeben" UWORD B_TRUE 1 100 0 1 BIT_MASK 0x4 FORMAT "%13.11" ECU_ADDRESS 0x38104C /end MEASUREMENT
/begin MEASUREMENT B_cdnws2 "Diagnosefunktion NWS Bank2 über Codewort CDNWS freigegeben" UWORD B_TRUE 1 100 0 1 BIT_MASK 0x200 FORMAT "%13.11" ECU_ADDRESS 0x38104C /end MEASUREMENT
/begin MEASUREMENT B_cdsls "Funktion über Codewort CDSLS freigegeben" UWORD B_TRUE 1 100 0 1 BIT_MASK 0x1 FORMAT "%13.11" ECU_ADDRESS 0x38104C /end MEASUREMENT
/begin MEASUREMENT B_cdswe "Funktion über Codewort CDSWE freigegeben" UWORD B_TRUE 1 100 0 1 BIT_MASK 0x200 FORMAT "%13.11" ECU_ADDRESS 0xFDCA /end MEASUREMENT
/begin MEASUREMENT B_cdtes "Funktion über Codewort CDTES freigegeben" UWORD B_TRUE 1 100 0 1 BIT_MASK 0x2000 FORMAT "%13.11" ECU_ADDRESS 0x38104A /end MEASUREMENT
/begin MEASUREMENT B_clrtm "" UWORD B_TRUE 1 100 0 1 BIT_MASK 0x400 FORMAT "%13.11" ECU_ADDRESS 0xFDCA /end MEASUREMENT
/begin MEASUREMENT B_craus "Ausgewertet durch LREB: Werkstattbit zum Stillegen LR" UWORD B_TRUE 1 100 0 1 BIT_MASK 0x800 FORMAT "%13.11" ECU_ADDRESS 0xFDCA /end MEASUREMENT
/begin MEASUREMENT B_cvt "Bedingung continuously variable transmission" UWORD B_TRUE 1 100 0 1 BIT_MASK 0x20 FORMAT "%13.11" ECU_ADDRESS 0xFD48 /end MEASUREMENT
/begin MEASUREMENT B_dash "Bedingung: Dashpot-Änderungsbegrenzung aktiv" UWORD B_TRUE 1 100 0 1 BIT_MASK 0x1 FORMAT "%13.11" ECU_ADDRESS 0xFD22 /end MEASUREMENT
/begin MEASUREMENT B_dknolu "Bedingung Drosselklappensteller stromlos" UWORD B_TRUE 1 100 0 1 BIT_MASK 0x1000 FORMAT "%13.11" ECU_ADDRESS 0xFD40 /end MEASUREMENT
/begin MEASUREMENT B_dkpiu "Bedingung: irreversible SKA" UWORD B_TRUE 1 100 0 1 BIT_MASK 0x2000 FORMAT "%13.11" ECU_ADDRESS 0xFD40 /end MEASUREMENT
/begin MEASUREMENT B_dkpru "Bedingung: reversible SKA" UWORD B_TRUE 1 100 0 1 BIT_MASK 0x80 FORMAT "%13.11" ECU_ADDRESS 0xFD8A /end MEASUREMENT
/begin MEASUREMENT B_dkpu "Bedingung Sicherheitskraftstoffabschaltung (SKA)" UWORD B_TRUE 1 100 0 1 BIT_MASK 0x4000 FORMAT "%13.11" ECU_ADDRESS 0xFD40 /end MEASUREMENT
/begin MEASUREMENT B_dmtllhv "Bedingung Anforderung Feinleckprüfung wegen Leck-Heilung oder -Verifizierung" UWORD B_TRUE 1 100 0 1 BIT_MASK 0x800 FORMAT "%13.11" ECU_ADDRESS 0xFDC4 /end MEASUREMENT
/begin MEASUREMENT B_dp "Bedingung: Dashpotwert größer Fahrerwunsch (=1)" UWORD B_TRUE 1 100 0 1 BIT_MASK 0x20 FORMAT "%13.11" ECU_ADDRESS 0xFDC2 /end MEASUREMENT
/begin MEASUREMENT B_dslal2 "Bedingung Diagnose SLS Anpassung Reglerparameter LR Bank 2" UWORD B_TRUE 1 100 0 1 BIT_MASK 0x1000 FORMAT "%13.11" ECU_ADDRESS 0xFDCA /end MEASUREMENT
/begin MEASUREMENT B_dslalr "Bedingung Diagnose Sekundärluftsystem Anpassung Reglerparameter LR" UWORD B_TRUE 1 100 0 1 BIT_MASK 0x2000 FORMAT "%13.11" ECU_ADDRESS 0xFDCA /end MEASUREMENT
/begin MEASUREMENT B_dslil2 "Bedingung Diagnose SLS Integratorsteigung LR Bank 2" UWORD B_TRUE 1 100 0 1 BIT_MASK 0x4000 FORMAT "%13.11" ECU_ADDRESS 0xFDCA /end MEASUREMENT
/begin MEASUREMENT B_dslilr "Bedingung Diagnose Sekundärluftsystem Integratorsteigung LR" UWORD B_TRUE 1 100 0 1 BIT_MASK 0x8000 FORMAT "%13.11" ECU_ADDRESS 0xFDCA /end MEASUREMENT
/begin MEASUREMENT B_dslreset "Bedingung: Zurücksetzen Sekundärluftadaption/Kurztest" UWORD B_TRUE 1 100 0 1 BIT_MASK 0x2 FORMAT "%13.11" ECU_ADDRESS 0x380EA6 /end MEASUREMENT
/begin MEASUREMENT B_dslsa "Diagnose Sekundärluft-System: Erzwingt LR auch dann, wenn E_sls gesetzt ist" UWORD B_TRUE 1 100 0 1 BIT_MASK 0x1 FORMAT "%13.11" ECU_ADDRESS 0xFDCC /end MEASUREMENT
/begin MEASUREMENT B_dslset "Bedingung: Setzen Sekundärluftadaption/Kurztest" UWORD B_TRUE 1 100 0 1 BIT_MASK 0x1 FORMAT "%13.11" ECU_ADDRESS 0x380EA6 /end MEASUREMENT
/begin MEASUREMENT B_dslsk "Bedingung Diagnose Sekundärluftsystem für Kurztest" UWORD B_TRUE 1 100 0 1 BIT_MASK 0x2 FORMAT "%13.11" ECU_ADDRESS 0xFDCC /end MEASUREMENT
/begin MEASUREMENT B_dslst "Bedingung Steuerung des Regelfaktors aus DSLS" UWORD B_TRUE 1 100 0 1 BIT_MASK 0x4 FORMAT "%13.11" ECU_ADDRESS 0xFDCC /end MEASUREMENT
/begin MEASUREMENT B_dslst2 "Bedingung Steuerung des Regelfaktors Bank2 aus DSLS" UWORD B_TRUE 1 100 0 1 BIT_MASK 0x8 FORMAT "%13.11" ECU_ADDRESS 0xFDCC /end MEASUREMENT
/begin MEASUREMENT B_dsve "Bedingung Diagnose Sekundärluft-Ventil ein" UWORD B_TRUE 1 100 0 1 BIT_MASK 0x10 FORMAT "%13.11" ECU_ADDRESS 0xFDCC /end MEASUREMENT
/begin MEASUREMENT B_dtefrr "Bedingung Lambdareglerreset bei Tankentlüftungsdiagnose" UWORD B_TRUE 1 100 0 1 BIT_MASK 0x20 FORMAT "%13.11" ECU_ADDRESS 0xFDCC /end MEASUREMENT
/begin MEASUREMENT B_edp "Bedingung Erlaubnis Dashpot" UWORD B_TRUE 1 100 0 1 BIT_MASK 0x40 FORMAT "%13.11" ECU_ADDRESS 0xFDC2 /end MEASUREMENT
/begin MEASUREMENT B_elsd "Bedingung Erlaubnis Lastschlagdämpfung" UWORD B_TRUE 1 100 0 1 BIT_MASK 0x80 FORMAT "%13.11" ECU_ADDRESS 0xFDC2 /end MEASUREMENT
/begin MEASUREMENT B_etol "Bedingung Fehler in Öltemperatur" UWORD B_TRUE 1 100 0 1 BIT_MASK 0x1000 FORMAT "%13.11" ECU_ADDRESS 0xFDC4 /end MEASUREMENT
/begin MEASUREMENT B_faatm "Bedingung Funktionsanforderung kurze Taupunktendezeiten" UWORD B_TRUE 1 100 0 1 BIT_MASK 0x40 FORMAT "%13.11" ECU_ADDRESS 0xFDCC /end MEASUREMENT
/begin MEASUREMENT B_fadkvs "Funktionsaufforderung Diagnose Kraftstoffsystem für Schnelltest" UWORD B_TRUE 1 100 0 1 BIT_MASK 0x80 FORMAT "%13.11" ECU_ADDRESS 0xFDCC /end MEASUREMENT
/begin MEASUREMENT B_fakat "Bedingung Funktionsanforderung Katalysatorüberwachung" UWORD B_TRUE 1 100 0 1 BIT_MASK 0x100 FORMAT "%13.11" ECU_ADDRESS 0xFDCC /end MEASUREMENT
/begin MEASUREMENT B_fakat2 "Bedingung Funktionanforderung Katalysatorüberwachung (Stereo 2.Bank)" UWORD B_TRUE 1 100 0 1 BIT_MASK 0x200 FORMAT "%13.11" ECU_ADDRESS 0xFDCC /end MEASUREMENT
/begin MEASUREMENT B_fakvs "Funktionsaufforderung Diagnose Kraftstoffsystem für Schnelltest" UWORD B_TRUE 1 100 0 1 BIT_MASK 0x40 FORMAT "%13.11" ECU_ADDRESS 0xFD48 /end MEASUREMENT
/begin MEASUREMENT B_falsh "Bedingung Funktionsanforderung Lambda-Sonde hinter KAT" UWORD B_TRUE 1 100 0 1 BIT_MASK 0x80 FORMAT "%13.11" ECU_ADDRESS 0xFD48 /end MEASUREMENT
/begin MEASUREMENT B_falsh2 "Bedingung Funktionsanforderung Lambda-Sonde hinter KAT Bank2" UWORD B_TRUE 1 100 0 1 BIT_MASK 0x100 FORMAT "%13.11" ECU_ADDRESS 0xFD48 /end MEASUREMENT
/begin MEASUREMENT B_fash "Bedingung Funktionsanforderung Schwingungsprüfung" UWORD B_TRUE 1 100 0 1 BIT_MASK 0x400 FORMAT "%13.11" ECU_ADDRESS 0xFDCC /end MEASUREMENT
/begin MEASUREMENT B_fash2 "Bedingung Funktionsanforderung Schwingungsprüfung Bank2" UWORD B_TRUE 1 100 0 1 BIT_MASK 0x800 FORMAT "%13.11" ECU_ADDRESS 0xFDCC /end MEASUREMENT
/begin MEASUREMENT B_fasla "Bedingung: externe Anforderung an Sekundärluft aktiv" UWORD B_TRUE 1 100 0 1 BIT_MASK 0x4 FORMAT "%13.11" ECU_ADDRESS 0xFD68 /end MEASUREMENT
/begin MEASUREMENT B_faslarq "Bedingung: lokale Anforderung Testdurchlauf Sekundärluft starten" UWORD B_TRUE 1 100 0 1 BIT_MASK 0x8 FORMAT "%13.11" ECU_ADDRESS 0xFD68 /end MEASUREMENT
/begin MEASUREMENT B_fatp "Bedingung Funktionsanforderung TP-Überwachung" UWORD B_TRUE 1 100 0 1 BIT_MASK 0x1000 FORMAT "%13.11" ECU_ADDRESS 0xFDCC /end MEASUREMENT
/begin MEASUREMENT B_fatp2 "Bedingung Funktionsanforderung TP-Überwachung Bank2" UWORD B_TRUE 1 100 0 1 BIT_MASK 0x2000 FORMAT "%13.11" ECU_ADDRESS 0xFDCC /end MEASUREMENT
/begin MEASUREMENT B_fatv "Bedingung Funktionsanforderung TV-Überwachung" UWORD B_TRUE 1 100 0 1 BIT_MASK 0x4000 FORMAT "%13.11" ECU_ADDRESS 0xFDCC /end MEASUREMENT
/begin MEASUREMENT B_fatv2 "Bedingung Funktionsanforderung TV-Überwachung Bank2" UWORD B_TRUE 1 100 0 1 BIT_MASK 0x8000 FORMAT "%13.11" ECU_ADDRESS 0xFDCC /end MEASUREMENT
/begin MEASUREMENT B_fbm "Bedingung Bezugsmarkenfehler => mindestens 1 Zahn zuviel oder zuwenig erkannt" UWORD B_TRUE 1 100 0 1 BIT_MASK 0x80 FORMAT "%13.11" ECU_ADDRESS 0xFD4A /end MEASUREMENT
/begin MEASUREMENT B_fgr "Bedingung FGR (Tempomat) aktiv" UWORD B_TRUE 1 100 0 1 BIT_MASK 0x2 FORMAT "%13.11" ECU_ADDRESS 0xFD22 /end MEASUREMENT
/begin MEASUREMENT B_fhz "Bedingung Frontscheibenheizung" UWORD B_TRUE 1 100 0 1 BIT_MASK 0x1 FORMAT "%13.11" ECU_ADDRESS 0xFDCE /end MEASUREMENT
/begin MEASUREMENT B_fil "Bedingung PT1-Filter für SAWE aktiv" UWORD B_TRUE 1 100 0 1 BIT_MASK 0x4 FORMAT "%13.11" ECU_ADDRESS 0xFD22 /end MEASUREMENT
/begin MEASUREMENT B_fpwdkap "DK-Steuerung direkt über Fahrpedal" UWORD B_TRUE 1 100 0 1 BIT_MASK 0x200 FORMAT "%13.11" ECU_ADDRESS 0xFD48 /end MEASUREMENT
/begin MEASUREMENT B_fspclr "Bedingung Fehlerspeicher wurde gelöscht" UWORD B_TRUE 1 100 0 1 BIT_MASK 0x400 FORMAT "%13.11" ECU_ADDRESS 0xFD48 /end MEASUREMENT
/begin MEASUREMENT B_fsu "Bedingung Fahrstufe, Umschaltung" UWORD B_TRUE 1 100 0 1 BIT_MASK 0x1 FORMAT "%13.11" ECU_ADDRESS 0xFDC2 /end MEASUREMENT
/begin MEASUREMENT B_ftedab "Bedingung Spülrate für Diagnose zusteuern" UWORD B_TRUE 1 100 0 1 BIT_MASK 0x2 FORMAT "%13.11" ECU_ADDRESS 0xFDCE /end MEASUREMENT
/begin MEASUREMENT B_grdst "Bedingung Grundeinstellung" UWORD B_TRUE 1 100 0 1 BIT_MASK 0x4 FORMAT "%13.11" ECU_ADDRESS 0xFDCE /end MEASUREMENT
/begin MEASUREMENT B_hgsndy "Bedingung Drehzahldynamik in gangabhängiger Momentenbegrenzung" UWORD B_TRUE 1 100 0 1 BIT_MASK 0x1000 FORMAT "%13.11" ECU_ADDRESS 0xFDC2 /end MEASUREMENT
/begin MEASUREMENT B_iflsd "Bedingung Initialisierung Filter Lastschlagdämpfung" UWORD B_TRUE 1 100 0 1 BIT_MASK 0x100 FORMAT "%13.11" ECU_ADDRESS 0xFDC2 /end MEASUREMENT
/begin MEASUREMENT B_iniSyn "" UWORD B_TRUE 1 100 0 1 BIT_MASK 0x100 FORMAT "%13.11" ECU_ADDRESS 0xFD4A /end MEASUREMENT
/begin MEASUREMENT B_i_ska_fr "FR-Fehlerreaktion irreversible SKA (Sicherheits-Kraftstoff-Abschaltung)" UWORD B_TRUE 1 100 0 1 BIT_MASK 0x100 FORMAT "%13.11" ECU_ADDRESS 0xFD8A /end MEASUREMENT
/begin MEASUREMENT B_katfz "Bedingung Kat in Fahrzeug eingebaut" UWORD B_TRUE 1 100 0 1 BIT_MASK 0x2000 FORMAT "%13.11" ECU_ADDRESS 0xFDC4 /end MEASUREMENT
/begin MEASUREMENT B_kath "Bedingung Kat Heizung in Fahrzeug eingebaut" UWORD B_TRUE 1 100 0 1 BIT_MASK 0x4000 FORMAT "%13.11" ECU_ADDRESS 0xFDC4 /end MEASUREMENT
/begin MEASUREMENT B_ll "Bedingung Leerlauf" UWORD B_TRUE 1 100 0 1 BIT_MASK 0x8 FORMAT "%13.11" ECU_ADDRESS 0xFD22 /end MEASUREMENT
/begin MEASUREMENT B_lmsslof "Bedingung Lambda-Motor-Soll-Sekundärluftanteil, Aus" UWORD B_TRUE 1 100 0 1 BIT_MASK 0x10 FORMAT "%13.11" ECU_ADDRESS 0xFD68 /end MEASUREMENT
/begin MEASUREMENT B_lrndia "Bedingung: DV-E-Adaption und Prüfungen per Diagnose-Tester aktivieren" UWORD B_TRUE 1 100 0 1 BIT_MASK 0x8 FORMAT "%13.11" ECU_ADDRESS 0xFDCE /end MEASUREMENT
/begin MEASUREMENT B_lrssa "LRSEB: Einschaltbed. für Lambdareg. nach Schub bei langsamer Sonde" UWORD B_TRUE 1 100 0 1 BIT_MASK 0x10 FORMAT "%13.11" ECU_ADDRESS 0xFDCE /end MEASUREMENT
/begin MEASUREMENT B_lrssa2 "Einschaltbed. für Lambdareg. nach Schub bei langsamer Sonde, Bank2" UWORD B_TRUE 1 100 0 1 BIT_MASK 0x20 FORMAT "%13.11" ECU_ADDRESS 0xFDCE /end MEASUREMENT
/begin MEASUREMENT B_ls "Bedingung: Lastschlagbegrenzung kleiner Fahrerwunsch (=1)" UWORD B_TRUE 1 100 0 1 BIT_MASK 0x200 FORMAT "%13.11" ECU_ADDRESS 0xFDC2 /end MEASUREMENT
/begin MEASUREMENT B_lsd "Bedingung: Pos. Lastschlagdämpfung aktiv" UWORD B_TRUE 1 100 0 1 BIT_MASK 0x10 FORMAT "%13.11" ECU_ADDRESS 0xFD22 /end MEASUREMENT
/begin MEASUREMENT B_lsh "Bedingung Lambda-Sonde hinter Kat verbaut, 2. Sonde nach Auslaß (Bank1)" UWORD B_TRUE 1 100 0 1 BIT_MASK 0x400 FORMAT "%13.11" ECU_ADDRESS 0xFD50 /end MEASUREMENT
/begin MEASUREMENT B_lsh2 "Bedingung Lambda-Sonde hinter Kat verbaut, 2. Sonde nach Auslaß (Bank2)" UWORD B_TRUE 1 100 0 1 BIT_MASK 0x800 FORMAT "%13.11" ECU_ADDRESS 0xFD50 /end MEASUREMENT
/begin MEASUREMENT B_lsv "Bedingung Lambda-Sonde vor Kat verbaut, 1. Sonde nach Auslaß (Bank1)" UWORD B_TRUE 1 100 0 1 BIT_MASK 0x1000 FORMAT "%13.11" ECU_ADDRESS 0xFD50 /end MEASUREMENT
/begin MEASUREMENT B_lsv2 "Bedingung Lambda-Sonde vor Kat verbaut, 1. Sonde nach Auslaß (Bank2)" UWORD B_TRUE 1 100 0 1 BIT_MASK 0x2000 FORMAT "%13.11" ECU_ADDRESS 0xFD50 /end MEASUREMENT
/begin MEASUREMENT B_m8te "Bedingung Fkt-Anforderung Tankentlüftung nach SAE J1979 Mode 8 TID $01" UBYTE B_TRUE 1 100 0 1 BIT_MASK 0x1 FORMAT "%13.11" ECU_ADDRESS 0x380BEB /end MEASUREMENT
/begin MEASUREMENT B_m9cvnclr "Bedingung zum Löschen der Checksumme (CVN)" UBYTE B_TRUE 1 100 0 1 BIT_MASK 0x2 FORMAT "%13.11" ECU_ADDRESS 0x380BEB /end MEASUREMENT
/begin MEASUREMENT B_madfk "Bedingung Momentenadaption Fahrstufe und Klimakompressor ein" UWORD B_TRUE 1 100 0 1 BIT_MASK 0x400 FORMAT "%13.11" ECU_ADDRESS 0xFDC0 /end MEASUREMENT
/begin MEASUREMENT B_madfs "Bedingung Momentenadaption Fahrstufe ein" UWORD B_TRUE 1 100 0 1 BIT_MASK 0x800 FORMAT "%13.11" ECU_ADDRESS 0xFDC0 /end MEASUREMENT
/begin MEASUREMENT B_madko "Bedingung Momentenadaption Klimakompressor ein" UWORD B_TRUE 1 100 0 1 BIT_MASK 0x1000 FORMAT "%13.11" ECU_ADDRESS 0xFDC0 /end MEASUREMENT
/begin MEASUREMENT B_madll "Bedingung Momentenadaption ohne Last" UWORD B_TRUE 1 100 0 1 BIT_MASK 0x2000 FORMAT "%13.11" ECU_ADDRESS 0xFDC0 /end MEASUREMENT
/begin MEASUREMENT B_madstp "Bedingung Momentenadaption durch Fehler im System gestoppt" UWORD B_TRUE 1 100 0 1 BIT_MASK 0x4000 FORMAT "%13.11" ECU_ADDRESS 0xFDC0 /end MEASUREMENT
/begin MEASUREMENT B_mde8e "Bedingung Mode $08 erlaubt" UWORD B_TRUE 1 100 0 1 BIT_MASK 0x8000 FORMAT "%13.11" ECU_ADDRESS 0xFDC4 /end MEASUREMENT
/begin MEASUREMENT B_mde9e "Bedingung Mode $09 erlaubt" UWORD B_TRUE 1 100 0 1 BIT_MASK 0x1 FORMAT "%13.11" ECU_ADDRESS 0xFDC6 /end MEASUREMENT
/begin MEASUREMENT B_mdee "Bedingung Momentenreduzierung über Einspritzausblendung erlaubt" UWORD B_TRUE 1 100 0 1 BIT_MASK 0x4000 FORMAT "%13.11" ECU_ADDRESS 0xFD22 /end MEASUREMENT
/begin MEASUREMENT B_mdein "Bedingung Momenteneingriff aktiv" UWORD B_TRUE 1 100 0 1 BIT_MASK 0x100 FORMAT "%13.11" ECU_ADDRESS 0xFD22 /end MEASUREMENT
/begin MEASUREMENT B_mdmax "Bedingung maximal ereichbares indiziertes Moment erreicht" UWORD B_TRUE 1 100 0 1 BIT_MASK 0x40 FORMAT "%13.11" ECU_ADDRESS 0xFDCE /end MEASUREMENT
/begin MEASUREMENT B_mdmin "Bedingung minimal erreichbares indiziertes Moment erreicht" UWORD B_TRUE 1 100 0 1 BIT_MASK 0x80 FORMAT "%13.11" ECU_ADDRESS 0xFDCE /end MEASUREMENT
/begin MEASUREMENT B_mdnstab "Bedingung Drehzahlstabilisierung aktiv" UWORD B_TRUE 1 100 0 1 BIT_MASK 0x40 FORMAT "%13.11" ECU_ADDRESS 0xFDC0 /end MEASUREMENT
/begin MEASUREMENT B_mdredhyein "" UWORD B_TRUE 1 100 0 1 BIT_MASK 0x8000 FORMAT "%13.11" ECU_ADDRESS 0xFD22 /end MEASUREMENT
/begin MEASUREMENT B_mibeg "Bedingung Momentenbegrenzung ist aktiv" UWORD B_TRUE 1 100 0 1 BIT_MASK 0x200 FORMAT "%13.11" ECU_ADDRESS 0xFD22 /end MEASUREMENT
/begin MEASUREMENT B_mibegdau "Bedingung: Momentenüberwachung begrenzt dauerhaft" UWORD B_TRUE 1 100 0 1 BIT_MASK 0x1 FORMAT "%13.11" ECU_ADDRESS 0xFD20 /end MEASUREMENT
/begin MEASUREMENT B_mibgr "Bedingung Regelung der gangabh. Momentenbegrenzung aktiv" UWORD B_TRUE 1 100 0 1 BIT_MASK 0x2000 FORMAT "%13.11" ECU_ADDRESS 0xFDC2 /end MEASUREMENT
/begin MEASUREMENT B_milfb "MIL-Ansteuerung fremdbestimmt durch externes SG" UBYTE B_TRUE 1 100 0 1 BIT_MASK 0x2 FORMAT "%13.11" ECU_ADDRESS 0x382FFC /end MEASUREMENT
/begin MEASUREMENT B_mnmsl "Bedingung Sekundärluftabbruch wegen zu geringer Sekundärluft" UWORD B_TRUE 1 100 0 1 BIT_MASK 0x100 FORMAT "%13.11" ECU_ADDRESS 0xFDCE /end MEASUREMENT
/begin MEASUREMENT B_msloff "Sekundärluftmasse ausgeräumt nach Sekundärluftphase" UWORD B_TRUE 1 100 0 1 BIT_MASK 0x20 FORMAT "%13.11" ECU_ADDRESS 0xFD68 /end MEASUREMENT
/begin MEASUREMENT B_mslon "Sekundärluftmasse eingeschwungen nach Start der Sekundärluft" UWORD B_TRUE 1 100 0 1 BIT_MASK 0x40 FORMAT "%13.11" ECU_ADDRESS 0xFD68 /end MEASUREMENT
/begin MEASUREMENT B_msmd "Bedingung Momentenbegrenzung für Motorschutz aktiv" UWORD B_TRUE 1 100 0 1 BIT_MASK 0x20 FORMAT "%13.11" ECU_ADDRESS 0xFDC4 /end MEASUREMENT
/begin MEASUREMENT B_msr "Bedingung für Momentenschlupfregelung" UWORD B_TRUE 1 100 0 1 BIT_MASK 0x400 FORMAT "%13.11" ECU_ADDRESS 0xFD22 /end MEASUREMENT
/begin MEASUREMENT B_mzns "Nachstartaufweitung des zul. Moments aktiv" UWORD B_TRUE 1 100 0 1 BIT_MASK 0x4000 FORMAT "%13.11" ECU_ADDRESS 0xFDC2 /end MEASUREMENT
/begin MEASUREMENT B_nachl "Steuerung SG-Nachlauf" UWORD B_TRUE 1 100 0 1 BIT_MASK 0x8000 FORMAT "%13.11" ECU_ADDRESS 0x383A42 /end MEASUREMENT
/begin MEASUREMENT B_nachlend "Bedingung SG-Nachlauf regulär beendet" UWORD B_TRUE 1 100 0 1 BIT_MASK 0x4000 FORMAT "%13.11" ECU_ADDRESS 0x383A42 /end MEASUREMENT
/begin MEASUREMENT B_nachln "Steuerung SG-Nachlauf nach n > NMIN" UWORD B_TRUE 1 100 0 1 BIT_MASK 0x2 FORMAT "%13.11" ECU_ADDRESS 0xFDC2 /end MEASUREMENT
/begin MEASUREMENT B_ndsav "Bedingung EEPROM-Emulation aktiv" UWORD B_TRUE 1 100 0 1 BIT_MASK 0x2 FORMAT "%13.11" ECU_ADDRESS 0xFDC6 /end MEASUREMENT
/begin MEASUREMENT B_nl10 "Bedingung EC-Lüfternachlaufsteuerung mit 10 Hz" UWORD B_TRUE 1 100 0 1 BIT_MASK 0x4 FORMAT "%13.11" ECU_ADDRESS 0xFDC2 /end MEASUREMENT
/begin MEASUREMENT B_nlacls "Anforderung Steuergerätenachlauf von AC-Lüftersteuerung" UWORD B_TRUE 1 100 0 1 BIT_MASK 0x2 FORMAT "%13.11" ECU_ADDRESS 0x383A42 /end MEASUREMENT
/begin MEASUREMENT B_nlale "Anforderung Steuergerätenachlauf von Funktion ALE" UWORD B_TRUE 1 100 0 1 BIT_MASK 0x1 FORMAT "%13.11" ECU_ADDRESS 0x383A42 /end MEASUREMENT
/begin MEASUREMENT B_nlcan "Bedingung für SG-Nachlauf von CAN" UWORD B_TRUE 1 100 0 1 BIT_MASK 0x200 FORMAT "%13.11" ECU_ADDRESS 0x383A42 /end MEASUREMENT
/begin MEASUREMENT B_nldsc "Anforderung Steuergerätenachlauf von DSC-Funktion" UWORD B_TRUE 1 100 0 1 BIT_MASK 0x400 FORMAT "%13.11" ECU_ADDRESS 0x383A42 /end MEASUREMENT
/begin MEASUREMENT B_nldte "Anforderung Steuergerätenachlauf Diagnose Tankentlüftung" UWORD B_TRUE 1 100 0 1 BIT_MASK 0x100 FORMAT "%13.11" ECU_ADDRESS 0x383A42 /end MEASUREMENT
/begin MEASUREMENT B_nlEEPR "Bedingung Nachlauf EEPROM schreiben" UWORD B_TRUE 1 100 0 1 BIT_MASK 0x20 FORMAT "%13.11" ECU_ADDRESS 0x383A42 /end MEASUREMENT
/begin MEASUREMENT B_nlmls "Anforderung Steuergerätenachlauf von Motor-Lüftersteuerung" UWORD B_TRUE 1 100 0 1 BIT_MASK 0x8 FORMAT "%13.11" ECU_ADDRESS 0x383A42 /end MEASUREMENT
/begin MEASUREMENT B_nlobd "Anforderung Steuergerätenachlauf von OBD" UWORD B_TRUE 1 100 0 1 BIT_MASK 0x10 FORMAT "%13.11" ECU_ADDRESS 0x383A42 /end MEASUREMENT
/begin MEASUREMENT B_nlsgls "Anforderung Steuergerätenachlauf von Steuergeräte-Lüftersteuerung" UWORD B_TRUE 1 100 0 1 BIT_MASK 0x40 FORMAT "%13.11" ECU_ADDRESS 0x383A42 /end MEASUREMENT
/begin MEASUREMENT B_nlsiko "Bedingung Nachlauf EGAS-Überwachung" UWORD B_TRUE 1 100 0 1 BIT_MASK 0x80 FORMAT "%13.11" ECU_ADDRESS 0x383A42 /end MEASUREMENT
/begin MEASUREMENT B_nlwst "Anforderung Steuergerätenachlauf für Wiederholstarterkennung" UWORD B_TRUE 1 100 0 1 BIT_MASK 0x4 FORMAT "%13.11" ECU_ADDRESS 0x383A42 /end MEASUREMENT
/begin MEASUREMENT B_nmax "Bedingung Drehzahlbegrenzung aktiv" UWORD B_TRUE 1 100 0 1 BIT_MASK 0x10 FORMAT "%13.11" ECU_ADDRESS 0xFD5E /end MEASUREMENT
/begin MEASUREMENT B_nmaxd "Bedingung Drehzahlbegrenzung mit Einspritzausblendung an allen Zylindern" UWORD B_TRUE 1 100 0 1 BIT_MASK 0x20 FORMAT "%13.11" ECU_ADDRESS 0xFD5E /end MEASUREMENT
/begin MEASUREMENT B_nmotue1 "" UWORD B_TRUE 1 100 0 1 BIT_MASK 0x8 FORMAT "%13.11" ECU_ADDRESS 0xFDC4 /end MEASUREMENT
/begin MEASUREMENT B_nnot "Bedingung Drehzahlanhebung im Notlauf" UWORD B_TRUE 1 100 0 1 BIT_MASK 0x200 FORMAT "%13.11" ECU_ADDRESS 0xFDCE /end MEASUREMENT
/begin MEASUREMENT B_nocins "Bedingung: Fz-Konfiguration ohne CAN-Kombiinstrument" UWORD B_TRUE 1 100 0 1 BIT_MASK 0x4 FORMAT "%13.11" ECU_ADDRESS 0xFDC6 /end MEASUREMENT
/begin MEASUREMENT B_notl "Notlaufbetrieb" UWORD B_TRUE 1 100 0 1 BIT_MASK 0x400 FORMAT "%13.11" ECU_ADDRESS 0xFDCE /end MEASUREMENT
/begin MEASUREMENT B_notlu_fr "Anforderung Notluftfahren vom Funktionsrechner" UWORD B_TRUE 1 100 0 1 BIT_MASK 0x200 FORMAT "%13.11" ECU_ADDRESS 0xFD8A /end MEASUREMENT
/begin MEASUREMENT B_nozwe "Bedingung kein Zündwinkeleingriff der Drehmomentstruktur" UWORD B_TRUE 1 100 0 1 BIT_MASK 0x100 FORMAT "%13.11" ECU_ADDRESS 0xFD24 /end MEASUREMENT
/begin MEASUREMENT B_nsakt "Nachstart aktiv für Nachstartaufweitung" UWORD B_TRUE 1 100 0 1 BIT_MASK 0x8000 FORMAT "%13.11" ECU_ADDRESS 0xFDC2 /end MEASUREMENT
/begin MEASUREMENT B_nsend "Nachstartüberwachungszeit abgelaufen" UWORD B_TRUE 1 100 0 1 BIT_MASK 0x1 FORMAT "%13.11" ECU_ADDRESS 0xFDC4 /end MEASUREMENT
/begin MEASUREMENT B_nswo1 "Bedingung Drehzahl > NSWO1" UWORD B_TRUE 1 100 0 1 BIT_MASK 0x800 FORMAT "%13.11" ECU_ADDRESS 0xFD48 /end MEASUREMENT
/begin MEASUREMENT B_nswo2 "Bedingung Drehzahl > NSWO2" UWORD B_TRUE 1 100 0 1 BIT_MASK 0x1000 FORMAT "%13.11" ECU_ADDRESS 0xFD48 /end MEASUREMENT
/begin MEASUREMENT B_nswo3 "" UWORD B_TRUE 1 100 0 1 BIT_MASK 0x2000 FORMAT "%13.11" ECU_ADDRESS 0xFD48 /end MEASUREMENT
/begin MEASUREMENT b_nwtv "Bedingung Nockenwelle Tastverhältnis" UWORD default 1 100 0 1 BIT_MASK 0x80 FORMAT "%5.3" ECU_ADDRESS 0xFDDA /end MEASUREMENT
/begin MEASUREMENT b_nwtv2 "Bedingung Nockenwelle Tastverhältnis (Sensor2)" UWORD default 1 100 0 1 BIT_MASK 0x100 FORMAT "%5.3" ECU_ADDRESS 0xFDDA /end MEASUREMENT
/begin MEASUREMENT B_pwf "Bedingung Powerfail" UWORD B_TRUE 1 100 0 1 BIT_MASK 0x10 FORMAT "%13.11" ECU_ADDRESS 0xFD4A /end MEASUREMENT
/begin MEASUREMENT B_sa "Bedingung Schubabschalten" UWORD B_TRUE 1 100 0 1 BIT_MASK 0x1 FORMAT "%13.11" ECU_ADDRESS 0xFD24 /end MEASUREMENT
/begin MEASUREMENT B_sacvt "Bedingung Schubabschaltunterstützung für CVT-Getriebe" UWORD B_TRUE 1 100 0 1 BIT_MASK 0x4000 FORMAT "%13.11" ECU_ADDRESS 0xFD48 /end MEASUREMENT
/begin MEASUREMENT B_saue1 "Bedingung Schubabschaltanforderung aus MD-Begrenzung UE1" UWORD B_TRUE 1 100 0 1 BIT_MASK 0x10 FORMAT "%13.11" ECU_ADDRESS 0xFDC4 /end MEASUREMENT
/begin MEASUREMENT B_sl "Bedingung Servo-Lenkung" UWORD B_TRUE 1 100 0 1 BIT_MASK 0x800 FORMAT "%13.11" ECU_ADDRESS 0xFDCE /end MEASUREMENT
/begin MEASUREMENT B_sldsl4 "Bedingung: Freigabe Sekundärluft für Diagnosephase 4" UWORD B_TRUE 1 100 0 1 BIT_MASK 0x4 FORMAT "%13.11" ECU_ADDRESS 0x380EA6 /end MEASUREMENT
/begin MEASUREMENT B_slkhof "Bedingung Abschalten der Sekundärluftpumpe durch imlpr-Schwelle" UWORD B_TRUE 1 100 0 1 BIT_MASK 0x80 FORMAT "%13.11" ECU_ADDRESS 0xFD68 /end MEASUREMENT
/begin MEASUREMENT B_slkt "Bedingung: Freigabe Sekundärluft für Kurztest" UWORD B_TRUE 1 100 0 1 BIT_MASK 0x8 FORMAT "%13.11" ECU_ADDRESS 0x380EA6 /end MEASUREMENT
/begin MEASUREMENT B_slp "Bedingung für Sekundärluftpumpe" UWORD B_TRUE 1 100 0 1 BIT_MASK 0x100 FORMAT "%13.11" ECU_ADDRESS 0xFD68 /end MEASUREMENT
/begin MEASUREMENT B_slpena "Bedingung Einschalten der Sekundärluftpumpe" UWORD B_TRUE 1 100 0 1 BIT_MASK 0x10 FORMAT "%13.11" ECU_ADDRESS 0x380EA6 /end MEASUREMENT
/begin MEASUREMENT B_slpoff "Sekundärluftpumpe abgeschaltet" UWORD B_TRUE 1 100 0 1 BIT_MASK 0x200 FORMAT "%13.11" ECU_ADDRESS 0xFD68 /end MEASUREMENT
/begin MEASUREMENT B_slpofst "Bedingung für Setzen Flip Flop  B_slpoff" UWORD B_TRUE 1 100 0 1 BIT_MASK 0x20 FORMAT "%13.11" ECU_ADDRESS 0x380EA6 /end MEASUREMENT
/begin MEASUREMENT B_sls "Bedingung Sekundärluft aktiv" UWORD B_TRUE 1 100 0 1 BIT_MASK 0x800 FORMAT "%13.11" ECU_ADDRESS 0xFD2C /end MEASUREMENT
/begin MEASUREMENT B_slsadap "Bedingung: Sekundärluftmassenadaption" UWORD B_TRUE 1 100 0 1 BIT_MASK 0x400 FORMAT "%13.11" ECU_ADDRESS 0xFD68 /end MEASUREMENT
/begin MEASUREMENT B_slsdis "Bedingung für  Abschalten der Sekundärluftpumpe" UWORD B_TRUE 1 100 0 1 BIT_MASK 0x80 FORMAT "%13.11" ECU_ADDRESS 0x380EA6 /end MEASUREMENT
/begin MEASUREMENT B_slserr "Bedingungen sperren Einschalten der Sekundärluftpumpe" UWORD B_TRUE 1 100 0 1 BIT_MASK 0x100 FORMAT "%13.11" ECU_ADDRESS 0x380EA6 /end MEASUREMENT
/begin MEASUREMENT B_slsfz "Bedingung SLS in Fahrzeug eingebaut" UWORD B_TRUE 1 100 0 1 BIT_MASK 0x8 FORMAT "%13.11" ECU_ADDRESS 0xFDC6 /end MEASUREMENT
/begin MEASUREMENT B_slsinhi "Bedingung sperrt Setzen von Bit B_sls" UWORD B_TRUE 1 100 0 1 BIT_MASK 0x40 FORMAT "%13.11" ECU_ADDRESS 0x380EA6 /end MEASUREMENT
/begin MEASUREMENT B_slsoff "Sekundärlufteinblasung nach Ausräumen der Sekundärluft beendet" UWORD B_TRUE 1 100 0 1 BIT_MASK 0x800 FORMAT "%13.11" ECU_ADDRESS 0xFD68 /end MEASUREMENT
/begin MEASUREMENT B_slv "Bedingung für Sekundärluftventil" UWORD B_TRUE 1 100 0 1 BIT_MASK 0x1000 FORMAT "%13.11" ECU_ADDRESS 0xFD68 /end MEASUREMENT
/begin MEASUREMENT B_sta "Bedingung automatischer Start" UWORD B_TRUE 1 100 0 1 BIT_MASK 0x1 FORMAT "%13.11" ECU_ADDRESS 0xFDCA /end MEASUREMENT
/begin MEASUREMENT B_sta0ag "Bedingung Start-Automatik AG-Fzg" UWORD B_TRUE 1 100 0 1 BIT_MASK 0x2 FORMAT "%13.11" ECU_ADDRESS 0xFDCA /end MEASUREMENT
/begin MEASUREMENT B_sta0hg "Bedingung Start-Automatik HG-Fzg" UWORD B_TRUE 1 100 0 1 BIT_MASK 0x4 FORMAT "%13.11" ECU_ADDRESS 0xFDCA /end MEASUREMENT
/begin MEASUREMENT B_staa "Bedingung Startadaption aktiv im Nachstart" UWORD B_TRUE 1 100 0 1 BIT_MASK 0x1000 FORMAT "%13.11" ECU_ADDRESS 0xFDCE /end MEASUREMENT
/begin MEASUREMENT B_su "Bedingung Saugrohrumschaltung" UWORD B_TRUE 1 100 0 1 BIT_MASK 0x8000 FORMAT "%13.11" ECU_ADDRESS 0xFD48 /end MEASUREMENT
/begin MEASUREMENT B_syn "Bedingung Synchronisation erfolgt" UWORD B_TRUE 1 100 0 1 BIT_MASK 0x2000 FORMAT "%13.11" ECU_ADDRESS 0xFDCE /end MEASUREMENT
/begin MEASUREMENT B_synph "Bedingung Synchronisation Phase" UWORD B_TRUE 1 100 0 1 BIT_MASK 0x1 FORMAT "%13.11" ECU_ADDRESS 0xFD4A /end MEASUREMENT
/begin MEASUREMENT B_temin "Bedingung TEMIN-Begrenzung aktiv, Bank 1" UWORD B_TRUE 1 100 0 1 BIT_MASK 0x40 FORMAT "%13.11" ECU_ADDRESS 0xFD2A /end MEASUREMENT
/begin MEASUREMENT B_temin2 "Bedingung TEMIN-Begrenzung aktiv, Bank 2" UWORD B_TRUE 1 100 0 1 BIT_MASK 0x80 FORMAT "%13.11" ECU_ADDRESS 0xFD2A /end MEASUREMENT
/begin MEASUREMENT B_teza "Bedingung Tankentlüftung zwangsaktiv" UWORD B_TRUE 1 100 0 1 BIT_MASK 0x4000 FORMAT "%13.11" ECU_ADDRESS 0xFDCE /end MEASUREMENT
/begin MEASUREMENT B_tfst2ok "CAN: Fuellstandssignal Geber 2 okay" UWORD B_TRUE 1 100 0 1 BIT_MASK 0x8000 FORMAT "%13.11" ECU_ADDRESS 0xFDCE /end MEASUREMENT
/begin MEASUREMENT B_tfstok "CAN: Fuellstandssignal Geber 1 okay" UWORD B_TRUE 1 100 0 1 BIT_MASK 0x1 FORMAT "%13.11" ECU_ADDRESS 0xFDD0 /end MEASUREMENT
/begin MEASUREMENT B_tfu "Bedingung Temperaturfühler Umgebung vorhanden" UWORD B_TRUE 1 100 0 1 BIT_MASK 0x10 FORMAT "%13.11" ECU_ADDRESS 0xFDC6 /end MEASUREMENT
/begin MEASUREMENT B_tnaset "" UWORD B_TRUE 1 100 0 1 BIT_MASK 0x2 FORMAT "%13.11" ECU_ADDRESS 0xFD4A /end MEASUREMENT
/begin MEASUREMENT B_Tper10msAllZ "" UWORD B_TRUE 1 100 0 1 BIT_MASK 0x200 FORMAT "%13.11" ECU_ADDRESS 0xFD4A /end MEASUREMENT
/begin MEASUREMENT B_uhrrmin "Bedingung Uhr mit relativem Minutenzähler" UWORD B_TRUE 1 100 0 1 BIT_MASK 0x20 FORMAT "%13.11" ECU_ADDRESS 0xFDC6 /end MEASUREMENT
/begin MEASUREMENT B_uhrrsec "Bedingung Uhr mit relativem Sekundenzähler" UWORD B_TRUE 1 100 0 1 BIT_MASK 0x40 FORMAT "%13.11" ECU_ADDRESS 0xFDC6 /end MEASUREMENT
/begin MEASUREMENT B_wdksap "DK-Steuerung über Festwert, Bit 1 hat Priorität" UWORD B_TRUE 1 100 0 1 BIT_MASK 0x4 FORMAT "%13.11" ECU_ADDRESS 0xFD4A /end MEASUREMENT
/begin MEASUREMENT B_xff "Bedingung externer Freeze Frame" UBYTE B_TRUE 1 100 0 1 BIT_MASK 0x1 FORMAT "%13.11" ECU_ADDRESS 0x382FFC /end MEASUREMENT
/begin MEASUREMENT B_zadsti "Geberrad-Adaption stoppen wegen ti (Sprit) -> Verbrenng. im Schub (B_sa) möglich" UWORD B_TRUE 1 100 0 1 BIT_MASK 0x2 FORMAT "%13.11" ECU_ADDRESS 0xFDD0 /end MEASUREMENT
/begin MEASUREMENT B_zwappl "Bedingung Zündwinkelapplikation ohne Drehmomenteingriffe" UWORD B_TRUE 1 100 0 1 BIT_MASK 0x8 FORMAT "%13.11" ECU_ADDRESS 0xFD4A /end MEASUREMENT
/begin MEASUREMENT B_zwvs "Bedingung für schnellen äußeren ZW-Eingriff der Momentenschnittstelle" UWORD B_TRUE 1 100 0 1 BIT_MASK 0x800 FORMAT "%13.11" ECU_ADDRESS 0xFD22 /end MEASUREMENT
/begin MEASUREMENT B_zwvz "Bedingung für Zündwinkeleingriff der Momentenschnittstelle" UWORD B_TRUE 1 100 0 1 BIT_MASK 0x1000 FORMAT "%13.11" ECU_ADDRESS 0xFD22 /end MEASUREMENT
/begin MEASUREMENT B_zwvzm "" UWORD B_TRUE 1 100 0 1 BIT_MASK 0x200 FORMAT "%13.11" ECU_ADDRESS 0xFD24 /end MEASUREMENT
/begin MEASUREMENT cd_bits1_w "" UWORD dez 1 100 0 65535 FORMAT "%8.2" ECU_ADDRESS 0x38104A /end MEASUREMENT
/begin MEASUREMENT cd_bits2_w "" UWORD dez 1 100 0 65535 FORMAT "%8.2" ECU_ADDRESS 0x38104C /end MEASUREMENT
/begin MEASUREMENT cw_erfil "Status Codewort Filtervariante für Ausgabe der AS-Fehler an GST" UBYTE dez 1 100 0 255 FORMAT "%5.1" ECU_ADDRESS 0x380CE9 /end MEASUREMENT
/begin MEASUREMENT cw_obd "Status Codewort CWOBD" UBYTE dez 1 100 0 255 FORMAT "%5.1" ECU_ADDRESS 0x380CEA /end MEASUREMENT
/begin MEASUREMENT cyclebg_w "" UWORD runtime2_sy 1 100 0 838848 FORMAT "%8.1" ECU_ADDRESS 0x382508 /end MEASUREMENT
/begin MEASUREMENT dftea "Faktor Gemischadaption bei Tankentlüftung Abweichung von 1" UBYTE dez 1 100 0 255 FORMAT "%5.1" ECU_ADDRESS 0x380D2C /end MEASUREMENT
/begin MEASUREMENT dlamatr2_w "Delta Lambdasoll aus Abgastemperaturregelung Bank 2" UWORD fak_uw_b16 1 100 0 15.9998 FORMAT "%8.5" ECU_ADDRESS 0x382630 /end MEASUREMENT
/begin MEASUREMENT dlamatr_w "Delta Lambdasoll aus Abgastemperaturregelung" UWORD fak_uw_b16 1 100 0 15.9998 FORMAT "%8.5" ECU_ADDRESS 0x382632 /end MEASUREMENT
/begin MEASUREMENT dlambts_w "Delta Lambda für Bauteileschutz" UWORD fak_uw_b16 1 100 0 15.9998 FORMAT "%8.5" ECU_ADDRESS 0x382634 /end MEASUREMENT
/begin MEASUREMENT dlsd_w "Dämpfung PT2-Filter in Lastschlagdämpfung" UWORD fak_uw_b2 1 100 0 1.99997 FORMAT "%8.6" ECU_ADDRESS 0x382418 /end MEASUREMENT
/begin MEASUREMENT dmaufr_w "Delta Aufregelmoment" UWORD rel_uw_b100 1 100 0 99.9985 FORMAT "%8.5" ECU_ADDRESS 0x38107E /end MEASUREMENT
/begin MEASUREMENT dmdpo_w "delta Moment Dashpot-Ausloesung" SWORD rel_sw_b100 1 100 -100 99.9969 FORMAT "%8.4" ECU_ADDRESS 0x38241A /end MEASUREMENT
/begin MEASUREMENT dmdpu_w "delta Moment Dashpot-Ende" SWORD rel_sw_b100 1 100 -100 99.9969 FORMAT "%8.4" ECU_ADDRESS 0x38241C /end MEASUREMENT
/begin MEASUREMENT dmlsdo_w "Delta Moment Auslösung Lastschlagdämpfung" SWORD rel_sw_b100 1 100 -100 99.9969 FORMAT "%8.4" ECU_ADDRESS 0x38241E /end MEASUREMENT
/begin MEASUREMENT dmlsdu_w "Delta Moment Ende Lastschlagdämpfung" SWORD rel_sw_b100 1 100 -100 99.9969 FORMAT "%8.4" ECU_ADDRESS 0x382420 /end MEASUREMENT
/begin MEASUREMENT dmnmxi_w "Drehmoment aus Integralanteil der NMAX-Regelung" SWORD rel_sw_b100 1 100 -100 99.9969 FORMAT "%8.4" ECU_ADDRESS 0x381218 /end MEASUREMENT
/begin MEASUREMENT dmnmxp_w "Drehmoment aus Proportionalanteil der NMAX-Regelung" SWORD rel_sw_b100 1 100 -100 99.9969 FORMAT "%8.4" ECU_ADDRESS 0x38121A /end MEASUREMENT
/begin MEASUREMENT dmrac "Reservemoment für AC-Kompressor" UBYTE rel_ub_b99p6 1 100 0 99.6094 FORMAT "%5.2" ECU_ADDRESS 0x380CD3 /end MEASUREMENT
/begin MEASUREMENT dmrkat "" UBYTE rel_ub_b99p6 1 100 0 99.6094 FORMAT "%5.2" ECU_ADDRESS 0x380B01 /end MEASUREMENT
/begin MEASUREMENT dmrkt_w "Momentenreserve im Kurztrip" UWORD rel_uw_b100 1 100 0 99.9985 FORMAT "%8.5" ECU_ADDRESS 0x381476 /end MEASUREMENT
/begin MEASUREMENT dmvadfk_w "Delta-Motordrehmoment aus Verlustmoment-Adaption (B_fs=1 & B_ko=1)" SWORD rel_sw_b100 1 100 -100 99.9969 FORMAT "%8.4" ECU_ADDRESS 0x383A2A /end MEASUREMENT
/begin MEASUREMENT dmvadfs_w "Delta-Motordrehmoment aus Verlustmoment-Adaption (B_fs=1)" SWORD rel_sw_b100 1 100 -100 99.9969 FORMAT "%8.4" ECU_ADDRESS 0x383A2C /end MEASUREMENT
/begin MEASUREMENT dmvadko_w "Delta-Motordrehmoment aus Verlustmoment-Adaption (B_ko=1)" SWORD rel_sw_b100 1 100 -100 99.9969 FORMAT "%8.4" ECU_ADDRESS 0x383A2E /end MEASUREMENT
/begin MEASUREMENT dmvadll_w "Delta-Motordrehmoment aus Verlustmoment-Adaption (B_ll=1)" SWORD rel_sw_b100 1 100 -100 99.9969 FORMAT "%8.4" ECU_ADDRESS 0x383A30 /end MEASUREMENT
/begin MEASUREMENT dmvad_w "Delta-Motordrehmoment aus Verlustmoment-Adaption" SWORD rel_sw_b100 1 100 -100 99.9969 FORMAT "%8.4" ECU_ADDRESS 0x3823EC /end MEASUREMENT
/begin MEASUREMENT dmvamnfk_w "Minimalbegrenzung der Verlustmomentadaption (B_fs=1 & B_ko=1)" SWORD rel_sw_b100 1 100 -100 99.9969 FORMAT "%8.4" ECU_ADDRESS 0x3823EE /end MEASUREMENT
/begin MEASUREMENT dmvamnfs_w "Minimalbegrenzung der Verlustmomentadaption (B_fs=1)" SWORD rel_sw_b100 1 100 -100 99.9969 FORMAT "%8.4" ECU_ADDRESS 0x3823F0 /end MEASUREMENT
/begin MEASUREMENT dmvamnko_w "Minimalbegrenzung der Verlustmomentadaption (B_ko=1)" SWORD rel_sw_b100 1 100 -100 99.9969 FORMAT "%8.4" ECU_ADDRESS 0x3823F2 /end MEASUREMENT
/begin MEASUREMENT dmvamnll_w "Minimalbegrenzung der Verlustmomentadaption (B_ll=1)" SWORD rel_sw_b100 1 100 -100 99.9969 FORMAT "%8.4" ECU_ADDRESS 0x3823F4 /end MEASUREMENT
/begin MEASUREMENT dmvamxfk_w "0aximalbegrenzung der Verlustmomentadaption (B_fs=1 & B_ko=1)" SWORD rel_sw_b100 1 100 -100 99.9969 FORMAT "%8.4" ECU_ADDRESS 0x3823F6 /end MEASUREMENT
/begin MEASUREMENT dmvamxfs_w "Maximalbegrenzung der Verlustmomentadaption (B_fs=1)" SWORD rel_sw_b100 1 100 -100 99.9969 FORMAT "%8.4" ECU_ADDRESS 0x3823F8 /end MEASUREMENT
/begin MEASUREMENT dmvamxko_w "Maximalbegrenzung der Verlustmomentadaption (B_ko=1)" SWORD rel_sw_b100 1 100 -100 99.9969 FORMAT "%8.4" ECU_ADDRESS 0x3823FA /end MEASUREMENT
/begin MEASUREMENT dmvamxll_w "Maximalbegrenzung der Verlustmomentadaption (B_ll=1)" SWORD rel_sw_b100 1 100 -100 99.9969 FORMAT "%8.4" ECU_ADDRESS 0x3823FC /end MEASUREMENT
/begin MEASUREMENT dmverl_w "Verlustmoment nach DT1-Filter" SWORD rel_sw_b100 1 100 -100 99.9969 FORMAT "%8.4" ECU_ADDRESS 0x3823DC /end MEASUREMENT
/begin MEASUREMENT dmzms_w "Abstand des indizierten Sollmoments vom zulässigen Sollmoment" SWORD rel_sw_b100 1 100 -100 99.9969 FORMAT "%8.4" ECU_ADDRESS 0x38105C /end MEASUREMENT
/begin MEASUREMENT dnsi_w "Differenz zwischen Soll- und Ist-Motordrehzahl" SWORD nmot_sw_q0p25 1 100 -8192 8191.75 FORMAT "%8.3" ECU_ADDRESS 0x38121C /end MEASUREMENT
/begin MEASUREMENT dnturb "Turbinendrehzahldifferenz des Wandlers" SBYTE nmot_sb_q20 1 100 -2560 2540 FORMAT "%5.0" ECU_ADDRESS 0x380CD6 /end MEASUREMENT
/begin MEASUREMENT drlfue_w "Lastkorrektur des Füllungsreglers" SWORD rel_sw_q0p0234 1 100 -768 767.977 FORMAT "%8.4" ECU_ADDRESS 0x380090 /end MEASUREMENT
/begin MEASUREMENT drlsol_w "Änderung Sollfüllung" SWORD rel_sw_q0p0234 1 100 -768 767.977 FORMAT "%8.4" ECU_ADDRESS 0xFA1A /end MEASUREMENT
/begin MEASUREMENT dtmuems "Differenz maximal zulässige Motortemperatur bei Überhitzung" UBYTE temp_sb_q0p75 1 100 0 191.25 FORMAT "%5.1" ECU_ADDRESS 0x380CE8 /end MEASUREMENT
/begin MEASUREMENT dzwi "Delta Zündwinkel zwischen zwopt und zwout" SBYTE zw_sb_q0p75 1 100 -96 95.25 FORMAT "%5.2" ECU_ADDRESS 0x38091C /end MEASUREMENT
/begin MEASUREMENT dzwnwsu "" SBYTE zw_sb_q0p75 1 100 -96 95.25 FORMAT "%5.2" ECU_ADDRESS 0x38008C /end MEASUREMENT
/begin MEASUREMENT dzws "Delta Zündwinekl zwischen zwopt und zwsol" SBYTE zw_sb_q0p75 1 100 -96 95.25 FORMAT "%5.2" ECU_ADDRESS 0x380A06 /end MEASUREMENT
/begin MEASUREMENT d_tol1 "Modelltemperaturanteil aus tmot" UWORD temp_uw_q0p0029_o48 1 100 -48 143.998 ECU_ADDRESS 0x382074 /end MEASUREMENT
/begin MEASUREMENT d_tol2 "Modelltemperaturanteil aus n_mot und rl" UWORD temp_uw_q0p0029_o48 1 100 -48 143.998 ECU_ADDRESS 0x382076 /end MEASUREMENT
/begin MEASUREMENT d_tol3 "Modelltemperaturanteil aus tumg und vfz" UWORD temp_uw_q0p0029_o48 1 100 -48 143.998 ECU_ADDRESS 0x382078 /end MEASUREMENT
/begin MEASUREMENT esst_san12esuw "" UWORD dez 1 100 0 65535 FORMAT "%8.2" ECU_ADDRESS 0xE46E /end MEASUREMENT
/begin MEASUREMENT esst_sdk10teub "" UWORD dez 1 100 0 65535 FORMAT "%8.2" ECU_ADDRESS 0xE470 /end MEASUREMENT
/begin MEASUREMENT esst_set08ldub "" UWORD dez 1 100 0 65535 FORMAT "%8.2" ECU_ADDRESS 0x381E42 /end MEASUREMENT
/begin MEASUREMENT esst_sez06tmub "" UWORD dez 1 100 0 65535 FORMAT "%8.2" ECU_ADDRESS 0x381E44 /end MEASUREMENT
/begin MEASUREMENT esst_sfr05teub "" UWORD dez 1 100 0 65535 FORMAT "%8.2" ECU_ADDRESS 0xE472 /end MEASUREMENT
/begin MEASUREMENT esst_sga07mdub "" UWORD dez 1 100 0 65535 FORMAT "%8.2" ECU_ADDRESS 0x381E46 /end MEASUREMENT
/begin MEASUREMENT esst_sga08mdub "" UWORD dez 1 100 0 65535 FORMAT "%8.2" ECU_ADDRESS 0xE474 /end MEASUREMENT
/begin MEASUREMENT esst_sks06esub "" UWORD dez 1 100 0 65535 FORMAT "%8.2" ECU_ADDRESS 0xE476 /end MEASUREMENT
/begin MEASUREMENT esst_slx06tmuw "" UWORD dez 1 100 0 65535 FORMAT "%8.2" ECU_ADDRESS 0x381E48 /end MEASUREMENT
/begin MEASUREMENT esst_sly06tmuw "" UWORD dez 1 100 0 65535 FORMAT "%8.2" ECU_ADDRESS 0x381E4A /end MEASUREMENT
/begin MEASUREMENT esst_smk06mdsw "" SWORD dez 1 100 -32768 32767 FORMAT "%8.2" ECU_ADDRESS 0xE3F8 /end MEASUREMENT
/begin MEASUREMENT esst_sml05dkub "" UWORD dez 1 100 0 65535 FORMAT "%8.2" ECU_ADDRESS 0x381E4C /end MEASUREMENT
/begin MEASUREMENT esst_sml05lkub "" UWORD dez 1 100 0 65535 FORMAT "%8.2" ECU_ADDRESS 0xE478 /end MEASUREMENT
/begin MEASUREMENT esst_sml05tmuw "" UWORD dez 1 100 0 65535 FORMAT "%8.2" ECU_ADDRESS 0xE47A /end MEASUREMENT
/begin MEASUREMENT esst_sml06teub "" UWORD dez 1 100 0 65535 FORMAT "%8.2" ECU_ADDRESS 0xE47C /end MEASUREMENT
/begin MEASUREMENT esst_sml06tmub "" UWORD dez 1 100 0 65535 FORMAT "%8.2" ECU_ADDRESS 0x381E4E /end MEASUREMENT
/begin MEASUREMENT esst_sml07tmub "" UWORD dez 1 100 0 65535 FORMAT "%8.2" ECU_ADDRESS 0xE47E /end MEASUREMENT
/begin MEASUREMENT esst_sml07tmuw "" UWORD dez 1 100 0 65535 FORMAT "%8.2" ECU_ADDRESS 0x381E50 /end MEASUREMENT
/begin MEASUREMENT esst_sml08lhub "" UWORD dez 1 100 0 65535 FORMAT "%8.2" ECU_ADDRESS 0xE480 /end MEASUREMENT
/begin MEASUREMENT esst_smo08opub "" UWORD dez 1 100 0 65535 FORMAT "%8.2" ECU_ADDRESS 0x38247A /end MEASUREMENT
/begin MEASUREMENT esst_sng06llsb "" UWORD dez 1 100 0 65535 FORMAT "%8.2" ECU_ADDRESS 0xE482 /end MEASUREMENT
/begin MEASUREMENT esst_snm05dkub "" UWORD dez 1 100 0 65535 FORMAT "%8.2" ECU_ADDRESS 0xE484 /end MEASUREMENT
/begin MEASUREMENT esst_snm05tmub "" UWORD dez 1 100 0 65535 FORMAT "%8.2" ECU_ADDRESS 0x381E52 /end MEASUREMENT
/begin MEASUREMENT esst_snm06lhub "" UWORD dez 1 100 0 65535 FORMAT "%8.2" ECU_ADDRESS 0xE486 /end MEASUREMENT
/begin MEASUREMENT esst_snm06llub "" UWORD dez 1 100 0 65535 FORMAT "%8.2" ECU_ADDRESS 0xE488 /end MEASUREMENT
/begin MEASUREMENT esst_snm06mduw "" UWORD dez 1 100 0 65535 FORMAT "%8.2" ECU_ADDRESS 0xE48A /end MEASUREMENT
/begin MEASUREMENT esst_snm07esub "" UWORD dez 1 100 0 65535 FORMAT "%8.2" ECU_ADDRESS 0xE48C /end MEASUREMENT
/begin MEASUREMENT esst_snm07lrub "" UWORD dez 1 100 0 65535 FORMAT "%8.2" ECU_ADDRESS 0xE48E /end MEASUREMENT
/begin MEASUREMENT esst_snm08dmub "" UWORD dez 1 100 0 65535 FORMAT "%8.2" ECU_ADDRESS 0xE490 /end MEASUREMENT
/begin MEASUREMENT esst_snm08feub "" UWORD dez 1 100 0 65535 FORMAT "%8.2" ECU_ADDRESS 0xE492 /end MEASUREMENT
/begin MEASUREMENT esst_snm08kruw "" UWORD dez 1 100 0 65535 FORMAT "%8.2" ECU_ADDRESS 0xE494 /end MEASUREMENT
/begin MEASUREMENT esst_snm08ldub "" UWORD dez 1 100 0 65535 FORMAT "%8.2" ECU_ADDRESS 0x381E54 /end MEASUREMENT
/begin MEASUREMENT esst_snm08lduw "" UWORD dez 1 100 0 65535 FORMAT "%8.2" ECU_ADDRESS 0x381E56 /end MEASUREMENT
/begin MEASUREMENT esst_snm08lhub "" UWORD dez 1 100 0 65535 FORMAT "%8.2" ECU_ADDRESS 0xE496 /end MEASUREMENT
/begin MEASUREMENT esst_snm08opub "" UWORD dez 1 100 0 65535 FORMAT "%8.2" ECU_ADDRESS 0xE498 /end MEASUREMENT
/begin MEASUREMENT esst_snm08__ub "" UWORD dez 1 100 0 65535 FORMAT "%8.2" ECU_ADDRESS 0xE49A /end MEASUREMENT
/begin MEASUREMENT esst_snm10teub "" UWORD dez 1 100 0 65535 FORMAT "%8.2" ECU_ADDRESS 0xE49C /end MEASUREMENT
/begin MEASUREMENT esst_snm10__ub "" UWORD dez 1 100 0 65535 FORMAT "%8.2" ECU_ADDRESS 0xE49E /end MEASUREMENT
/begin MEASUREMENT esst_snm12esub "" UWORD dez 1 100 0 65535 FORMAT "%8.2" ECU_ADDRESS 0xE4A0 /end MEASUREMENT
/begin MEASUREMENT esst_snm12feub "" UWORD dez 1 100 0 65535 FORMAT "%8.2" ECU_ADDRESS 0xE4A2 /end MEASUREMENT
/begin MEASUREMENT esst_snm16feuw "" UWORD dez 1 100 0 65535 FORMAT "%8.2" ECU_ADDRESS 0xE458 /end MEASUREMENT
/begin MEASUREMENT esst_snm16krub "" UWORD dez 1 100 0 65535 FORMAT "%8.2" ECU_ADDRESS 0xE4A4 /end MEASUREMENT
/begin MEASUREMENT esst_snm16ldub "" UWORD dez 1 100 0 65535 FORMAT "%8.2" ECU_ADDRESS 0x381E58 /end MEASUREMENT
/begin MEASUREMENT esst_snm16opuw "" UWORD dez 1 100 0 65535 FORMAT "%8.2" ECU_ADDRESS 0xE45A /end MEASUREMENT
/begin MEASUREMENT esst_snm16zuub "" UWORD dez 1 100 0 65535 FORMAT "%8.2" ECU_ADDRESS 0xE45C /end MEASUREMENT
/begin MEASUREMENT esst_snm24zuub "" UWORD dez 1 100 0 65535 FORMAT "%8.2" ECU_ADDRESS 0xE45E /end MEASUREMENT
/begin MEASUREMENT esst_spl08ldub "" UWORD dez 1 100 0 65535 FORMAT "%8.2" ECU_ADDRESS 0x381E5A /end MEASUREMENT
/begin MEASUREMENT esst_srl03zuub "" UWORD dez 1 100 0 65535 FORMAT "%8.2" ECU_ADDRESS 0xE460 /end MEASUREMENT
/begin MEASUREMENT esst_srl04krub "" UWORD dez 1 100 0 65535 FORMAT "%8.2" ECU_ADDRESS 0xE4A6 /end MEASUREMENT
/begin MEASUREMENT esst_srl05tmub "" UWORD dez 1 100 0 65535 FORMAT "%8.2" ECU_ADDRESS 0x381E5C /end MEASUREMENT
/begin MEASUREMENT esst_srl06lhub "" UWORD dez 1 100 0 65535 FORMAT "%8.2" ECU_ADDRESS 0xE4A8 /end MEASUREMENT
/begin MEASUREMENT esst_srl06lrub "" UWORD dez 1 100 0 65535 FORMAT "%8.2" ECU_ADDRESS 0xE4AA /end MEASUREMENT
/begin MEASUREMENT esst_srl08dmub "" UWORD dez 1 100 0 65535 FORMAT "%8.2" ECU_ADDRESS 0xE4AC /end MEASUREMENT
/begin MEASUREMENT esst_srl12esub "" UWORD dez 1 100 0 65535 FORMAT "%8.2" ECU_ADDRESS 0xE4AE /end MEASUREMENT
/begin MEASUREMENT esst_srl12zuub "" UWORD dez 1 100 0 65535 FORMAT "%8.2" ECU_ADDRESS 0xE462 /end MEASUREMENT
/begin MEASUREMENT esst_srl16zuub "" UWORD dez 1 100 0 65535 FORMAT "%8.2" ECU_ADDRESS 0xE464 /end MEASUREMENT
/begin MEASUREMENT esst_st107tmub "" UWORD dez 1 100 0 65535 FORMAT "%8.2" ECU_ADDRESS 0x381E5E /end MEASUREMENT
/begin MEASUREMENT esst_st207tmub "" UWORD dez 1 100 0 65535 FORMAT "%8.2" ECU_ADDRESS 0x381E60 /end MEASUREMENT
/begin MEASUREMENT esst_st307tmub "" UWORD dez 1 100 0 65535 FORMAT "%8.2" ECU_ADDRESS 0x381E62 /end MEASUREMENT
/begin MEASUREMENT esst_st407tmub "" UWORD dez 1 100 0 65535 FORMAT "%8.2" ECU_ADDRESS 0x381E64 /end MEASUREMENT
/begin MEASUREMENT esst_sta06esub "" UWORD dez 1 100 0 65535 FORMAT "%8.2" ECU_ADDRESS 0x381E66 /end MEASUREMENT
/begin MEASUREMENT esst_sta06__ub "" UWORD dez 1 100 0 65535 FORMAT "%8.2" ECU_ADDRESS 0x381E68 /end MEASUREMENT
/begin MEASUREMENT esst_sta08ldub "" UWORD dez 1 100 0 65535 FORMAT "%8.2" ECU_ADDRESS 0x381E6A /end MEASUREMENT
/begin MEASUREMENT esst_stm04msuw "" UWORD dez 1 100 0 65535 FORMAT "%8.2" ECU_ADDRESS 0xE4B0 /end MEASUREMENT
/begin MEASUREMENT esst_stm04saub "" UWORD dez 1 100 0 65535 FORMAT "%8.2" ECU_ADDRESS 0x381E6C /end MEASUREMENT
/begin MEASUREMENT esst_stm04__ub "" UWORD dez 1 100 0 65535 FORMAT "%8.2" ECU_ADDRESS 0xE4B2 /end MEASUREMENT
/begin MEASUREMENT esst_stm05saub "" UWORD dez 1 100 0 65535 FORMAT "%8.2" ECU_ADDRESS 0x381E6E /end MEASUREMENT
/begin MEASUREMENT esst_stm05tmub "" UWORD dez 1 100 0 65535 FORMAT "%8.2" ECU_ADDRESS 0xE4B4 /end MEASUREMENT
/begin MEASUREMENT esst_stm06llub "" UWORD dez 1 100 0 65535 FORMAT "%8.2" ECU_ADDRESS 0x381E70 /end MEASUREMENT
/begin MEASUREMENT esst_stm06__ub "" UWORD dez 1 100 0 65535 FORMAT "%8.2" ECU_ADDRESS 0x381E72 /end MEASUREMENT
/begin MEASUREMENT esst_stm08dmub "" UWORD dez 1 100 0 65535 FORMAT "%8.2" ECU_ADDRESS 0xE4B6 /end MEASUREMENT
/begin MEASUREMENT esst_stm08leub "" UWORD dez 1 100 0 65535 FORMAT "%8.2" ECU_ADDRESS 0xE4B8 /end MEASUREMENT
/begin MEASUREMENT esst_stm08__ub "" UWORD dez 1 100 0 65535 FORMAT "%8.2" ECU_ADDRESS 0x381E74 /end MEASUREMENT
/begin MEASUREMENT esst_stm09esub "" UWORD dez 1 100 0 65535 FORMAT "%8.2" ECU_ADDRESS 0xE4BA /end MEASUREMENT
/begin MEASUREMENT esst_stm12esub "" UWORD dez 1 100 0 65535 FORMAT "%8.2" ECU_ADDRESS 0x381E76 /end MEASUREMENT
/begin MEASUREMENT esst_stn12esub "" UWORD dez 1 100 0 65535 FORMAT "%8.2" ECU_ADDRESS 0x381E78 /end MEASUREMENT
/begin MEASUREMENT esst_sts06tmuw "" UWORD dez 1 100 0 65535 FORMAT "%8.2" ECU_ADDRESS 0x381E7A /end MEASUREMENT
/begin MEASUREMENT esst_sts08esub "" UWORD dez 1 100 0 65535 FORMAT "%8.2" ECU_ADDRESS 0x381E7C /end MEASUREMENT
/begin MEASUREMENT esst_sts12esub "" UWORD dez 1 100 0 65535 FORMAT "%8.2" ECU_ADDRESS 0x381E7E /end MEASUREMENT
/begin MEASUREMENT esst_stu05tmub "" UWORD dez 1 100 0 65535 FORMAT "%8.2" ECU_ADDRESS 0xE4BC /end MEASUREMENT
/begin MEASUREMENT esst_stw06mdub "" UWORD dez 1 100 0 65535 FORMAT "%8.2" ECU_ADDRESS 0x381E80 /end MEASUREMENT
/begin MEASUREMENT esst_sub06__ub "" UWORD dez 1 100 0 65535 FORMAT "%8.2" ECU_ADDRESS 0x381E82 /end MEASUREMENT
/begin MEASUREMENT esst_svr08ldub "" UWORD dez 1 100 0 65535 FORMAT "%8.2" ECU_ADDRESS 0x381E84 /end MEASUREMENT
/begin MEASUREMENT esst_swd06krsw "" UWORD dez 1 100 0 65535 FORMAT "%8.2" ECU_ADDRESS 0xE4BE /end MEASUREMENT
/begin MEASUREMENT esst_swn10feub "" UWORD dez 1 100 0 65535 FORMAT "%8.2" ECU_ADDRESS 0xE466 /end MEASUREMENT
/begin MEASUREMENT esst_swp08ldub "" UWORD dez 1 100 0 65535 FORMAT "%8.2" ECU_ADDRESS 0x381E86 /end MEASUREMENT
/begin MEASUREMENT esst_swp08opub "" UWORD dez 1 100 0 65535 FORMAT "%8.2" ECU_ADDRESS 0xE468 /end MEASUREMENT
/begin MEASUREMENT etabasf_w "Gefiltertes etabas_w" UWORD rel_uw_b100 1 100 0 99.9985 FORMAT "%8.5" ECU_ADDRESS 0x381228 /end MEASUREMENT
/begin MEASUREMENT etabas_w "multiplizierter zw und lambda-Wirkungsgrad" UWORD rel_uw_b100 1 100 0 99.9985 FORMAT "%8.5" ECU_ADDRESS 0x38122A /end MEASUREMENT
/begin MEASUREMENT etazaist "Ist-Zylinderausblendungswirkungsgrad" UBYTE rel_ub_b127p5 1 100 0 127.5 FORMAT "%5.1" ECU_ADDRESS 0x38091D /end MEASUREMENT
/begin MEASUREMENT etazwist "Ist-Zündwinkelwirkungsgrad" UBYTE rel_ub_b127p5 1 100 0 127.5 FORMAT "%5.1" ECU_ADDRESS 0x38091E /end MEASUREMENT
/begin MEASUREMENT etazws "Sollzündwinkelwirkungsgrad" UBYTE rel_ub_b127p5 1 100 0 127.5 FORMAT "%5.1" ECU_ADDRESS 0x380A07 /end MEASUREMENT
/begin MEASUREMENT flamsl2_w "Faktor Lambdaänderung durch Sekundärluft, Bank 2" UWORD fak_uw_b16 1 100 0 15.9998 FORMAT "%8.5" ECU_ADDRESS 0x380E9E /end MEASUREMENT
/begin MEASUREMENT flamsl_w "Faktor Lambdaänderung durch Sekundärluft" UWORD fak_uw_b16 1 100 0 15.9998 FORMAT "%8.5" ECU_ADDRESS 0x380EA0 /end MEASUREMENT
/begin MEASUREMENT flmssl "Faktor Lambda-Motor-Soll-Sekundärluftanteil" UBYTE fak_ub_b1 1 100 0 0.996094 ECU_ADDRESS 0x380A95 /end MEASUREMENT
/begin MEASUREMENT flr_ap "LR: Fettverschiebung durch TV-Verstellung mittels VS23" UBYTE dez 1 100 0 255 FORMAT "%5.1" ECU_ADDRESS 0x38008D /end MEASUREMENT
/begin MEASUREMENT fmibgrv_w "Regelfaktor für Korrektur gangabhängige Momentenbegrenzung vor Filterung" UWORD fak_uw_b2 1 100 0 1.99997 FORMAT "%8.6" ECU_ADDRESS 0x382464 /end MEASUREMENT
/begin MEASUREMENT fmibgr_w "Regelfaktor für Korrektur gangabhängige Momentenbegrenzung" UWORD fak_uw_b2 1 100 0 1.99997 FORMAT "%8.6" ECU_ADDRESS 0x382466 /end MEASUREMENT
/begin MEASUREMENT fmil_w "Faktor rel/ind Moment" UWORD rel_uw_b200 1 100 0 199.997 FORMAT "%8.4" ECU_ADDRESS 0x382422 /end MEASUREMENT
/begin MEASUREMENT fmsagd "Korrekturfaktor Abgasgegendruck der Sekundärluftmasse" UBYTE fak_ub_b2 1 100 0 1.99219 FORMAT "%5.3" ECU_ADDRESS 0x380A96 /end MEASUREMENT
/begin MEASUREMENT fmsldyn "Faktor Dynamikbeschreibung Sekundärluft" UBYTE fak_ub_b1 1 100 0 0.996094 ECU_ADDRESS 0x380A97 /end MEASUREMENT
/begin MEASUREMENT fmslrho "Dichtekorrektur der Sekundärluftmasse" UBYTE fak_ub_b2 1 100 0 1.99219 FORMAT "%5.3" ECU_ADDRESS 0x380A98 /end MEASUREMENT
/begin MEASUREMENT fmsltm "tmot- Korrektur der Sekundärluftmasse" UBYTE fak_ub_b2 1 100 0 1.99219 FORMAT "%5.3" ECU_ADDRESS 0x380A99 /end MEASUREMENT
/begin MEASUREMENT fnstab_w "Faktor zur Stabilisierung mittels Drehzahlquotient" UWORD fak_uw_b8 1 100 0 7.99988 FORMAT "%8.6" ECU_ADDRESS 0x3823D8 /end MEASUREMENT
/begin MEASUREMENT frdter_w "Faktor Regelung Referenz für TE-Diagnose" UWORD B_TRUE 1 100 0 1 FORMAT "%13.11" ECU_ADDRESS 0x382636 /end MEASUREMENT
/begin MEASUREMENT fslpdyn "Faktor Dynamikbeschreibung Sekundärluftpumpe" UBYTE fak_ub_b1 1 100 0 0.996094 ECU_ADDRESS 0x380A9A /end MEASUREMENT
/begin MEASUREMENT ftek2_w "Korrekturfaktor für effektive Einspritzzeit" UWORD fak_uw_b2 1 100 0 1.99997 FORMAT "%8.6" ECU_ADDRESS 0x3811BA /end MEASUREMENT
/begin MEASUREMENT ftek_w "Korrekturfaktor für effektive Einspritzzeit" UWORD fak_uw_b2 1 100 0 1.99997 FORMAT "%8.6" ECU_ADDRESS 0x3811BC /end MEASUREMENT
/begin MEASUREMENT fuka "ÜK-Adaptions-Faktor" UBYTE fak_ub_b4 1 100 0 3.98438 FORMAT "%5.3" ECU_ADDRESS 0x380D2D /end MEASUREMENT
/begin MEASUREMENT imlsla_w "Luftmassenintegral für Einbringen der Sekundärluft" UWORD m_uw_b4660 1 100 0 4660.27 FORMAT "%8.3" ECU_ADDRESS 0x380EA2 /end MEASUREMENT
/begin MEASUREMENT imlsle_w "Luftmassenintegral für Ende der Sekundärluft im Abgas" UWORD m_uw_b4660 1 100 0 4660.27 FORMAT "%8.3" ECU_ADDRESS 0x380EA4 /end MEASUREMENT
/begin MEASUREMENT inmax "Initialisierungswert Integrator für NMAX-Regelung" SBYTE rel_sb_q0p78 1 100 -99.84 99.06 FORMAT "%5.2" ECU_ADDRESS 0x380B4A /end MEASUREMENT
/begin MEASUREMENT iwflsd_w "Initialisierungswert Filter Lastschlagdämpfung" UWORD rel_uw_b100 1 100 0 99.9985 FORMAT "%8.5" ECU_ADDRESS 0x382424 /end MEASUREMENT
/begin MEASUREMENT kf_out2 "KFMTOL2-Ausgang" UBYTE temp_ub_q0p75_o48 1 100 -48 143.25 FORMAT "%5.1" ECU_ADDRESS 0x380C4B /end MEASUREMENT
/begin MEASUREMENT kf_out3 "KFMTOL3-Ausgang" UBYTE temp_ub_q0p75_o48 1 100 -48 143.25 FORMAT "%5.1" ECU_ADDRESS 0x380C4C /end MEASUREMENT
/begin MEASUREMENT kopwm "Klimakompressor-Signal als PWM-Signal" UBYTE rel_ub_b99p6 1 100 0 99.6094 FORMAT "%5.2" ECU_ADDRESS 0x380D2E /end MEASUREMENT
/begin MEASUREMENT kstaa "Aktueller Startmengenadaptionsfaktor" UBYTE fak_ub_b2 1 100 0 1.99219 FORMAT "%5.3" ECU_ADDRESS 0x380D2F /end MEASUREMENT
/begin MEASUREMENT lamatr2_w "Lambdasoll aus Abgastemperaturregelung Bank 2" UWORD fak_uw_b16 1 100 0 15.9998 FORMAT "%8.5" ECU_ADDRESS 0x382638 /end MEASUREMENT
/begin MEASUREMENT lamatr_w "Lambdasoll aus Abgastemperaturregelung" UWORD fak_uw_b16 1 100 0 15.9998 FORMAT "%8.5" ECU_ADDRESS 0x38263A /end MEASUREMENT
/begin MEASUREMENT lambts_w "Lambda für Bauteileschutz" UWORD fak_uw_b16 1 100 0 15.9998 FORMAT "%8.5" ECU_ADDRESS 0x38263C /end MEASUREMENT
/begin MEASUREMENT laufz100_w "" UWORD runtime1_sy 1 100 0 52428 FORMAT "%8.2" ECU_ADDRESS 0x38250A /end MEASUREMENT
/begin MEASUREMENT laufz10m_w "" UWORD runtime1_sy 1 100 0 52428 FORMAT "%8.2" ECU_ADDRESS 0x38250C /end MEASUREMENT
/begin MEASUREMENT laufz1m_w "" UWORD runtime1_sy 1 100 0 52428 FORMAT "%8.2" ECU_ADDRESS 0x38250E /end MEASUREMENT
/begin MEASUREMENT laufz1s_w "" UWORD runtime1_sy 1 100 0 52428 FORMAT "%8.2" ECU_ADDRESS 0x382510 /end MEASUREMENT
/begin MEASUREMENT laufz200_w "" UWORD runtime1_sy 1 100 0 52428 FORMAT "%8.2" ECU_ADDRESS 0x382512 /end MEASUREMENT
/begin MEASUREMENT laufz20m_w "" UWORD runtime1_sy 1 100 0 52428 FORMAT "%8.2" ECU_ADDRESS 0x382514 /end MEASUREMENT
/begin MEASUREMENT laufz2m_w "" UWORD runtime1_sy 1 100 0 52428 FORMAT "%8.2" ECU_ADDRESS 0x382516 /end MEASUREMENT
/begin MEASUREMENT laufz50m_w "" UWORD runtime1_sy 1 100 0 52428 FORMAT "%8.2" ECU_ADDRESS 0x382518 /end MEASUREMENT
/begin MEASUREMENT laufzbg_w "" UWORD runtime1_sy 1 100 0 52428 FORMAT "%8.2" ECU_ADDRESS 0x38251A /end MEASUREMENT
/begin MEASUREMENT laufzsyn_w "" UWORD runtime1_sy 1 100 0 52428 FORMAT "%8.2" ECU_ADDRESS 0x38251C /end MEASUREMENT
/begin MEASUREMENT losphctr "" UBYTE dez 1 100 0 255 FORMAT "%5.1" ECU_ADDRESS 0x382FE0 /end MEASUREMENT
/begin MEASUREMENT lzmaxnmot "" UBYTE nmot_ub_q40 1 100 0 10200 FORMAT "%5.0" ECU_ADDRESS 0x380CEB /end MEASUREMENT
/begin MEASUREMENT lzmaxrl "" UBYTE rel_ub_b99p6 1 100 0 99.6094 FORMAT "%5.2" ECU_ADDRESS 0x380CEC /end MEASUREMENT
/begin MEASUREMENT lzmaxstate "" UBYTE dez 1 100 0 255 FORMAT "%5.1" ECU_ADDRESS 0x380CED /end MEASUREMENT
/begin MEASUREMENT lzmaxwdkba "" UBYTE relDK_ub_b100 1 100 0 100 FORMAT "%5.1" ECU_ADDRESS 0x380CEE /end MEASUREMENT
/begin MEASUREMENT lzmaxwped "" UBYTE rel_ub_b99p6 1 100 0 99.6094 FORMAT "%5.2" ECU_ADDRESS 0x380CEF /end MEASUREMENT
/begin MEASUREMENT lzs_dash "" UBYTE B_TRUE 1 100 0 1 BIT_MASK 0x10 FORMAT "%13.11" ECU_ADDRESS 0x380CED /end MEASUREMENT
/begin MEASUREMENT lzs_kr "" UBYTE B_TRUE 1 100 0 1 BIT_MASK 0x1 FORMAT "%13.11" ECU_ADDRESS 0x380CED /end MEASUREMENT
/begin MEASUREMENT lzs_ldr "" UBYTE B_TRUE 1 100 0 1 BIT_MASK 0x4 FORMAT "%13.11" ECU_ADDRESS 0x380CED /end MEASUREMENT
/begin MEASUREMENT lzs_lr "" UBYTE B_TRUE 1 100 0 1 BIT_MASK 0x2 FORMAT "%13.11" ECU_ADDRESS 0x380CED /end MEASUREMENT
/begin MEASUREMENT lzs_lsd "" UBYTE B_TRUE 1 100 0 1 BIT_MASK 0x8 FORMAT "%13.11" ECU_ADDRESS 0x380CED /end MEASUREMENT
/begin MEASUREMENT lzs_sa "" UBYTE B_TRUE 1 100 0 1 BIT_MASK 0x20 FORMAT "%13.11" ECU_ADDRESS 0x380CED /end MEASUREMENT
/begin MEASUREMENT mdindg_w "indiziertes Motormoment Hochdruckphase wenn alle Zylinder befeuert" UWORD rel_uw_b100 1 100 0 99.9985 FORMAT "%8.5" ECU_ADDRESS 0x381078 /end MEASUREMENT
/begin MEASUREMENT mdko "Momentenaufnahme Klimakompressor" UBYTE rel_ub_b99p6 1 100 0 99.6094 FORMAT "%5.2" ECU_ADDRESS 0x380CD4 /end MEASUREMENT
/begin MEASUREMENT mds_w "Motorschleppmoment" UWORD rel_uw_b100 1 100 0 99.9985 FORMAT "%8.5" ECU_ADDRESS 0x3823DE /end MEASUREMENT
/begin MEASUREMENT mdverb "Momentenbedarf der Nebenaggregate" UBYTE rel_ub_b99p6 1 100 0 99.6094 FORMAT "%5.2" ECU_ADDRESS 0x380CD5 /end MEASUREMENT
/begin MEASUREMENT mdverf_w "Gefiltertes Verlustmoment" UWORD rel_uw_b100 1 100 0 99.9985 FORMAT "%8.5" ECU_ADDRESS 0x3823E0 /end MEASUREMENT
/begin MEASUREMENT mdverl_w "Motor-Verlustmoment" UWORD rel_uw_b100 1 100 0 99.9985 FORMAT "%8.5" ECU_ADDRESS 0x3810D0 /end MEASUREMENT
/begin MEASUREMENT mdwan_w "Drehmomentaufnahme des Wandlers" SWORD rel_sw_b100 1 100 -100 99.9969 FORMAT "%8.4" ECU_ADDRESS 0x382404 /end MEASUREMENT
/begin MEASUREMENT mibdp_w "indiziertes Soll-Motormoment Dashpot" UWORD rel_uw_b100 1 100 0 99.9985 FORMAT "%8.5" ECU_ADDRESS 0x382426 /end MEASUREMENT
/begin MEASUREMENT mibeg_w "Begrenzungsmoment" UWORD rel_uw_b100 1 100 0 99.9985 FORMAT "%8.5" ECU_ADDRESS 0x38105E /end MEASUREMENT
/begin MEASUREMENT mibgrv_w "indiziertes soll-Moment für gangabhängige Momentenbegrenzung vor Regelung" UWORD rel_uw_b100 1 100 0 99.9985 FORMAT "%8.5" ECU_ADDRESS 0x382468 /end MEASUREMENT
/begin MEASUREMENT mibgr_w "indiziertes soll-Moment für gangabhängige Kupplungsmomentbegrenzung" UWORD rel_uw_b100 1 100 0 99.9985 FORMAT "%8.5" ECU_ADDRESS 0x3813D8 /end MEASUREMENT
/begin MEASUREMENT miblsd_w "Begrenztes indiziertes Moment aus Lastschlagdämpfung" UWORD rel_uw_b100 1 100 0 99.9985 FORMAT "%8.5" ECU_ADDRESS 0x382428 /end MEASUREMENT
/begin MEASUREMENT miextv_w "von extern gefordertes Moment vor Abwürgeschutz" UWORD rel_uw_b100 1 100 0 99.9985 FORMAT "%8.5" ECU_ADDRESS 0x381060 /end MEASUREMENT
/begin MEASUREMENT miext_w "von außen (ASR, GS, usw.) angefordertes indiziertes Motormoment" UWORD rel_uw_b100 1 100 0 99.9985 FORMAT "%8.5" ECU_ADDRESS 0x381062 /end MEASUREMENT
/begin MEASUREMENT mifa "indiziertes Motormoment Fahrerwunsch" UBYTE rel_ub_b99p6 1 100 0 99.6094 FORMAT "%5.2" ECU_ADDRESS 0x380910 /end MEASUREMENT
/begin MEASUREMENT mifab_w "Begrenztes indiziertes Fahrerwunschmoment" UWORD rel_uw_b100 1 100 0 99.9985 FORMAT "%8.5" ECU_ADDRESS 0x381064 /end MEASUREMENT
/begin MEASUREMENT mifafu_w "Fahrermomentenwunsch für Füllung" UWORD rel_uw_b100 1 100 0 99.9985 FORMAT "%8.5" ECU_ADDRESS 0x3811EA /end MEASUREMENT
/begin MEASUREMENT mifal_w "Indiziertes Fahrerwunschmoment für Momentenkoordination Füllung" UWORD rel_uw_b100 1 100 0 99.9985 FORMAT "%8.5" ECU_ADDRESS 0x381478 /end MEASUREMENT
/begin MEASUREMENT mifa_w "indiziertes Motormoment Fahrerwunsch" UWORD rel_uw_b100 1 100 0 99.9985 FORMAT "%8.5" ECU_ADDRESS 0x38147A /end MEASUREMENT
/begin MEASUREMENT migef_w "Gefiltertes indiziertes Fahrerwunschmoment" UWORD rel_uw_b100 1 100 0 99.9985 FORMAT "%8.5" ECU_ADDRESS 0x38242A /end MEASUREMENT
/begin MEASUREMENT miges_w "Indiziertes Soll-Motormoment für Getriebeschutz" UWORD rel_uw_b100 1 100 0 99.9985 FORMAT "%8.5" ECU_ADDRESS 0x3813DA /end MEASUREMENT
/begin MEASUREMENT miist_w "indiziertes Motormoment Hochdruckphase Istwert" UWORD rel_uw_b100 1 100 0 99.9985 FORMAT "%8.5" ECU_ADDRESS 0xFA30 /end MEASUREMENT
/begin MEASUREMENT mil1_w "ind. Moment aus MINMAX-Auswahl" UWORD rel_uw_b100 1 100 0 99.9985 FORMAT "%8.5" ECU_ADDRESS 0x38242C /end MEASUREMENT
/begin MEASUREMENT mil2_w "ind. Moment aus MINMAX-Auswahl" UWORD rel_uw_b100 1 100 0 99.9985 FORMAT "%8.5" ECU_ADDRESS 0x38242E /end MEASUREMENT
/begin MEASUREMENT mil3_w "ind. Moment aus MINMAX-Auswahl" UWORD rel_uw_b100 1 100 0 99.9985 FORMAT "%8.5" ECU_ADDRESS 0x382430 /end MEASUREMENT
/begin MEASUREMENT mill_w "Indiziertes Motormoment im Leerlauf" UWORD rel_uw_b100 1 100 0 99.9985 FORMAT "%8.5" ECU_ADDRESS 0x3823D4 /end MEASUREMENT
/begin MEASUREMENT milres_w "Momentenanforderung für Luftpfad mit allen Reserven" UWORD rel_uw_b100 1 100 0 99.9985 FORMAT "%8.5" ECU_ADDRESS 0x3811EC /end MEASUREMENT
/begin MEASUREMENT milsol_w "Fahrermomentenwunsch für Füllung" UWORD rel_uw_b100 1 100 0 99.9985 FORMAT "%8.5" ECU_ADDRESS 0xFA32 /end MEASUREMENT
/begin MEASUREMENT mimax_w "maximal erreichbares indiziertes Moment" UWORD rel_uw_b100 1 100 0 99.9985 FORMAT "%8.5" ECU_ADDRESS 0x381058 /end MEASUREMENT
/begin MEASUREMENT mimin_w "Minimales Motor-Moment" UWORD rel_uw_b100 1 100 0 99.9985 FORMAT "%8.5" ECU_ADDRESS 0x3823D6 /end MEASUREMENT
/begin MEASUREMENT mims_w "indiziertes Motormoment zum Motorschutz" UWORD rel_uw_b100 1 100 0 99.9985 FORMAT "%8.5" ECU_ADDRESS 0x38249A /end MEASUREMENT
/begin MEASUREMENT mimxl1_w "Maximales optimales Moment bei Lambda = 1" UWORD rel_uw_b100 1 100 0 99.9985 FORMAT "%8.5" ECU_ADDRESS 0x382474 /end MEASUREMENT
/begin MEASUREMENT minbeg_w "Indiziertes Fahrerwunschmoment nach Änderungsbegrenzung" UWORD rel_uw_b100 1 100 0 99.9985 FORMAT "%8.5" ECU_ADDRESS 0x382432 /end MEASUREMENT
/begin MEASUREMENT minmxb_w "indiziertes Soll-Moment für NMAX-Begrenzung ohne Begrenzung" SWORD rel_sw_b100 1 100 -100 99.9969 FORMAT "%8.4" ECU_ADDRESS 0x38121E /end MEASUREMENT
/begin MEASUREMENT minmxs "ind. Soll-Motormoment zur Integratorinitialisierung NMAX-Regelung" SBYTE rel_sb_q0p78 1 100 -99.84 99.06 FORMAT "%5.2" ECU_ADDRESS 0x380B4B /end MEASUREMENT
/begin MEASUREMENT minmx_w "Momentenanforderung der Drehzahlbegrenzung" UWORD rel_uw_b100 1 100 0 99.9985 FORMAT "%8.5" ECU_ADDRESS 0xFA36 /end MEASUREMENT
/begin MEASUREMENT mired1 "Indiziertes Reduktionsmoment zur NMAX-Regelung" UBYTE rel_ub_b99p6 1 100 0 99.6094 FORMAT "%5.2" ECU_ADDRESS 0x380B4C /end MEASUREMENT
/begin MEASUREMENT misolv_w "Indiziertes resultierendes Sollmoment vor Momentenbegrenzung" UWORD rel_uw_b100 1 100 0 99.9985 FORMAT "%8.5" ECU_ADDRESS 0x381066 /end MEASUREMENT
/begin MEASUREMENT misol_w "Indiziertes resultierendes Sollmoment" UWORD rel_uw_b100 1 100 0 99.9985 FORMAT "%8.5" ECU_ADDRESS 0xF84A /end MEASUREMENT
/begin MEASUREMENT misopl1_w "Solluftmoment, rückgerechnet auf Lambda=1 und zwopt" UWORD rel_uw_b100 1 100 0 99.9985 FORMAT "%8.5" ECU_ADDRESS 0x38122C /end MEASUREMENT
/begin MEASUREMENT mistt "Startmoment" UBYTE rel_ub_b99p6 1 100 0 99.6094 FORMAT "%5.2" ECU_ADDRESS 0x380CDA /end MEASUREMENT
/begin MEASUREMENT miszul_w "Maximal zulässiges indiziertes Moment" UWORD rel_uw_b100 1 100 0 99.9985 FORMAT "%8.5" ECU_ADDRESS 0x38105A /end MEASUREMENT
/begin MEASUREMENT mivbeb_w "Indiziertes Moment vor Änderungsbegrenzung, nach oben auf mimax_w begrenzt" UWORD rel_uw_b100 1 100 0 99.9985 FORMAT "%8.5" ECU_ADDRESS 0x382434 /end MEASUREMENT
/begin MEASUREMENT mivbeg_w "inidziertes Fahrerwunschmoment vor Änderungsbegrenzung" UWORD rel_uw_b100 1 100 0 99.9985 FORMAT "%8.5" ECU_ADDRESS 0x382436 /end MEASUREMENT
/begin MEASUREMENT mizsolv_w "Indiziertes resultierendes Sollmoment für ZW-Eingriff vor Momentenbegrenzung" UWORD rel_uw_b100 1 100 0 99.9985 FORMAT "%8.5" ECU_ADDRESS 0x381068 /end MEASUREMENT
/begin MEASUREMENT mizsol_w "Indiziertes resultierendes Sollmoment für ZW-Eingriff" UWORD rel_uw_b100 1 100 0 99.9985 FORMAT "%8.5" ECU_ADDRESS 0x38106A /end MEASUREMENT
/begin MEASUREMENT mizufil_w "Zulässiges indiziertes Moment nach Filter" UWORD rel_uw_b100 1 100 0 99.9985 FORMAT "%8.5" ECU_ADDRESS 0x38247C /end MEASUREMENT
/begin MEASUREMENT mizuofil "Zulässiges indiziertes Moment ohne Filter" UBYTE rel_ub_b99p6 1 100 0 99.6094 FORMAT "%5.2" ECU_ADDRESS 0x380CE1 /end MEASUREMENT
/begin MEASUREMENT mizuvfil "Zulässiges indiziertes Moment vor Filter" UBYTE rel_ub_b99p6 1 100 0 99.6094 FORMAT "%5.2" ECU_ADDRESS 0x380CE2 /end MEASUREMENT
/begin MEASUREMENT mizwmn_w "indiziertes Motormoment beim spätesten Zündwinkel" UWORD rel_uw_b100 1 100 0 99.9985 FORMAT "%8.5" ECU_ADDRESS 0x38107A /end MEASUREMENT
/begin MEASUREMENT mi_mr_w "ind. Moment in rel. Moment" UWORD rel_uw_b200 1 100 0 199.997 FORMAT "%8.4" ECU_ADDRESS 0x382438 /end MEASUREMENT
/begin MEASUREMENT mkfanb_w "Kupplungsmoment aus begrenztem Fahrerwunsch" SWORD rel_sw_b100 1 100 -100 99.9969 FORMAT "%8.4" ECU_ADDRESS 0x38243A /end MEASUREMENT
/begin MEASUREMENT mrfamx_w "Relatives Fahrerwunschmoment Maximalwert" UWORD rel_uw_b200 1 100 0 199.997 FORMAT "%8.4" ECU_ADDRESS 0x38147C /end MEASUREMENT
/begin MEASUREMENT mrfav_w "Relatives Fahrerwunschmoment vor Berücksichtigung Notfahren" UWORD rel_uw_b200 1 100 0 199.997 FORMAT "%8.4" ECU_ADDRESS 0x38243C /end MEASUREMENT
/begin MEASUREMENT mrfa_w "Relatives Fahrerwunschmoment aus FGR und Pedal" UWORD rel_uw_b200 1 100 0 199.997 FORMAT "%8.4" ECU_ADDRESS 0x38147E /end MEASUREMENT
/begin MEASUREMENT mrfuemx_w "max. erreichbares rel. Fahrerwunschmoment für Pedalüberweg" UWORD rel_uw_b200 1 100 0 199.997 FORMAT "%8.4" ECU_ADDRESS 0x381480 /end MEASUREMENT
/begin MEASUREMENT mrfue_w "Relatives Fahrerwunschmoment im Pedalüberweg" UWORD rel_uw_b200 1 100 0 199.997 FORMAT "%8.4" ECU_ADDRESS 0x381482 /end MEASUREMENT
/begin MEASUREMENT mrped_w "relatives Fahrerwunschmoment aus Fahrpedal" UWORD rel_uw_b200 1 100 0 199.997 FORMAT "%8.4" ECU_ADDRESS 0x38243E /end MEASUREMENT
/begin MEASUREMENT mrstt_w "relatives Startmoment" UWORD rel_uw_b200 1 100 0 199.997 FORMAT "%8.4" ECU_ADDRESS 0x382410 /end MEASUREMENT
/begin MEASUREMENT msl "Sekundärluftmassenstrom" UBYTE m_ub_q0p4 1 100 0 102 FORMAT "%5.1" ECU_ADDRESS 0x380A9B /end MEASUREMENT
/begin MEASUREMENT msl2 "Sekundärluftmasse Bank 2" UBYTE m_ub_q0p4 1 100 0 102 FORMAT "%5.1" ECU_ADDRESS 0x380A9C /end MEASUREMENT
/begin MEASUREMENT mslpub "Sekundärluftmassenstrom, batteriespannungsabhängig" UBYTE m_ub_q0p4 1 100 0 102 FORMAT "%5.1" ECU_ADDRESS 0x380A9D /end MEASUREMENT
/begin MEASUREMENT mslstat "statischer Sekundärluftmassenstrom" UBYTE m_ub_q0p4 1 100 0 102 FORMAT "%5.1" ECU_ADDRESS 0x380A9E /end MEASUREMENT
/begin MEASUREMENT m_tol "Toel Modelltemperatur" UBYTE temp_ub_q0p75_o48 1 100 -48 143.25 FORMAT "%5.1" ECU_ADDRESS 0x380C4D /end MEASUREMENT
/begin MEASUREMENT m_tolab "Toel Modelltemperatur beim Abstellen des Motors" UBYTE temp_ub_q0p75_o48 1 100 -48 143.25 FORMAT "%5.1" ECU_ADDRESS 0x38310E /end MEASUREMENT
/begin MEASUREMENT m_tolc "Modellierte Motoröltemperatur zur Ausgabe auf CAN" UBYTE temp_q1_o48 1 100 -48 207 FORMAT "%5.1" ECU_ADDRESS 0x380C4E /end MEASUREMENT
/begin MEASUREMENT nghgs_w "gefilterter Drehzahlgradient" SWORD nmotg_sw_q0p39 1 100 -12800.2 12799.8 FORMAT "%8.2" ECU_ADDRESS 0x38246A /end MEASUREMENT
/begin MEASUREMENT NIST_1U "Motoristdrehzahl in 1/min" UWORD NQ1_W 1 100 0 65535 FORMAT "%8.2" ECU_ADDRESS 0xF9D4 /end MEASUREMENT
/begin MEASUREMENT nmotll "Motordrehzahl im Leerlaufbereich" UBYTE nmot_ub_q10 1 100 0 2550 FORMAT "%5.0" ECU_ADDRESS 0x380CD2 /end MEASUREMENT
/begin MEASUREMENT nmotpr_w "Prädizierte Motordrehzahl für NMAX-Regelung" UWORD nmot_uw_q0p25 1 100 0 16383.8 FORMAT "%8.2" ECU_ADDRESS 0x381220 /end MEASUREMENT
/begin MEASUREMENT nturb "Turbinendrehzahl des Wandlers" UBYTE nmot_ub_q20 1 100 0 5100 FORMAT "%5.0" ECU_ADDRESS 0x380CD7 /end MEASUREMENT
/begin MEASUREMENT nturbv "Voraussichtliche Turbinendrehzahl des Wandlers" UBYTE nmot_ub_q20 1 100 0 5100 FORMAT "%5.0" ECU_ADDRESS 0x380CD8 /end MEASUREMENT
/begin MEASUREMENT nver_w "Drehzahlverhältnis" UWORD fak_uw_b8 1 100 0 7.99988 FORMAT "%8.6" ECU_ADDRESS 0x3823DA /end MEASUREMENT
/begin MEASUREMENT obdsteuer "aus CAN-Signal OBD_STEUER aufbereitete Größe für ME" UBYTE dez 1 100 0 255 FORMAT "%5.1" ECU_ADDRESS 0x380BEA /end MEASUREMENT
/begin MEASUREMENT ObdsvNvBits "" UBYTE dez 1 100 0 255 FORMAT "%5.1" ECU_ADDRESS 0x382FFC /end MEASUREMENT
/begin MEASUREMENT perffilt_w "" UWORD rel_q0p025 1 100 0 1638.38 FORMAT "%8.3" ECU_ADDRESS 0x38251E /end MEASUREMENT
/begin MEASUREMENT perfmax_w "" UWORD rel_q0p025 1 100 0 1638.38 FORMAT "%8.3" ECU_ADDRESS 0x382520 /end MEASUREMENT
/begin MEASUREMENT perfmin_w "" UWORD rel_q0p025 1 100 0 1638.38 FORMAT "%8.3" ECU_ADDRESS 0x382522 /end MEASUREMENT
/begin MEASUREMENT perform_w "" UWORD rel_q0p025 1 100 0 1638.38 FORMAT "%8.3" ECU_ADDRESS 0x382524 /end MEASUREMENT
/begin MEASUREMENT peri50ms_w "" UWORD runtime2_sy 1 100 0 838848 FORMAT "%8.1" ECU_ADDRESS 0x382526 /end MEASUREMENT
/begin MEASUREMENT psagr_w "Partialdruck durch externes Restgas (Restluft+Inertgas)" UWORD p_uw_q0p039 1 100 0 2559.96 FORMAT "%8.3" ECU_ADDRESS 0x380092 /end MEASUREMENT
/begin MEASUREMENT psl "Öldruck von der Servo-Lenkung" UBYTE dez 1 100 0 255 FORMAT "%5.1" ECU_ADDRESS 0x380D30 /end MEASUREMENT
/begin MEASUREMENT pte "Tankdifferenzdruck, Eingangssignal, (nach AD-Wandler)" UBYTE p_sb_q32 1 100 0 63.75 FORMAT "%5.2" ECU_ADDRESS 0x380D31 /end MEASUREMENT
/begin MEASUREMENT qnst_w "Drehzahlquotient im Start" UWORD fak_uw_b2 1 100 0 1.99997 FORMAT "%8.6" ECU_ADDRESS 0x382412 /end MEASUREMENT
/begin MEASUREMENT qntns "Quotient aus Turbinendrehzahl des Wandlers und Solldrehzahl der LLR" UBYTE fak_ub_b8 1 100 0 7.96875 FORMAT "%5.3" ECU_ADDRESS 0x380CD9 /end MEASUREMENT
/begin MEASUREMENT redhyst "Reduzierstufenhysterese" SBYTE rel_sb_q0p02 1 100 -2.56 2.54 FORMAT "%5.3" ECU_ADDRESS 0x38091F /end MEASUREMENT
/begin MEASUREMENT redneu "neu berechnete Reduzierstufe" UBYTE dez 1 100 0 255 FORMAT "%5.1" ECU_ADDRESS 0x380920 /end MEASUREMENT
/begin MEASUREMENT redsol "Berechnete Soll-Reduzierstufe" UBYTE dez 1 100 0 255 FORMAT "%5.1" ECU_ADDRESS 0x380921 /end MEASUREMENT
/begin MEASUREMENT redze "Schwelle in Reduzierstufe zwischen Zünd- und Einspritzeingriff" UBYTE dez 1 100 0 255 FORMAT "%5.1" ECU_ADDRESS 0x380922 /end MEASUREMENT
/begin MEASUREMENT redzst_w "Reduzierstufe ohne Hysterese und Rundung" UWORD rel_uw_q0p001 1 100 0 65.535 FORMAT "%8.5" ECU_ADDRESS 0x38107C /end MEASUREMENT
/begin MEASUREMENT resetMonIdx "" UWORD dez 1 100 0 65535 FORMAT "%8.2" ECU_ADDRESS 0x383E96 /end MEASUREMENT
/begin MEASUREMENT rlmax_w "maximal erreichbare Füllung bei Turbo" UWORD rel_uw_q0p0234 1 100 0 1535.98 FORMAT "%8.3" ECU_ADDRESS 0x380094 /end MEASUREMENT
/begin MEASUREMENT rlmin_w "minimal zulässiges rl" UWORD rel_uw_q0p0234 1 100 0 1535.98 FORMAT "%8.3" ECU_ADDRESS 0x38122E /end MEASUREMENT
/begin MEASUREMENT rlossCtr_w "" UWORD dez 1 100 0 65535 FORMAT "%8.2" ECU_ADDRESS 0x382528 /end MEASUREMENT
/begin MEASUREMENT rlsolold_w "" UWORD rel_uw_q0p0234 1 100 0 1535.98 FORMAT "%8.3" ECU_ADDRESS 0x381230 /end MEASUREMENT
/begin MEASUREMENT rlsol_w "Soll-Füllung" UWORD rel_uw_q0p0234 1 100 0 1535.98 FORMAT "%8.3" ECU_ADDRESS 0xFA1C /end MEASUREMENT
/begin MEASUREMENT rlugd_w "Füllung im ungedrosselten Zustand" UWORD rel_uw_q0p0234 1 100 0 1535.98 FORMAT "%8.3" ECU_ADDRESS 0x382476 /end MEASUREMENT
/begin MEASUREMENT rstMon "" UWORD dez 1 100 0 65535 FORMAT "%8.2" ARRAY_SIZE 12 ECU_ADDRESS 0x383E98 /end MEASUREMENT
/begin MEASUREMENT scattBits "" UBYTE dez 1 100 0 255 FORMAT "%5.1" ECU_ADDRESS 0x380BEB /end MEASUREMENT
/begin MEASUREMENT SLSlokBits "" UWORD dez 1 100 0 65535 FORMAT "%8.2" ECU_ADDRESS 0x380EA6 /end MEASUREMENT
/begin MEASUREMENT sumode "Zustand der Saugrohrumschaltung" UBYTE dez 1 100 0 255 FORMAT "%5.1" ECU_ADDRESS 0x38008E /end MEASUREMENT
/begin MEASUREMENT swOffDlBits "" UWORD dez 1 100 0 65535 FORMAT "%8.2" ECU_ADDRESS 0x383A42 /end MEASUREMENT
/begin MEASUREMENT synchroCtr "" UWORD dez 1 100 0 65535 FORMAT "%8.2" ECU_ADDRESS 0x3813E0 /end MEASUREMENT
/begin MEASUREMENT systemStackUsage "" UWORD fak_uw_b1 1 100 0 0.999985 FORMAT "%9.7" ECU_ADDRESS 0x38262C /end MEASUREMENT
/begin MEASUREMENT S_dp "Schalter Dashpot (1=ein)" UWORD B_TRUE 1 100 0 1 BIT_MASK 0x400 FORMAT "%13.11" ECU_ADDRESS 0xFDC2 /end MEASUREMENT
/begin MEASUREMENT S_ls "Schalter Lastschlagdämpfung (1=ein)" UWORD B_TRUE 1 100 0 1 BIT_MASK 0x800 FORMAT "%13.11" ECU_ADDRESS 0xFDC2 /end MEASUREMENT
/begin MEASUREMENT t1tvi_w "Zeitpunkt des TV-Interrupts" UWORD tsquant 1 100 0 52428 FORMAT "%8.2" ARRAY_SIZE 2 ECU_ADDRESS 0x381002 /end MEASUREMENT
/begin MEASUREMENT tags_w "AGR Temperatur bei Einleitung ins Saugrohr (Word)" UWORD temp_sw_q0p75 1 100 0 49151.3 FORMAT "%8.2" ECU_ADDRESS 0x38263E /end MEASUREMENT
/begin MEASUREMENT taml "Tastverhältnis E-Lüfter" UBYTE rel_ub_b100 1 100 0 100 FORMAT "%5.1" ECU_ADDRESS 0x380CDB /end MEASUREMENT
/begin MEASUREMENT tamlaus "Tastverhältnis Motorlüfter nach Normierung" UBYTE rel_ub_b100 1 100 0 100 FORMAT "%5.1" ECU_ADDRESS 0x380CDC /end MEASUREMENT
/begin MEASUREMENT tamlnh "Tastverhältnis E-Lüfter nach Hysterese (prozentuale Lüfterleistung)" UBYTE rel_ub_b100 1 100 0 100 FORMAT "%5.1" ECU_ADDRESS 0x380CDD /end MEASUREMENT
/begin MEASUREMENT tamlnhk "" UBYTE rel_ub_b100 1 100 0 100 FORMAT "%5.1" ECU_ADDRESS 0x380CDE /end MEASUREMENT
/begin MEASUREMENT tamlnl "Tastverhältnis E-Lüfter im Lüfternachlauf" UBYTE rel_ub_b100 1 100 0 100 FORMAT "%5.1" ECU_ADDRESS 0x380CDF /end MEASUREMENT
/begin MEASUREMENT tamls "Tastverhältnis (prozentuale Lüfterleistung)" UBYTE rel_ub_b100 1 100 0 100 FORMAT "%5.1" ECU_ADDRESS 0x380CE0 /end MEASUREMENT
/begin MEASUREMENT tCorrCtr "" UBYTE dez 1 100 0 255 FORMAT "%5.1" ECU_ADDRESS 0x380AD6 /end MEASUREMENT
/begin MEASUREMENT te2_w "effektive Einspritzzeit Bank2 (word)" UWORD tinjection_sy 1 100 0 209.712 FORMAT "%8.4" ECU_ADDRESS 0xF9EC /end MEASUREMENT
/begin MEASUREMENT tevfa2_w "effektive Einspritzzeit vor Feinabgleich (word)" UWORD tinjection_sy 1 100 0 209.712 FORMAT "%8.4" ECU_ADDRESS 0x3811BE /end MEASUREMENT
/begin MEASUREMENT tevfa_w "effektive Einspritzzeit vor Feinabgleich (word)" UWORD tinjection_sy 1 100 0 209.712 FORMAT "%8.4" ECU_ADDRESS 0x3811C0 /end MEASUREMENT
/begin MEASUREMENT tevfa_w_kge "" UWORD tinjection_sy 1 100 0 209.712 FORMAT "%8.4" ECU_ADDRESS 0x380DCE /end MEASUREMENT
/begin MEASUREMENT te_w "effektive Einspritzzeit (word)" UWORD tinjection_sy 1 100 0 209.712 FORMAT "%8.4" ECU_ADDRESS 0xF9EE /end MEASUREMENT
/begin MEASUREMENT tfst2 "Tankfuellstand Tank 2" UBYTE fuel_ub_q1 1 100 0 255 FORMAT "%5.1" ECU_ADDRESS 0x380D32 /end MEASUREMENT
/begin MEASUREMENT ti2_w "Einspritzzeit für Zylinder 2 (word)" UWORD tinjection5_sy 1 100 0 1048.56 FORMAT "%8.3" ECU_ADDRESS 0xF9F0 /end MEASUREMENT
/begin MEASUREMENT timmot_w "Zähler Zeit nach Motorlauf n>NINI (word)" UWORD t10msxs_uw_b655p35 1 100 0 655.35 FORMAT "%8.4" ECU_ADDRESS 0x38265E /end MEASUREMENT
/begin MEASUREMENT ti_b1 "Einspritzzeit für EV's auf Bank1" UWORD tinjection_sy 1 100 0 209.712 FORMAT "%8.4" ECU_ADDRESS 0xF9F2 /end MEASUREMENT
/begin MEASUREMENT ti_b2 "Einspritzzeit für EV's auf Bank2" UWORD tinjection_sy 1 100 0 209.712 FORMAT "%8.4" ECU_ADDRESS 0xF9F4 /end MEASUREMENT
/begin MEASUREMENT ti_tvu_w "Batteriespannungsabhängige Einspritzzeitkorrektur CPU-Quantisierung" UWORD tinjection_sy 1 100 0 209.712 FORMAT "%8.4" ECU_ADDRESS 0xF9F6 /end MEASUREMENT
/begin MEASUREMENT ti_w "Einspritzzeit" UWORD tinjection5_sy 1 100 0 1048.56 FORMAT "%8.3" ECU_ADDRESS 0xF9F8 /end MEASUREMENT
/begin MEASUREMENT tmotst "Motor-Temperatur bei Start" UBYTE temp_ub_q0p75_o48 1 100 -48 143.25 FORMAT "%5.1" ECU_ADDRESS 0x380D33 /end MEASUREMENT
/begin MEASUREMENT tn2 "Segmentzeit pro Zündung" UWORD tsync_q3p2us 1 100 0 209.712 FORMAT "%8.4" ECU_ADDRESS 0xF898 /end MEASUREMENT
/begin MEASUREMENT tnachl_w "SG-Nachlaufzeit" UWORD t100msxs_uw_b6553p6 1 100 0 6553.5 FORMAT "%8.3" ECU_ADDRESS 0x383A44 /end MEASUREMENT
/begin MEASUREMENT tnscCtr_w "" UWORD t20msxs_uw_q0p02 1 100 0 1310.7 FORMAT "%8.3" ECU_ADDRESS 0x38247E /end MEASUREMENT
/begin MEASUREMENT tnsofCtr "" UBYTE t20msxs_ub_b5p1 1 100 0 5.1 FORMAT "%5.3" ECU_ADDRESS 0x380CE3 /end MEASUREMENT
/begin MEASUREMENT tol "Motor-ÖL-Temperatur" UBYTE temp_ub_q0p75_o48 1 100 -48 143.25 FORMAT "%5.1" ECU_ADDRESS 0x380D34 /end MEASUREMENT
/begin MEASUREMENT tPer10ms "" UBYTE t10msxs_sb_q0p01 1 100 0 2.55 FORMAT "%5.3" ARRAY_SIZE 32 ECU_ADDRESS 0x380AD7 /end MEASUREMENT
/begin MEASUREMENT tPerPtr "" UWORD dez 1 100 0 65535 FORMAT "%8.2" ECU_ADDRESS 0x38129E /end MEASUREMENT
/begin MEASUREMENT tr_zeit_msb "" UBYTE dez 1 100 0 255 FORMAT "%5.1" ECU_ADDRESS 0xF89A /end MEASUREMENT
/begin MEASUREMENT tr_zeit_msb_alt "" UBYTE dez 1 100 0 255 FORMAT "%5.1" ECU_ADDRESS 0x380AF7 /end MEASUREMENT
/begin MEASUREMENT tseghi "Winkel-Segmentzeit, high, low byte des high word" UBYTE dez 1 100 0 255 FORMAT "%5.1" ECU_ADDRESS 0x380AF8 /end MEASUREMENT
/begin MEASUREMENT tseg_w "Winkel-Segmentzeit" UWORD TSQL 1 100 0 52428 FORMAT "%8.2" ECU_ADDRESS 0x3812A0 /end MEASUREMENT
/begin MEASUREMENT tToothAt10ms "" UWORD dez 1 100 0 65535 FORMAT "%8.2" ECU_ADDRESS 0x3812A2 /end MEASUREMENT
/begin MEASUREMENT twan "Öltemperatur im Wandler" UBYTE temp_ub_q0p75_o48 1 100 -48 143.25 FORMAT "%5.1" ECU_ADDRESS 0x380D35 /end MEASUREMENT
/begin MEASUREMENT udsl_w "Spannung Drucksensor Ladedruck (word)" UWORD spg_uw_q0p00488 1 100 0 319.995 FORMAT "%8.4" ECU_ADDRESS 0x382640 /end MEASUREMENT
/begin MEASUREMENT userStackUsage "" UWORD fak_uw_b1 1 100 0 0.999985 FORMAT "%9.7" ECU_ADDRESS 0x38262E /end MEASUREMENT
/begin MEASUREMENT uzkw_w "Kurbelwellen-Umdrehungszähler" UWORD dez 1 100 0 65535 FORMAT "%8.2" ECU_ADDRESS 0x3812A4 /end MEASUREMENT
/begin MEASUREMENT vfzg2 "" UBYTE vfzg_ub_q1p25 1 100 0 318.75 FORMAT "%5.1" ECU_ADDRESS 0x380D36 /end MEASUREMENT
/begin MEASUREMENT vfzg2_w "Fahrzeuggeschwindigkeit 2. Signal" UWORD vfzg_uw_b512 1 100 0 511.992 FORMAT "%8.4" ECU_ADDRESS 0x382642 /end MEASUREMENT
/begin MEASUREMENT vrlsol "Verhaeltnis relative Soll-Füllung zu Maximalfuellung" UBYTE rel_ub_b99p6 1 100 0 99.6094 FORMAT "%5.2" ECU_ADDRESS 0x380D37 /end MEASUREMENT
/begin MEASUREMENT vstfba "Faktor Beschleunigungsanreicherung (Testerschnittstelle)" UBYTE fak_ub_b2 1 100 0 1.99219 FORMAT "%5.3" ECU_ADDRESS 0x380D38 /end MEASUREMENT
/begin MEASUREMENT vstfns "Anpassung Faktor Nachstart (Testerschnittstelle)" UBYTE fak_ub_b2 1 100 0 1.99219 FORMAT "%5.3" ECU_ADDRESS 0x380D39 /end MEASUREMENT
/begin MEASUREMENT vstfva "Faktor Verzoegerungsabmagerung (Testerschnittstelle)" UBYTE fak_ub_b2 1 100 0 1.99219 FORMAT "%5.3" ECU_ADDRESS 0x380D3A /end MEASUREMENT
/begin MEASUREMENT vstfwl "Anpassung Faktor Warmlauf (Testerschnittstelle)" UBYTE fak_ub_b2 1 100 0 1.99219 FORMAT "%5.3" ECU_ADDRESS 0x380D3B /end MEASUREMENT
/begin MEASUREMENT vstlr "Anpassung tv-Zeit  (Testerschnittstelle)" SBYTE t10msxs_sb_q0p01 1 100 -1.28 1.27 FORMAT "%5.3" ECU_ADDRESS 0x38008F /end MEASUREMENT
/begin MEASUREMENT wpfgr_w "Rückgerechneter Pedalwert bei FGR-Betrieb" UWORD rel_uw_b100 1 100 0 99.9985 FORMAT "%8.5" ECU_ADDRESS 0x382440 /end MEASUREMENT
/begin MEASUREMENT zdash_w "Zeitkonstante Dashpot" UWORD zk10msxs_uw_b655 1 100 0.0100002 655.36 FORMAT "%10.6" ECU_ADDRESS 0x382442 /end MEASUREMENT
/begin MEASUREMENT zlsd_w "Zeitkonstante PT2-Filter Lastschlagdämpfung" UWORD zk10msxs_uw_b655 1 100 0.0100002 655.36 FORMAT "%10.6" ECU_ADDRESS 0x382444 /end MEASUREMENT
/begin MEASUREMENT zntmnakt "" UWORD tsync_q3p2us 1 100 0 209.712 FORMAT "%8.4" ECU_ADDRESS 0x382644 /end MEASUREMENT
/begin MEASUREMENT zntmnmax "" UWORD tsync_q3p2us 1 100 0 209.712 FORMAT "%8.4" ECU_ADDRESS 0x382646 /end MEASUREMENT
/begin MEASUREMENT zntmnmin "" UWORD tsync_q3p2us 1 100 0 209.712 FORMAT "%8.4" ECU_ADDRESS 0x382648 /end MEASUREMENT
/begin MEASUREMENT zwsol "Soll-Zündwinkel aus Momenteneingriff" SBYTE zw_sb_q0p75 1 100 -96 95.25 FORMAT "%5.2" ECU_ADDRESS 0x380A08 /end MEASUREMENT
/begin MEASUREMENT zzyl "SW-Zylinderzähler" UBYTE dez 1 100 0 255 FORMAT "%5.1" ECU_ADDRESS 0x380AF9 /end MEASUREMENT
/begin MEASUREMENT zzylzue "SW-Zylinderzähler für Zündungsberechnung" UBYTE dez 1 100 0 255 FORMAT "%5.1" ECU_ADDRESS 0x380AFA /end MEASUREMENT
/begin FUNCTION MDFAW "Fahrerwunschmoment"
 /begin DEF_CHARACTERISTIC CWDMFAB DLSDHK DLSDHKLR DMDPUG DMDPUGLR DMIFSAWE DMLSDUG DMLSDULR KDMLDOLR KFDLSD KFDLSDLR KFDMDPLR KFDMDPO KFDMLSDO KFMILSD KFMIMR KFMRMI KFPED KFPEDU KFWPFGR KFZDASH KFZDSHLR KFZLSD KFZLSDLR KMILSDLR MKLSDO MRFALLO MRFALLU MRFUEMXN NGFSAWE SMK06MDSW TDMFBSA TDMFBWE TVFSAWE ZLSDHK ZLSDHKLR /end DEF_CHARACTERISTIC
 /begin REF_CHARACTERISTIC MDIMX SGA08MDUB SNM06MDUW /end REF_CHARACTERISTIC
 /begin IN_MEASUREMENT B_autget B_fgren B_kuppl B_lowra B_nmot B_sa B_sab B_savfgr B_stend B_vnull B_wk dmllri_w dmverl_w esst_sga08mdub esst_snm06mduw gangi mdverl_w miasrl_w mibgr_w miges_w miist_w mimax_w mimin_w mims_w mimxl1_w minmx_w miszul_w mivmx_w mrfgr_w mrstt_w ngfil_w nmot_w wped_w /end IN_MEASUREMENT
 /begin OUT_MEASUREMENT B_dash B_fgr B_ll esst_smk06mdsw fmil_w mifa mifal_w mifa_w mrfamx_w mrfav_w mrfuemx_w mrfue_w wpfgr_w /end OUT_MEASUREMENT
 /begin LOC_MEASUREMENT B_dp B_edp B_elsd B_fil B_iflsd B_ls B_lsd dlsd_w dmdpo_w dmdpu_w dmlsdo_w dmlsdu_w iwflsd_w mibdp_w miblsd_w migef_w mil1_w mil2_w mil3_w minbeg_w mivbeb_w mivbeg_w mi_mr_w mkfanb_w mrfa_w mrped_w S_dp S_ls zdash_w zlsd_w /end LOC_MEASUREMENT
 /begin SUB_FUNCTION /end SUB_FUNCTION
/end FUNCTION
/begin FUNCTION MDFUE "Sollwertvorgabe für Luftmasse aus Sollmoment" /begin DEF_CHARACTERISTIC KFMIRL RLMNN RLMNSAN ZETABASN /end DEF_CHARACTERISTIC /begin REF_CHARACTERISTIC SNM12FEUB /end REF_CHARACTERISTIC
 /begin IN_MEASUREMENT B_sa esst_snm12feub etalab etazwbm milsol_w nmot nmot_w rlmax_w /end IN_MEASUREMENT
 /begin OUT_MEASUREMENT drlsol_w rlsol_w /end OUT_MEASUREMENT
 /begin LOC_MEASUREMENT etabasf_w etabas_w misopl1_w rlmin_w rlsolold_w /end LOC_MEASUREMENT
 /begin SUB_FUNCTION /end SUB_FUNCTION
/end FUNCTION
/begin FUNCTION MDIHGS "Momentenbegrenzung Gangabhängig" /begin DEF_CHARACTERISTIC FMIHGN MIHGSLG NGHGS ZMIBGR ZNGHGS /end DEF_CHARACTERISTIC /begin REF_CHARACTERISTIC MDIMX /end REF_CHARACTERISTIC /begin IN_MEASUREMENT B_autget gangi mifafu_w miint_w milsol_w ngas_w nmot /end IN_MEASUREMENT
 /begin OUT_MEASUREMENT B_hgsndy B_mibgr fmibgrv_w fmibgr_w mibgrv_w mibgr_w miges_w nghgs_w /end OUT_MEASUREMENT
 /begin LOC_MEASUREMENT /end LOC_MEASUREMENT
 /begin SUB_FUNCTION /end SUB_FUNCTION
/end FUNCTION
/begin FUNCTION MDIST10 "" /begin DEF_CHARACTERISTIC /end DEF_CHARACTERISTIC /begin REF_CHARACTERISTIC ETADZW _REDMX /end REF_CHARACTERISTIC /begin IN_MEASUREMENT dzw_kge miopt_w redist zwist zwopt /end IN_MEASUREMENT /begin OUT_MEASUREMENT etazaist etazwist miist_w /end OUT_MEASUREMENT /begin LOC_MEASUREMENT dzwi mdindg_w /end LOC_MEASUREMENT /begin SUB_FUNCTION /end SUB_FUNCTION /end FUNCTION
/begin FUNCTION MDKOG "9.40      Drehmomentenkoordination für Gesamteingriffe"
 /begin DEF_CHARACTERISTIC CWMDKOG CWTEZW CWZWE CWZWVMX DMRKHO DMRKHU MDHYST NASNOT NKUPZWEO NKUPZWEU NLLZWEO NLLZWEU NLSDZWEO NLSDZWEU TMVER TPNSMD VKUPZWEO VKUPZWEU VLLZWEO VLLZWEU VLSDZWEO VLSDZWEU /end DEF_CHARACTERISTIC
 /begin REF_CHARACTERISTIC MDIMX /end REF_CHARACTERISTIC
 /begin IN_MEASUREMENT B_dash B_fil B_kh B_kuppl B_kw B_ll B_llrein B_lsd B_stend dmar_w dmllrz_w dmrkh dmrkt_w miasrl_w miasrs_w mibas_w mibgr_w mifa_w migs_w milres_w mimax_w mimsr_w minmx_w miszul_w mitebg_w mivmx_w nmot rlmin_w rlsol_w vfzg /end IN_MEASUREMENT
 /begin OUT_MEASUREMENT B_allzw B_allzwe B_asr B_mdein B_mibeg B_msr B_zwvs B_zwvz dmzms_w mifab_w misol_w mizsol_w /end OUT_MEASUREMENT
 /begin LOC_MEASUREMENT B_mibegdau mibeg_w miextv_w miext_w misolv_w mizsolv_w /end LOC_MEASUREMENT
 /begin SUB_FUNCTION /end SUB_FUNCTION
/end FUNCTION
/begin FUNCTION MDKOL "Momentenkoordination auf Füllungsebene" /begin DEF_CHARACTERISTIC /end DEF_CHARACTERISTIC /begin REF_CHARACTERISTIC MDIMX NASNOT /end REF_CHARACTERISTIC
 /begin IN_MEASUREMENT B_llrein B_mibeg dmlllmn_w dmllr_w dmrkh dmrkt_w dmrllr_w etazwbm etazwmn miasrl_w mibgr_w mifal_w mifa_w miges_w mimsr_w mims_w minmx_w miszul_w mitebg_w mivmx_w nmot vsdmr /end IN_MEASUREMENT
 /begin OUT_MEASUREMENT milsol_w /end OUT_MEASUREMENT
 /begin LOC_MEASUREMENT dmrkat mifafu_w milres_w /end LOC_MEASUREMENT
 /begin SUB_FUNCTION /end SUB_FUNCTION
/end FUNCTION
/begin FUNCTION MDMAX "Berechnung maximales indiziertes Motormoment" /begin DEF_CHARACTERISTIC FMIVL FRLVTM RLVMXN /end DEF_CHARACTERISTIC /begin REF_CHARACTERISTIC KFMIOP SNM16OPUW SRL11OPUW /end REF_CHARACTERISTIC
 /begin IN_MEASUREMENT esst_snm16opuw esst_srl11opuw fho_w ftvdk mrfamx_w nmot nmot_w rl_w_kge tmot /end IN_MEASUREMENT
 /begin OUT_MEASUREMENT mimax_w mimxl1_w /end OUT_MEASUREMENT
 /begin LOC_MEASUREMENT rlugd_w /end LOC_MEASUREMENT
 /begin SUB_FUNCTION /end SUB_FUNCTION
/end FUNCTION
/begin FUNCTION MDMIN "Minimales Motormoment Koordination" /begin DEF_CHARACTERISTIC /end DEF_CHARACTERISTIC /begin REF_CHARACTERISTIC /end REF_CHARACTERISTIC /begin IN_MEASUREMENT B_sab fnstab_w mdverf_w mistt nmot_w /end IN_MEASUREMENT /begin OUT_MEASUREMENT mill_w mimin_w nmotll /end OUT_MEASUREMENT /begin LOC_MEASUREMENT /end LOC_MEASUREMENT /begin SUB_FUNCTION /end SUB_FUNCTION /end FUNCTION
/begin FUNCTION MDNSTAB "Drehmoment: Drehzahlstabilisierung" /begin DEF_CHARACTERISTIC FNSTABNV /end DEF_CHARACTERISTIC /begin REF_CHARACTERISTIC /end REF_CHARACTERISTIC /begin IN_MEASUREMENT nmot_w nstat /end IN_MEASUREMENT /begin OUT_MEASUREMENT fnstab_w /end OUT_MEASUREMENT /begin LOC_MEASUREMENT B_mdnstab nver_w /end LOC_MEASUREMENT /begin SUB_FUNCTION /end SUB_FUNCTION /end FUNCTION
/begin FUNCTION MDRED "Berechnung Reduzierstufe aus Momentenanforderung"
 /begin DEF_CHARACTERISTIC CREDSTU MDHYEZ NSAUE1 NWEUE1 REDHYOC REDHYUC REDZEM WPUE1MX /end DEF_CHARACTERISTIC
 /begin REF_CHARACTERISTIC _REDMX /end REF_CHARACTERISTIC
 /begin IN_MEASUREMENT B_asr B_dknolu B_dkpu B_mibeg B_msr B_nmax B_sab etazwmn mibas_w miopt_w misol_w nmot tmot wped /end IN_MEASUREMENT
 /begin OUT_MEASUREMENT B_sa redsol /end OUT_MEASUREMENT
 /begin LOC_MEASUREMENT B_mdee B_mdredhyein B_nmotue1 B_saue1 mizwmn_w redhyst redneu redze redzst_w /end LOC_MEASUREMENT
 /begin SUB_FUNCTION /end SUB_FUNCTION
/end FUNCTION
/begin FUNCTION MDTRIP "2.10      Berechnung der Momentenreserve im Kurztrip" /begin DEF_CHARACTERISTIC /end DEF_CHARACTERISTIC /begin REF_CHARACTERISTIC /end REF_CHARACTERISTIC /begin IN_MEASUREMENT dmrdsls_w dmrlash_w dmrlsh_w /end IN_MEASUREMENT /begin OUT_MEASUREMENT dmrkt_w /end OUT_MEASUREMENT /begin LOC_MEASUREMENT /end LOC_MEASUREMENT /begin SUB_FUNCTION /end SUB_FUNCTION /end FUNCTION
/begin FUNCTION MDVER "Motor-Verlustmoment" /begin DEF_CHARACTERISTIC CNFMDVER DMDNSM KFMDS MDSM ZFMDVERL ZMDNS /end DEF_CHARACTERISTIC /begin REF_CHARACTERISTIC STM06__UB /end REF_CHARACTERISTIC
 /begin IN_MEASUREMENT B_llrein B_sa dmvad_w esst_stm06__ub mdverb mdwan_w nmot_w rl_w tmot /end IN_MEASUREMENT
 /begin OUT_MEASUREMENT dmverl_w mdverf_w mdverl_w /end OUT_MEASUREMENT
 /begin LOC_MEASUREMENT mds_w /end LOC_MEASUREMENT
 /begin SUB_FUNCTION /end SUB_FUNCTION
/end FUNCTION
/begin FUNCTION MDVERAD "Adaption Verlustmoment"
 /begin DEF_CHARACTERISTIC DMADFK DMADFS DMADKO DMADLL DMADMNFK DMADMNFS DMADMNKO DMADMNLL DMADMXFK DMADMXFS DMADMXKO DMADMXLL DMOFK DMOFS DMOKO DMOLL TMDMAD TWDMAD ZKDMADFK ZKDMADFS ZKDMADKO ZKDMADLL /end DEF_CHARACTERISTIC
 /begin REF_CHARACTERISTIC /end REF_CHARACTERISTIC
 /begin IN_MEASUREMENT B_dknolu B_dkpu B_dtes B_edkvs B_edkvs2 B_eepdif B_eev B_evloc B_fs B_koe B_llr B_llrein B_mdarv B_ndsav B_nswo1 B_pwf B_vllr dmllri_w tmot /end IN_MEASUREMENT
 /begin OUT_MEASUREMENT dmvad_w /end OUT_MEASUREMENT
 /begin LOC_MEASUREMENT B_adwfk B_adwfs B_adwko B_madfk B_madfs B_madko B_madll B_madstp dmvadfk_w dmvadfs_w dmvadko_w dmvadll_w dmvamnfk_w dmvamnfs_w dmvamnko_w dmvamnll_w dmvamxfk_w dmvamxfs_w dmvamxko_w dmvamxll_w /end LOC_MEASUREMENT
 /begin SUB_FUNCTION /end SUB_FUNCTION
/end FUNCTION
/begin FUNCTION MDVERB "Momentenbedarf der Nebenaggregate (z.B. Klimaanlage, sonst. Verbraucher)" /begin DEF_CHARACTERISTIC DMDKOE FABMDKO KFMDKO KFMDKOG MDSL ZKMDKO /end DEF_CHARACTERISTIC /begin REF_CHARACTERISTIC /end REF_CHARACTERISTIC /begin IN_MEASUREMENT B_acres B_koe B_koger B_sl kopwm mdkog nmot tans /end IN_MEASUREMENT /begin OUT_MEASUREMENT dmrac mdko mdverb /end OUT_MEASUREMENT /begin LOC_MEASUREMENT /end LOC_MEASUREMENT /begin SUB_FUNCTION /end SUB_FUNCTION /end FUNCTION
/begin FUNCTION MDWAN "Drehmomentaufnahme des Wandlers"
 /begin DEF_CHARACTERISTIC CWMDWAN FABMDWA FMDWAT FNRAD TVFSAM TVFSEM TVFUE UEVERG ZKMDWA /end DEF_CHARACTERISTIC
 /begin REF_CHARACTERISTIC STW06MDUB /end REF_CHARACTERISTIC
 /begin IN_MEASUREMENT B_fs esst_stw06mdub gangi mdwancan nsol twan vfzg /end IN_MEASUREMENT
 /begin OUT_MEASUREMENT mdwan_w /end OUT_MEASUREMENT
 /begin LOC_MEASUREMENT B_fsu dnturb nturb nturbv qntns /end LOC_MEASUREMENT
 /begin SUB_FUNCTION /end SUB_FUNCTION
/end FUNCTION
/begin FUNCTION MDZUL "Maximal zulässiges Moment"
 /begin DEF_CHARACTERISTIC KFMIZUFIL KFMIZUNS KFMIZUOF NSTART NSTEND SMO08OPUB TANSMN TFMIZU TMNSMN TNSC TNSOF /end DEF_CHARACTERISTIC
 /begin REF_CHARACTERISTIC MDIMX SNM08OPUB SWP08OPUB /end REF_CHARACTERISTIC
 /begin IN_MEASUREMENT B_fgr B_msr B_mzns_um esst_snm08opub esst_swp08opub nmot tans tmot wped /end IN_MEASUREMENT
 /begin OUT_MEASUREMENT miszul_w /end OUT_MEASUREMENT
 /begin LOC_MEASUREMENT B_mzns B_nsakt B_nsend esst_smo08opub mizufil_w mizuofil mizuvfil tnscCtr_w tnsofCtr /end LOC_MEASUREMENT
 /begin SUB_FUNCTION /end SUB_FUNCTION
/end FUNCTION
/begin FUNCTION MDZW "Berechnung Moment in Sollzündwinkel" /begin DEF_CHARACTERISTIC DMAUFN DZWETA /end DEF_CHARACTERISTIC /begin REF_CHARACTERISTIC /end REF_CHARACTERISTIC
 /begin IN_MEASUREMENT B_zwvs B_zwvz etazaist mibas_w miopt_w misol_w mizsol_w mizwmn_w nmot_w zwopt /end IN_MEASUREMENT
 /begin OUT_MEASUREMENT B_nozwe zwsol /end OUT_MEASUREMENT
 /begin LOC_MEASUREMENT B_zwvzm dmaufr_w dzws etazws /end LOC_MEASUREMENT
 /begin SUB_FUNCTION /end SUB_FUNCTION
/end FUNCTION
/begin FUNCTION MLS "Motorlüfter-Steuerung"
 /begin DEF_CHARACTERISTIC FMLVFZG TALUNL TAMHYS TAMLAC TAMLSMN TAMLSMX TAMLSNH TAMLTKA TAMLU /end DEF_CHARACTERISTIC
 /begin REF_CHARACTERISTIC TNLSGMN /end REF_CHARACTERISTIC
 /begin IN_MEASUREMENT B_famls B_nachl B_nmin B_stend B_uetm stmlac swOffDlBits tamldia tka tnachl_w ub vfzg /end IN_MEASUREMENT
 /begin OUT_MEASUREMENT taml /end OUT_MEASUREMENT
 /begin LOC_MEASUREMENT B_nachln B_nl10 tamlaus tamlnh tamlnhk tamlnl tamls /end LOC_MEASUREMENT
 /begin SUB_FUNCTION /end SUB_FUNCTION
/end FUNCTION
/begin FUNCTION MOTAUS "Motor-Abstellen" /begin DEF_CHARACTERISTIC TNLSGMN TNLSGMX UBNLMN /end DEF_CHARACTERISTIC /begin REF_CHARACTERISTIC /end REF_CHARACTERISTIC /begin IN_MEASUREMENT B_airbag B_nmin B_pwf ub /end IN_MEASUREMENT
 /begin OUT_MEASUREMENT B_nachl B_nachlend B_nlacls B_nlale B_nlcan B_nldsc B_nldte B_nlEEPR B_nlmls B_nlobd B_nlsgls B_nlsiko B_nlwst swOffDlBits tnachl_w /end OUT_MEASUREMENT
 /begin LOC_MEASUREMENT /end LOC_MEASUREMENT
 /begin SUB_FUNCTION /end SUB_FUNCTION
/end FUNCTION
/begin FUNCTION MSMD "Motorschutz über Momentenreduzierung" /begin DEF_CHARACTERISTIC DTMABMS FPMSTM FPMSTME MDMSMIN TMMSX TMSTKA /end DEF_CHARACTERISTIC /begin REF_CHARACTERISTIC MDIMX /end REF_CHARACTERISTIC /begin IN_MEASUREMENT B_got B_ntkw B_stend mimxl1_w nmot_w tka tmot /end IN_MEASUREMENT /begin OUT_MEASUREMENT B_msmd dtmuems mims_w /end OUT_MEASUREMENT /begin LOC_MEASUREMENT /end LOC_MEASUREMENT /begin SUB_FUNCTION /end SUB_FUNCTION /end FUNCTION
/begin FUNCTION MTOEL "Modell Motoröltemperatur" /begin DEF_CHARACTERISTIC KFMTOL1 KFMTOL2 KFMTOL3 Z_OEL1 Z_OEL2 Z_OEL3 /end DEF_CHARACTERISTIC /begin REF_CHARACTERISTIC /end REF_CHARACTERISTIC /begin IN_MEASUREMENT B_pwf nmot rl tabst_w tmot tmotab tumg vfzg /end IN_MEASUREMENT /begin OUT_MEASUREMENT m_tol m_tolc /end OUT_MEASUREMENT /begin LOC_MEASUREMENT abtim_b d_tol1 d_tol2 d_tol3 kf_out2 kf_out3 m_tolab /end LOC_MEASUREMENT /begin SUB_FUNCTION /end SUB_FUNCTION /end FUNCTION
/begin FUNCTION NCHK "EGAS: Sicherheitskonzept, Prüfung des Drehzahlsignals" /begin DEF_CHARACTERISTIC /end DEF_CHARACTERISTIC /begin REF_CHARACTERISTIC /end REF_CHARACTERISTIC /begin IN_MEASUREMENT NIST /end IN_MEASUREMENT /begin OUT_MEASUREMENT /end OUT_MEASUREMENT /begin LOC_MEASUREMENT /end LOC_MEASUREMENT /begin SUB_FUNCTION /end SUB_FUNCTION /end FUNCTION
/begin FUNCTION NFB "Notluftfahren bei EGAS-Steller in Notluftposition" /begin DEF_CHARACTERISTIC /end DEF_CHARACTERISTIC /begin REF_CHARACTERISTIC /end REF_CHARACTERISTIC /begin IN_MEASUREMENT NIST_1U /end IN_MEASUREMENT /begin OUT_MEASUREMENT /end OUT_MEASUREMENT /begin LOC_MEASUREMENT /end LOC_MEASUREMENT /begin SUB_FUNCTION /end SUB_FUNCTION /end FUNCTION
/begin FUNCTION NMAXMD "Drehzahlbegrenzung"
 /begin DEF_CHARACTERISTIC DNMAXHG DNMAXLR KFMIRED1 MDIMX NMAX NMAXLR NMAXPG NMAXPLR NMXDAEF NMXDKPU TNMXPRG TNMXPRLR UKWNMAXG UWNMAXLR ZINMAXG ZINMAXLR /end DEF_CHARACTERISTIC
 /begin REF_CHARACTERISTIC SGA07MDUB /end REF_CHARACTERISTIC
 /begin IN_MEASUREMENT bfzglf B_dknolu B_dkpu B_lowra esst_sga07mdub gangi mifab_w miist_w ngfil_w nmot_w rl uzkw_w wped /end IN_MEASUREMENT
 /begin OUT_MEASUREMENT B_nmax B_nmaxd minmx_w /end OUT_MEASUREMENT
 /begin LOC_MEASUREMENT anzkwu_w dmnmxi_w dmnmxp_w dnsi_w inmax minmxb_w minmxs mired1 nmotpr_w /end LOC_MEASUREMENT
 /begin SUB_FUNCTION /end SUB_FUNCTION
/end FUNCTION
/begin FUNCTION NS_W "Nachstartfunktion Zündung" /begin DEF_CHARACTERISTIC /end DEF_CHARACTERISTIC /begin REF_CHARACTERISTIC /end REF_CHARACTERISTIC /begin IN_MEASUREMENT /end IN_MEASUREMENT /begin OUT_MEASUREMENT /end OUT_MEASUREMENT /begin LOC_MEASUREMENT NIST_1U /end LOC_MEASUREMENT /begin SUB_FUNCTION /end SUB_FUNCTION /end FUNCTION
/begin FUNCTION OBDSV "OBD-Statusverwaltung" /begin DEF_CHARACTERISTIC /end DEF_CHARACTERISTIC /begin REF_CHARACTERISTIC /end REF_CHARACTERISTIC /begin IN_MEASUREMENT bbdcy bbwuc B_egscok B_pwf ffzdfp obdstegs /end IN_MEASUREMENT /begin OUT_MEASUREMENT B_blkfb B_milfb B_xff obdsteuer ObdsvNvBits /end OUT_MEASUREMENT /begin LOC_MEASUREMENT /end LOC_MEASUREMENT /begin SUB_FUNCTION /end SUB_FUNCTION /end FUNCTION
/begin FUNCTION OBP_CAN "" /begin DEF_CHARACTERISTIC /end DEF_CHARACTERISTIC /begin REF_CHARACTERISTIC /end REF_CHARACTERISTIC /begin IN_MEASUREMENT /end IN_MEASUREMENT /begin OUT_MEASUREMENT /end OUT_MEASUREMENT /begin LOC_MEASUREMENT /end LOC_MEASUREMENT /begin SUB_FUNCTION /end SUB_FUNCTION /end FUNCTION
/begin FUNCTION OBP_EEP "" /begin DEF_CHARACTERISTIC /end DEF_CHARACTERISTIC /begin REF_CHARACTERISTIC /end REF_CHARACTERISTIC /begin IN_MEASUREMENT /end IN_MEASUREMENT /begin OUT_MEASUREMENT /end OUT_MEASUREMENT /begin LOC_MEASUREMENT /end LOC_MEASUREMENT /begin SUB_FUNCTION /end SUB_FUNCTION /end FUNCTION
/begin FUNCTION OWNW1 "" /begin DEF_CHARACTERISTIC /end DEF_CHARACTERISTIC /begin REF_CHARACTERISTIC /end REF_CHARACTERISTIC /begin IN_MEASUREMENT /end IN_MEASUREMENT /begin OUT_MEASUREMENT t1tvi_w /end OUT_MEASUREMENT /begin LOC_MEASUREMENT b_nwtv b_nwtv2 /end LOC_MEASUREMENT /begin SUB_FUNCTION /end SUB_FUNCTION /end FUNCTION
/begin FUNCTION PK "" /begin DEF_CHARACTERISTIC /end DEF_CHARACTERISTIC /begin REF_CHARACTERISTIC /end REF_CHARACTERISTIC /begin IN_MEASUREMENT /end IN_MEASUREMENT /begin OUT_MEASUREMENT /end OUT_MEASUREMENT /begin LOC_MEASUREMENT /end LOC_MEASUREMENT /begin SUB_FUNCTION /end SUB_FUNCTION /end FUNCTION
/begin FUNCTION PROKON "Projektkonfiguration"
 /begin DEF_CHARACTERISTIC CDAGR CDDMTL CDEFST CDHSH CDHSV CDLLR CDLSA CDLSH CDLSV CDMD CDNWS CDSLS CWDKAT CWDKVS CWDTES CWERFIL CWKONABG CWKONLS CWNOCINS CWNSABG CWOBD CWSCTMDE CWSLS CWTF CWUHR /end DEF_CHARACTERISTIC
 /begin REF_CHARACTERISTIC CWDTLECK /end REF_CHARACTERISTIC
 /begin IN_MEASUREMENT B_nokatfz /end IN_MEASUREMENT
 /begin OUT_MEASUREMENT B_abstnl B_auakt B_cdagr B_cddmtl B_cdfst B_cdhsh B_cdhsv B_cdkat B_cdkvs B_cdlash B_cdlatp B_cdlatv B_cdldp B_cdllr B_cdlsa B_cdlsh B_cdlsv B_cdmd B_cdnws B_cdnws2 B_cdsls B_cdtes B_dmtllhv B_etol B_katfz B_kath B_lsh B_lsh2 B_lsv B_lsv2 B_mde8e B_mde9e B_ndsav B_nocins B_slsfz B_tfu B_uhrrmin B_uhrrsec cd_bits1_w cd_bits2_w cw_erfil cw_obd /end OUT_MEASUREMENT
 /begin LOC_MEASUREMENT /end LOC_MEASUREMENT
 /begin SUB_FUNCTION /end SUB_FUNCTION
/end FUNCTION
/begin FUNCTION ram "" /begin DEF_CHARACTERISTIC /end DEF_CHARACTERISTIC /begin REF_CHARACTERISTIC /end REF_CHARACTERISTIC /begin IN_MEASUREMENT /end IN_MEASUREMENT /begin OUT_MEASUREMENT synchroCtr /end OUT_MEASUREMENT /begin LOC_MEASUREMENT /end LOC_MEASUREMENT /begin SUB_FUNCTION /end SUB_FUNCTION /end FUNCTION
/begin FUNCTION RKTI "Einspritzdauerberechnung ti aus relativer Kraftstoffmasse rk" /begin DEF_CHARACTERISTIC FKKVS TEMIN /end DEF_CHARACTERISTIC /begin REF_CHARACTERISTIC _STERVK /end REF_CHARACTERISTIC /begin IN_MEASUREMENT B_stend frkte nmot rk2_w rk_w tvu_w /end IN_MEASUREMENT
 /begin OUT_MEASUREMENT B_temin B_temin2 ftek2_w ftek_w te2_w tevfa2_w tevfa_w te_w ti2_w ti_b1 ti_b2 ti_tvu_w ti_w /end OUT_MEASUREMENT
 /begin LOC_MEASUREMENT tevfa_w_kge /end LOC_MEASUREMENT
 /begin SUB_FUNCTION /end SUB_FUNCTION
/end FUNCTION
/begin FUNCTION rstmon "Reset Monitor" /begin DEF_CHARACTERISTIC /end DEF_CHARACTERISTIC /begin REF_CHARACTERISTIC /end REF_CHARACTERISTIC /begin IN_MEASUREMENT /end IN_MEASUREMENT /begin OUT_MEASUREMENT resetMonIdx /end OUT_MEASUREMENT /begin LOC_MEASUREMENT rstMon /end LOC_MEASUREMENT /begin SUB_FUNCTION /end SUB_FUNCTION /end FUNCTION
/begin FUNCTION RUNTIME "" /begin DEF_CHARACTERISTIC AUFW100M AUFW10MS AUFW20MS AUFWSYNC /end DEF_CHARACTERISTIC /begin REF_CHARACTERISTIC /end REF_CHARACTERISTIC /begin IN_MEASUREMENT B_dash B_kr B_llr B_lr B_lsd B_sa nmot rl wdkba wped /end IN_MEASUREMENT
 /begin OUT_MEASUREMENT cyclebg_w laufz100_w laufz10m_w laufz1m_w laufz1s_w laufz200_w laufz20m_w laufz2m_w laufz50m_w laufzbg_w laufzsyn_w lzmaxnmot lzmaxrl lzmaxstate lzmaxwdkba lzmaxwped lzs_dash lzs_kr lzs_ldr lzs_lr lzs_lsd lzs_sa perffilt_w perfmax_w perfmin_w perform_w peri50ms_w rlossCtr_w /end OUT_MEASUREMENT
 /begin LOC_MEASUREMENT /end LOC_MEASUREMENT
 /begin SUB_FUNCTION /end SUB_FUNCTION
/end FUNCTION
/begin FUNCTION SCATT "SCAN TOOL-Testerschnittstelle" /begin DEF_CHARACTERISTIC /end DEF_CHARACTERISTIC /begin REF_CHARACTERISTIC /end REF_CHARACTERISTIC /begin IN_MEASUREMENT B_m9cvnout B_mde8e B_mde9e fcmEnd /end IN_MEASUREMENT /begin OUT_MEASUREMENT B_m8te B_m9cvnclr scattBits /end OUT_MEASUREMENT /begin LOC_MEASUREMENT /end LOC_MEASUREMENT /begin SUB_FUNCTION /end SUB_FUNCTION /end FUNCTION
/begin FUNCTION SLS "Sekundärluftsteuerung"
 /begin DEF_CHARACTERISTIC CWFASL CWSLSOF DPSLV FMSL FMSL2 FMSLOFF FMSRHOL FMSTMOT IMLSLMN IMLSLMX IMLSLSA IMLSLSE KFFMSML MLSLMX MSLUB TASLSO TASLSU TDDSLA TDSLKT TLMSSLAB TLMSSLMX TMFASLMN TMSSLO TMSSLSTO TMSSLSTU TMSSLU TSLABB TSLPMN TSLUBST TVDSLOFF TVSLVOFF TVSLVON UBSLMN UBSLMX UBSLSTMN VSLS ZFLMSSL ZKSLPOFF ZKSLPON ZKSLSOFF ZKSLSON /end DEF_CHARACTERISTIC
 /begin REF_CHARACTERISTIC CWSLS /end REF_CHARACTERISTIC
 /begin IN_MEASUREMENT ATMbits B_atmtpl B_brems B_dslfa B_dslsp4 B_dspe B_fa B_fasls B_fs B_kh B_kha B_khab B_kuppl B_ll B_mslmn B_nmot B_sla B_slsfz B_st B_stend fmsla fmsla2 frhol_w imlpr ml mlbb2_w mlbb_w ml_w nmot ps_w pu rl tans tmot tmst tnst_w ubf vfzg /end IN_MEASUREMENT
 /begin OUT_MEASUREMENT B_fasla B_faslarq B_lmsslof B_msloff B_mslon B_slkhof B_slp B_slpoff B_sls B_slsadap B_slsoff B_slv flamsl2_w flamsl_w flmssl fslpdyn msl msl2 mslstat /end OUT_MEASUREMENT
 /begin LOC_MEASUREMENT B_dslreset B_dslset B_sldsl4 B_slkt B_slpena B_slpofst B_slsdis B_slserr B_slsinhi fmsagd fmsldyn fmslrho fmsltm imlsla_w imlsle_w mslpub SLSlokBits /end LOC_MEASUREMENT
 /begin SUB_FUNCTION /end SUB_FUNCTION
/end FUNCTION
/begin FUNCTION SREAKT "EGAS: Sicherheitskonzept, Fehlerreaktionen" /begin DEF_CHARACTERISTIC /end DEF_CHARACTERISTIC /begin REF_CHARACTERISTIC /end REF_CHARACTERISTIC
 /begin IN_MEASUREMENT B_dkunb B_dlrbe B_dlrpide B_fprzab B_i_ska_um B_nlpne B_ubdve B_umauab B_wdksive /end IN_MEASUREMENT
 /begin OUT_MEASUREMENT B_dknolu B_dkpiu B_dkpru B_dkpu B_i_ska_fr B_notlu_fr /end OUT_MEASUREMENT
 /begin LOC_MEASUREMENT /end LOC_MEASUREMENT
 /begin SUB_FUNCTION /end SUB_FUNCTION
/end FUNCTION
/begin FUNCTION SSTBER1 ""
 /begin DEF_CHARACTERISTIC SAN12ESUW SDK10TEUB SET08LDUB SEZ06TMUB SFR05TEUB SGA07MDUB SGA08MDUB SKS06ESUB SLX06TMUW SLY06TMUW SML05DKUB SML05LKUB SML05TMUW SML06TEUB SML06TMUB SML07TMUB SML07TMUW SML08LHUB SNG06LLSB SNM05DKUB SNM05TMUB SNM06LHUB SNM06LLUB SNM06MDUW SNM07ESUB SNM07LRUB SNM08DMUB SNM08FEUB SNM08KRUW SNM08LDUB SNM08LDUW SNM08LHUB SNM08OPUB SNM08__UB SNM10TEUB SNM10__UB SNM12ESUB SNM12FEUB SNM16FEUW SNM16KRUB SNM16LDUB SNM16OPUW SNM16ZUUB SNM24ZUUB SPL08LDUB SRL03ZUUB SRL04KRUB SRL05TMUB SRL06LHUB SRL06LRUB SRL08DMUB SRL12ESUB SRL12ZUUB SRL16ZUUB ST107TMUB ST207TMUB ST307TMUB ST407TMUB STA06ESUB STA06__UB STA08LDUB STM04MSUW STM04SAUB STM04__UB STM05SAUB STM05TMUB STM06LLUB STM06__UB STM08DMUB STM08LEUB STM08__UB STM09ESUB STM12ESUB STN12ESUB STS06TMUW STS08ESUB STS12ESUB STU05TMUB STW06MDUB SUB06__UB SVR08LDUB SWD06KRSW SWN10FEUB SWP08LDUB SWP08OPUB /end DEF_CHARACTERISTIC
 /begin REF_CHARACTERISTIC /end REF_CHARACTERISTIC
 /begin IN_MEASUREMENT anztib_w etazwimt etazwist frmit gangi kstaa lamsons2_w lamsons_w ml ml_w ngfil nmot nmot_w plsol rl tabgmst tabgmst2 tabst_w tans tatu tkatmst tkatmst2 tmot tmst twan ub vrlsol wdkba wdkba_w wnwue wped /end IN_MEASUREMENT
 /begin OUT_MEASUREMENT esst_san12esuw esst_sdk10teub esst_set08ldub esst_sez06tmub esst_sfr05teub esst_sga07mdub esst_sga08mdub esst_sks06esub esst_slx06tmuw esst_sly06tmuw esst_sml05dkub esst_sml05lkub esst_sml05tmuw esst_sml06teub esst_sml06tmub esst_sml07tmub esst_sml07tmuw esst_sml08lhub esst_sng06llsb esst_snm05dkub esst_snm05tmub esst_snm06lhub esst_snm06llub esst_snm06mduw esst_snm07esub esst_snm07lrub esst_snm08dmub esst_snm08feub esst_snm08kruw esst_snm08ldub esst_snm08lduw esst_snm08lhub esst_snm08opub esst_snm08__ub esst_snm10teub esst_snm10__ub esst_snm12esub esst_snm12feub esst_snm16feuw esst_snm16krub esst_snm16ldub esst_snm16opuw esst_snm16zuub esst_snm24zuub esst_spl08ldub esst_srl03zuub esst_srl04krub esst_srl05tmub esst_srl06lhub esst_srl06lrub esst_srl08dmub esst_srl12esub esst_srl12zuub esst_srl16zuub esst_st107tmub esst_st207tmub esst_st307tmub esst_st407tmub esst_sta06esub esst_sta06__ub esst_sta08ldub esst_stm04msuw esst_stm04saub esst_stm04__ub esst_stm05saub esst_stm05tmub esst_stm06llub esst_stm06__ub esst_stm08dmub esst_stm08leub esst_stm08__ub esst_stm09esub esst_stm12esub esst_stn12esub esst_sts06tmuw esst_sts08esub esst_sts12esub esst_stu05tmub esst_stw06mdub esst_sub06__ub esst_svr08ldub esst_swd06krsw esst_swn10feub esst_swp08ldub esst_swp08opub /end OUT_MEASUREMENT
 /begin LOC_MEASUREMENT /end LOC_MEASUREMENT
 /begin SUB_FUNCTION /end SUB_FUNCTION
/end FUNCTION
/begin FUNCTION STA "Startautomatik" /begin DEF_CHARACTERISTIC CWSTA NSTMXM TANMX TPAST TSTA TSTSV /end DEF_CHARACTERISTIC /begin REF_CHARACTERISTIC /end REF_CHARACTERISTIC /begin IN_MEASUREMENT B_autget B_estart B_ez B_kl15 B_pn nmot nmot_w tmot /end IN_MEASUREMENT /begin OUT_MEASUREMENT B_sta /end OUT_MEASUREMENT /begin LOC_MEASUREMENT B_sta0ag B_sta0hg /end LOC_MEASUREMENT /begin SUB_FUNCTION /end SUB_FUNCTION /end FUNCTION
/begin FUNCTION STACKMON "" /begin DEF_CHARACTERISTIC /end DEF_CHARACTERISTIC /begin REF_CHARACTERISTIC /end REF_CHARACTERISTIC /begin IN_MEASUREMENT /end IN_MEASUREMENT /begin OUT_MEASUREMENT systemStackUsage userStackUsage /end OUT_MEASUREMENT /begin LOC_MEASUREMENT /end LOC_MEASUREMENT /begin SUB_FUNCTION /end SUB_FUNCTION /end FUNCTION
/begin FUNCTION STARTUPF "" /begin DEF_CHARACTERISTIC CWPWF /end DEF_CHARACTERISTIC /begin REF_CHARACTERISTIC /end REF_CHARACTERISTIC /begin IN_MEASUREMENT /end IN_MEASUREMENT /begin OUT_MEASUREMENT B_pwf /end OUT_MEASUREMENT /begin LOC_MEASUREMENT /end LOC_MEASUREMENT /begin SUB_FUNCTION /end SUB_FUNCTION /end FUNCTION
/begin FUNCTION STMD "Startmoment" /begin DEF_CHARACTERISTIC KFMDST /end DEF_CHARACTERISTIC /begin REF_CHARACTERISTIC /end REF_CHARACTERISTIC /begin IN_MEASUREMENT B_llrein mimin_w mimxl1_w mrfamx_w nmotll nsst tmot /end IN_MEASUREMENT /begin OUT_MEASUREMENT mistt mrstt_w /end OUT_MEASUREMENT /begin LOC_MEASUREMENT qnst_w /end LOC_MEASUREMENT /begin SUB_FUNCTION /end SUB_FUNCTION /end FUNCTION
/begin FUNCTION SWADP111 ""
 /begin DEF_CHARACTERISTIC CDFALSH CDFALSH2 CDSWE CWCVT CWMDAPP CWSACVT CW_FANWH NSWO NSWO1 NSWO3 RLNORM /end DEF_CHARACTERISTIC
 /begin REF_CHARACTERISTIC /end REF_CHARACTERISTIC
 /begin IN_MEASUREMENT /end IN_MEASUREMENT
 /begin OUT_MEASUREMENT B_cdswe B_clrtm B_craus B_cvt B_dslal2 B_dslalr B_dslil2 B_dslilr B_dslsa B_dslsk B_dslst B_dslst2 B_dsve B_dtefrr B_faatm B_fadkvs B_fakat B_fakat2 B_fakvs B_falsh B_falsh2 B_fash B_fash2 B_fatp B_fatp2 B_fatv B_fatv2 B_fhz B_fpwdkap B_fspclr B_ftedab B_grdst B_lrndia B_lrssa B_lrssa2 B_mdmax B_mdmin B_mnmsl B_nnot B_notl B_nswo1 B_nswo2 B_nswo3 B_sacvt B_sl B_staa B_su B_syn B_synph B_teza B_tfst2ok B_tfstok B_tnaset B_wdksap B_zadsti B_zwappl dftea dlamatr2_w dlamatr_w dlambts_w drlfue_w dzwnwsu flr_ap frdter_w fuka kopwm kstaa lamatr2_w lamatr_w lambts_w psagr_w psl pte rlmax_w sumode tags_w tfst2 tmotst tol twan udsl_w vfzg2 vfzg2_w vrlsol vstfba vstfns vstfva vstfwl vstlr zntmnakt zntmnmax zntmnmin /end OUT_MEASUREMENT
 /begin LOC_MEASUREMENT /end LOC_MEASUREMENT
 /begin SUB_FUNCTION /end SUB_FUNCTION
/end FUNCTION
/begin FUNCTION SYABK "Symbole und Abkürzungen" /begin DEF_CHARACTERISTIC /end DEF_CHARACTERISTIC /begin REF_CHARACTERISTIC /end REF_CHARACTERISTIC /begin IN_MEASUREMENT /end IN_MEASUREMENT /begin OUT_MEASUREMENT /end OUT_MEASUREMENT /begin LOC_MEASUREMENT /end LOC_MEASUREMENT /begin SUB_FUNCTION /end SUB_FUNCTION /end FUNCTION
/begin FUNCTION SYK111 "" /begin DEF_CHARACTERISTIC /end DEF_CHARACTERISTIC /begin REF_CHARACTERISTIC /end REF_CHARACTERISTIC /begin IN_MEASUREMENT /end IN_MEASUREMENT /begin OUT_MEASUREMENT /end OUT_MEASUREMENT /begin LOC_MEASUREMENT /end LOC_MEASUREMENT /begin SUB_FUNCTION /end SUB_FUNCTION /end FUNCTION
/begin FUNCTION SYNC111 "" /begin DEF_CHARACTERISTIC /end DEF_CHARACTERISTIC /begin REF_CHARACTERISTIC /end REF_CHARACTERISTIC /begin IN_MEASUREMENT B_synphlost nmot_w /end IN_MEASUREMENT
 /begin OUT_MEASUREMENT B_bm B_fbm B_iniSyn B_Tper10msAllZ losphctr tCorrCtr tn2 tPer10ms tPerPtr tr_zeit_msb tr_zeit_msb_alt tseghi tseg_w tToothAt10ms uzkw_w zzyl zzylzue /end OUT_MEASUREMENT
 /begin LOC_MEASUREMENT /end LOC_MEASUREMENT
 /begin SUB_FUNCTION /end SUB_FUNCTION
/end FUNCTION
/begin FUNCTION syskn "" /begin DEF_CHARACTERISTIC /end DEF_CHARACTERISTIC /begin REF_CHARACTERISTIC /end REF_CHARACTERISTIC /begin IN_MEASUREMENT B_nmot /end IN_MEASUREMENT /begin OUT_MEASUREMENT timmot_w /end OUT_MEASUREMENT /begin LOC_MEASUREMENT /end LOC_MEASUREMENT /begin SUB_FUNCTION /end SUB_FUNCTION /end FUNCTION
/begin COMPU_METHOD B_TRUE "boolsche Zustände, positive Logik" TAB_VERB "%6.3" "" COMPU_TAB_REF B_TRUE /end COMPU_METHOD
/begin COMPU_VTAB B_TRUE "boolsche Zustände, positive Logik" TAB_VERB 2 0 "----" 1 "TRUE" /end COMPU_VTAB
/begin COMPU_METHOD DEZ "1 : 1 Umrechnug (dez/hex)" RAT_FUNC "%6.2" "" COEFFS 0 1 0 0 0 1 /end COMPU_METHOD
/begin COMPU_METHOD dez "1 : 1 Umrechnug (dez/hex)" RAT_FUNC "%6.2" "" COEFFS 0 1 0 0 0 1 /end COMPU_METHOD
/begin COMPU_METHOD fak_ub_b1 "" RAT_FUNC "%6.4" "-" COEFFS 0 256 0 0 0 1 /end COMPU_METHOD
/begin COMPU_METHOD fak_ub_b16 "" RAT_FUNC "%6.4" "-" COEFFS 0 256 0 0 0 16 /end COMPU_METHOD
/begin COMPU_METHOD fak_ub_b2 "" RAT_FUNC "%6.4" "-" COEFFS 0 256 0 0 0 2 /end COMPU_METHOD
/begin COMPU_METHOD fak_ub_b4 "" RAT_FUNC "%6.4" "-" COEFFS 0 256 0 0 0 4 /end COMPU_METHOD
/begin COMPU_METHOD fak_ub_b8 "" RAT_FUNC "%6.4" "-" COEFFS 0 256 0 0 0 8 /end COMPU_METHOD
/begin COMPU_METHOD fak_ub_q0p09765 "" RAT_FUNC "%6.3" "%/ms" COEFFS 0 256 0 0 0 25 /end COMPU_METHOD
/begin COMPU_METHOD fak_ub_q4p7Em7 "" RAT_FUNC "%9.8" "-" COEFFS 0 1 0 0 0 4.7e-007 /end COMPU_METHOD
/begin COMPU_METHOD fak_uw_b1 "" RAT_FUNC "%7.6" "-" COEFFS 0 65536 0 0 0 1 /end COMPU_METHOD
/begin COMPU_METHOD fak_uw_b16 "" RAT_FUNC "%6.5" "-" COEFFS 0 65536 0 0 0 16 /end COMPU_METHOD
/begin COMPU_METHOD fak_uw_b2 "" RAT_FUNC "%7.6" "-" COEFFS 0 65536 0 0 0 2 /end COMPU_METHOD
/begin COMPU_METHOD fak_uw_b8 "" RAT_FUNC "%6.5" "-" COEFFS 0 65536 0 0 0 8 /end COMPU_METHOD
/begin COMPU_METHOD fuel_ub_q1 "" RAT_FUNC "%6.2" "l" COEFFS 0 1 0 0 0 1 /end COMPU_METHOD
/begin COMPU_METHOD md_ub_q1 "" RAT_FUNC "%6.2" "Nm" COEFFS 0 1 0 0 0 1 /end COMPU_METHOD
/begin COMPU_METHOD m_ub_b1020 "" RAT_FUNC "%6.2" "kg/h" COEFFS 0 1 0 0 0 4 /end COMPU_METHOD
/begin COMPU_METHOD m_ub_q0p4 "" RAT_FUNC "%6.3" "kg/h" COEFFS 0 1 0 0 0 0.4 /end COMPU_METHOD
/begin COMPU_METHOD m_uw_b4660 "" RAT_FUNC "%6.4" "g" COEFFS 0 3600 0 0 0 256 /end COMPU_METHOD
/begin COMPU_METHOD m_uw_b6553p5 "" RAT_FUNC "%6.3" "kg/h" COEFFS 0 1 0 0 0 0.1 /end COMPU_METHOD
/begin COMPU_METHOD nmotg_sb_q100 "" RAT_FUNC "%6.0" "U/min/s" COEFFS 0 1 0 0 0 100 /end COMPU_METHOD
/begin COMPU_METHOD nmotg_sw_q0p39 "" RAT_FUNC "%6.3" "U/min/s" COEFFS 0 1 0 0 0 0.39063 /end COMPU_METHOD
/begin COMPU_METHOD nmot_sb_q20 "" RAT_FUNC "%6.1" "U/min" COEFFS 0 1 0 0 0 20 /end COMPU_METHOD
/begin COMPU_METHOD nmot_sw_q0p25 "" RAT_FUNC "%6.3" "U/min" COEFFS 0 1 0 0 0 0.25 /end COMPU_METHOD
/begin COMPU_METHOD nmot_ub_q10 "" RAT_FUNC "%6.1" "U/min" COEFFS 0 1 0 0 0 10 /end COMPU_METHOD
/begin COMPU_METHOD nmot_ub_q20 "" RAT_FUNC "%6.1" "U/min" COEFFS 0 1 0 0 0 20 /end COMPU_METHOD
/begin COMPU_METHOD nmot_ub_q40 "" RAT_FUNC "%6.1" "Upm" COEFFS 0 1 0 0 0 40 /end COMPU_METHOD
/begin COMPU_METHOD nmot_uw_q0p25 "" RAT_FUNC "%6.3" "U/min" COEFFS 0 1 0 0 0 0.25 /end COMPU_METHOD
/begin COMPU_METHOD NQ1_W "Drehzahlquantisierung 1.000[Upm]" RAT_FUNC "%6.2" "Upm" COEFFS 0 1 0 0 0 1 /end COMPU_METHOD
/begin COMPU_METHOD p_sb_q32 "" RAT_FUNC "%6.3" "hPa" COEFFS 0 256 0 0 0 64 /end COMPU_METHOD
/begin COMPU_METHOD p_ub_q10 "" RAT_FUNC "%6.1" "hPa" COEFFS 0 1 0 0 0 10 /end COMPU_METHOD
/begin COMPU_METHOD p_ub_q5 "" RAT_FUNC "%6.2" "hPa" COEFFS 0 1 0 0 0 5 /end COMPU_METHOD
/begin COMPU_METHOD p_uw_q0p039 "" RAT_FUNC "%6.4" "hPa" COEFFS 0 256 0 0 0 10 /end COMPU_METHOD
/begin COMPU_METHOD relDK_q0p02441 "" RAT_FUNC "%6.4" "% DK" COEFFS 0 65536 0 0 0 1600 /end COMPU_METHOD
/begin COMPU_METHOD relDK_ub_b100 "" RAT_FUNC "%6.3" "% DK" COEFFS 0 255 0 0 0 100 /end COMPU_METHOD
/begin COMPU_METHOD relnmot_q0p0039 "" RAT_FUNC "%6.4" "%/(U/min)" COEFFS 0 256 0 0 0 1 /end COMPU_METHOD
/begin COMPU_METHOD relPED_ub_b100 "" RAT_FUNC "%6.3" "% PED" COEFFS 0 255 0 0 0 100 /end COMPU_METHOD
/begin COMPU_METHOD relPED_uw_b100 "" RAT_FUNC "%6.4" "% PED" COEFFS 0 65535 0 0 0 100 /end COMPU_METHOD
/begin COMPU_METHOD reltemp_q0p001526 "" RAT_FUNC "%6.4" "%/°K" COEFFS 0 65535 0 0 0 100 /end COMPU_METHOD
/begin COMPU_METHOD rel_q0p025 "" RAT_FUNC "%6.4" "%" COEFFS 0 1 0 0 0 0.025 /end COMPU_METHOD
/begin COMPU_METHOD rel_sb_q0p02 "" RAT_FUNC "%6.4" "%" COEFFS 0 50 0 0 0 1 /end COMPU_METHOD
/begin COMPU_METHOD rel_sb_q0p78 "" RAT_FUNC "%6.3" "%" COEFFS 0 1 0 0 0 0.78 /end COMPU_METHOD
/begin COMPU_METHOD rel_sw_b100 "" RAT_FUNC "%6.4" "%" COEFFS 0 32768 0 0 0 100 /end COMPU_METHOD
/begin COMPU_METHOD rel_sw_q0p0234 "" RAT_FUNC "%6.4" "%/seg" COEFFS 0 32 0 0 0 0.75 /end COMPU_METHOD
/begin COMPU_METHOD rel_ub_b100 "" RAT_FUNC "%6.3" "%" COEFFS 0 255 0 0 0 100 /end COMPU_METHOD
/begin COMPU_METHOD rel_ub_b127p5 "" RAT_FUNC "%6.3" "%" COEFFS 0 2 0 0 0 1 /end COMPU_METHOD
/begin COMPU_METHOD rel_ub_b24p9 "" RAT_FUNC "%6.3" "%" COEFFS 0 255 0 0 0 24.9 /end COMPU_METHOD
/begin COMPU_METHOD rel_ub_b2p0 "" RAT_FUNC "%6.4" "%" COEFFS 0 256 0 0 0 2 /end COMPU_METHOD
/begin COMPU_METHOD rel_ub_b49p725 "" RAT_FUNC "%6.3" "%" COEFFS 0 255 0 0 0 49.725 /end COMPU_METHOD
/begin COMPU_METHOD rel_ub_b99p6 "" RAT_FUNC "%6.3" "%" COEFFS 0 256 0 0 0 100 /end COMPU_METHOD
/begin COMPU_METHOD rel_ub_bn24p9 "" RAT_FUNC "%6.5" "%" COEFFS 0 -255 0 0 0 24.9 /end COMPU_METHOD
/begin COMPU_METHOD rel_ub_q0p75 "" RAT_FUNC "%6.3" "%" COEFFS 0 1 0 0 0 0.75 /end COMPU_METHOD
/begin COMPU_METHOD rel_uw_b100 "" RAT_FUNC "%6.4" "%" COEFFS 0 65536 0 0 0 100 /end COMPU_METHOD
/begin COMPU_METHOD rel_uw_b200 "" RAT_FUNC "%6.4" "%" COEFFS 0 65536 0 0 0 200 /end COMPU_METHOD
/begin COMPU_METHOD rel_uw_q0p001 "" RAT_FUNC "%6.5" "%" COEFFS 0 1000 0 0 0 1 /end COMPU_METHOD
/begin COMPU_METHOD rel_uw_q0p0234 "" RAT_FUNC "%6.4" "%" COEFFS 0 32 0 0 0 0.75 /end COMPU_METHOD
/begin COMPU_METHOD runtime1_sy "" RAT_FUNC "%6.2" "us" COEFFS 0 1.25 0 0 0 1 /end COMPU_METHOD
/begin COMPU_METHOD runtime2_sy "" RAT_FUNC "%6.1" "us" COEFFS 0 0.078125 0 0 0 1 /end COMPU_METHOD
/begin COMPU_METHOD spg_ubatt "" RAT_FUNC "%6.3" "V" COEFFS 0 1 0 0 0 0.0942 /end COMPU_METHOD
/begin COMPU_METHOD spg_uw_q0p00488 "" RAT_FUNC "%6.4" "V" COEFFS 0 1024 0 0 0 5 /end COMPU_METHOD
/begin COMPU_METHOD t100msxs_ub_b255 "" RAT_FUNC "%6.2" "s" COEFFS 0 1 0 0 0 1 /end COMPU_METHOD
/begin COMPU_METHOD t100msxs_ub_b25p5 "" RAT_FUNC "%6.3" "s" COEFFS 0 1 0 0 0 0.1 /end COMPU_METHOD
/begin COMPU_METHOD t100msxs_uw_b6553p6 "" RAT_FUNC "%6.3" "s" COEFFS 0 10 0 0 0 1 /end COMPU_METHOD
/begin COMPU_METHOD t10msxs_sb_q0p01 "" RAT_FUNC "%6.4" "s" COEFFS 0 1 0 0 0 0.01 /end COMPU_METHOD
/begin COMPU_METHOD t10msxs_ub_b2p55 "" RAT_FUNC "%6.4" "s" COEFFS 0 1 0 0 0 0.01 /end COMPU_METHOD
/begin COMPU_METHOD t10msxs_uw_b655p35 "" RAT_FUNC "%6.4" "s" COEFFS 0 1 0 0 0 0.01 /end COMPU_METHOD
/begin COMPU_METHOD t1sxs_uw_b65535 "" RAT_FUNC "%6.2" "s" COEFFS 0 1 0 0 0 1 /end COMPU_METHOD
/begin COMPU_METHOD t1sxs_uw_q1 "" RAT_FUNC "%6.2" "s" COEFFS 0 1 0 0 0 1 /end COMPU_METHOD
/begin COMPU_METHOD t1sxs_uw_q16 "" RAT_FUNC "%6.1" "s" COEFFS 0 1 0 0 0 16 /end COMPU_METHOD
/begin COMPU_METHOD t200msxs_ub_b51 "" RAT_FUNC "%6.3" "s" COEFFS 0 1 0 0 0 0.2 /end COMPU_METHOD
/begin COMPU_METHOD t20msxs_ub_b5p1 "" RAT_FUNC "%6.4" "s" COEFFS 0 1 0 0 0 0.02 /end COMPU_METHOD
/begin COMPU_METHOD t20msxs_uw_q0p02 "" RAT_FUNC "%6.4" "s" COEFFS 0 1 0 0 0 0.02 /end COMPU_METHOD
/begin COMPU_METHOD t20usxus_q20 "" RAT_FUNC "%6.1" "us" COEFFS 0 1 0 0 0 20 /end COMPU_METHOD
/begin COMPU_METHOD temp_q1_o48 "" RAT_FUNC "%6.2" "Grad C" COEFFS 0 1 48 0 0 1 /end COMPU_METHOD
/begin COMPU_METHOD temp_sb_q0p75 "" RAT_FUNC "%6.3" "Grad C" COEFFS 0 1 0 0 0 0.75 /end COMPU_METHOD
/begin COMPU_METHOD temp_sw_q0p75 "" RAT_FUNC "%6.3" "Grad C" COEFFS 0 4 0 0 0 3 /end COMPU_METHOD
/begin COMPU_METHOD temp_ub_q0p75_o48 "" RAT_FUNC "%6.2" "Grad C" COEFFS 0 1 48 0 0 0.75 /end COMPU_METHOD
/begin COMPU_METHOD temp_ub_q5_o50 "" RAT_FUNC "%6.2" "Grad C" COEFFS 0 1 50 0 0 5 /end COMPU_METHOD
/begin COMPU_METHOD temp_uw_q0p0029_o48 "" RAT_FUNC "%6.2" "Grad C" COEFFS 0 1 48 0 0 0.0029297 /end COMPU_METHOD
/begin COMPU_METHOD tinjection5_sy "" RAT_FUNC "%6.4" "ms" COEFFS 0 62.5 0 0 0 1 /end COMPU_METHOD
/begin COMPU_METHOD tinjection_sy "" RAT_FUNC "%6.4" "ms" COEFFS 0 312.5 0 0 0 1 /end COMPU_METHOD
/begin COMPU_METHOD TSQL "Quantisierung von te, 16 Bit mit  0.667[us]" RAT_FUNC "%6.2" "us" COEFFS 0 1 0 0 0 0.8 /end COMPU_METHOD
/begin COMPU_METHOD tsquant "Umrechnung Segmentzeit in DMD" RAT_FUNC "%6.2" "us" COEFFS 0 1.25 0 0 0 1 /end COMPU_METHOD
/begin COMPU_METHOD tsync_q3p2us "" RAT_FUNC "%6.4" "ms" COEFFS 0 312.5 0 0 0 1 /end COMPU_METHOD
/begin COMPU_METHOD vfzg_ub_q1p25 "" RAT_FUNC "%6.2" "km/h" COEFFS 0 1 0 0 0 1.25 /end COMPU_METHOD
/begin COMPU_METHOD vfzg_uw_b512 "" RAT_FUNC "%6.4" "km/h" COEFFS 0 65536 0 0 0 512 /end COMPU_METHOD
/begin COMPU_METHOD wkw_ub_q0p5 "" RAT_FUNC "%7.3" "Grad KW" COEFFS 0 2 0 0 0 1 /end COMPU_METHOD
/begin COMPU_METHOD zk100msxs_ub_b25p5 "" RAT_FUNC "%6.3" "s" COEFFS 0 0 256 0 10 0 /end COMPU_METHOD
/begin COMPU_METHOD zk10msxs_ub_b2p55 "" RAT_FUNC "%6.4" "s" COEFFS 0 0 255 0 100 0 /end COMPU_METHOD
/begin COMPU_METHOD zk10msxs_uw_b655 "" RAT_FUNC "%10.4" "s" COEFFS 0 0 65536 0 100 0 /end COMPU_METHOD
/begin COMPU_METHOD zk200msxs_uw_b13107 "" RAT_FUNC "%10.2" "s" COEFFS 0 0 13107.2 0 1 0 /end COMPU_METHOD
/begin COMPU_METHOD zk20msxs_ub_b5p1 "" RAT_FUNC "%6.4" "s" COEFFS 0 0 5.1 0 1 0 /end COMPU_METHOD
/begin COMPU_METHOD zk20msxs_uw_b1310 "" RAT_FUNC "%10.3" "s" COEFFS 0 0 1310 0 1 0 /end COMPU_METHOD
/begin COMPU_METHOD zk50msxs_uw_b3276p8 "" RAT_FUNC "%10.3" "s" COEFFS 0 0 65536 0 20 0 /end COMPU_METHOD
/begin COMPU_METHOD zw_sb_q0p75 "" RAT_FUNC "%6.3" "grad KW" COEFFS 0 255 0 0 0 191.25 /end COMPU_METHOD
/begin COMPU_METHOD default "" RAT_FUNC "%6.2" "" COEFFS 0 1 0 0 0 1 /end COMPU_METHOD
/begin RECORD_LAYOUT FklWSb FNC_VALUES 1 SBYTE COLUMN_DIR DIRECT /end RECORD_LAYOUT
/begin RECORD_LAYOUT GkfWSw FNC_VALUES 1 SWORD COLUMN_DIR DIRECT /end RECORD_LAYOUT
/begin RECORD_LAYOUT GkfWUb FNC_VALUES 1 UBYTE COLUMN_DIR DIRECT /end RECORD_LAYOUT
/begin RECORD_LAYOUT GkfWUw FNC_VALUES 1 UWORD COLUMN_DIR DIRECT /end RECORD_LAYOUT
/begin RECORD_LAYOUT GklWSw FNC_VALUES 1 SWORD COLUMN_DIR DIRECT /end RECORD_LAYOUT
/begin RECORD_LAYOUT GklWUb FNC_VALUES 1 UBYTE COLUMN_DIR DIRECT /end RECORD_LAYOUT
/begin RECORD_LAYOUT GklWUw FNC_VALUES 1 UWORD COLUMN_DIR DIRECT /end RECORD_LAYOUT
/begin RECORD_LAYOUT KfAxUbAyUbSstxUbSstyUbWUb NO_AXIS_PTS_X 1 UBYTE NO_AXIS_PTS_Y 2 UBYTE AXIS_PTS_X 3 UBYTE INDEX_INCR DIRECT AXIS_PTS_Y 4 UBYTE INDEX_INCR DIRECT FNC_VALUES 5 UBYTE COLUMN_DIR DIRECT /end RECORD_LAYOUT
/begin RECORD_LAYOUT KfAxUbAyUbSstxUbSstyUwWUw NO_AXIS_PTS_X 1 UBYTE NO_AXIS_PTS_Y 2 UBYTE AXIS_PTS_X 3 UBYTE INDEX_INCR DIRECT AXIS_PTS_Y 4 UWORD INDEX_INCR DIRECT FNC_VALUES 5 UWORD COLUMN_DIR DIRECT /end RECORD_LAYOUT
/begin RECORD_LAYOUT KfAxUbAyUbSstxUwSstyUbWUb NO_AXIS_PTS_X 1 UBYTE NO_AXIS_PTS_Y 2 UBYTE AXIS_PTS_X 3 UWORD INDEX_INCR DIRECT AXIS_PTS_Y 4 UBYTE INDEX_INCR DIRECT FNC_VALUES 5 UBYTE COLUMN_DIR DIRECT /end RECORD_LAYOUT
/begin RECORD_LAYOUT KfAxUwAyUwSstxUwSstyUwWUw NO_AXIS_PTS_X 1 UWORD NO_AXIS_PTS_Y 2 UWORD AXIS_PTS_X 3 UWORD INDEX_INCR DIRECT AXIS_PTS_Y 4 UWORD INDEX_INCR DIRECT FNC_VALUES 5 UWORD COLUMN_DIR DIRECT /end RECORD_LAYOUT
/begin RECORD_LAYOUT KlAUbSstUbWUb NO_AXIS_PTS_X 1 UBYTE AXIS_PTS_X 2 UBYTE INDEX_INCR DIRECT FNC_VALUES 3 UBYTE COLUMN_DIR DIRECT /end RECORD_LAYOUT
/begin RECORD_LAYOUT KlAUbSstUbWUw NO_AXIS_PTS_X 1 UBYTE AXIS_PTS_X 2 UBYTE INDEX_INCR DIRECT FNC_VALUES 3 UWORD COLUMN_DIR DIRECT /end RECORD_LAYOUT
/begin RECORD_LAYOUT KlAUwSstUwWUw NO_AXIS_PTS_X 1 UWORD AXIS_PTS_X 2 UWORD INDEX_INCR DIRECT FNC_VALUES 3 UWORD COLUMN_DIR DIRECT /end RECORD_LAYOUT
/begin RECORD_LAYOUT KwSb FNC_VALUES 1 SBYTE COLUMN_DIR DIRECT /end RECORD_LAYOUT
/begin RECORD_LAYOUT KwSw FNC_VALUES 1 SWORD COLUMN_DIR DIRECT /end RECORD_LAYOUT
/begin RECORD_LAYOUT KwUb FNC_VALUES 1 UBYTE COLUMN_DIR DIRECT /end RECORD_LAYOUT
/begin RECORD_LAYOUT KwUw FNC_VALUES 1 UWORD COLUMN_DIR DIRECT /end RECORD_LAYOUT
/begin RECORD_LAYOUT SstASwSstSw NO_AXIS_PTS_X 1 SWORD AXIS_PTS_X 2 SWORD INDEX_INCR DIRECT /end RECORD_LAYOUT
/begin RECORD_LAYOUT SstAUbSstSb NO_AXIS_PTS_X 1 UBYTE AXIS_PTS_X 2 SBYTE INDEX_INCR DIRECT /end RECORD_LAYOUT
/begin RECORD_LAYOUT SstAUbSstUb NO_AXIS_PTS_X 1 UBYTE AXIS_PTS_X 2 UBYTE INDEX_INCR DIRECT /end RECORD_LAYOUT
/begin RECORD_LAYOUT SstAUwSstUw NO_AXIS_PTS_X 1 UWORD AXIS_PTS_X 2 UWORD INDEX_INCR DIRECT /end RECORD_LAYOUT
/end MODULE
/end PROJECT
