ASAP2_VERSION 1 3
/begin PROJECT _7211165 "195"
/begin HEADER "" VERSION "_7211165" PROJECT_NO _7211165 /end HEADER
/begin MODULE DIM ""
/begin MOD_COMMON "" BYTE_ORDER MSB_LAST ALIGNMENT_BYTE 1 ALIGNMENT_WORD 2 ALIGNMENT_LONG 2 /end MOD_COMMON
/begin CHARACTERISTIC CDCAAA "Dummy: Tabellenanfang" VAL_BLK 0x814F52 KwbUw 65535.00 dez 0.00 65535.00 FORMAT "%8.2" NUMBER 4 /end CHARACTERISTIC
/begin CHARACTERISTIC CDCANSKE "Codewort CARB: Ansaugklappe Endstufe" VAL_BLK 0x814F7A KwbUw 65535.00 dez 0.00 65535.00 FORMAT "%8.2" NUMBER 4 /end CHARACTERISTIC
/begin CHARACTERISTIC CDCBM "Codewort CARB: Bezugsmarkengeber" VAL_BLK 0x814F8A KwbUw 65535.00 dez 0.00 65535.00 FORMAT "%8.2" NUMBER 4 /end CHARACTERISTIC
/begin CHARACTERISTIC CDCDHDMTE "Codewort CARB: DM-TL Heizung (Endstufe)" VAL_BLK 0x814FCA KwbUw 65535.00 dez 0.00 65535.00 FORMAT "%8.2" NUMBER 4 /end CHARACTERISTIC
/begin CHARACTERISTIC CDCDMMVE "Codewort CARB: DM-TL Magnetventil (Endstufe)" VAL_BLK 0x814FEA KwbUw 65535.00 dez 0.00 65535.00 FORMAT "%8.2" NUMBER 4 /end CHARACTERISTIC
/begin CHARACTERISTIC CDCDMPME "Codewort CARB: DM-TL Pumpenmotor (Endstufe)" VAL_BLK 0x814FF2 KwbUw 65535.00 dez 0.00 65535.00 FORMAT "%8.2" NUMBER 4 /end CHARACTERISTIC
/begin CHARACTERISTIC CDCDMTK "Codewort CARB: Tankentlüftungssystem Feinstleck" VAL_BLK 0x814FFA KwbUw 65535.00 dez 0.00 65535.00 FORMAT "%8.2" NUMBER 4 /end CHARACTERISTIC
/begin CHARACTERISTIC CDCDMTKNM "Codewort CARB: Kleinstleck, no MIL" VAL_BLK 0x815002 KwbUw 65535.00 dez 0.00 65535.00 FORMAT "%8.2" NUMBER 4 /end CHARACTERISTIC
/begin CHARACTERISTIC CDCDMTL "Codewort CARB: Tankentlüftungssystem Modulfehler (Hardware)" VAL_BLK 0x81500A KwbUw 65535.00 dez 0.00 65535.00 FORMAT "%8.2" NUMBER 4 /end CHARACTERISTIC
/begin CHARACTERISTIC CDCDPMEE "Codewort CARB: DM-TL Pumpenmotor (Endstufe) aus DECJ" VAL_BLK 0x815012 KwbUw 65535.00 dez 0.00 65535.00 FORMAT "%8.2" NUMBER 4 /end CHARACTERISTIC
/begin CHARACTERISTIC CDCETS "Codewort CARB: Elektrisches Thermostat" VAL_BLK 0x815082 KwbUw 65535.00 dez 0.00 65535.00 FORMAT "%8.2" NUMBER 4 /end CHARACTERISTIC
/begin CHARACTERISTIC CDCEV1 "Codewort CARB: EV von Zyl. 1" VAL_BLK 0x81508A KwbUw 65535.00 dez 0.00 65535.00 FORMAT "%8.2" NUMBER 4 /end CHARACTERISTIC
/begin CHARACTERISTIC CDCEV2 "Codewort CARB: EV von Zyl. 2" VAL_BLK 0x815092 KwbUw 65535.00 dez 0.00 65535.00 FORMAT "%8.2" NUMBER 4 /end CHARACTERISTIC
/begin CHARACTERISTIC CDCEV3 "Codewort CARB: EV von Zyl. 3" VAL_BLK 0x81509A KwbUw 65535.00 dez 0.00 65535.00 FORMAT "%8.2" NUMBER 4 /end CHARACTERISTIC
/begin CHARACTERISTIC CDCEV4 "Codewort CARB: EV von Zyl. 4" VAL_BLK 0x8150A2 KwbUw 65535.00 dez 0.00 65535.00 FORMAT "%8.2" NUMBER 4 /end CHARACTERISTIC
/begin CHARACTERISTIC CDCEV5 "Codewort CARB: EV von Zyl. 5" VAL_BLK 0x8150AA KwbUw 65535.00 dez 0.00 65535.00 FORMAT "%8.2" NUMBER 4 /end CHARACTERISTIC
/begin CHARACTERISTIC CDCEV6 "Codewort CARB: EV von Zyl. 6" VAL_BLK 0x8150B2 KwbUw 65535.00 dez 0.00 65535.00 FORMAT "%8.2" NUMBER 4 /end CHARACTERISTIC
/begin CHARACTERISTIC CDCEV7 "Codewort CARB: EV von Zyl. 7" VAL_BLK 0x8150BA KwbUw 65535.00 dez 0.00 65535.00 FORMAT "%8.2" NUMBER 4 /end CHARACTERISTIC
/begin CHARACTERISTIC CDCEV8 "Codewort CARB: EV von Zyl. 8" VAL_BLK 0x8150C2 KwbUw 65535.00 dez 0.00 65535.00 FORMAT "%8.2" NUMBER 4 /end CHARACTERISTIC
/begin CHARACTERISTIC CDCFRAO "Codewort CARB: LR-Adaption obere multiplikativ" VAL_BLK 0x8150E2 KwbUw 65535.00 dez 0.00 65535.00 FORMAT "%8.2" NUMBER 4 /end CHARACTERISTIC
/begin CHARACTERISTIC CDCFRAO2 "Codewort CARB: LR-Adaption obere multiplikativ Bank 2" VAL_BLK 0x8150EA KwbUw 65535.00 dez 0.00 65535.00 FORMAT "%8.2" NUMBER 4 /end CHARACTERISTIC
/begin CHARACTERISTIC CDCFRAU "Codewort CARB: LR-Adaption untere multiplikativ" VAL_BLK 0x8150F2 KwbUw 65535.00 dez 0.00 65535.00 FORMAT "%8.2" NUMBER 4 /end CHARACTERISTIC
/begin CHARACTERISTIC CDCFRAU2 "Codewort CARB: LR-Adaption untere multiplikativ Bank 2" VAL_BLK 0x8150FA KwbUw 65535.00 dez 0.00 65535.00 FORMAT "%8.2" NUMBER 4 /end CHARACTERISTIC
/begin CHARACTERISTIC CDCFRST "Codewort CARB: LR-Abweichung" VAL_BLK 0x815102 KwbUw 65535.00 dez 0.00 65535.00 FORMAT "%8.2" NUMBER 4 /end CHARACTERISTIC
/begin CHARACTERISTIC CDCFRST2 "Codewort CARB: LR-Abweichung Bank 2" VAL_BLK 0x81510A KwbUw 65535.00 dez 0.00 65535.00 FORMAT "%8.2" NUMBER 4 /end CHARACTERISTIC
/begin CHARACTERISTIC CDCFST "Codewort CARB: Tankfüllstand" VAL_BLK 0x815112 KwbUw 65535.00 dez 0.00 65535.00 FORMAT "%8.2" NUMBER 4 /end CHARACTERISTIC
/begin CHARACTERISTIC CDCGLOR "Codewort CARB: Getriebe Low Range" VAL_BLK 0x81511A KwbUw 65535.00 dez 0.00 65535.00 FORMAT "%8.2" NUMBER 4 /end CHARACTERISTIC
/begin CHARACTERISTIC CDCHSH "Codewort CARB:	Lambdasonden-Heizung hinter Katalysator" VAL_BLK 0x815122 KwbUw 65535.00 dez 0.00 65535.00 FORMAT "%8.2" NUMBER 4 /end CHARACTERISTIC
/begin CHARACTERISTIC CDCHSH2 "Codewort CARB:	Lambdasonden-Heizung hinter Katalysator; (Bank2)" VAL_BLK 0x81512A KwbUw 65535.00 dez 0.00 65535.00 FORMAT "%8.2" NUMBER 4 /end CHARACTERISTIC
/begin CHARACTERISTIC CDCHSV "Codewort CARB:	Lambdasonden-Heizung vor Katalysator" VAL_BLK 0x815132 KwbUw 65535.00 dez 0.00 65535.00 FORMAT "%8.2" NUMBER 4 /end CHARACTERISTIC
/begin CHARACTERISTIC CDCHSV2 "Codewort CARB:	Lambdasonden-Heizung vor Katalysator; (Bank2)" VAL_BLK 0x81513A KwbUw 65535.00 dez 0.00 65535.00 FORMAT "%8.2" NUMBER 4 /end CHARACTERISTIC
/begin CHARACTERISTIC CDCKAT "Codewort CARB:	Katalysator-Konvertierung" VAL_BLK 0x815142 KwbUw 65535.00 dez 0.00 65535.00 FORMAT "%8.2" NUMBER 4 /end CHARACTERISTIC
/begin CHARACTERISTIC CDCKAT2 "Codewort CARB:	Katalysator-Konvertierung	(Bank 2)" VAL_BLK 0x81514A KwbUw 65535.00 dez 0.00 65535.00 FORMAT "%8.2" NUMBER 4 /end CHARACTERISTIC
/begin CHARACTERISTIC CDCKKUE "Codewort CARB: Kraftstoffkreislauf-Umschaltung Endstufe" VAL_BLK 0x815152 KwbUw 65535.00 dez 0.00 65535.00 FORMAT "%8.2" NUMBER 4 /end CHARACTERISTIC
/begin CHARACTERISTIC CDCKOS "Codewort CARB:	Klimakompressorsteuerung" VAL_BLK 0x81515A KwbUw 65535.00 dez 0.00 65535.00 FORMAT "%8.2" NUMBER 4 /end CHARACTERISTIC
/begin CHARACTERISTIC CDCKPE "Codewort CARB: EKP-Relais Endstufe" VAL_BLK 0x815162 KwbUw 65535.00 dez 0.00 65535.00 FORMAT "%8.2" NUMBER 4 /end CHARACTERISTIC
/begin CHARACTERISTIC CDCKRNT "Codewort CARB:	Klopfregelung Nulltest" VAL_BLK 0x81516A KwbUw 65535.00 dez 0.00 65535.00 FORMAT "%8.2" NUMBER 4 /end CHARACTERISTIC
/begin CHARACTERISTIC CDCKROF "Codewort CARB: Klopfregelung Offset" VAL_BLK 0x815172 KwbUw 65535.00 dez 0.00 65535.00 FORMAT "%8.2" NUMBER 4 /end CHARACTERISTIC
/begin CHARACTERISTIC CDCKRTP "Codewort CARB: Klopfregelung Testimpulse" VAL_BLK 0x81517A KwbUw 65535.00 dez 0.00 65535.00 FORMAT "%8.2" NUMBER 4 /end CHARACTERISTIC
/begin CHARACTERISTIC CDCKS1 "Codewort CARB:	Klopfsensor 1" VAL_BLK 0x815182 KwbUw 65535.00 dez 0.00 65535.00 FORMAT "%8.2" NUMBER 4 /end CHARACTERISTIC
/begin CHARACTERISTIC CDCKS2 "Codewort CARB:	Klopfsensor 2" VAL_BLK 0x81518A KwbUw 65535.00 dez 0.00 65535.00 FORMAT "%8.2" NUMBER 4 /end CHARACTERISTIC
/begin CHARACTERISTIC CDCKS3 "Codewort CARB:	Klopfsensor 3" VAL_BLK 0x815192 KwbUw 65535.00 dez 0.00 65535.00 FORMAT "%8.2" NUMBER 4 /end CHARACTERISTIC
/begin CHARACTERISTIC CDCKS4 "Codewort CARB:	Klopfsensor 4" VAL_BLK 0x81519A KwbUw 65535.00 dez 0.00 65535.00 FORMAT "%8.2" NUMBER 4 /end CHARACTERISTIC
/begin CHARACTERISTIC CDCKUPPL "Codewort CARB: Kupplungspedalwertgeber" VAL_BLK 0x8151A2 KwbUw 65535.00 dez 0.00 65535.00 FORMAT "%8.2" NUMBER 4 /end CHARACTERISTIC
/begin CHARACTERISTIC CDCLDE "Codewort CARB: Ladedrucksteuerventil (Endstufe)" VAL_BLK 0x8151DA KwbUw 65535.00 dez 0.00 65535.00 FORMAT "%8.2" NUMBER 4 /end CHARACTERISTIC
/begin CHARACTERISTIC CDCLDP "Codewort CARB: Leckdiagnosepumpe" VAL_BLK 0x8151E2 KwbUw 65535.00 dez 0.00 65535.00 FORMAT "%8.2" NUMBER 4 /end CHARACTERISTIC
/begin CHARACTERISTIC CDCLDPE "Codewort CARB: Leckdiagnosepumpe Endstufe" VAL_BLK 0x8151EA KwbUw 65535.00 dez 0.00 65535.00 FORMAT "%8.2" NUMBER 4 /end CHARACTERISTIC
/begin CHARACTERISTIC CDCLM "Codewort CARB:	LMM/HLM/HFM" VAL_BLK 0x8151FA KwbUw 65535.00 dez 0.00 65535.00 FORMAT "%8.2" NUMBER 4 /end CHARACTERISTIC
/begin CHARACTERISTIC CDCLUEA "Codewort CARB: Endstufe Lüfter A" VAL_BLK 0x81522A KwbUw 65535.00 dez 0.00 65535.00 FORMAT "%8.2" NUMBER 4 /end CHARACTERISTIC
/begin CHARACTERISTIC CDCMILE "Codewort CARB: MIL-Endstufe" VAL_BLK 0x81528A KwbUw 65535.00 dez 0.00 65535.00 FORMAT "%8.2" NUMBER 4 /end CHARACTERISTIC
/begin CHARACTERISTIC CDCN "Codewort CARB: Drehzahlsignalgeber" VAL_BLK 0x815292 KwbUw 65535.00 dez 0.00 65535.00 FORMAT "%8.2" NUMBER 4 /end CHARACTERISTIC
/begin CHARACTERISTIC CDCNWSE "Codewort CARB: Nockenwellensteuerungsventil Endstufe" VAL_BLK 0x8152AA KwbUw 65535.00 dez 0.00 65535.00 FORMAT "%8.2" NUMBER 4 /end CHARACTERISTIC
/begin CHARACTERISTIC CDCNWSE2 "Codewort CARB: Nockenwellensteuerungsventil Endstufe 2" VAL_BLK 0x8152B2 KwbUw 65535.00 dez 0.00 65535.00 FORMAT "%8.2" NUMBER 4 /end CHARACTERISTIC
/begin CHARACTERISTIC CDCRKAT "Codewort CARB: LR-Adaption QL-additiv" VAL_BLK 0x8152CA KwbUw 65535.00 dez 0.00 65535.00 FORMAT "%8.2" NUMBER 4 /end CHARACTERISTIC
/begin CHARACTERISTIC CDCRKAT2 "Codewort CARB: LR-Adaption QL-additiv Bank 2" VAL_BLK 0x8152D2 KwbUw 65535.00 dez 0.00 65535.00 FORMAT "%8.2" NUMBER 4 /end CHARACTERISTIC
/begin CHARACTERISTIC CDCRKAZ "Codewort CARB: LR-Adaption ti-additiv" VAL_BLK 0x8152DA KwbUw 65535.00 dez 0.00 65535.00 FORMAT "%8.2" NUMBER 4 /end CHARACTERISTIC
/begin CHARACTERISTIC CDCRKAZ2 "Codewort CARB: LR-Adaption ti-additiv Bank 2" VAL_BLK 0x8152E2 KwbUw 65535.00 dez 0.00 65535.00 FORMAT "%8.2" NUMBER 4 /end CHARACTERISTIC
/begin CHARACTERISTIC CDCSLPE "Codewort CARB: Sekundärluftpumpe (Endstufe)" VAL_BLK 0x8152EA KwbUw 65535.00 dez 0.00 65535.00 FORMAT "%8.2" NUMBER 4 /end CHARACTERISTIC
/begin CHARACTERISTIC CDCSLVE "Codewort CARB: Sekundärluftventil (Endstufe)" VAL_BLK 0x815312 KwbUw 65535.00 dez 0.00 65535.00 FORMAT "%8.2" NUMBER 4 /end CHARACTERISTIC
/begin CHARACTERISTIC CDCSTAE "Codewort CARB: Startautomatik Endstufe" VAL_BLK 0x815322 KwbUw 65535.00 dez 0.00 65535.00 FORMAT "%8.2" NUMBER 4 /end CHARACTERISTIC
/begin CHARACTERISTIC CDCTESB "Codewort CARB: Tankentlüftungssystem verstopfte leitung" VAL_BLK 0x81534A KwbUw 65535.00 dez 0.00 65535.00 FORMAT "%8.2" NUMBER 4 /end CHARACTERISTIC
/begin CHARACTERISTIC CDCTESK "Codewort CARB: Tankentlüftungssystem Kleinstleck" VAL_BLK 0x81535A KwbUw 65535.00 dez 0.00 65535.00 FORMAT "%8.2" NUMBER 4 /end CHARACTERISTIC
/begin CHARACTERISTIC CDCTEVE "Codewort CARB:	Tankentlüftungsventil Endstufe" VAL_BLK 0x815362 KwbUw 65535.00 dez 0.00 65535.00 FORMAT "%8.2" NUMBER 4 /end CHARACTERISTIC
/begin CHARACTERISTIC CDCZZZ "Dummy: Tabellenende" VAL_BLK 0x8153E2 KwbUw 65535.00 dez 0.00 65535.00 FORMAT "%8.2" NUMBER 4 /end CHARACTERISTIC
/begin CHARACTERISTIC CDKAAA "Dummy: Tabellenanfang" VALUE 0x8153EA KwUw 65535.00 dez 0.00 65535.00 FORMAT "%8.2" /end CHARACTERISTIC
/begin CHARACTERISTIC CDKANSKE "Codewort Kunde: Ansaugklappe Endstufe" VALUE 0x8153F4 KwUw 65535.00 dez 0.00 65535.00 FORMAT "%8.2" /end CHARACTERISTIC
/begin CHARACTERISTIC CDKBM "Codewort Kunde: Bezugsmarkengeber" VALUE 0x8153F8 KwUw 65535.00 dez 0.00 65535.00 FORMAT "%8.2" /end CHARACTERISTIC
/begin CHARACTERISTIC CDKDHDMTE "Codewort Kunde: DMTL- Heizung Endstufe" VALUE 0x815408 KwUw 65535.00 dez 0.00 65535.00 FORMAT "%8.2" /end CHARACTERISTIC
/begin CHARACTERISTIC CDKDMMVE "Codewort Kunde: DMTL- Magnet Ventil Endstufe" VALUE 0x815410 KwUw 65535.00 dez 0.00 65535.00 FORMAT "%8.2" /end CHARACTERISTIC
/begin CHARACTERISTIC CDKDMPME "Codewort Kunde: DMTL- Pumpenmotor" VALUE 0x815412 KwUw 65535.00 dez 0.00 65535.00 FORMAT "%8.2" /end CHARACTERISTIC
/begin CHARACTERISTIC CDKDMTK "Codewort Kunde: Tankentlüftungssystem, Feinstleck" VALUE 0x815414 KwUw 65535.00 dez 0.00 65535.00 FORMAT "%8.2" /end CHARACTERISTIC
/begin CHARACTERISTIC CDKDMTKNM "Codewort Kunde: Kleinstleck, no MIL" VALUE 0x815416 KwUw 65535.00 dez 0.00 65535.00 FORMAT "%8.2" /end CHARACTERISTIC
/begin CHARACTERISTIC CDKDMTL "Codewort Kunde: Tankentlüftungssystem, Modulefehler (Hardware)" VALUE 0x815418 KwUw 65535.00 dez 0.00 65535.00 FORMAT "%8.2" /end CHARACTERISTIC
/begin CHARACTERISTIC CDKDPMEE "Codewort Kunde: DM-TL Pumpenmotor (Endst.) aus DECJ" VALUE 0x81541A KwUw 65535.00 dez 0.00 65535.00 FORMAT "%8.2" /end CHARACTERISTIC
/begin CHARACTERISTIC CDKETS "Codewort Kunde: Elektrisches Thermostat" VALUE 0x815436 KwUw 65535.00 dez 0.00 65535.00 FORMAT "%8.2" /end CHARACTERISTIC
/begin CHARACTERISTIC CDKEV1 "Codewort Kunde: EV von Zyl. 1" VALUE 0x815438 KwUw 65535.00 dez 0.00 65535.00 FORMAT "%8.2" /end CHARACTERISTIC
/begin CHARACTERISTIC CDKEV2 "Codewort Kunde: EV von Zyl. 2" VALUE 0x81543A KwUw 65535.00 dez 0.00 65535.00 FORMAT "%8.2" /end CHARACTERISTIC
/begin CHARACTERISTIC CDKEV3 "Codewort Kunde: EV von Zyl. 3" VALUE 0x81543C KwUw 65535.00 dez 0.00 65535.00 FORMAT "%8.2" /end CHARACTERISTIC
/begin CHARACTERISTIC CDKEV4 "Codewort Kunde: EV von Zyl. 4" VALUE 0x81543E KwUw 65535.00 dez 0.00 65535.00 FORMAT "%8.2" /end CHARACTERISTIC
/begin CHARACTERISTIC CDKEV5 "Codewort Kunde: EV von Zyl. 5" VALUE 0x815440 KwUw 65535.00 dez 0.00 65535.00 FORMAT "%8.2" /end CHARACTERISTIC
/begin CHARACTERISTIC CDKEV6 "Codewort Kunde: EV von Zyl. 6" VALUE 0x815442 KwUw 65535.00 dez 0.00 65535.00 FORMAT "%8.2" /end CHARACTERISTIC
/begin CHARACTERISTIC CDKEV7 "Codewort Kunde: EV von Zyl. 7" VALUE 0x815444 KwUw 65535.00 dez 0.00 65535.00 FORMAT "%8.2" /end CHARACTERISTIC
/begin CHARACTERISTIC CDKEV8 "Codewort Kunde: EV von Zyl. 8" VALUE 0x815446 KwUw 65535.00 dez 0.00 65535.00 FORMAT "%8.2" /end CHARACTERISTIC
/begin CHARACTERISTIC CDKFRAO "Codewort Kunde: LR- Adaption multi. obere Schwelle" VALUE 0x81544E KwUw 65535.00 dez 0.00 65535.00 FORMAT "%8.2" /end CHARACTERISTIC
/begin CHARACTERISTIC CDKFRAO2 "Codewort Kunde: LR- Adaption mult. oderer Bereich" VALUE 0x815450 KwUw 65535.00 dez 0.00 65535.00 FORMAT "%8.2" /end CHARACTERISTIC
/begin CHARACTERISTIC CDKFRAU "Codewort Kunde: LR- Adaption multi. untere Schwelle" VALUE 0x815452 KwUw 65535.00 dez 0.00 65535.00 FORMAT "%8.2" /end CHARACTERISTIC
/begin CHARACTERISTIC CDKFRAU2 "Codewort Kunde: LR- Adaption mult. untere Schwelle Bank 2" VALUE 0x815454 KwUw 65535.00 dez 0.00 65535.00 FORMAT "%8.2" /end CHARACTERISTIC
/begin CHARACTERISTIC CDKFRST "Codewort Kunde: LR- Abweichung" VALUE 0x815456 KwUw 65535.00 dez 0.00 65535.00 FORMAT "%8.2" /end CHARACTERISTIC
/begin CHARACTERISTIC CDKFRST2 "Codewort Kunde: LR- Abweichung Bank 2" VALUE 0x815458 KwUw 65535.00 dez 0.00 65535.00 FORMAT "%8.2" /end CHARACTERISTIC
/begin CHARACTERISTIC CDKFST "Codewort Kunde: Tankfüllstand" VALUE 0x81545A KwUw 65535.00 dez 0.00 65535.00 FORMAT "%8.2" /end CHARACTERISTIC
/begin CHARACTERISTIC CDKGLOR "Codewort Kunde: Getriebe Low Range" VALUE 0x81545C KwUw 65535.00 dez 0.00 65535.00 FORMAT "%8.2" /end CHARACTERISTIC
/begin CHARACTERISTIC CDKHSH "Codewort Kunde:	Lambdasonden-Heizung hinter Katalysator" VALUE 0x81545E KwUw 65535.00 dez 0.00 65535.00 FORMAT "%8.2" /end CHARACTERISTIC
/begin CHARACTERISTIC CDKHSH2 "Codewort Kunde:	Lambdasonden-Heizung hinter Katalysator, Bank 2" VALUE 0x815460 KwUw 65535.00 dez 0.00 65535.00 FORMAT "%8.2" /end CHARACTERISTIC
/begin CHARACTERISTIC CDKHSV "Codewort Kunde: Lambdasonden-Heizung vor Katalysator" VALUE 0x815462 KwUw 65535.00 dez 0.00 65535.00 FORMAT "%8.2" /end CHARACTERISTIC
/begin CHARACTERISTIC CDKHSV2 "Codewort Kunde:	Lambdasonden-Heizung vor Katalysator, Bank 2" VALUE 0x815464 KwUw 65535.00 dez 0.00 65535.00 FORMAT "%8.2" /end CHARACTERISTIC
/begin CHARACTERISTIC CDKKAT "Codewort Kunde:	Katalysator-Konvertierung" VALUE 0x815466 KwUw 65535.00 dez 0.00 65535.00 FORMAT "%8.2" /end CHARACTERISTIC
/begin CHARACTERISTIC CDKKAT2 "Codewort Kunde:	Katalysator-Konvertierung	(Bank 2)" VALUE 0x815468 KwUw 65535.00 dez 0.00 65535.00 FORMAT "%8.2" /end CHARACTERISTIC
/begin CHARACTERISTIC CDKKKUE "Codewort Kunde: Kraftstoffkreislauf-Umschaltung Endstufe" VALUE 0x81546A KwUw 65535.00 dez 0.00 65535.00 FORMAT "%8.2" /end CHARACTERISTIC
/begin CHARACTERISTIC CDKKOS "Codewort Kunde:	Klimakompressorsteuerung" VALUE 0x81546C KwUw 65535.00 dez 0.00 65535.00 FORMAT "%8.2" /end CHARACTERISTIC
/begin CHARACTERISTIC CDKKPE "Codewort Kunde: EKP-Relais Endstufe" VALUE 0x81546E KwUw 65535.00 dez 0.00 65535.00 FORMAT "%8.2" /end CHARACTERISTIC
/begin CHARACTERISTIC CDKKRNT "Codewort Kunde:	Klopfregelung Nulltest" VALUE 0x815470 KwUw 65535.00 dez 0.00 65535.00 FORMAT "%8.2" /end CHARACTERISTIC
/begin CHARACTERISTIC CDKKROF "Codewort Kunde:	Klopfregelung Offset" VALUE 0x815472 KwUw 65535.00 dez 0.00 65535.00 FORMAT "%8.2" /end CHARACTERISTIC
/begin CHARACTERISTIC CDKKRTP "Codewort Kunde: Klopfregelung Testimpuls" VALUE 0x815474 KwUw 65535.00 dez 0.00 65535.00 FORMAT "%8.2" /end CHARACTERISTIC
/begin CHARACTERISTIC CDKKS1 "Codewort Kunde:	Klopfsensor 1" VALUE 0x815476 KwUw 65535.00 dez 0.00 65535.00 FORMAT "%8.2" /end CHARACTERISTIC
/begin CHARACTERISTIC CDKKS2 "Codewort Kunde:	Klopfsensor 2" VALUE 0x815478 KwUw 65535.00 dez 0.00 65535.00 FORMAT "%8.2" /end CHARACTERISTIC
/begin CHARACTERISTIC CDKKS3 "Codewort Kunde:	Klopfsensor 3" VALUE 0x81547A KwUw 65535.00 dez 0.00 65535.00 FORMAT "%8.2" /end CHARACTERISTIC
/begin CHARACTERISTIC CDKKS4 "Codewort Kunde:	Klopfsensor 4" VALUE 0x81547C KwUw 65535.00 dez 0.00 65535.00 FORMAT "%8.2" /end CHARACTERISTIC
/begin CHARACTERISTIC CDKKUPPL "Codewort Kunde: Pedalwertgeber Kupplung" VALUE 0x81547E KwUw 65535.00 dez 0.00 65535.00 FORMAT "%8.2" /end CHARACTERISTIC
/begin CHARACTERISTIC CDKLDE "Codeword Kunde: Ladedrucksteuerventil (Endstufe)" VALUE 0x81548C KwUw 65535.00 dez 0.00 65535.00 FORMAT "%8.2" /end CHARACTERISTIC
/begin CHARACTERISTIC CDKLDP "Codewort Kunde: Leckdiagnosepumpe" VALUE 0x81548E KwUw 65535.00 dez 0.00 65535.00 FORMAT "%8.2" /end CHARACTERISTIC
/begin CHARACTERISTIC CDKLDPE "Codewort Kunde: Leckdiagnosepumpe Endstufe" VALUE 0x815490 KwUw 65535.00 dez 0.00 65535.00 FORMAT "%8.2" /end CHARACTERISTIC
/begin CHARACTERISTIC CDKLM "Codewort Kunde:	LMM/HLM/HFM" VALUE 0x815494 KwUw 65535.00 dez 0.00 65535.00 FORMAT "%8.2" /end CHARACTERISTIC
/begin CHARACTERISTIC CDKLUEA "Codewort Kunde:	Endstufe Lüfter A" VALUE 0x8154A0 KwUw 65535.00 dez 0.00 65535.00 FORMAT "%8.2" /end CHARACTERISTIC
/begin CHARACTERISTIC CDKMILE "Codewort Kunde: MIL-Endstufe" VALUE 0x8154B8 KwUw 65535.00 dez 0.00 65535.00 FORMAT "%8.2" /end CHARACTERISTIC
/begin CHARACTERISTIC CDKN "Codewort Kunde: Drehzahlsignalgeber" VALUE 0x8154BA KwUw 65535.00 dez 0.00 65535.00 FORMAT "%8.2" /end CHARACTERISTIC
/begin CHARACTERISTIC CDKNWSE "Codewort Kunde: Nockenwellensteuerungsventil Endstufe" VALUE 0x8154C0 KwUw 65535.00 dez 0.00 65535.00 FORMAT "%8.2" /end CHARACTERISTIC
/begin CHARACTERISTIC CDKNWSE2 "Codewort Kunde: Nockenwellensteuerungsventil (Endstufe Bank 2)" VALUE 0x8154C2 KwUw 65535.00 dez 0.00 65535.00 FORMAT "%8.2" /end CHARACTERISTIC
/begin CHARACTERISTIC CDKRKAT "Codewort Kunde: LR- Adaption pro Zeit" VALUE 0x8154C8 KwUw 65535.00 dez 0.00 65535.00 FORMAT "%8.2" /end CHARACTERISTIC
/begin CHARACTERISTIC CDKRKAT2 "Codewort Kunde: LR- Adaption pro Zeit Bank 2" VALUE 0x8154CA KwUw 65535.00 dez 0.00 65535.00 FORMAT "%8.2" /end CHARACTERISTIC
/begin CHARACTERISTIC CDKRKAZ "Codewort Kunde: LR- Adaption additiv pro Zündung" VALUE 0x8154CC KwUw 65535.00 dez 0.00 65535.00 FORMAT "%8.2" /end CHARACTERISTIC
/begin CHARACTERISTIC CDKRKAZ2 "Codewort Kunde: Lambdaregelungsadaption Kraftstoff (Bank 2)" VALUE 0x8154CE KwUw 65535.00 dez 0.00 65535.00 FORMAT "%8.2" /end CHARACTERISTIC
/begin CHARACTERISTIC CDKSLPE "Codewort Kunde: Sekundärluftpumpe  (Endstufe)" VALUE 0x8154D0 KwUw 65535.00 dez 0.00 65535.00 FORMAT "%8.2" /end CHARACTERISTIC
/begin CHARACTERISTIC CDKSLVE "Codewort Kunde:	Sekundärluftventil (Endstufe)" VALUE 0x8154DA KwUw 65535.00 dez 0.00 65535.00 FORMAT "%8.2" /end CHARACTERISTIC
/begin CHARACTERISTIC CDKSTAE "Codewort Kunde: Startautomatik (Endstufe)" VALUE 0x8154DE KwUw 65535.00 dez 0.00 65535.00 FORMAT "%8.2" /end CHARACTERISTIC
/begin CHARACTERISTIC CDKTESB "Codewort Kunde: Tankentlüftungssystem verstopfte Leitung" VALUE 0x8154E8 KwUw 65535.00 dez 0.00 65535.00 FORMAT "%8.2" /end CHARACTERISTIC
/begin CHARACTERISTIC CDKTESK "Codewort Kunde: Tankentlüftungssystem Kleinstleck" VALUE 0x8154EC KwUw 65535.00 dez 0.00 65535.00 FORMAT "%8.2" /end CHARACTERISTIC
/begin CHARACTERISTIC CDKTEVE "Codewort Kunde:	Tankentlüftungsventil Endstufe" VALUE 0x8154EE KwUw 65535.00 dez 0.00 65535.00 FORMAT "%8.2" /end CHARACTERISTIC
/begin CHARACTERISTIC CDKZZZ "Dummy: Tabellenendeng" VALUE 0x81550E KwUw 65535.00 dez 0.00 65535.00 FORMAT "%8.2" /end CHARACTERISTIC
/begin CHARACTERISTIC CDTAAA "Dummy: Tabellenanfang" VALUE 0x815510 KwUw 65535.00 dez 0.00 65535.00 FORMAT "%8.2" /end CHARACTERISTIC
/begin CHARACTERISTIC CDTANSKE "Codewort Tester: Ansaugklappe Endstufe" VALUE 0x81551A KwUw 65535.00 dez 0.00 65535.00 FORMAT "%8.2" /end CHARACTERISTIC
/begin CHARACTERISTIC CDTBM "Codewort Tester: Bezugsmarkengeber" VALUE 0x81551E KwUw 65535.00 dez 0.00 65535.00 FORMAT "%8.2" /end CHARACTERISTIC
/begin CHARACTERISTIC CDTDHDMTE "Codewort Tester: DM-TL Heizung (Endst.)" VALUE 0x81552E KwUw 65535.00 dez 0.00 65535.00 FORMAT "%8.2" /end CHARACTERISTIC
/begin CHARACTERISTIC CDTDMMVE "Codewort Tester: DM-TL Magnetventil (Endst.)" VALUE 0x815536 KwUw 65535.00 dez 0.00 65535.00 FORMAT "%8.2" /end CHARACTERISTIC
/begin CHARACTERISTIC CDTDMPME "Codewort Tester: DM-TL Pumpenmotor (Endst.)" VALUE 0x815538 KwUw 65535.00 dez 0.00 65535.00 FORMAT "%8.2" /end CHARACTERISTIC
/begin CHARACTERISTIC CDTDMTK "Codewort Tester: Tankentlüftungssystem Feinstleck" VALUE 0x81553A KwUw 65535.00 dez 0.00 65535.00 FORMAT "%8.2" /end CHARACTERISTIC
/begin CHARACTERISTIC CDTDMTKNM "Codewort Tester: Kleinstleck ohne MIL Ansteuerung" VALUE 0x81553C KwUw 65535.00 dez 0.00 65535.00 FORMAT "%8.2" /end CHARACTERISTIC
/begin CHARACTERISTIC CDTDMTL "Codewort Tester: Tankentlüftungssystem Modulfehler (Hardware)" VALUE 0x81553E KwUw 65535.00 dez 0.00 65535.00 FORMAT "%8.2" /end CHARACTERISTIC
/begin CHARACTERISTIC CDTDPMEE "Codewort Tester: DM-TL Pumpenmotor (Endst.) aus DECJ" VALUE 0x815540 KwUw 65535.00 dez 0.00 65535.00 FORMAT "%8.2" /end CHARACTERISTIC
/begin CHARACTERISTIC CDTETS "Codewort Tester: Elektrisches Thermostat" VALUE 0x81555C KwUw 65535.00 dez 0.00 65535.00 FORMAT "%8.2" /end CHARACTERISTIC
/begin CHARACTERISTIC CDTEV1 "Codewort Tester: EV von Zyl. 1" VALUE 0x81555E KwUw 65535.00 dez 0.00 65535.00 FORMAT "%8.2" /end CHARACTERISTIC
/begin CHARACTERISTIC CDTEV2 "Codewort Tester: EV von Zyl. 2" VALUE 0x815560 KwUw 65535.00 dez 0.00 65535.00 FORMAT "%8.2" /end CHARACTERISTIC
/begin CHARACTERISTIC CDTEV3 "Codewort Tester: EV von Zyl. 3" VALUE 0x815562 KwUw 65535.00 dez 0.00 65535.00 FORMAT "%8.2" /end CHARACTERISTIC
/begin CHARACTERISTIC CDTEV4 "Codewort Tester: EV von Zyl. 4" VALUE 0x815564 KwUw 65535.00 dez 0.00 65535.00 FORMAT "%8.2" /end CHARACTERISTIC
/begin CHARACTERISTIC CDTEV5 "Codewort Tester: EV von Zyl. 5" VALUE 0x815566 KwUw 65535.00 dez 0.00 65535.00 FORMAT "%8.2" /end CHARACTERISTIC
/begin CHARACTERISTIC CDTEV6 "Codewort Tester: EV von Zyl. 6" VALUE 0x815568 KwUw 65535.00 dez 0.00 65535.00 FORMAT "%8.2" /end CHARACTERISTIC
/begin CHARACTERISTIC CDTEV7 "Codewort Tester: EV von Zyl. 7" VALUE 0x81556A KwUw 65535.00 dez 0.00 65535.00 FORMAT "%8.2" /end CHARACTERISTIC
/begin CHARACTERISTIC CDTEV8 "Codewort Tester: EV von Zyl. 8" VALUE 0x81556C KwUw 65535.00 dez 0.00 65535.00 FORMAT "%8.2" /end CHARACTERISTIC
/begin CHARACTERISTIC CDTFRAO "Codewort Tester: LR-Adaption multiplikativ obere Schwelle" VALUE 0x815574 KwUw 65535.00 dez 0.00 65535.00 FORMAT "%8.2" /end CHARACTERISTIC
/begin CHARACTERISTIC CDTFRAO2 "Codewort Tester: LR-Adaption multiplikativ obere Schwelle Bank 2" VALUE 0x815576 KwUw 65535.00 dez 0.00 65535.00 FORMAT "%8.2" /end CHARACTERISTIC
/begin CHARACTERISTIC CDTFRAU "Codewort Tester: LR-Adaption multiplikativ untere Schwelle" VALUE 0x815578 KwUw 65535.00 dez 0.00 65535.00 FORMAT "%8.2" /end CHARACTERISTIC
/begin CHARACTERISTIC CDTFRAU2 "Codewort Tester: LR-Adaption multiplikativ untere Schwelle Bank 2" VALUE 0x81557A KwUw 65535.00 dez 0.00 65535.00 FORMAT "%8.2" /end CHARACTERISTIC
/begin CHARACTERISTIC CDTFRST "Codewort Tester: LR-Abweichung" VALUE 0x81557C KwUw 65535.00 dez 0.00 65535.00 FORMAT "%8.2" /end CHARACTERISTIC
/begin CHARACTERISTIC CDTFRST2 "Codewort Tester: LR-Abweichung Bank 2" VALUE 0x81557E KwUw 65535.00 dez 0.00 65535.00 FORMAT "%8.2" /end CHARACTERISTIC
/begin CHARACTERISTIC CDTFST "Codewort Tester: Tankfüllstand" VALUE 0x815580 KwUw 65535.00 dez 0.00 65535.00 FORMAT "%8.2" /end CHARACTERISTIC
/begin CHARACTERISTIC CDTGLOR "Codewort Tester: Getriebe Low Range" VALUE 0x815582 KwUw 65535.00 dez 0.00 65535.00 FORMAT "%8.2" /end CHARACTERISTIC
/begin CHARACTERISTIC CDTHSH "Codewort Tester: Lambdasonden-Heizung hinter Katalysator" VALUE 0x815584 KwUw 65535.00 dez 0.00 65535.00 FORMAT "%8.2" /end CHARACTERISTIC
/begin CHARACTERISTIC CDTHSH2 "Codewort Tester: Lambdasonden-Heizung hinter Kat., Bank 2" VALUE 0x815586 KwUw 65535.00 dez 0.00 65535.00 FORMAT "%8.2" /end CHARACTERISTIC
/begin CHARACTERISTIC CDTHSV "Codewort Tester: Lambdasonden-Heizung vor Katalysator" VALUE 0x815588 KwUw 65535.00 dez 0.00 65535.00 FORMAT "%8.2" /end CHARACTERISTIC
/begin CHARACTERISTIC CDTHSV2 "Codewort Tester: Lambdasonden-Heizung vor Kat., Bank 2" VALUE 0x81558A KwUw 65535.00 dez 0.00 65535.00 FORMAT "%8.2" /end CHARACTERISTIC
/begin CHARACTERISTIC CDTKAT "Codewort Tester: Katalysator-Konvertierung" VALUE 0x81558C KwUw 65535.00 dez 0.00 65535.00 FORMAT "%8.2" /end CHARACTERISTIC
/begin CHARACTERISTIC CDTKAT2 "Codewort Tester: Katalysator-Konvertierung (Bank 2)" VALUE 0x81558E KwUw 65535.00 dez 0.00 65535.00 FORMAT "%8.2" /end CHARACTERISTIC
/begin CHARACTERISTIC CDTKKUE "Codewort Tester: Kraftstoffkreislauf-Umschaltung Endstufe" VALUE 0x815590 KwUw 65535.00 dez 0.00 65535.00 FORMAT "%8.2" /end CHARACTERISTIC
/begin CHARACTERISTIC CDTKOS "Codewort Tester: Klimakompressorsteuerung" VALUE 0x815592 KwUw 65535.00 dez 0.00 65535.00 FORMAT "%8.2" /end CHARACTERISTIC
/begin CHARACTERISTIC CDTKPE "Codewort Tester: EKP-Relais Endstufe" VALUE 0x815594 KwUw 65535.00 dez 0.00 65535.00 FORMAT "%8.2" /end CHARACTERISTIC
/begin CHARACTERISTIC CDTKRNT "Codewort Tester: Klopfregelung Nulltest" VALUE 0x815596 KwUw 65535.00 dez 0.00 65535.00 FORMAT "%8.2" /end CHARACTERISTIC
/begin CHARACTERISTIC CDTKROF "Codewort Tester: Klopfregelung Offset" VALUE 0x815598 KwUw 65535.00 dez 0.00 65535.00 FORMAT "%8.2" /end CHARACTERISTIC
/begin CHARACTERISTIC CDTKRTP "Codewort Tester: Klopfregelung Testimpuls" VALUE 0x81559A KwUw 65535.00 dez 0.00 65535.00 FORMAT "%8.2" /end CHARACTERISTIC
/begin CHARACTERISTIC CDTKS1 "Codewort Tester: Klopfsensor 1" VALUE 0x81559C KwUw 65535.00 dez 0.00 65535.00 FORMAT "%8.2" /end CHARACTERISTIC
/begin CHARACTERISTIC CDTKS2 "Codewort Tester: Klopfsensor 2" VALUE 0x81559E KwUw 65535.00 dez 0.00 65535.00 FORMAT "%8.2" /end CHARACTERISTIC
/begin CHARACTERISTIC CDTKS3 "Codewort Tester: Klopfsensor 3" VALUE 0x8155A0 KwUw 65535.00 dez 0.00 65535.00 FORMAT "%8.2" /end CHARACTERISTIC
/begin CHARACTERISTIC CDTKS4 "Codewort Tester: Klopfsensor 4" VALUE 0x8155A2 KwUw 65535.00 dez 0.00 65535.00 FORMAT "%8.2" /end CHARACTERISTIC
/begin CHARACTERISTIC CDTKUPPL "Fehlerpfadcode: Pedalwertgeber Kupplung" VALUE 0x8155A4 KwUw 65535.00 dez 0.00 65535.00 FORMAT "%8.2" /end CHARACTERISTIC
/begin CHARACTERISTIC CDTLDE "Codewort Tester: Ladedrucksteuerventil (Endstufe)" VALUE 0x8155B2 KwUw 65535.00 dez 0.00 65535.00 FORMAT "%8.2" /end CHARACTERISTIC
/begin CHARACTERISTIC CDTLDP "Codewort Tester: Tankentlüftung; Leckdiagnosepumpe" VALUE 0x8155B4 KwUw 65535.00 dez 0.00 65535.00 FORMAT "%8.2" /end CHARACTERISTIC
/begin CHARACTERISTIC CDTLDPE "Codewort Tester: Leckdiagnosepumpe Endstufe" VALUE 0x8155B6 KwUw 65535.00 dez 0.00 65535.00 FORMAT "%8.2" /end CHARACTERISTIC
/begin CHARACTERISTIC CDTLM "Codewort Tester: LMM/HLM/HFM" VALUE 0x8155BA KwUw 65535.00 dez 0.00 65535.00 FORMAT "%8.2" /end CHARACTERISTIC
/begin CHARACTERISTIC CDTLUEA "Codewort Tester: Endstufe Lüfter A" VALUE 0x8155C6 KwUw 65535.00 dez 0.00 65535.00 FORMAT "%8.2" /end CHARACTERISTIC
/begin CHARACTERISTIC CDTMILE "Codewort Tester: MIL-Endstufe" VALUE 0x8155DE KwUw 65535.00 dez 0.00 65535.00 FORMAT "%8.2" /end CHARACTERISTIC
/begin CHARACTERISTIC CDTN "Codewort Tester: Drehzahlsignalgeber" VALUE 0x8155E0 KwUw 65535.00 dez 0.00 65535.00 FORMAT "%8.2" /end CHARACTERISTIC
/begin CHARACTERISTIC CDTNWSE "Codewort Tester: Nockenwellensteuerungsventil Endstufe" VALUE 0x8155E6 KwUw 65535.00 dez 0.00 65535.00 FORMAT "%8.2" /end CHARACTERISTIC
/begin CHARACTERISTIC CDTNWSE2 "Codewort Tester: Nockenwellensteuerventil Endst. Bank 2" VALUE 0x8155E8 KwUw 65535.00 dez 0.00 65535.00 FORMAT "%8.2" /end CHARACTERISTIC
/begin CHARACTERISTIC CDTRKAT "Codewort Tester: LR-Adaption additiv pro Zeit" VALUE 0x8155EE KwUw 65535.00 dez 0.00 65535.00 FORMAT "%8.2" /end CHARACTERISTIC
/begin CHARACTERISTIC CDTRKAT2 "Codewort Tester: LR-Adaption additiv pro Zeit bank 2" VALUE 0x8155F0 KwUw 65535.00 dez 0.00 65535.00 FORMAT "%8.2" /end CHARACTERISTIC
/begin CHARACTERISTIC CDTRKAZ "Codewort Tester: LR-Adaption additiv pro Zündung" VALUE 0x8155F2 KwUw 65535.00 dez 0.00 65535.00 FORMAT "%8.2" /end CHARACTERISTIC
/begin CHARACTERISTIC CDTRKAZ2 "Codewort Tester: LR-Adaption additiv pro Zündung bank 2" VALUE 0x8155F4 KwUw 65535.00 dez 0.00 65535.00 FORMAT "%8.2" /end CHARACTERISTIC
/begin CHARACTERISTIC CDTSLPE "Codewort Tester: Sekundärluftpumpe (Endstufe)" VALUE 0x8155F6 KwUw 65535.00 dez 0.00 65535.00 FORMAT "%8.2" /end CHARACTERISTIC
/begin CHARACTERISTIC CDTSLVE "Codewort Tester: Sekundärluftventil (Endstufe)" VALUE 0x815600 KwUw 65535.00 dez 0.00 65535.00 FORMAT "%8.2" /end CHARACTERISTIC
/begin CHARACTERISTIC CDTSTAE "Codewort Tester: Startautomatik     (Endstufe)" VALUE 0x815604 KwUw 65535.00 dez 0.00 65535.00 FORMAT "%8.2" /end CHARACTERISTIC
/begin CHARACTERISTIC CDTTESB "Codewort Tester: Tankentlüftungssystem, Leitung blockiert" VALUE 0x81560E KwUw 65535.00 dez 0.00 65535.00 FORMAT "%8.2" /end CHARACTERISTIC
/begin CHARACTERISTIC CDTTESK "Codewort Tester: Tankentlüftungssystem Kleinstleck" VALUE 0x815612 KwUw 65535.00 dez 0.00 65535.00 FORMAT "%8.2" /end CHARACTERISTIC
/begin CHARACTERISTIC CDTTEVE "Codewort Tester: Tankentlüftungsventil Endstufe" VALUE 0x815614 KwUw 65535.00 dez 0.00 65535.00 FORMAT "%8.2" /end CHARACTERISTIC
/begin CHARACTERISTIC CDTZZZ "Dummy: Tabellenende" VALUE 0x815634 KwUw 65535.00 dez 0.00 65535.00 FORMAT "%8.2" /end CHARACTERISTIC
/begin CHARACTERISTIC CLAAAA "Dummy: Tabellenanfang" VALUE 0x811603 KwUb 255.0 dez 0.00 255.0 FORMAT "%5.1" /end CHARACTERISTIC
/begin CHARACTERISTIC CLAANSKE "Fehlerklasse: Ansaugklappe Endstufe" VALUE 0x811608 KwUb 255.0 dez 0.00 255.0 FORMAT "%5.1" /end CHARACTERISTIC
/begin CHARACTERISTIC CLABM "Fehlerklasse: Bezugsmarkengeber" VALUE 0x81160A KwUb 255.0 dez 0.00 255.0 FORMAT "%5.1" /end CHARACTERISTIC
/begin CHARACTERISTIC CLADHDMTE "Fehlerklasse: DM-TL Heizung (Endstufe)" VALUE 0x811612 KwUb 255.0 dez 0.00 255.0 FORMAT "%5.1" /end CHARACTERISTIC
/begin CHARACTERISTIC CLADMMVE "Fehlerklasse: DM-TL Magnetventil (Endstufe)" VALUE 0x811616 KwUb 255.0 dez 0.00 255.0 FORMAT "%5.1" /end CHARACTERISTIC
/begin CHARACTERISTIC CLADMPME "Fehlerklasse: DM-TL Pumpenmotor (Endstufe)" VALUE 0x811617 KwUb 255.0 dez 0.00 255.0 FORMAT "%5.1" /end CHARACTERISTIC
/begin CHARACTERISTIC CLADMTK "Fehlerklasse: Tankdiagnose, Feinstleck" VALUE 0x811618 KwUb 255.0 dez 0.00 255.0 FORMAT "%5.1" /end CHARACTERISTIC
/begin CHARACTERISTIC CLADMTKNM "Fehlerklasse: Kleinstleck, no MIL" VALUE 0x811619 KwUb 255.0 dez 0.00 255.0 FORMAT "%5.1" /end CHARACTERISTIC
/begin CHARACTERISTIC CLADMTL "Fehlerklasse: Tankdiagnose, Modulfehler" VALUE 0x81161A KwUb 255.0 dez 0.00 255.0 FORMAT "%5.1" /end CHARACTERISTIC
/begin CHARACTERISTIC CLADPMEE "Fehlerklasse: DM-TL Pumpenmotor (Endstufe) aus DECJ" VALUE 0x81161B KwUb 255.0 dez 0.00 255.0 FORMAT "%5.1" /end CHARACTERISTIC
/begin CHARACTERISTIC CLAETS "Fehlerklasse: ETS-Endstufe" VALUE 0x811629 KwUb 255.0 dez 0.00 255.0 FORMAT "%5.1" /end CHARACTERISTIC
/begin CHARACTERISTIC CLAEV1 "Fehlerklasse: EV Endtsufe 1" VALUE 0x81162A KwUb 255.0 dez 0.00 255.0 FORMAT "%5.1" /end CHARACTERISTIC
/begin CHARACTERISTIC CLAEV2 "Fehlerklasse: EV Endstufe 2" VALUE 0x81162B KwUb 255.0 dez 0.00 255.0 FORMAT "%5.1" /end CHARACTERISTIC
/begin CHARACTERISTIC CLAEV3 "Fehlerklasse: EV Endstufe 3" VALUE 0x81162C KwUb 255.0 dez 0.00 255.0 FORMAT "%5.1" /end CHARACTERISTIC
/begin CHARACTERISTIC CLAEV4 "Fehlerklasse: EV Endstufe 4" VALUE 0x81162D KwUb 255.0 dez 0.00 255.0 FORMAT "%5.1" /end CHARACTERISTIC
/begin CHARACTERISTIC CLAEV5 "Fehlerklasse: EV Endstufe 5" VALUE 0x81162E KwUb 255.0 dez 0.00 255.0 FORMAT "%5.1" /end CHARACTERISTIC
/begin CHARACTERISTIC CLAEV6 "Fehlerklasse: EV Endstufe 6" VALUE 0x81162F KwUb 255.0 dez 0.00 255.0 FORMAT "%5.1" /end CHARACTERISTIC
/begin CHARACTERISTIC CLAEV7 "Fehlerklasse: EV Endstufe 7" VALUE 0x811630 KwUb 255.0 dez 0.00 255.0 FORMAT "%5.1" /end CHARACTERISTIC
/begin CHARACTERISTIC CLAEV8 "Fehlerklasse: EV Endstufe 8" VALUE 0x811631 KwUb 255.0 dez 0.00 255.0 FORMAT "%5.1" /end CHARACTERISTIC
/begin CHARACTERISTIC CLAFRAO "Fehlerklasse: LR-Adaption oberer Bereich" VALUE 0x811635 KwUb 255.0 dez 0.00 255.0 FORMAT "%5.1" /end CHARACTERISTIC
/begin CHARACTERISTIC CLAFRAO2 "Fehlerklasse: LR-Adaption oberer Bereich Bank 2" VALUE 0x811636 KwUb 255.0 dez 0.00 255.0 FORMAT "%5.1" /end CHARACTERISTIC
/begin CHARACTERISTIC CLAFRAU "Fehlerklasse: LR-Adaption unterer Bereich" VALUE 0x811637 KwUb 255.0 dez 0.00 255.0 FORMAT "%5.1" /end CHARACTERISTIC
/begin CHARACTERISTIC CLAFRAU2 "Fehlerklasse: LR-Adaption unterer Bereich Bank 2" VALUE 0x811638 KwUb 255.0 dez 0.00 255.0 FORMAT "%5.1" /end CHARACTERISTIC
/begin CHARACTERISTIC CLAFRST "Fehlerklasse: LR-Abweichung" VALUE 0x811639 KwUb 255.0 dez 0.00 255.0 FORMAT "%5.1" /end CHARACTERISTIC
/begin CHARACTERISTIC CLAFRST2 "Fehlerklasse : LR-Abweichung Bank 2" VALUE 0x81163A KwUb 255.0 dez 0.00 255.0 FORMAT "%5.1" /end CHARACTERISTIC
/begin CHARACTERISTIC CLAFST "Fehlerklasse: Tankfüllstandssensor" VALUE 0x81163B KwUb 255.0 dez 0.00 255.0 FORMAT "%5.1" /end CHARACTERISTIC
/begin CHARACTERISTIC CLAGLOR "Fehlerklasse: Getriebe, low range Erkennung" VALUE 0x81163C KwUb 255.0 dez 0.00 255.0 FORMAT "%5.1" /end CHARACTERISTIC
/begin CHARACTERISTIC CLAHSH "Fehlerklasse: Heizung Lambdasonde hinter Kat" VALUE 0x81163D KwUb 255.0 dez 0.00 255.0 FORMAT "%5.1" /end CHARACTERISTIC
/begin CHARACTERISTIC CLAHSH2 "Fehlerklasse: Heizung Lambdasonde 2 hinter Kat" VALUE 0x81163E KwUb 255.0 dez 0.00 255.0 FORMAT "%5.1" /end CHARACTERISTIC
/begin CHARACTERISTIC CLAHSV "Fehlerklasse: Heizung Lambdasonde vor Kat" VALUE 0x81163F KwUb 255.0 dez 0.00 255.0 FORMAT "%5.1" /end CHARACTERISTIC
/begin CHARACTERISTIC CLAHSV2 "Fehlerklasse: Heizung Lambdasonde 2 vor Kat" VALUE 0x811640 KwUb 255.0 dez 0.00 255.0 FORMAT "%5.1" /end CHARACTERISTIC
/begin CHARACTERISTIC CLAKAT "Fehlerklasse: Katalysator" VALUE 0x811641 KwUb 255.0 dez 0.00 255.0 FORMAT "%5.1" /end CHARACTERISTIC
/begin CHARACTERISTIC CLAKAT2 "Fehlerklasse: Katalysator Bank 2" VALUE 0x811642 KwUb 255.0 dez 0.00 255.0 FORMAT "%5.1" /end CHARACTERISTIC
/begin CHARACTERISTIC CLAKKUE "" VALUE 0x811643 KwUb 255.0 dez 0.00 255.0 FORMAT "%5.1" /end CHARACTERISTIC
/begin CHARACTERISTIC CLAKOS "Fehlerklasse: Kompressor-Endstufe" VALUE 0x811644 KwUb 255.0 dez 0.00 255.0 FORMAT "%5.1" /end CHARACTERISTIC
/begin CHARACTERISTIC CLAKPE "Fehlerklasse: EKP-Relais Endstufe" VALUE 0x811645 KwUb 255.0 dez 0.00 255.0 FORMAT "%5.1" /end CHARACTERISTIC
/begin CHARACTERISTIC CLAKRNT "Fehlerklasse: Klopfregelung Nulltest" VALUE 0x811646 KwUb 255.0 dez 0.00 255.0 FORMAT "%5.1" /end CHARACTERISTIC
/begin CHARACTERISTIC CLAKROF "Fehlerklasse: Klopfreglung Offset" VALUE 0x811647 KwUb 255.0 dez 0.00 255.0 FORMAT "%5.1" /end CHARACTERISTIC
/begin CHARACTERISTIC CLAKRTP "Fehlerklasse: Klopfregelung Testimpuls" VALUE 0x811648 KwUb 255.0 dez 0.00 255.0 FORMAT "%5.1" /end CHARACTERISTIC
/begin CHARACTERISTIC CLAKS1 "Fehlerklasse: Klopfsensor 1" VALUE 0x811649 KwUb 255.0 dez 0.00 255.0 FORMAT "%5.1" /end CHARACTERISTIC
/begin CHARACTERISTIC CLAKS2 "Fehlerklasse: Klopfsensor 2" VALUE 0x81164A KwUb 255.0 dez 0.00 255.0 FORMAT "%5.1" /end CHARACTERISTIC
/begin CHARACTERISTIC CLAKS3 "Fehlerklasse: Klopfsensor 3" VALUE 0x81164B KwUb 255.0 dez 0.00 255.0 FORMAT "%5.1" /end CHARACTERISTIC
/begin CHARACTERISTIC CLAKS4 "Fehlerklasse: Klopfsensor 4" VALUE 0x81164C KwUb 255.0 dez 0.00 255.0 FORMAT "%5.1" /end CHARACTERISTIC
/begin CHARACTERISTIC CLAKUPPL "Fehlerklasse: Pedalwertgeber Kupplung" VALUE 0x81164D KwUb 255.0 dez 0.00 255.0 FORMAT "%5.1" /end CHARACTERISTIC
/begin CHARACTERISTIC CLALDE "Fehlerklasse: LDR-Taktventil Endstufe" VALUE 0x811654 KwUb 255.0 dez 0.00 255.0 FORMAT "%5.1" /end CHARACTERISTIC
/begin CHARACTERISTIC CLALDP "Fehlerklasse: Leckdiagnosepumpe" VALUE 0x811655 KwUb 255.0 dez 0.00 255.0 FORMAT "%5.1" /end CHARACTERISTIC
/begin CHARACTERISTIC CLALDPE "Fehlerklasse: LDP  Endstufe" VALUE 0x811656 KwUb 255.0 dez 0.00 255.0 FORMAT "%5.1" /end CHARACTERISTIC
/begin CHARACTERISTIC CLALM "Fehlerklasse: Hauptfüllungssignal" VALUE 0x811658 KwUb 255.0 dez 0.00 255.0 FORMAT "%5.1" /end CHARACTERISTIC
/begin CHARACTERISTIC CLALUEA "Fehlerklasse: Motorlüfter Endstufe A" VALUE 0x81165E KwUb 255.0 dez 0.00 255.0 FORMAT "%5.1" /end CHARACTERISTIC
/begin CHARACTERISTIC CLAMILE "Fehlerklasse: MIL-Endstufe" VALUE 0x81166A KwUb 255.0 dez 0.00 255.0 FORMAT "%5.1" /end CHARACTERISTIC
/begin CHARACTERISTIC CLAN "Fehlerklasse: Drehzahlgeber" VALUE 0x81166B KwUb 255.0 dez 0.00 255.0 FORMAT "%5.1" /end CHARACTERISTIC
/begin CHARACTERISTIC CLANWSE "Fehlerklasse: Nockenwellensteuerungsventil Endstufe" VALUE 0x81166E KwUb 255.0 dez 0.00 255.0 FORMAT "%5.1" /end CHARACTERISTIC
/begin CHARACTERISTIC CLANWSE2 "Fehlerklasse: Nockenwellensteuerungsventil Endstufe Bank 2" VALUE 0x81166F KwUb 255.0 dez 0.00 255.0 FORMAT "%5.1" /end CHARACTERISTIC
/begin CHARACTERISTIC CLARKAT "Fehlerklasse: LR-Adaption additiver Bereich pro Zeit" VALUE 0x811672 KwUb 255.0 dez 0.00 255.0 FORMAT "%5.1" /end CHARACTERISTIC
/begin CHARACTERISTIC CLARKAT2 "Fehlerklasse: LR-Adaption additiver Bereich pro Zeit Bank 2" VALUE 0x811673 KwUb 255.0 dez 0.00 255.0 FORMAT "%5.1" /end CHARACTERISTIC
/begin CHARACTERISTIC CLARKAZ "Fehlerklasse: LR-Adaption additiver Bereich pro Zündung" VALUE 0x811674 KwUb 255.0 dez 0.00 255.0 FORMAT "%5.1" /end CHARACTERISTIC
/begin CHARACTERISTIC CLARKAZ2 "Fehlerklasse: LR-Adaption additiver Bereich pro Zündung Bank 2" VALUE 0x811675 KwUb 255.0 dez 0.00 255.0 FORMAT "%5.1" /end CHARACTERISTIC
/begin CHARACTERISTIC CLASLPE "Fehlerklasse: Sekundärluftpumpe Endstufe" VALUE 0x811676 KwUb 255.0 dez 0.00 255.0 FORMAT "%5.1" /end CHARACTERISTIC
/begin CHARACTERISTIC CLASLVE "Fehlerklasse: Sekundärluftventil Endstufe" VALUE 0x81167B KwUb 255.0 dez 0.00 255.0 FORMAT "%5.1" /end CHARACTERISTIC
/begin CHARACTERISTIC CLASTAE "Fehlerklasse: Start-Relais Endstufe" VALUE 0x81167D KwUb 255.0 dez 0.00 255.0 FORMAT "%5.1" /end CHARACTERISTIC
/begin CHARACTERISTIC CLATESB "Fehlerklasse: Tankentlüftungssystem verstopfte Leitung" VALUE 0x811682 KwUb 255.0 dez 0.00 255.0 FORMAT "%5.1" /end CHARACTERISTIC
/begin CHARACTERISTIC CLATESK "Fehlerklasse: Tankdiagnose, Kleinstleck" VALUE 0x811684 KwUb 255.0 dez 0.00 255.0 FORMAT "%5.1" /end CHARACTERISTIC
/begin CHARACTERISTIC CLATEVE "Fehlerklasse: Tankentlüftungsventil Endstufe" VALUE 0x811685 KwUb 255.0 dez 0.00 255.0 FORMAT "%5.1" /end CHARACTERISTIC
/begin CHARACTERISTIC CLAZZZ "Dummy: Tabellenende" VALUE 0x811695 KwUb 255.0 dez 0.00 255.0 FORMAT "%5.1" /end CHARACTERISTIC
/begin CHARACTERISTIC FFTAAA "Dummy: Tabellenanfang" VAL_BLK 0x811696 KwbUb 255.0 dez 0.00 255.0 FORMAT "%5.1" NUMBER 4 /end CHARACTERISTIC
/begin CHARACTERISTIC FFTANSKE "Freeze Frame Tabelle: Ansaugklappe Endstufe" VAL_BLK 0x8116AA KwbUb 255.0 dez 0.00 255.0 FORMAT "%5.1" NUMBER 4 /end CHARACTERISTIC
/begin CHARACTERISTIC FFTBM "Freeze Frame Tabelle: Bezugsmarkengeber" VAL_BLK 0x8116B2 KwbUb 255.0 dez 0.00 255.0 FORMAT "%5.1" NUMBER 4 /end CHARACTERISTIC
/begin CHARACTERISTIC FFTDHDMTE "Freeze Frame Tabelle: DM-TL Heizung (Endstufe)" VAL_BLK 0x8116D2 KwbUb 255.0 dez 0.00 255.0 FORMAT "%5.1" NUMBER 4 /end CHARACTERISTIC
/begin CHARACTERISTIC FFTDMMVE "Freeze Frame Tabelle: DM-TL Magnetventil (Endstufe)" VAL_BLK 0x8116E2 KwbUb 255.0 dez 0.00 255.0 FORMAT "%5.1" NUMBER 4 /end CHARACTERISTIC
/begin CHARACTERISTIC FFTDMPME "Freeze Frame Tabelle: DM-TL Pumpenmotor (Endstufe)" VAL_BLK 0x8116E6 KwbUb 255.0 dez 0.00 255.0 FORMAT "%5.1" NUMBER 4 /end CHARACTERISTIC
/begin CHARACTERISTIC FFTDMTK "Freeze Frame Tabelle: Tankdiagnose, Feinstleck" VAL_BLK 0x8116EA KwbUb 255.0 dez 0.00 255.0 FORMAT "%5.1" NUMBER 4 /end CHARACTERISTIC
/begin CHARACTERISTIC FFTDMTKNM "Freeze Frame Tabelle: Kleinstleck, no MIL" VAL_BLK 0x8116EE KwbUb 255.0 dez 0.00 255.0 FORMAT "%5.1" NUMBER 4 /end CHARACTERISTIC
/begin CHARACTERISTIC FFTDMTL "Freeze Frame Tabelle: Tankdiagnose, Modulfehler (Hardware)" VAL_BLK 0x8116F2 KwbUb 255.0 dez 0.00 255.0 FORMAT "%5.1" NUMBER 4 /end CHARACTERISTIC
/begin CHARACTERISTIC FFTDPMEE "Freeze Frame Tabelle: DM-TL Pumpenmotor (Endstufe) aus DECJ" VAL_BLK 0x8116F6 KwbUb 255.0 dez 0.00 255.0 FORMAT "%5.1" NUMBER 4 /end CHARACTERISTIC
/begin CHARACTERISTIC FFTETS "Freeze Frame Tabelle: ETS-Endstufe" VAL_BLK 0x81172E KwbUb 255.0 dez 0.00 255.0 FORMAT "%5.1" NUMBER 4 /end CHARACTERISTIC
/begin CHARACTERISTIC FFTEV1 "Freeze Frame Tabelle: EV Endstufe 1" VAL_BLK 0x811732 KwbUb 255.0 dez 0.00 255.0 FORMAT "%5.1" NUMBER 4 /end CHARACTERISTIC
/begin CHARACTERISTIC FFTEV2 "Freeze Frame Tabelle: EV Endstufe 2" VAL_BLK 0x811736 KwbUb 255.0 dez 0.00 255.0 FORMAT "%5.1" NUMBER 4 /end CHARACTERISTIC
/begin CHARACTERISTIC FFTEV3 "Freeze Frame Tabelle: EV Endstufe 3" VAL_BLK 0x81173A KwbUb 255.0 dez 0.00 255.0 FORMAT "%5.1" NUMBER 4 /end CHARACTERISTIC
/begin CHARACTERISTIC FFTEV4 "Freeze Frame Tabelle: EV Endstufe 4" VAL_BLK 0x81173E KwbUb 255.0 dez 0.00 255.0 FORMAT "%5.1" NUMBER 4 /end CHARACTERISTIC
/begin CHARACTERISTIC FFTEV5 "Freeze Frame Tabelle: EV Endstufe 5" VAL_BLK 0x811742 KwbUb 255.0 dez 0.00 255.0 FORMAT "%5.1" NUMBER 4 /end CHARACTERISTIC
/begin CHARACTERISTIC FFTEV6 "Freeze frame Tabelle: EV Endstufe 6" VAL_BLK 0x811746 KwbUb 255.0 dez 0.00 255.0 FORMAT "%5.1" NUMBER 4 /end CHARACTERISTIC
/begin CHARACTERISTIC FFTEV7 "Freeze Frame Tabelle: EV Endstufe 7" VAL_BLK 0x81174A KwbUb 255.0 dez 0.00 255.0 FORMAT "%5.1" NUMBER 4 /end CHARACTERISTIC
/begin CHARACTERISTIC FFTEV8 "Freeze Frame Tabelle: EV Endstufe 8" VAL_BLK 0x81174E KwbUb 255.0 dez 0.00 255.0 FORMAT "%5.1" NUMBER 4 /end CHARACTERISTIC
/begin CHARACTERISTIC FFTFRAO "Freeze Frame Tabelle: FRAO Gemischadaption" VAL_BLK 0x81175E KwbUb 255.0 dez 0.00 255.0 FORMAT "%5.1" NUMBER 4 /end CHARACTERISTIC
/begin CHARACTERISTIC FFTFRAO2 "Freeze Frame Tabelle: FRAO Gemischadaption Bank 2" VAL_BLK 0x811762 KwbUb 255.0 dez 0.00 255.0 FORMAT "%5.1" NUMBER 4 /end CHARACTERISTIC
/begin CHARACTERISTIC FFTFRAU "Freeze Frame Tabelle: FRAU Gemischadaption" VAL_BLK 0x811766 KwbUb 255.0 dez 0.00 255.0 FORMAT "%5.1" NUMBER 4 /end CHARACTERISTIC
/begin CHARACTERISTIC FFTFRAU2 "Freeze Frame Tabelle: FRAU Gemischadaption Bank 2" VAL_BLK 0x81176A KwbUb 255.0 dez 0.00 255.0 FORMAT "%5.1" NUMBER 4 /end CHARACTERISTIC
/begin CHARACTERISTIC FFTFRST "Freeze Frame Tabelle: LR-Abweichung" VAL_BLK 0x81176E KwbUb 255.0 dez 0.00 255.0 FORMAT "%5.1" NUMBER 4 /end CHARACTERISTIC
/begin CHARACTERISTIC FFTFRST2 "Freeze Frame Tabelle: LR-Abweichung Bank 2" VAL_BLK 0x811772 KwbUb 255.0 dez 0.00 255.0 FORMAT "%5.1" NUMBER 4 /end CHARACTERISTIC
/begin CHARACTERISTIC FFTFST "Freeze Frame Tabelle: Tankfüllstand" VAL_BLK 0x811776 KwbUb 255.0 dez 0.00 255.0 FORMAT "%5.1" NUMBER 4 /end CHARACTERISTIC
/begin CHARACTERISTIC FFTGLOR "Freeze Frame Tabelle: Getriebe, low range Erkennung" VAL_BLK 0x81177A KwbUb 255.0 dez 0.00 255.0 FORMAT "%5.1" NUMBER 4 /end CHARACTERISTIC
/begin CHARACTERISTIC FFTHSH "Tabelle Umweltbedingungen Heizung Lambdasonde hinter Kat" VAL_BLK 0x81177E KwbUb 255.0 dez 0.00 255.0 FORMAT "%5.1" NUMBER 4 /end CHARACTERISTIC
/begin CHARACTERISTIC FFTHSH2 "Tabelle Umweltbedingungen Heizung Lambdasonde hinter Kat Bank2" VAL_BLK 0x811782 KwbUb 255.0 dez 0.00 255.0 FORMAT "%5.1" NUMBER 4 /end CHARACTERISTIC
/begin CHARACTERISTIC FFTHSV "Tabelle Umweltbedingungen Heizung Lambdasonde vor Kat" VAL_BLK 0x811786 KwbUb 255.0 dez 0.00 255.0 FORMAT "%5.1" NUMBER 4 /end CHARACTERISTIC
/begin CHARACTERISTIC FFTHSV2 "Tabelle Umweltbedingungen Heizung Lambdasonde vor Kat Bank2" VAL_BLK 0x81178A KwbUb 255.0 dez 0.00 255.0 FORMAT "%5.1" NUMBER 4 /end CHARACTERISTIC
/begin CHARACTERISTIC FFTKAT "Freeze Frame Tabelle: Katalysator" VAL_BLK 0x81178E KwbUb 255.0 dez 0.00 255.0 FORMAT "%5.1" NUMBER 4 /end CHARACTERISTIC
/begin CHARACTERISTIC FFTKAT2 "Freeze Frame Tabelle: Katalysator" VAL_BLK 0x811792 KwbUb 255.0 dez 0.00 255.0 FORMAT "%5.1" NUMBER 4 /end CHARACTERISTIC
/begin CHARACTERISTIC FFTKKUE "" VAL_BLK 0x811796 KwbUb 255.0 dez 0.00 255.0 FORMAT "%5.1" NUMBER 4 /end CHARACTERISTIC
/begin CHARACTERISTIC FFTKOS "Freeze Frame Tabelle: Klimakompressor Endstufe" VAL_BLK 0x81179A KwbUb 255.0 dez 0.00 255.0 FORMAT "%5.1" NUMBER 4 /end CHARACTERISTIC
/begin CHARACTERISTIC FFTKPE "Freeze Frame Tabelle: EKP-Relais Endstufe" VAL_BLK 0x81179E KwbUb 255.0 dez 0.00 255.0 FORMAT "%5.1" NUMBER 4 /end CHARACTERISTIC
/begin CHARACTERISTIC FFTKRNT "Freeze frame Tabelle: Klopfregelung Nulltest" VAL_BLK 0x8117A2 KwbUb 255.0 dez 0.00 255.0 FORMAT "%5.1" NUMBER 4 /end CHARACTERISTIC
/begin CHARACTERISTIC FFTKROF "Freeze Frame Tabelle: Klopfregelung Offset" VAL_BLK 0x8117A6 KwbUb 255.0 dez 0.00 255.0 FORMAT "%5.1" NUMBER 4 /end CHARACTERISTIC
/begin CHARACTERISTIC FFTKRTP "Freeze Frame Tabelle: Klopfregelung Testimpuls" VAL_BLK 0x8117AA KwbUb 255.0 dez 0.00 255.0 FORMAT "%5.1" NUMBER 4 /end CHARACTERISTIC
/begin CHARACTERISTIC FFTKS1 "Freeze Frame Tabelle: Klopfsensor 1" VAL_BLK 0x8117AE KwbUb 255.0 dez 0.00 255.0 FORMAT "%5.1" NUMBER 4 /end CHARACTERISTIC
/begin CHARACTERISTIC FFTKS2 "Freeze Frame Tabelle: Klopfsensor 2" VAL_BLK 0x8117B2 KwbUb 255.0 dez 0.00 255.0 FORMAT "%5.1" NUMBER 4 /end CHARACTERISTIC
/begin CHARACTERISTIC FFTKS3 "Freeze Frame Tabelle: Klopfsensor 3" VAL_BLK 0x8117B6 KwbUb 255.0 dez 0.00 255.0 FORMAT "%5.1" NUMBER 4 /end CHARACTERISTIC
/begin CHARACTERISTIC FFTKS4 "Freeze Frame Tabelle: Klopfsensor 4" VAL_BLK 0x8117BA KwbUb 255.0 dez 0.00 255.0 FORMAT "%5.1" NUMBER 4 /end CHARACTERISTIC
/begin CHARACTERISTIC FFTKUPPL "Freeze Frame Tabelle: Pedalwertgeber Kupplung" VAL_BLK 0x8117BE KwbUb 255.0 dez 0.00 255.0 FORMAT "%5.1" NUMBER 4 /end CHARACTERISTIC
/begin CHARACTERISTIC FFTLDE "Freeze Frame Tabelle: LDR Taktventil Endstufe" VAL_BLK 0x8117DA KwbUb 255.0 dez 0.00 255.0 FORMAT "%5.1" NUMBER 4 /end CHARACTERISTIC
/begin CHARACTERISTIC FFTLDP "Freeze Frame Tabelle: Leckdiagnosepumpe" VAL_BLK 0x8117DE KwbUb 255.0 dez 0.00 255.0 FORMAT "%5.1" NUMBER 4 /end CHARACTERISTIC
/begin CHARACTERISTIC FFTLDPE "Freeze Frame Tabelle: LDP Endstufe" VAL_BLK 0x8117E2 KwbUb 255.0 dez 0.00 255.0 FORMAT "%5.1" NUMBER 4 /end CHARACTERISTIC
/begin CHARACTERISTIC FFTLM "Freeze Frame Tabelle: Hauptfüllungssensor" VAL_BLK 0x8117EA KwbUb 255.0 dez 0.00 255.0 FORMAT "%5.1" NUMBER 4 /end CHARACTERISTIC
/begin CHARACTERISTIC FFTLUEA "Freeze Frame Tabelle: Lüfterendstufe A" VAL_BLK 0x811802 KwbUb 255.0 dez 0.00 255.0 FORMAT "%5.1" NUMBER 4 /end CHARACTERISTIC
/begin CHARACTERISTIC FFTMILE "Freeze Frame Tabelle: MIL-Endstufe" VAL_BLK 0x811832 KwbUb 255.0 dez 0.00 255.0 FORMAT "%5.1" NUMBER 4 /end CHARACTERISTIC
/begin CHARACTERISTIC FFTN "Freeze Frame Tabelle: Drehzahlgeber" VAL_BLK 0x811836 KwbUb 255.0 dez 0.00 255.0 FORMAT "%5.1" NUMBER 4 /end CHARACTERISTIC
/begin CHARACTERISTIC FFTNWSE "Freeze Frame Tabelle: Nockenwellensteuerungsventil Endstufe" VAL_BLK 0x811842 KwbUb 255.0 dez 0.00 255.0 FORMAT "%5.1" NUMBER 4 /end CHARACTERISTIC
/begin CHARACTERISTIC FFTNWSE2 "Freeze Frame Tabelle: Nockenwellensteuerung Endstufe 2" VAL_BLK 0x811846 KwbUb 255.0 dez 0.00 255.0 FORMAT "%5.1" NUMBER 4 /end CHARACTERISTIC
/begin CHARACTERISTIC FFTRKAT "Freeze Frame Tabelle: RKAT Gemischadaption" VAL_BLK 0x811852 KwbUb 255.0 dez 0.00 255.0 FORMAT "%5.1" NUMBER 4 /end CHARACTERISTIC
/begin CHARACTERISTIC FFTRKAT2 "Freeze Frame Tabelle: RKAT Gemischadaption Bank 2" VAL_BLK 0x811856 KwbUb 255.0 dez 0.00 255.0 FORMAT "%5.1" NUMBER 4 /end CHARACTERISTIC
/begin CHARACTERISTIC FFTRKAZ "Freeze Frame Tabelle: RKAZ Gemischadaption" VAL_BLK 0x81185A KwbUb 255.0 dez 0.00 255.0 FORMAT "%5.1" NUMBER 4 /end CHARACTERISTIC
/begin CHARACTERISTIC FFTRKAZ2 "Freeze Frame Tabelle: RKAZ Gemischadaption Bank 2" VAL_BLK 0x81185E KwbUb 255.0 dez 0.00 255.0 FORMAT "%5.1" NUMBER 4 /end CHARACTERISTIC
/begin CHARACTERISTIC FFTSLPE "Freeze Frame Tabelle: Sekundärluftpumpe Endstufe" VAL_BLK 0x811862 KwbUb 255.0 dez 0.00 255.0 FORMAT "%5.1" NUMBER 4 /end CHARACTERISTIC
/begin CHARACTERISTIC FFTSLVE "Freeze Frame Tabelle: Sekundärluftventil Endstufe" VAL_BLK 0x811876 KwbUb 255.0 dez 0.00 255.0 FORMAT "%5.1" NUMBER 4 /end CHARACTERISTIC
/begin CHARACTERISTIC FFTSTAE "Freeze Frame Tabelle: Start-Relais Endstufe" VAL_BLK 0x81187E KwbUb 255.0 dez 0.00 255.0 FORMAT "%5.1" NUMBER 4 /end CHARACTERISTIC
/begin CHARACTERISTIC FFTTESB "Freeze Frame Tabelle: Tankentlüftungssystem verstopfte Leitung" VAL_BLK 0x811892 KwbUb 255.0 dez 0.00 255.0 FORMAT "%5.1" NUMBER 4 /end CHARACTERISTIC
/begin CHARACTERISTIC FFTTESK "Freeze Frame Tabelle: Tankdiagnose, Kleinstleck" VAL_BLK 0x81189A KwbUb 255.0 dez 0.00 255.0 FORMAT "%5.1" NUMBER 4 /end CHARACTERISTIC
/begin CHARACTERISTIC FFTTEVE "Freeze Frame Tabelle: Tankentlüftungsventil Endstufe" VAL_BLK 0x81189E KwbUb 255.0 dez 0.00 255.0 FORMAT "%5.1" NUMBER 4 /end CHARACTERISTIC
/begin CHARACTERISTIC FFTZZZ "Dummy: Tabellenende" VAL_BLK 0x8118DE KwbUb 255.0 dez 0.00 255.0 FORMAT "%5.1" NUMBER 4 /end CHARACTERISTIC
/begin CHARACTERISTIC TSFAAA "Dummy: Tabellenanfang" VALUE 0x8118E2 KwUb 255.0 dez 0.00 255.0 FORMAT "%5.1" /end CHARACTERISTIC
/begin CHARACTERISTIC TSFANSKE "Fehlersummenzeit: Ansaugklappe Endstufe" VALUE 0x8118E7 KwUb 255.0 dez 0.00 255.0 FORMAT "%5.1" /end CHARACTERISTIC
/begin CHARACTERISTIC TSFBM "Fehlersummenzeit: Bezugsmarkengeber" VALUE 0x8118E9 KwUb 255.0 dez 0.00 255.0 FORMAT "%5.1" /end CHARACTERISTIC
/begin CHARACTERISTIC TSFDHDMTE "Fehlersummenzeit: DM-TL Heizung (Endstufe)" VALUE 0x8118F1 KwUb 255.0 dez 0.00 255.0 FORMAT "%5.1" /end CHARACTERISTIC
/begin CHARACTERISTIC TSFDMMVE "Fehlersummenzeit: DM-TL Magnetventil (Endstufe)" VALUE 0x8118F5 KwUb 255.0 dez 0.00 255.0 FORMAT "%5.1" /end CHARACTERISTIC
/begin CHARACTERISTIC TSFDMPME "Fehlersummenzeit: DM-TL Pumpenmotor (Endstufe)" VALUE 0x8118F6 KwUb 255.0 dez 0.00 255.0 FORMAT "%5.1" /end CHARACTERISTIC
/begin CHARACTERISTIC TSFDMTK "Fehlersummenzeit: Tankentlüftungssystem, Feinstleck" VALUE 0x8118F7 KwUb 255.0 dez 0.00 255.0 FORMAT "%5.1" /end CHARACTERISTIC
/begin CHARACTERISTIC TSFDMTKNM "Fehlersummenzeit: Feinstleck, no Mil" VALUE 0x8118F8 KwUb 255.0 dez 0.00 255.0 FORMAT "%5.1" /end CHARACTERISTIC
/begin CHARACTERISTIC TSFDMTL "Fehlersummenzeit: Tankentlüftungssystem, Modulfehler (Hardware)" VALUE 0x8118F9 KwUb 255.0 dez 0.00 255.0 FORMAT "%5.1" /end CHARACTERISTIC
/begin CHARACTERISTIC TSFDPMEE "Fehlersummenzeit: DM-TL Pumpenmotor (Endstufe) aus DECJ" VALUE 0x8118FA KwUb 255.0 dez 0.00 255.0 FORMAT "%5.1" /end CHARACTERISTIC
/begin CHARACTERISTIC TSFETS "Fehlersummenzeit: Elektrisches Thermostat" VALUE 0x811908 KwUb 255.0 dez 0.00 255.0 FORMAT "%5.1" /end CHARACTERISTIC
/begin CHARACTERISTIC TSFEV1 "Fehlersummenzeit: EV von Zyl. 1" VALUE 0x811909 KwUb 255.0 dez 0.00 255.0 FORMAT "%5.1" /end CHARACTERISTIC
/begin CHARACTERISTIC TSFEV2 "Fehlersummenzeit: EV von Zyl. 2" VALUE 0x81190A KwUb 255.0 dez 0.00 255.0 FORMAT "%5.1" /end CHARACTERISTIC
/begin CHARACTERISTIC TSFEV3 "Fehlersummenzeit: EV von Zyl. 3" VALUE 0x81190B KwUb 255.0 dez 0.00 255.0 FORMAT "%5.1" /end CHARACTERISTIC
/begin CHARACTERISTIC TSFEV4 "Fehlersummenzeit: EV von Zyl. 4" VALUE 0x81190C KwUb 255.0 dez 0.00 255.0 FORMAT "%5.1" /end CHARACTERISTIC
/begin CHARACTERISTIC TSFEV5 "Fehlersummenzeit: EV von Zyl. 5" VALUE 0x81190D KwUb 255.0 dez 0.00 255.0 FORMAT "%5.1" /end CHARACTERISTIC
/begin CHARACTERISTIC TSFEV6 "Fehlersummenzeit: EV von Zyl. 6" VALUE 0x81190E KwUb 255.0 dez 0.00 255.0 FORMAT "%5.1" /end CHARACTERISTIC
/begin CHARACTERISTIC TSFEV7 "Fehlersummenzeit: EV von Zyl. 7" VALUE 0x81190F KwUb 255.0 dez 0.00 255.0 FORMAT "%5.1" /end CHARACTERISTIC
/begin CHARACTERISTIC TSFEV8 "Fehlersummenzeit: EV von Zyl. 8" VALUE 0x811910 KwUb 255.0 dez 0.00 255.0 FORMAT "%5.1" /end CHARACTERISTIC
/begin CHARACTERISTIC TSFFRAO "Fehlersummenzeit: LR-Adaption oberer Bereich" VALUE 0x811914 KwUb 255.0 dez 0.00 255.0 FORMAT "%5.1" /end CHARACTERISTIC
/begin CHARACTERISTIC TSFFRAO2 "Fehlersummenzeit: LR-Adaption oberer Bereich Bank 2" VALUE 0x811915 KwUb 255.0 dez 0.00 255.0 FORMAT "%5.1" /end CHARACTERISTIC
/begin CHARACTERISTIC TSFFRAU "Fehlersummenzeit: LR-Adaption unterer Bereich" VALUE 0x811916 KwUb 255.0 dez 0.00 255.0 FORMAT "%5.1" /end CHARACTERISTIC
/begin CHARACTERISTIC TSFFRAU2 "Fehlersummenzeit: LR-Adaption unterer Bereich Bank 2" VALUE 0x811917 KwUb 255.0 dez 0.00 255.0 FORMAT "%5.1" /end CHARACTERISTIC
/begin CHARACTERISTIC TSFFRST "Fehlersummenzeit: LR-Abweichung" VALUE 0x811918 KwUb 255.0 dez 0.00 255.0 FORMAT "%5.1" /end CHARACTERISTIC
/begin CHARACTERISTIC TSFFRST2 "Fehlersummenzeit: LR-Abweichung Bank 2" VALUE 0x811919 KwUb 255.0 dez 0.00 255.0 FORMAT "%5.1" /end CHARACTERISTIC
/begin CHARACTERISTIC TSFFST "Fehlersummenzeit: Tankfüllstand" VALUE 0x81191A KwUb 255.0 dez 0.00 255.0 FORMAT "%5.1" /end CHARACTERISTIC
/begin CHARACTERISTIC TSFGLOR "Fehlersummenzeit: Getriebe Low Range" VALUE 0x81191B KwUb 255.0 dez 0.00 255.0 FORMAT "%5.1" /end CHARACTERISTIC
/begin CHARACTERISTIC TSFHSH "Fehlersummenzeit: Lambdasonden-Heizung hinter Katalysator" VALUE 0x81191C KwUb 255.0 dez 0.00 255.0 FORMAT "%5.1" /end CHARACTERISTIC
/begin CHARACTERISTIC TSFHSH2 "Fehlersummenzeit: Lambdasonden-Heizung hinter Katalysator, Bank 2" VALUE 0x81191D KwUb 255.0 dez 0.00 255.0 FORMAT "%5.1" /end CHARACTERISTIC
/begin CHARACTERISTIC TSFHSV "Fehlersummenzeit: Lambdasonden-Heizung vor Katalysator" VALUE 0x81191E KwUb 255.0 dez 0.00 255.0 FORMAT "%5.1" /end CHARACTERISTIC
/begin CHARACTERISTIC TSFHSV2 "Fehlersummenzeit: Lambdasonden-Heizung vor Katalysator, Bank 2" VALUE 0x81191F KwUb 255.0 dez 0.00 255.0 FORMAT "%5.1" /end CHARACTERISTIC
/begin CHARACTERISTIC TSFKAT "Fehlersummenzeit: Katalysator-Konvertierung" VALUE 0x811920 KwUb 255.0 dez 0.00 255.0 FORMAT "%5.1" /end CHARACTERISTIC
/begin CHARACTERISTIC TSFKAT2 "Fehlersummenzeit: Katalysator-Konvertierung (Bank 2)" VALUE 0x811921 KwUb 255.0 dez 0.00 255.0 FORMAT "%5.1" /end CHARACTERISTIC
/begin CHARACTERISTIC TSFKKUE "Fehlersummenzeit: Kraftstoffkreislauf-Umschaltung Endstufe" VALUE 0x811922 KwUb 255.0 dez 0.00 255.0 FORMAT "%5.1" /end CHARACTERISTIC
/begin CHARACTERISTIC TSFKOS "Fehlersummenzeit: Klimakompressorsteuerung" VALUE 0x811923 KwUb 255.0 dez 0.00 255.0 FORMAT "%5.1" /end CHARACTERISTIC
/begin CHARACTERISTIC TSFKPE "Fehlersummenzeit: EKP-Relais Endstufe" VALUE 0x811924 KwUb 255.0 dez 0.00 255.0 FORMAT "%5.1" /end CHARACTERISTIC
/begin CHARACTERISTIC TSFKRNT "Fehlersummenzeit: Klopfregelung Nulltest" VALUE 0x811925 KwUb 255.0 dez 0.00 255.0 FORMAT "%5.1" /end CHARACTERISTIC
/begin CHARACTERISTIC TSFKROF "Fehlersummenzeit: Klopfregelung Offset" VALUE 0x811926 KwUb 255.0 dez 0.00 255.0 FORMAT "%5.1" /end CHARACTERISTIC
/begin CHARACTERISTIC TSFKRTP "Fehlersummenzeit: Klopfregelung Testimpuls" VALUE 0x811927 KwUb 255.0 dez 0.00 255.0 FORMAT "%5.1" /end CHARACTERISTIC
/begin CHARACTERISTIC TSFKS1 "Fehlersummenzeit: Klopfsensor 1" VALUE 0x811928 KwUb 255.0 dez 0.00 255.0 FORMAT "%5.1" /end CHARACTERISTIC
/begin CHARACTERISTIC TSFKS2 "Fehlersummenzeit: Klopfsensor 2" VALUE 0x811929 KwUb 255.0 dez 0.00 255.0 FORMAT "%5.1" /end CHARACTERISTIC
/begin CHARACTERISTIC TSFKS3 "Fehlersummenzeit: Klopfsensor 3" VALUE 0x81192A KwUb 255.0 dez 0.00 255.0 FORMAT "%5.1" /end CHARACTERISTIC
/begin CHARACTERISTIC TSFKS4 "Fehlersummenzeit: Klopfsensor 4" VALUE 0x81192B KwUb 255.0 dez 0.00 255.0 FORMAT "%5.1" /end CHARACTERISTIC
/begin CHARACTERISTIC TSFKUPPL "Fehlersummenzeit: Pedalwertgeber Kupplung" VALUE 0x81192C KwUb 255.0 dez 0.00 255.0 FORMAT "%5.1" /end CHARACTERISTIC
/begin CHARACTERISTIC TSFLDE "Fehlersummenzeit: Ladedrucksteuerventil (Endstufe)" VALUE 0x811933 KwUb 255.0 dez 0.00 255.0 FORMAT "%5.1" /end CHARACTERISTIC
/begin CHARACTERISTIC TSFLDP "Fehlersummenzeit: Leckdiagnosepumpe" VALUE 0x811934 KwUb 255.0 dez 0.00 255.0 FORMAT "%5.1" /end CHARACTERISTIC
/begin CHARACTERISTIC TSFLDPE "Fehlersummenzeit: Leckdiagnosepumpe Endstufe" VALUE 0x811935 KwUb 255.0 dez 0.00 255.0 FORMAT "%5.1" /end CHARACTERISTIC
/begin CHARACTERISTIC TSFLM "Fehlersummenzeit: LMM/HLM/HFM" VALUE 0x811937 KwUb 255.0 dez 0.00 255.0 FORMAT "%5.1" /end CHARACTERISTIC
/begin CHARACTERISTIC TSFLUEA "Fehlersummenzeit: Lüfterendstufe A" VALUE 0x81193D KwUb 255.0 dez 0.00 255.0 FORMAT "%5.1" /end CHARACTERISTIC
/begin CHARACTERISTIC TSFMILE "Fehlersummenzeit: MIL-Endstufe" VALUE 0x811949 KwUb 255.0 dez 0.00 255.0 FORMAT "%5.1" /end CHARACTERISTIC
/begin CHARACTERISTIC TSFN "Fehlersummenzeit: Drehzahlgeber" VALUE 0x81194A KwUb 255.0 dez 0.00 255.0 FORMAT "%5.1" /end CHARACTERISTIC
/begin CHARACTERISTIC TSFNWSE "Fehlersummenzeit: Nockenwellensteuerungsventil Endstufe" VALUE 0x81194D KwUb 255.0 dez 0.00 255.0 FORMAT "%5.1" /end CHARACTERISTIC
/begin CHARACTERISTIC TSFNWSE2 "Fehlersummenzeit: Nockenwellensteuerungsventil Endstufe" VALUE 0x81194E KwUb 255.0 dez 0.00 255.0 FORMAT "%5.1" /end CHARACTERISTIC
/begin CHARACTERISTIC TSFRKAT "Fehlersummenzeit: LR-Adaption additiver Bereich pro Zeit" VALUE 0x811951 KwUb 255.0 dez 0.00 255.0 FORMAT "%5.1" /end CHARACTERISTIC
/begin CHARACTERISTIC TSFRKAT2 "Fehlersummenzeit: LR-Adaption additiver Bereich pro Zeit Bank 2" VALUE 0x811952 KwUb 255.0 dez 0.00 255.0 FORMAT "%5.1" /end CHARACTERISTIC
/begin CHARACTERISTIC TSFRKAZ "Fehlersummenzeit: LR-Adaption additiver Bereich pro Zündung" VALUE 0x811953 KwUb 255.0 dez 0.00 255.0 FORMAT "%5.1" /end CHARACTERISTIC
/begin CHARACTERISTIC TSFRKAZ2 "Fehlersummenzeit: LR-Adaption additiver Bereich pro Zündung Bank 2" VALUE 0x811954 KwUb 255.0 dez 0.00 255.0 FORMAT "%5.1" /end CHARACTERISTIC
/begin CHARACTERISTIC TSFSLPE "Fehlersummenzeit: Sekundärluftpumpe (Endstufe)" VALUE 0x811955 KwUb 255.0 dez 0.00 255.0 FORMAT "%5.1" /end CHARACTERISTIC
/begin CHARACTERISTIC TSFSLVE "Fehlersummenzeit: Sekundärluftventil (Endstufe)" VALUE 0x81195A KwUb 255.0 dez 0.00 255.0 FORMAT "%5.1" /end CHARACTERISTIC
/begin CHARACTERISTIC TSFSTAE "Fehlersummenzeit: Startautomatik (Endstufe)" VALUE 0x81195C KwUb 255.0 dez 0.00 255.0 FORMAT "%5.1" /end CHARACTERISTIC
/begin CHARACTERISTIC TSFTESB "Fehlersummenzeit: Tankentlüftungssystem verstopfte Leitung" VALUE 0x811961 KwUb 255.0 dez 0.00 255.0 FORMAT "%5.1" /end CHARACTERISTIC
/begin CHARACTERISTIC TSFTESK "Fehlersummenzeit: Tankentlüftungssystem Leck vorhanden" VALUE 0x811963 KwUb 255.0 dez 0.00 255.0 FORMAT "%5.1" /end CHARACTERISTIC
/begin CHARACTERISTIC TSFTEVE "Fehlersummenzeit: Tankentlüftungsventil Endstufe" VALUE 0x811964 KwUb 255.0 dez 0.00 255.0 FORMAT "%5.1" /end CHARACTERISTIC
/begin CHARACTERISTIC TSFZZZ "Dummy: Tabellenende" VALUE 0x811974 KwUb 255.0 dez 0.00 255.0 FORMAT "%5.1" /end CHARACTERISTIC
/begin MEASUREMENT B_beanske "" UWORD B_TRUE 1 100 0 1 BIT_MASK 0x20 FORMAT "%13.11" ECU_ADDRESS 0x3838D2 /end MEASUREMENT
/begin MEASUREMENT B_bebm "Bedingung Bandende-Funktionsanforderung Bezugsmarke erkannt" UWORD B_TRUE 1 100 0 1 BIT_MASK 0x20 FORMAT "%13.11" ECU_ADDRESS 0x3838D6 /end MEASUREMENT
/begin MEASUREMENT B_bedhdmte "Bedingung Bandende-Funktionsanfordeung DM-TL Heizung" UWORD B_TRUE 1 100 0 1 BIT_MASK 0x20 FORMAT "%13.11" ECU_ADDRESS 0x3838E6 /end MEASUREMENT
/begin MEASUREMENT B_bedmmve "Bedingung Bandende-Funktionsanfordeung DM-TL Magnetventil" UWORD B_TRUE 1 100 0 1 BIT_MASK 0x20 FORMAT "%13.11" ECU_ADDRESS 0x3838EE /end MEASUREMENT
/begin MEASUREMENT B_bedmpme "Bedingung Bandende-Funktionsanfordeung DM-TL Pumpenmotor" UWORD B_TRUE 1 100 0 1 BIT_MASK 0x20 FORMAT "%13.11" ECU_ADDRESS 0x3838F0 /end MEASUREMENT
/begin MEASUREMENT B_bedmtk "" UWORD B_TRUE 1 100 0 1 BIT_MASK 0x20 FORMAT "%13.11" ECU_ADDRESS 0x3838F2 /end MEASUREMENT
/begin MEASUREMENT B_bedmtknm "" UWORD B_TRUE 1 100 0 1 BIT_MASK 0x20 FORMAT "%13.11" ECU_ADDRESS 0x3838F4 /end MEASUREMENT
/begin MEASUREMENT B_bedmtl "" UWORD B_TRUE 1 100 0 1 BIT_MASK 0x20 FORMAT "%13.11" ECU_ADDRESS 0x3838F6 /end MEASUREMENT
/begin MEASUREMENT B_bedpmee "Bedingung Bandende-Funktionsanfordeung DM-TL Pumpe" UWORD B_TRUE 1 100 0 1 BIT_MASK 0x20 FORMAT "%13.11" ECU_ADDRESS 0x3838F8 /end MEASUREMENT
/begin MEASUREMENT B_beets "Bedingung Bandendeanforderung für el. Thermostat-Endstufe" UWORD B_TRUE 1 100 0 1 BIT_MASK 0x20 FORMAT "%13.11" ECU_ADDRESS 0x383914 /end MEASUREMENT
/begin MEASUREMENT B_beev1 "Bedingung Bandendeanforderung  für Fehler Endstufe EV1" UWORD B_TRUE 1 100 0 1 BIT_MASK 0x20 FORMAT "%13.11" ECU_ADDRESS 0x383916 /end MEASUREMENT
/begin MEASUREMENT B_beev2 "Bedingung Bandendeanforderung  für Fehler Endstufe EV2" UWORD B_TRUE 1 100 0 1 BIT_MASK 0x20 FORMAT "%13.11" ECU_ADDRESS 0x383918 /end MEASUREMENT
/begin MEASUREMENT B_beev3 "Bedingung Bandendeanforderung  für Fehler Endstufe EV3" UWORD B_TRUE 1 100 0 1 BIT_MASK 0x20 FORMAT "%13.11" ECU_ADDRESS 0x38391A /end MEASUREMENT
/begin MEASUREMENT B_beev4 "Bedingung Bandendeanforderung  für Fehler Endstufe EV4" UWORD B_TRUE 1 100 0 1 BIT_MASK 0x20 FORMAT "%13.11" ECU_ADDRESS 0x38391C /end MEASUREMENT
/begin MEASUREMENT B_beev5 "Bedingung Bandendeanforderung  für Fehler Endstufe EV5" UWORD B_TRUE 1 100 0 1 BIT_MASK 0x20 FORMAT "%13.11" ECU_ADDRESS 0x38391E /end MEASUREMENT
/begin MEASUREMENT B_beev6 "Bedingung Bandendeanforderung  für Fehler Endstufe EV6" UWORD B_TRUE 1 100 0 1 BIT_MASK 0x20 FORMAT "%13.11" ECU_ADDRESS 0x383920 /end MEASUREMENT
/begin MEASUREMENT B_beev7 "Bedingung Bandendeanforderung  für Fehler Endstufe EV7" UWORD B_TRUE 1 100 0 1 BIT_MASK 0x20 FORMAT "%13.11" ECU_ADDRESS 0x383922 /end MEASUREMENT
/begin MEASUREMENT B_beev8 "Bedingung Bandendeanforderung  für Fehler Endstufe EV8" UWORD B_TRUE 1 100 0 1 BIT_MASK 0x20 FORMAT "%13.11" ECU_ADDRESS 0x383924 /end MEASUREMENT
/begin MEASUREMENT B_befrao "Bedingung: Bandendefunktionanford. für FRAO" UWORD B_TRUE 1 100 0 1 BIT_MASK 0x20 FORMAT "%13.11" ECU_ADDRESS 0x38392C /end MEASUREMENT
/begin MEASUREMENT B_befrao2 "Bedingung: Bandendefunktionanford. für FRAO2" UWORD B_TRUE 1 100 0 1 BIT_MASK 0x20 FORMAT "%13.11" ECU_ADDRESS 0x38392E /end MEASUREMENT
/begin MEASUREMENT B_befrau "Bedingung: Bandendefunktionanford. für FRAU" UWORD B_TRUE 1 100 0 1 BIT_MASK 0x20 FORMAT "%13.11" ECU_ADDRESS 0x383930 /end MEASUREMENT
/begin MEASUREMENT B_befrau2 "Bedingung: Bandendefunktionanford. für FRAU2" UWORD B_TRUE 1 100 0 1 BIT_MASK 0x20 FORMAT "%13.11" ECU_ADDRESS 0x383932 /end MEASUREMENT
/begin MEASUREMENT B_befrst "Bedingung: Bandendefunktionanford. für LR- Kurztest" UWORD B_TRUE 1 100 0 1 BIT_MASK 0x20 FORMAT "%13.11" ECU_ADDRESS 0x383934 /end MEASUREMENT
/begin MEASUREMENT B_befrst2 "Bedingung: Bandendefunktionanford. für LR- Kurztest (Bank 2)" UWORD B_TRUE 1 100 0 1 BIT_MASK 0x20 FORMAT "%13.11" ECU_ADDRESS 0x383936 /end MEASUREMENT
/begin MEASUREMENT B_befst "Bedingung: Bandendeanforderung für Fehler FST" UWORD B_TRUE 1 100 0 1 BIT_MASK 0x20 FORMAT "%13.11" ECU_ADDRESS 0x383938 /end MEASUREMENT
/begin MEASUREMENT B_beglor "" UWORD B_TRUE 1 100 0 1 BIT_MASK 0x20 FORMAT "%13.11" ECU_ADDRESS 0x38393A /end MEASUREMENT
/begin MEASUREMENT B_behsh "Bedingung: Bandendefunktionanford. für %DHLS" UWORD B_TRUE 1 100 0 1 BIT_MASK 0x20 FORMAT "%13.11" ECU_ADDRESS 0x38393C /end MEASUREMENT
/begin MEASUREMENT B_behsh2 "Bedingung: Bandendefunktionanford. für %DHLS Bank 2" UWORD B_TRUE 1 100 0 1 BIT_MASK 0x20 FORMAT "%13.11" ECU_ADDRESS 0x38393E /end MEASUREMENT
/begin MEASUREMENT B_behsv "Bedingung: Bandendefunktionanford. für %DHRLSU" UWORD B_TRUE 1 100 0 1 BIT_MASK 0x20 FORMAT "%13.11" ECU_ADDRESS 0x383940 /end MEASUREMENT
/begin MEASUREMENT B_behsv2 "Bedingung: Bandendefunktionanford. für %DHRLSU, Bank 2" UWORD B_TRUE 1 100 0 1 BIT_MASK 0x20 FORMAT "%13.11" ECU_ADDRESS 0x383942 /end MEASUREMENT
/begin MEASUREMENT B_bekat "Bedingung Bandende-Funktionsanforderung Katalysatordiagnose" UWORD B_TRUE 1 100 0 1 BIT_MASK 0x20 FORMAT "%13.11" ECU_ADDRESS 0x383944 /end MEASUREMENT
/begin MEASUREMENT B_bekat2 "Bedingung Bandende-Funktionsanforderung Katalysatordiagnose, Bank2" UWORD B_TRUE 1 100 0 1 BIT_MASK 0x20 FORMAT "%13.11" ECU_ADDRESS 0x383946 /end MEASUREMENT
/begin MEASUREMENT B_bekkue "" UWORD B_TRUE 1 100 0 1 BIT_MASK 0x20 FORMAT "%13.11" ECU_ADDRESS 0x383948 /end MEASUREMENT
/begin MEASUREMENT B_bekos "" UWORD B_TRUE 1 100 0 1 BIT_MASK 0x20 FORMAT "%13.11" ECU_ADDRESS 0x38394A /end MEASUREMENT
/begin MEASUREMENT B_bekpe "Bedingung Bandendeanforderung für Fehler Endstufe EKP" UWORD B_TRUE 1 100 0 1 BIT_MASK 0x20 FORMAT "%13.11" ECU_ADDRESS 0x38394C /end MEASUREMENT
/begin MEASUREMENT B_bekrnt "Bedingung Bandende-Funktionsanforderung Klopfregelung Diagnose Nulltest" UWORD B_TRUE 1 100 0 1 BIT_MASK 0x20 FORMAT "%13.11" ECU_ADDRESS 0x38394E /end MEASUREMENT
/begin MEASUREMENT B_bekrof "Bedingung Bandende-Funktionsanforderung Klopfregelung Diagnose Integrator Offset" UWORD B_TRUE 1 100 0 1 BIT_MASK 0x20 FORMAT "%13.11" ECU_ADDRESS 0x383950 /end MEASUREMENT
/begin MEASUREMENT B_bekrtp "Bedingung Bandende-Funktionsanforderung Klopfregelung Diagnose Testpuls" UWORD B_TRUE 1 100 0 1 BIT_MASK 0x20 FORMAT "%13.11" ECU_ADDRESS 0x383952 /end MEASUREMENT
/begin MEASUREMENT B_beks1 "Bedingung Bandende-Funktionsanforderung Diagnose Klopfsensor 1" UWORD B_TRUE 1 100 0 1 BIT_MASK 0x20 FORMAT "%13.11" ECU_ADDRESS 0x383954 /end MEASUREMENT
/begin MEASUREMENT B_beks2 "Bedingung Bandende-Funktionsanforderung Diagnose Klopfsensor 2" UWORD B_TRUE 1 100 0 1 BIT_MASK 0x20 FORMAT "%13.11" ECU_ADDRESS 0x383956 /end MEASUREMENT
/begin MEASUREMENT B_beks3 "Bedingung Bandende-Funktionsanforderung Diagnose Klopfsensor 3" UWORD B_TRUE 1 100 0 1 BIT_MASK 0x20 FORMAT "%13.11" ECU_ADDRESS 0x383958 /end MEASUREMENT
/begin MEASUREMENT B_beks4 "Bedingung Bandende-Funktionsanforderung Diagnose Klopfsensor 1" UWORD B_TRUE 1 100 0 1 BIT_MASK 0x20 FORMAT "%13.11" ECU_ADDRESS 0x38395A /end MEASUREMENT
/begin MEASUREMENT B_bekuppl "" UWORD B_TRUE 1 100 0 1 BIT_MASK 0x20 FORMAT "%13.11" ECU_ADDRESS 0x38395C /end MEASUREMENT
/begin MEASUREMENT B_belde "Bedingung: Fehlereintrag  LDR-Taktventil (Bandende)" UWORD B_TRUE 1 100 0 1 BIT_MASK 0x20 FORMAT "%13.11" ECU_ADDRESS 0x38396A /end MEASUREMENT
/begin MEASUREMENT B_beldp "" UWORD B_TRUE 1 100 0 1 BIT_MASK 0x20 FORMAT "%13.11" ECU_ADDRESS 0x38396C /end MEASUREMENT
/begin MEASUREMENT B_beldpe "" UWORD B_TRUE 1 100 0 1 BIT_MASK 0x20 FORMAT "%13.11" ECU_ADDRESS 0x38396E /end MEASUREMENT
/begin MEASUREMENT B_belm "Bedingung Bandende-Funktionsanforderung Luftmassensensor (HFM/DSS)" UWORD B_TRUE 1 100 0 1 BIT_MASK 0x20 FORMAT "%13.11" ECU_ADDRESS 0x383972 /end MEASUREMENT
/begin MEASUREMENT B_beluea "Bedingung Bandende-Funktionsanforderung Endstufe Lüftermotor A" UWORD B_TRUE 1 100 0 1 BIT_MASK 0x20 FORMAT "%13.11" ECU_ADDRESS 0x38397E /end MEASUREMENT
/begin MEASUREMENT B_bemile "Bedingung Bandende-Funktionsanforderung Endstufe Fehlerlampe" UWORD B_TRUE 1 100 0 1 BIT_MASK 0x20 FORMAT "%13.11" ECU_ADDRESS 0x383996 /end MEASUREMENT
/begin MEASUREMENT B_ben "" UWORD B_TRUE 1 100 0 1 BIT_MASK 0x20 FORMAT "%13.11" ECU_ADDRESS 0x383998 /end MEASUREMENT
/begin MEASUREMENT B_benwse "Bedingung Bandende-Funktionsanforderung NWS" UWORD B_TRUE 1 100 0 1 BIT_MASK 0x20 FORMAT "%13.11" ECU_ADDRESS 0x38399E /end MEASUREMENT
/begin MEASUREMENT B_benwse2 "" UWORD B_TRUE 1 100 0 1 BIT_MASK 0x20 FORMAT "%13.11" ECU_ADDRESS 0x3839A0 /end MEASUREMENT
/begin MEASUREMENT B_berkat "Bedingung: Bandendefunktionanford. für RKAT" UWORD B_TRUE 1 100 0 1 BIT_MASK 0x20 FORMAT "%13.11" ECU_ADDRESS 0x3839A6 /end MEASUREMENT
/begin MEASUREMENT B_berkat2 "Bedingung: Bandendefunktionanford. für RKAT2" UWORD B_TRUE 1 100 0 1 BIT_MASK 0x20 FORMAT "%13.11" ECU_ADDRESS 0x3839A8 /end MEASUREMENT
/begin MEASUREMENT B_berkaz "Bedingung: Bandendefunktionanford. für RKAZ" UWORD B_TRUE 1 100 0 1 BIT_MASK 0x20 FORMAT "%13.11" ECU_ADDRESS 0x3839AA /end MEASUREMENT
/begin MEASUREMENT B_berkaz2 "Bedingung: Bandendefunktionanford. für RKAZ2" UWORD B_TRUE 1 100 0 1 BIT_MASK 0x20 FORMAT "%13.11" ECU_ADDRESS 0x3839AC /end MEASUREMENT
/begin MEASUREMENT B_beslpe "Bedingung Bandendeanforderung setzt Fehler Sekundärluftpumpe Endstufe" UWORD B_TRUE 1 100 0 1 BIT_MASK 0x20 FORMAT "%13.11" ECU_ADDRESS 0x3839AE /end MEASUREMENT
/begin MEASUREMENT B_beslve "Bedingung Bandendeanforderung setzt Fehler Sekundärluftventil Endstufe" UWORD B_TRUE 1 100 0 1 BIT_MASK 0x20 FORMAT "%13.11" ECU_ADDRESS 0x3839B8 /end MEASUREMENT
/begin MEASUREMENT B_bestae "Bedingung Bandendeanforderung für Fehler Endstufe Starter Relais" UWORD B_TRUE 1 100 0 1 BIT_MASK 0x20 FORMAT "%13.11" ECU_ADDRESS 0x3839BC /end MEASUREMENT
/begin MEASUREMENT B_betesb "" UWORD B_TRUE 1 100 0 1 BIT_MASK 0x20 FORMAT "%13.11" ECU_ADDRESS 0x3839C6 /end MEASUREMENT
/begin MEASUREMENT B_betesk "" UWORD B_TRUE 1 100 0 1 BIT_MASK 0x20 FORMAT "%13.11" ECU_ADDRESS 0x3839CA /end MEASUREMENT
/begin MEASUREMENT B_beteve "Bedingung Bandendeanford. für Fehler Tanentlüftungsventil Endstufe" UWORD B_TRUE 1 100 0 1 BIT_MASK 0x20 FORMAT "%13.11" ECU_ADDRESS 0x3839CC /end MEASUREMENT
/begin MEASUREMENT B_bkanske "" UWORD B_TRUE 1 100 0 1 BIT_MASK 0x40 FORMAT "%13.11" ECU_ADDRESS 0x3838D2 /end MEASUREMENT
/begin MEASUREMENT B_bkbm "Bedingung Ersatzwert aktiv: Bezugsmarke" UWORD B_TRUE 1 100 0 1 BIT_MASK 0x40 FORMAT "%13.11" ECU_ADDRESS 0x3838D6 /end MEASUREMENT
/begin MEASUREMENT B_bkdhdmte "Bedingung Ersatzwert aktiv, DM-TL Heizungsendstufe" UWORD B_TRUE 1 100 0 1 BIT_MASK 0x40 FORMAT "%13.11" ECU_ADDRESS 0x3838E6 /end MEASUREMENT
/begin MEASUREMENT B_bkdmmve "Bedingung Ersatzwert aktiv, DM-TL Magnetventilendstufe" UWORD B_TRUE 1 100 0 1 BIT_MASK 0x40 FORMAT "%13.11" ECU_ADDRESS 0x3838EE /end MEASUREMENT
/begin MEASUREMENT B_bkdmpme "Bedingung Ersatzwert aktiv, DM-TL Pumpenmotorendstufe" UWORD B_TRUE 1 100 0 1 BIT_MASK 0x40 FORMAT "%13.11" ECU_ADDRESS 0x3838F0 /end MEASUREMENT
/begin MEASUREMENT B_bkdmtk "" UWORD B_TRUE 1 100 0 1 BIT_MASK 0x40 FORMAT "%13.11" ECU_ADDRESS 0x3838F2 /end MEASUREMENT
/begin MEASUREMENT B_bkdmtknm "" UWORD B_TRUE 1 100 0 1 BIT_MASK 0x40 FORMAT "%13.11" ECU_ADDRESS 0x3838F4 /end MEASUREMENT
/begin MEASUREMENT B_bkdmtl "" UWORD B_TRUE 1 100 0 1 BIT_MASK 0x40 FORMAT "%13.11" ECU_ADDRESS 0x3838F6 /end MEASUREMENT
/begin MEASUREMENT B_bkdpmee "Bedingung Ersatzwert aktiv, DM-TL Pumpenendstufe" UWORD B_TRUE 1 100 0 1 BIT_MASK 0x40 FORMAT "%13.11" ECU_ADDRESS 0x3838F8 /end MEASUREMENT
/begin MEASUREMENT B_bkets "Bedingung: Ersatzwert aktiv bei el. Thermostat-Endstufe" UWORD B_TRUE 1 100 0 1 BIT_MASK 0x40 FORMAT "%13.11" ECU_ADDRESS 0x383914 /end MEASUREMENT
/begin MEASUREMENT B_bkev1 "Bedingung: Einspritzventil 1 aktiv" UWORD B_TRUE 1 100 0 1 BIT_MASK 0x40 FORMAT "%13.11" ECU_ADDRESS 0x383916 /end MEASUREMENT
/begin MEASUREMENT B_bkev2 "Bedingung: Einspritzventil 2 aktiv" UWORD B_TRUE 1 100 0 1 BIT_MASK 0x40 FORMAT "%13.11" ECU_ADDRESS 0x383918 /end MEASUREMENT
/begin MEASUREMENT B_bkev3 "Bedingung: Einspritzventil 3 aktiv" UWORD B_TRUE 1 100 0 1 BIT_MASK 0x40 FORMAT "%13.11" ECU_ADDRESS 0x38391A /end MEASUREMENT
/begin MEASUREMENT B_bkev4 "Bedingung: Einspritzventil 4 aktiv" UWORD B_TRUE 1 100 0 1 BIT_MASK 0x40 FORMAT "%13.11" ECU_ADDRESS 0x38391C /end MEASUREMENT
/begin MEASUREMENT B_bkev5 "Bedingung: Einspritzventil 5 aktiv" UWORD B_TRUE 1 100 0 1 BIT_MASK 0x40 FORMAT "%13.11" ECU_ADDRESS 0x38391E /end MEASUREMENT
/begin MEASUREMENT B_bkev6 "Bedingung: Einspritzventil 6 aktiv" UWORD B_TRUE 1 100 0 1 BIT_MASK 0x40 FORMAT "%13.11" ECU_ADDRESS 0x383920 /end MEASUREMENT
/begin MEASUREMENT B_bkev7 "Bedingung: Einspritzventil 7 aktiv" UWORD B_TRUE 1 100 0 1 BIT_MASK 0x40 FORMAT "%13.11" ECU_ADDRESS 0x383922 /end MEASUREMENT
/begin MEASUREMENT B_bkev8 "Bedingung: Einspritzventil 8 aktiv" UWORD B_TRUE 1 100 0 1 BIT_MASK 0x40 FORMAT "%13.11" ECU_ADDRESS 0x383924 /end MEASUREMENT
/begin MEASUREMENT B_bkfrao "Ersatzwert für FRAO aktiv" UWORD B_TRUE 1 100 0 1 BIT_MASK 0x40 FORMAT "%13.11" ECU_ADDRESS 0x38392C /end MEASUREMENT
/begin MEASUREMENT B_bkfrao2 "Ersatzwert für FRAO aktiv Bank 2" UWORD B_TRUE 1 100 0 1 BIT_MASK 0x40 FORMAT "%13.11" ECU_ADDRESS 0x38392E /end MEASUREMENT
/begin MEASUREMENT B_bkfrau "Ersatzwert für FRAU aktiv" UWORD B_TRUE 1 100 0 1 BIT_MASK 0x40 FORMAT "%13.11" ECU_ADDRESS 0x383930 /end MEASUREMENT
/begin MEASUREMENT B_bkfrau2 "Ersatzwert für FRAU aktiv Bank 2" UWORD B_TRUE 1 100 0 1 BIT_MASK 0x40 FORMAT "%13.11" ECU_ADDRESS 0x383932 /end MEASUREMENT
/begin MEASUREMENT B_bkfrst "Bedingung: LR-Abweichung" UWORD B_TRUE 1 100 0 1 BIT_MASK 0x40 FORMAT "%13.11" ECU_ADDRESS 0x383934 /end MEASUREMENT
/begin MEASUREMENT B_bkfrst2 "Bedingung: LR-Abweichung Bank 2" UWORD B_TRUE 1 100 0 1 BIT_MASK 0x40 FORMAT "%13.11" ECU_ADDRESS 0x383936 /end MEASUREMENT
/begin MEASUREMENT B_bkfst "Bedingung: Ersatzwert aktiv, Tankfüllstandsgeber" UWORD B_TRUE 1 100 0 1 BIT_MASK 0x40 FORMAT "%13.11" ECU_ADDRESS 0x383938 /end MEASUREMENT
/begin MEASUREMENT B_bkglor "" UWORD B_TRUE 1 100 0 1 BIT_MASK 0x40 FORMAT "%13.11" ECU_ADDRESS 0x38393A /end MEASUREMENT
/begin MEASUREMENT B_bkhsh "Bedingung: Lambdasondenheizung hinter Kat. aktiv" UWORD B_TRUE 1 100 0 1 BIT_MASK 0x40 FORMAT "%13.11" ECU_ADDRESS 0x38393C /end MEASUREMENT
/begin MEASUREMENT B_bkhsh2 "Bedingung: Lambdasondenheizung hinter Kat. aktiv, Bank 2" UWORD B_TRUE 1 100 0 1 BIT_MASK 0x40 FORMAT "%13.11" ECU_ADDRESS 0x38393E /end MEASUREMENT
/begin MEASUREMENT B_bkhsv "Bedingung:Lambdasondenheizung vor Kat. aktiv" UWORD B_TRUE 1 100 0 1 BIT_MASK 0x40 FORMAT "%13.11" ECU_ADDRESS 0x383940 /end MEASUREMENT
/begin MEASUREMENT B_bkhsv2 "Bedingung:Lambdasondenheizung vor Kat. aktiv, Bank 2" UWORD B_TRUE 1 100 0 1 BIT_MASK 0x40 FORMAT "%13.11" ECU_ADDRESS 0x383942 /end MEASUREMENT
/begin MEASUREMENT B_bkkat "Bedingung Ersatzwert für Katalysator" UWORD B_TRUE 1 100 0 1 BIT_MASK 0x40 FORMAT "%13.11" ECU_ADDRESS 0x383944 /end MEASUREMENT
/begin MEASUREMENT B_bkkat2 "Bedingung Ersatzwert für Katalysator, Bank2" UWORD B_TRUE 1 100 0 1 BIT_MASK 0x40 FORMAT "%13.11" ECU_ADDRESS 0x383946 /end MEASUREMENT
/begin MEASUREMENT B_bkkkue "" UWORD B_TRUE 1 100 0 1 BIT_MASK 0x40 FORMAT "%13.11" ECU_ADDRESS 0x383948 /end MEASUREMENT
/begin MEASUREMENT B_bkkos "" UWORD B_TRUE 1 100 0 1 BIT_MASK 0x40 FORMAT "%13.11" ECU_ADDRESS 0x38394A /end MEASUREMENT
/begin MEASUREMENT B_bkkpe "Bedingung Ersatzwert für EKP-Relais Endstufe" UWORD B_TRUE 1 100 0 1 BIT_MASK 0x40 FORMAT "%13.11" ECU_ADDRESS 0x38394C /end MEASUREMENT
/begin MEASUREMENT B_bkkrnt "Bedingung: Klopfregelung Nulltest aktiv" UWORD B_TRUE 1 100 0 1 BIT_MASK 0x40 FORMAT "%13.11" ECU_ADDRESS 0x38394E /end MEASUREMENT
/begin MEASUREMENT B_bkkrof "Bedingung: Klopfregelung Offset aktiv" UWORD B_TRUE 1 100 0 1 BIT_MASK 0x40 FORMAT "%13.11" ECU_ADDRESS 0x383950 /end MEASUREMENT
/begin MEASUREMENT B_bkkrtp "Bedingung: Klopfregelung Testimpuls aktiv" UWORD B_TRUE 1 100 0 1 BIT_MASK 0x40 FORMAT "%13.11" ECU_ADDRESS 0x383952 /end MEASUREMENT
/begin MEASUREMENT B_bkks1 "Bedingung: Klopfsensor 1 aktiv" UWORD B_TRUE 1 100 0 1 BIT_MASK 0x40 FORMAT "%13.11" ECU_ADDRESS 0x383954 /end MEASUREMENT
/begin MEASUREMENT B_bkks2 "Bedingung: Klopfsensor 2 aktiv" UWORD B_TRUE 1 100 0 1 BIT_MASK 0x40 FORMAT "%13.11" ECU_ADDRESS 0x383956 /end MEASUREMENT
/begin MEASUREMENT B_bkks3 "Bedingung: Klopfsensor 3 aktiv" UWORD B_TRUE 1 100 0 1 BIT_MASK 0x40 FORMAT "%13.11" ECU_ADDRESS 0x383958 /end MEASUREMENT
/begin MEASUREMENT B_bkks4 "Bedingung: Klopfsensor 4 aktiv" UWORD B_TRUE 1 100 0 1 BIT_MASK 0x40 FORMAT "%13.11" ECU_ADDRESS 0x38395A /end MEASUREMENT
/begin MEASUREMENT B_bkkuppl "Ersatzwert aktiv" UWORD B_TRUE 1 100 0 1 BIT_MASK 0x40 FORMAT "%13.11" ECU_ADDRESS 0x38395C /end MEASUREMENT
/begin MEASUREMENT B_bklde "Bedingung: Ladedrucksteuerventil Endstufe aktiv" UWORD B_TRUE 1 100 0 1 BIT_MASK 0x40 FORMAT "%13.11" ECU_ADDRESS 0x38396A /end MEASUREMENT
/begin MEASUREMENT B_bkldp "Bedingung: Leckdiagnosemodul aktiv" UWORD B_TRUE 1 100 0 1 BIT_MASK 0x40 FORMAT "%13.11" ECU_ADDRESS 0x38396C /end MEASUREMENT
/begin MEASUREMENT B_bkldpe "Bedingung: Leckdiagnosemodul Endstufe aktiv" UWORD B_TRUE 1 100 0 1 BIT_MASK 0x40 FORMAT "%13.11" ECU_ADDRESS 0x38396E /end MEASUREMENT
/begin MEASUREMENT B_bklm "Bedingung: Hauptlastsensor aktiv" UWORD B_TRUE 1 100 0 1 BIT_MASK 0x40 FORMAT "%13.11" ECU_ADDRESS 0x383972 /end MEASUREMENT
/begin MEASUREMENT B_bkluea "Bedingung Ersatzwert aktiv: Motor-Lüfter Endstufe A" UWORD B_TRUE 1 100 0 1 BIT_MASK 0x40 FORMAT "%13.11" ECU_ADDRESS 0x38397E /end MEASUREMENT
/begin MEASUREMENT B_bkmile "Bedingung: MIL-Endstufe aktiv" UWORD B_TRUE 1 100 0 1 BIT_MASK 0x40 FORMAT "%13.11" ECU_ADDRESS 0x383996 /end MEASUREMENT
/begin MEASUREMENT B_bkn "Bedingung: Drehzahlsignalgeber aktiv" UWORD B_TRUE 1 100 0 1 BIT_MASK 0x40 FORMAT "%13.11" ECU_ADDRESS 0x383998 /end MEASUREMENT
/begin MEASUREMENT B_bknwse "Bedingung: Nockenwellensteuerung Endstufe aktiv" UWORD B_TRUE 1 100 0 1 BIT_MASK 0x40 FORMAT "%13.11" ECU_ADDRESS 0x38399E /end MEASUREMENT
/begin MEASUREMENT B_bknwse2 "" UWORD B_TRUE 1 100 0 1 BIT_MASK 0x40 FORMAT "%13.11" ECU_ADDRESS 0x3839A0 /end MEASUREMENT
/begin MEASUREMENT B_bkrkat "Ersatzwert für RKAT aktiv" UWORD B_TRUE 1 100 0 1 BIT_MASK 0x40 FORMAT "%13.11" ECU_ADDRESS 0x3839A6 /end MEASUREMENT
/begin MEASUREMENT B_bkrkat2 "Ersatzwert für RKAT aktiv Bank 2" UWORD B_TRUE 1 100 0 1 BIT_MASK 0x40 FORMAT "%13.11" ECU_ADDRESS 0x3839A8 /end MEASUREMENT
/begin MEASUREMENT B_bkrkaz "Ersatzwert für RKAZ aktiv" UWORD B_TRUE 1 100 0 1 BIT_MASK 0x40 FORMAT "%13.11" ECU_ADDRESS 0x3839AA /end MEASUREMENT
/begin MEASUREMENT B_bkrkaz2 "Ersatzwert für RKAZ aktiv Bank 2" UWORD B_TRUE 1 100 0 1 BIT_MASK 0x40 FORMAT "%13.11" ECU_ADDRESS 0x3839AC /end MEASUREMENT
/begin MEASUREMENT B_bkslpe "Bedingung: Sekundärluftpumpe ( Endstufe) aktiv" UWORD B_TRUE 1 100 0 1 BIT_MASK 0x40 FORMAT "%13.11" ECU_ADDRESS 0x3839AE /end MEASUREMENT
/begin MEASUREMENT B_bkslve "Bedingung: Sekundärluftventil Endstufe" UWORD B_TRUE 1 100 0 1 BIT_MASK 0x40 FORMAT "%13.11" ECU_ADDRESS 0x3839B8 /end MEASUREMENT
/begin MEASUREMENT B_bkstae "Bedingung Ersatzwert für Starter Relais Endstufe" UWORD B_TRUE 1 100 0 1 BIT_MASK 0x40 FORMAT "%13.11" ECU_ADDRESS 0x3839BC /end MEASUREMENT
/begin MEASUREMENT B_bktesb "" UWORD B_TRUE 1 100 0 1 BIT_MASK 0x40 FORMAT "%13.11" ECU_ADDRESS 0x3839C6 /end MEASUREMENT
/begin MEASUREMENT B_bktesk "Bedingung Ersatzwert aktiv Tankdiagnose Kleinstleck" UWORD B_TRUE 1 100 0 1 BIT_MASK 0x40 FORMAT "%13.11" ECU_ADDRESS 0x3839CA /end MEASUREMENT
/begin MEASUREMENT B_bkteve "Bedingung: Tankentlüftungsventil Endstufe aktiv" UWORD B_TRUE 1 100 0 1 BIT_MASK 0x40 FORMAT "%13.11" ECU_ADDRESS 0x3839CC /end MEASUREMENT
/begin MEASUREMENT B_clanske "Bedingung: Fehlerpfad Endstufe Ansaugklappe löschen" UWORD B_TRUE 1 100 0 1 BIT_MASK 0x80 FORMAT "%13.11" ECU_ADDRESS 0x3838D2 /end MEASUREMENT
/begin MEASUREMENT B_clbm "Bedingung Fehlerpfad Bezugsmarkengeber löschen" UWORD B_TRUE 1 100 0 1 BIT_MASK 0x80 FORMAT "%13.11" ECU_ADDRESS 0x3838D6 /end MEASUREMENT
/begin MEASUREMENT B_cldhdmte "Bedingung Fehlerpfad DHDMTE löschen" UWORD B_TRUE 1 100 0 1 BIT_MASK 0x80 FORMAT "%13.11" ECU_ADDRESS 0x3838E6 /end MEASUREMENT
/begin MEASUREMENT B_cldmmve "Bedingung Fehlerpfad DMMVE löschen" UWORD B_TRUE 1 100 0 1 BIT_MASK 0x80 FORMAT "%13.11" ECU_ADDRESS 0x3838EE /end MEASUREMENT
/begin MEASUREMENT B_cldmpme "Bedingung Fehlerpfad DMPME löschen" UWORD B_TRUE 1 100 0 1 BIT_MASK 0x80 FORMAT "%13.11" ECU_ADDRESS 0x3838F0 /end MEASUREMENT
/begin MEASUREMENT B_cldmtk "Bedingung Fehlerflag Feinstleck löschen" UWORD B_TRUE 1 100 0 1 BIT_MASK 0x80 FORMAT "%13.11" ECU_ADDRESS 0x3838F2 /end MEASUREMENT
/begin MEASUREMENT B_cldmtknm "" UWORD B_TRUE 1 100 0 1 BIT_MASK 0x80 FORMAT "%13.11" ECU_ADDRESS 0x3838F4 /end MEASUREMENT
/begin MEASUREMENT B_cldmtl "Bedingung Fehlerflag DMTL-Modul löschen" UWORD B_TRUE 1 100 0 1 BIT_MASK 0x80 FORMAT "%13.11" ECU_ADDRESS 0x3838F6 /end MEASUREMENT
/begin MEASUREMENT B_cldpmee "Bedingung Fehlerpfad DPMEE löschen" UWORD B_TRUE 1 100 0 1 BIT_MASK 0x80 FORMAT "%13.11" ECU_ADDRESS 0x3838F8 /end MEASUREMENT
/begin MEASUREMENT B_clets "Bedingung Fehlerpfad ETS löschen" UWORD B_TRUE 1 100 0 1 BIT_MASK 0x80 FORMAT "%13.11" ECU_ADDRESS 0x383914 /end MEASUREMENT
/begin MEASUREMENT B_clev1 "Bedingung Fehlerpfad EV 1 löschen" UWORD B_TRUE 1 100 0 1 BIT_MASK 0x80 FORMAT "%13.11" ECU_ADDRESS 0x383916 /end MEASUREMENT
/begin MEASUREMENT B_clev2 "Bedingung Fehlerpfad EV 2 löschen" UWORD B_TRUE 1 100 0 1 BIT_MASK 0x80 FORMAT "%13.11" ECU_ADDRESS 0x383918 /end MEASUREMENT
/begin MEASUREMENT B_clev3 "Bedingung Fehlerpfad EV 3 löschen" UWORD B_TRUE 1 100 0 1 BIT_MASK 0x80 FORMAT "%13.11" ECU_ADDRESS 0x38391A /end MEASUREMENT
/begin MEASUREMENT B_clev4 "Bedingung Fehlerpfad EV 4 löschen" UWORD B_TRUE 1 100 0 1 BIT_MASK 0x80 FORMAT "%13.11" ECU_ADDRESS 0x38391C /end MEASUREMENT
/begin MEASUREMENT B_clev5 "Bedingung Fehlerpfad EV 5 löschen" UWORD B_TRUE 1 100 0 1 BIT_MASK 0x80 FORMAT "%13.11" ECU_ADDRESS 0x38391E /end MEASUREMENT
/begin MEASUREMENT B_clev6 "Bedingung Fehlerpfad EV 6 löschen" UWORD B_TRUE 1 100 0 1 BIT_MASK 0x80 FORMAT "%13.11" ECU_ADDRESS 0x383920 /end MEASUREMENT
/begin MEASUREMENT B_clev7 "Bedingung Fehlerpfad EV 7 löschen" UWORD B_TRUE 1 100 0 1 BIT_MASK 0x80 FORMAT "%13.11" ECU_ADDRESS 0x383922 /end MEASUREMENT
/begin MEASUREMENT B_clev8 "Bedingung Fehlerpfad EV 8 löschen" UWORD B_TRUE 1 100 0 1 BIT_MASK 0x80 FORMAT "%13.11" ECU_ADDRESS 0x383924 /end MEASUREMENT
/begin MEASUREMENT B_clfrao "Bedingung Fehlerpfad FRAO löschen (obere Multipl. Bereich)" UWORD B_TRUE 1 100 0 1 BIT_MASK 0x80 FORMAT "%13.11" ECU_ADDRESS 0x38392C /end MEASUREMENT
/begin MEASUREMENT B_clfrao2 "Bedingung Fehlerpfad FRAO2 löschen (Stereo)" UWORD B_TRUE 1 100 0 1 BIT_MASK 0x80 FORMAT "%13.11" ECU_ADDRESS 0x38392E /end MEASUREMENT
/begin MEASUREMENT B_clfrau "Bedingung Fehlerpfad FRAU löschen (untere Multipl. Bereich)" UWORD B_TRUE 1 100 0 1 BIT_MASK 0x80 FORMAT "%13.11" ECU_ADDRESS 0x383930 /end MEASUREMENT
/begin MEASUREMENT B_clfrau2 "Bedingung Fehlerpfad FRAU2 löschen (Stereo)" UWORD B_TRUE 1 100 0 1 BIT_MASK 0x80 FORMAT "%13.11" ECU_ADDRESS 0x383932 /end MEASUREMENT
/begin MEASUREMENT B_clfrst "Bedingung Fehlerpfad FRST löschen (Kurztest)" UWORD B_TRUE 1 100 0 1 BIT_MASK 0x80 FORMAT "%13.11" ECU_ADDRESS 0x383934 /end MEASUREMENT
/begin MEASUREMENT B_clfrst2 "Bedingung Fehlerpfad FRST löschen (Kurztest Bank 2)" UWORD B_TRUE 1 100 0 1 BIT_MASK 0x80 FORMAT "%13.11" ECU_ADDRESS 0x383936 /end MEASUREMENT
/begin MEASUREMENT B_clfst "Fehlerpfad in GGFST löschen" UWORD B_TRUE 1 100 0 1 BIT_MASK 0x80 FORMAT "%13.11" ECU_ADDRESS 0x383938 /end MEASUREMENT
/begin MEASUREMENT B_clglor "Bedingung: Fehlerpfad Getriebe im Low Range löschen" UWORD B_TRUE 1 100 0 1 BIT_MASK 0x80 FORMAT "%13.11" ECU_ADDRESS 0x38393A /end MEASUREMENT
/begin MEASUREMENT B_clhsh "Bedingung Fehlerpfad DHLSHK löschen" UWORD B_TRUE 1 100 0 1 BIT_MASK 0x80 FORMAT "%13.11" ECU_ADDRESS 0x38393C /end MEASUREMENT
/begin MEASUREMENT B_clhsh2 "Bedingung Fehlerpfad DHLSHK2 löschen" UWORD B_TRUE 1 100 0 1 BIT_MASK 0x80 FORMAT "%13.11" ECU_ADDRESS 0x38393E /end MEASUREMENT
/begin MEASUREMENT B_clhsv "Bedingung Fehlerpfad DHLSVK löschen" UWORD B_TRUE 1 100 0 1 BIT_MASK 0x80 FORMAT "%13.11" ECU_ADDRESS 0x383940 /end MEASUREMENT
/begin MEASUREMENT B_clhsv2 "Bedingung Fehlerpfad DHLSVK2 löschen" UWORD B_TRUE 1 100 0 1 BIT_MASK 0x80 FORMAT "%13.11" ECU_ADDRESS 0x383942 /end MEASUREMENT
/begin MEASUREMENT B_clkat "Bedingung Fehlerpfad DKAT löschen" UWORD B_TRUE 1 100 0 1 BIT_MASK 0x80 FORMAT "%13.11" ECU_ADDRESS 0x383944 /end MEASUREMENT
/begin MEASUREMENT B_clkat2 "Bedingung Fehlerpfad Dkat löschen (Stereo)" UWORD B_TRUE 1 100 0 1 BIT_MASK 0x80 FORMAT "%13.11" ECU_ADDRESS 0x383946 /end MEASUREMENT
/begin MEASUREMENT B_clkkue "" UWORD B_TRUE 1 100 0 1 BIT_MASK 0x80 FORMAT "%13.11" ECU_ADDRESS 0x383948 /end MEASUREMENT
/begin MEASUREMENT B_clkos "Bedingung: Fehlerpfad Endstufe Klimakompressor löschen" UWORD B_TRUE 1 100 0 1 BIT_MASK 0x80 FORMAT "%13.11" ECU_ADDRESS 0x38394A /end MEASUREMENT
/begin MEASUREMENT B_clkpe "Bedingung Fehlerpfad EKP-Relais Endstufe löschen" UWORD B_TRUE 1 100 0 1 BIT_MASK 0x80 FORMAT "%13.11" ECU_ADDRESS 0x38394C /end MEASUREMENT
/begin MEASUREMENT B_clkrnt "Bedingung Fehlerpfad KR-Diagnose Integratorsteigung löschen" UWORD B_TRUE 1 100 0 1 BIT_MASK 0x80 FORMAT "%13.11" ECU_ADDRESS 0x38394E /end MEASUREMENT
/begin MEASUREMENT B_clkrof "Bedingung Fehlerpfad KR-Diagnose Resetwert löschen" UWORD B_TRUE 1 100 0 1 BIT_MASK 0x80 FORMAT "%13.11" ECU_ADDRESS 0x383950 /end MEASUREMENT
/begin MEASUREMENT B_clkrtp "Bedingung Fehlerpfad KR-Diagnose Testimpuls löschen" UWORD B_TRUE 1 100 0 1 BIT_MASK 0x80 FORMAT "%13.11" ECU_ADDRESS 0x383952 /end MEASUREMENT
/begin MEASUREMENT B_clks1 "Bedingung Fehlerpfad Klopfsensor 1 löschen" UWORD B_TRUE 1 100 0 1 BIT_MASK 0x80 FORMAT "%13.11" ECU_ADDRESS 0x383954 /end MEASUREMENT
/begin MEASUREMENT B_clks2 "Bedingung Fehlerpfad Klopfsensor 2 löschen" UWORD B_TRUE 1 100 0 1 BIT_MASK 0x80 FORMAT "%13.11" ECU_ADDRESS 0x383956 /end MEASUREMENT
/begin MEASUREMENT B_clks3 "Bedingung Fehlerpfad Klopfsensor 3 löschen" UWORD B_TRUE 1 100 0 1 BIT_MASK 0x80 FORMAT "%13.11" ECU_ADDRESS 0x383958 /end MEASUREMENT
/begin MEASUREMENT B_clks4 "Bedingung Fehlerpfad Klopfsensor 4 löschen" UWORD B_TRUE 1 100 0 1 BIT_MASK 0x80 FORMAT "%13.11" ECU_ADDRESS 0x38395A /end MEASUREMENT
/begin MEASUREMENT B_clkuppl "Bedingung: Fehlerpfad KUPPL (Gebergröße Kupplung) löschen" UWORD B_TRUE 1 100 0 1 BIT_MASK 0x80 FORMAT "%13.11" ECU_ADDRESS 0x38395C /end MEASUREMENT
/begin MEASUREMENT B_cllde "Bedingung Fehlerpfad LDE löschen" UWORD B_TRUE 1 100 0 1 BIT_MASK 0x80 FORMAT "%13.11" ECU_ADDRESS 0x38396A /end MEASUREMENT
/begin MEASUREMENT B_clldp "Bedingung: Fehlerpfad LDP löschen" UWORD B_TRUE 1 100 0 1 BIT_MASK 0x80 FORMAT "%13.11" ECU_ADDRESS 0x38396C /end MEASUREMENT
/begin MEASUREMENT B_clldpe "Bedingung: Fehlerpfad Endstufe LDP löschen" UWORD B_TRUE 1 100 0 1 BIT_MASK 0x80 FORMAT "%13.11" ECU_ADDRESS 0x38396E /end MEASUREMENT
/begin MEASUREMENT B_cllm "Bedingung: Fehlerpfad Hauptfüllungssensor löschen" UWORD B_TRUE 1 100 0 1 BIT_MASK 0x80 FORMAT "%13.11" ECU_ADDRESS 0x383972 /end MEASUREMENT
/begin MEASUREMENT B_clluea "Bedingung: Fehlerpfad Endstufe Motor Lüfter A Löschen" UWORD B_TRUE 1 100 0 1 BIT_MASK 0x80 FORMAT "%13.11" ECU_ADDRESS 0x38397E /end MEASUREMENT
/begin MEASUREMENT B_clmile "Bedingung Fehlerpfad MIL-Endstufe löschen" UWORD B_TRUE 1 100 0 1 BIT_MASK 0x80 FORMAT "%13.11" ECU_ADDRESS 0x383996 /end MEASUREMENT
/begin MEASUREMENT B_cln "Bedingung Fehlerpfad Drehzahlgeber löschen" UWORD B_TRUE 1 100 0 1 BIT_MASK 0x80 FORMAT "%13.11" ECU_ADDRESS 0x383998 /end MEASUREMENT
/begin MEASUREMENT B_clnwse "Bedingung Fehlerpfad Nockenwellensteuerung Endstufe löschen" UWORD B_TRUE 1 100 0 1 BIT_MASK 0x80 FORMAT "%13.11" ECU_ADDRESS 0x38399E /end MEASUREMENT
/begin MEASUREMENT B_clnwse2 "Bedingung Fehlerpfad Nockenwellensteuerung Bank2 Endstufe löschen" UWORD B_TRUE 1 100 0 1 BIT_MASK 0x80 FORMAT "%13.11" ECU_ADDRESS 0x3839A0 /end MEASUREMENT
/begin MEASUREMENT B_clrkat "Bedingung Fehlerpfad RKAT löschen (add. pro Zeit)" UWORD B_TRUE 1 100 0 1 BIT_MASK 0x80 FORMAT "%13.11" ECU_ADDRESS 0x3839A6 /end MEASUREMENT
/begin MEASUREMENT B_clrkat2 "Bedingung Fehlerpfad RKAT2 löschen (Stereo)" UWORD B_TRUE 1 100 0 1 BIT_MASK 0x80 FORMAT "%13.11" ECU_ADDRESS 0x3839A8 /end MEASUREMENT
/begin MEASUREMENT B_clrkaz "Bedingung Fehlerpfad RKAZ löschen (add. pro Zündung)" UWORD B_TRUE 1 100 0 1 BIT_MASK 0x80 FORMAT "%13.11" ECU_ADDRESS 0x3839AA /end MEASUREMENT
/begin MEASUREMENT B_clrkaz2 "Bedingung Fehlerpfad RKAZ2 löschen (Stereo)" UWORD B_TRUE 1 100 0 1 BIT_MASK 0x80 FORMAT "%13.11" ECU_ADDRESS 0x3839AC /end MEASUREMENT
/begin MEASUREMENT B_clslpe "Bedingung: Fehlerpfad Endstufe Sekundärluftpumpe löschen" UWORD B_TRUE 1 100 0 1 BIT_MASK 0x80 FORMAT "%13.11" ECU_ADDRESS 0x3839AE /end MEASUREMENT
/begin MEASUREMENT B_clslve "Bedingung: Fehlerpfad Endstufe Sekundärluftventil löschen" UWORD B_TRUE 1 100 0 1 BIT_MASK 0x80 FORMAT "%13.11" ECU_ADDRESS 0x3839B8 /end MEASUREMENT
/begin MEASUREMENT B_clstae "Bedingung: Fehlerpfad Endstufe Start Relais löschen" UWORD B_TRUE 1 100 0 1 BIT_MASK 0x80 FORMAT "%13.11" ECU_ADDRESS 0x3839BC /end MEASUREMENT
/begin MEASUREMENT B_cltesb "Bedingung Fehlerflag ""TEV verstopfte Leitung"" löschen" UWORD B_TRUE 1 100 0 1 BIT_MASK 0x80 FORMAT "%13.11" ECU_ADDRESS 0x3839C6 /end MEASUREMENT
/begin MEASUREMENT B_cltesk "Bedingung Fehlerflag ""Feinstleck"" löschen" UWORD B_TRUE 1 100 0 1 BIT_MASK 0x80 FORMAT "%13.11" ECU_ADDRESS 0x3839CA /end MEASUREMENT
/begin MEASUREMENT B_clteve "Bedingung Fehlerphad TEVE löschen" UWORD B_TRUE 1 100 0 1 BIT_MASK 0x80 FORMAT "%13.11" ECU_ADDRESS 0x3839CC /end MEASUREMENT
/begin MEASUREMENT B_fahsh "Bedingung Funktionsanforderung Diagnose Heizung Hinterkat-Lambdasonde" UWORD B_TRUE 1 100 0 1 BIT_MASK 0x10 FORMAT "%13.11" ECU_ADDRESS 0x38393C /end MEASUREMENT
/begin MEASUREMENT B_fahsh2 "" UWORD B_TRUE 1 100 0 1 BIT_MASK 0x10 FORMAT "%13.11" ECU_ADDRESS 0x38393E /end MEASUREMENT
/begin MEASUREMENT B_fahsv "Bedingung Funktionsanforderung Diagnose Heizung Vorkat-Lambdasonde" UWORD B_TRUE 1 100 0 1 BIT_MASK 0x10 FORMAT "%13.11" ECU_ADDRESS 0x383940 /end MEASUREMENT
/begin MEASUREMENT B_fahsv2 "" UWORD B_TRUE 1 100 0 1 BIT_MASK 0x10 FORMAT "%13.11" ECU_ADDRESS 0x383942 /end MEASUREMENT
/begin MEASUREMENT B_ftanske "" UWORD B_TRUE 1 100 0 1 BIT_MASK 0x10 FORMAT "%13.11" ECU_ADDRESS 0x3838D2 /end MEASUREMENT
/begin MEASUREMENT B_ftbm "" UWORD B_TRUE 1 100 0 1 BIT_MASK 0x10 FORMAT "%13.11" ECU_ADDRESS 0x3838D6 /end MEASUREMENT
/begin MEASUREMENT B_ftdhdmte "Bedingung Fehlereintrag durch Tester DM-TL Heizung" UWORD B_TRUE 1 100 0 1 BIT_MASK 0x10 FORMAT "%13.11" ECU_ADDRESS 0x3838E6 /end MEASUREMENT
/begin MEASUREMENT B_ftdmmve "Bedingung Fehlereintrag durch Tester DM-TL Magnetventil" UWORD B_TRUE 1 100 0 1 BIT_MASK 0x10 FORMAT "%13.11" ECU_ADDRESS 0x3838EE /end MEASUREMENT
/begin MEASUREMENT B_ftdmpme "Bedingung Fehlereintrag durch Tester DM-TL Pumpenmotor" UWORD B_TRUE 1 100 0 1 BIT_MASK 0x10 FORMAT "%13.11" ECU_ADDRESS 0x3838F0 /end MEASUREMENT
/begin MEASUREMENT B_ftdmtk "" UWORD B_TRUE 1 100 0 1 BIT_MASK 0x10 FORMAT "%13.11" ECU_ADDRESS 0x3838F2 /end MEASUREMENT
/begin MEASUREMENT B_ftdmtknm "" UWORD B_TRUE 1 100 0 1 BIT_MASK 0x10 FORMAT "%13.11" ECU_ADDRESS 0x3838F4 /end MEASUREMENT
/begin MEASUREMENT B_ftdmtl "" UWORD B_TRUE 1 100 0 1 BIT_MASK 0x10 FORMAT "%13.11" ECU_ADDRESS 0x3838F6 /end MEASUREMENT
/begin MEASUREMENT B_ftdpmee "Bedingung Fehlereintrag durch Tester DM-TL Pumpe" UWORD B_TRUE 1 100 0 1 BIT_MASK 0x10 FORMAT "%13.11" ECU_ADDRESS 0x3838F8 /end MEASUREMENT
/begin MEASUREMENT B_ftets "Bedingung: Fehlereintrag durch Tester für el. Thermostat-Endstufe" UWORD B_TRUE 1 100 0 1 BIT_MASK 0x10 FORMAT "%13.11" ECU_ADDRESS 0x383914 /end MEASUREMENT
/begin MEASUREMENT B_ftev1 "Bedingung: Fehlereintrag durch Tester für Endstufendiagnose EV1" UWORD B_TRUE 1 100 0 1 BIT_MASK 0x10 FORMAT "%13.11" ECU_ADDRESS 0x383916 /end MEASUREMENT
/begin MEASUREMENT B_ftev2 "Bedingung: Fehlereintrag durch Tester für Endstufendiagnose EV2" UWORD B_TRUE 1 100 0 1 BIT_MASK 0x10 FORMAT "%13.11" ECU_ADDRESS 0x383918 /end MEASUREMENT
/begin MEASUREMENT B_ftev3 "Bedingung: Fehlereintrag durch Tester für Endstufendiagnose EV3" UWORD B_TRUE 1 100 0 1 BIT_MASK 0x10 FORMAT "%13.11" ECU_ADDRESS 0x38391A /end MEASUREMENT
/begin MEASUREMENT B_ftev4 "Bedingung: Fehlereintrag durch Tester für Endstufendiagnose EV4" UWORD B_TRUE 1 100 0 1 BIT_MASK 0x10 FORMAT "%13.11" ECU_ADDRESS 0x38391C /end MEASUREMENT
/begin MEASUREMENT B_ftev5 "Bedingung: Fehlereintrag durch Tester für Endstufendiagnose EV5" UWORD B_TRUE 1 100 0 1 BIT_MASK 0x10 FORMAT "%13.11" ECU_ADDRESS 0x38391E /end MEASUREMENT
/begin MEASUREMENT B_ftev6 "Bedingung: Fehlereintrag durch Tester für Endstufendiagnose EV6" UWORD B_TRUE 1 100 0 1 BIT_MASK 0x10 FORMAT "%13.11" ECU_ADDRESS 0x383920 /end MEASUREMENT
/begin MEASUREMENT B_ftev7 "Bedingung: Fehlereintrag durch Tester für Endstufendiagnose EV7" UWORD B_TRUE 1 100 0 1 BIT_MASK 0x10 FORMAT "%13.11" ECU_ADDRESS 0x383922 /end MEASUREMENT
/begin MEASUREMENT B_ftev8 "Bedingung: Fehlereintrag durch Tester für Endstufendiagnose EV8" UWORD B_TRUE 1 100 0 1 BIT_MASK 0x10 FORMAT "%13.11" ECU_ADDRESS 0x383924 /end MEASUREMENT
/begin MEASUREMENT B_ftfrao "Bedingung Fehlereintrag durch Tester für FRAO" UWORD B_TRUE 1 100 0 1 BIT_MASK 0x10 FORMAT "%13.11" ECU_ADDRESS 0x38392C /end MEASUREMENT
/begin MEASUREMENT B_ftfrao2 "Bedingung Fehlereintrag durch Tester für FRAO2" UWORD B_TRUE 1 100 0 1 BIT_MASK 0x10 FORMAT "%13.11" ECU_ADDRESS 0x38392E /end MEASUREMENT
/begin MEASUREMENT B_ftfrau "Bedingung Fehlereintrag durch Tester für FRAU" UWORD B_TRUE 1 100 0 1 BIT_MASK 0x10 FORMAT "%13.11" ECU_ADDRESS 0x383930 /end MEASUREMENT
/begin MEASUREMENT B_ftfrau2 "Bedingung Fehlereintrag durch Tester für FRAU2" UWORD B_TRUE 1 100 0 1 BIT_MASK 0x10 FORMAT "%13.11" ECU_ADDRESS 0x383932 /end MEASUREMENT
/begin MEASUREMENT B_ftfrst "Bedingung Fehlereintrag durch Tester für FRST (FR-Kurztest)" UWORD B_TRUE 1 100 0 1 BIT_MASK 0x10 FORMAT "%13.11" ECU_ADDRESS 0x383934 /end MEASUREMENT
/begin MEASUREMENT B_ftfrst2 "Bedingung Fehlereintrag durch Tester für FRST (FR-Kurztest Bank 2)" UWORD B_TRUE 1 100 0 1 BIT_MASK 0x10 FORMAT "%13.11" ECU_ADDRESS 0x383936 /end MEASUREMENT
/begin MEASUREMENT B_ftfst "Bedingung: Fehlereintrag durch Tester FST" UWORD B_TRUE 1 100 0 1 BIT_MASK 0x10 FORMAT "%13.11" ECU_ADDRESS 0x383938 /end MEASUREMENT
/begin MEASUREMENT B_ftglor "" UWORD B_TRUE 1 100 0 1 BIT_MASK 0x10 FORMAT "%13.11" ECU_ADDRESS 0x38393A /end MEASUREMENT
/begin MEASUREMENT B_ftkat "Bedingung: Fehlereintrag durch Tester für Katalysator" UWORD B_TRUE 1 100 0 1 BIT_MASK 0x10 FORMAT "%13.11" ECU_ADDRESS 0x383944 /end MEASUREMENT
/begin MEASUREMENT B_ftkat2 "Bedingung: Fehlereintrag durch Tester für Katalysator, Bank2" UWORD B_TRUE 1 100 0 1 BIT_MASK 0x10 FORMAT "%13.11" ECU_ADDRESS 0x383946 /end MEASUREMENT
/begin MEASUREMENT B_ftkkue "" UWORD B_TRUE 1 100 0 1 BIT_MASK 0x10 FORMAT "%13.11" ECU_ADDRESS 0x383948 /end MEASUREMENT
/begin MEASUREMENT B_ftkos "" UWORD B_TRUE 1 100 0 1 BIT_MASK 0x10 FORMAT "%13.11" ECU_ADDRESS 0x38394A /end MEASUREMENT
/begin MEASUREMENT B_ftkpe "Bedingung: Fehlereintrag durch Tester für Endstufendiagnose EKP" UWORD B_TRUE 1 100 0 1 BIT_MASK 0x10 FORMAT "%13.11" ECU_ADDRESS 0x38394C /end MEASUREMENT
/begin MEASUREMENT B_ftkrnt "" UWORD B_TRUE 1 100 0 1 BIT_MASK 0x10 FORMAT "%13.11" ECU_ADDRESS 0x38394E /end MEASUREMENT
/begin MEASUREMENT B_ftkrof "" UWORD B_TRUE 1 100 0 1 BIT_MASK 0x10 FORMAT "%13.11" ECU_ADDRESS 0x383950 /end MEASUREMENT
/begin MEASUREMENT B_ftkrtp "" UWORD B_TRUE 1 100 0 1 BIT_MASK 0x10 FORMAT "%13.11" ECU_ADDRESS 0x383952 /end MEASUREMENT
/begin MEASUREMENT B_ftks1 "" UWORD B_TRUE 1 100 0 1 BIT_MASK 0x10 FORMAT "%13.11" ECU_ADDRESS 0x383954 /end MEASUREMENT
/begin MEASUREMENT B_ftks2 "" UWORD B_TRUE 1 100 0 1 BIT_MASK 0x10 FORMAT "%13.11" ECU_ADDRESS 0x383956 /end MEASUREMENT
/begin MEASUREMENT B_ftks3 "" UWORD B_TRUE 1 100 0 1 BIT_MASK 0x10 FORMAT "%13.11" ECU_ADDRESS 0x383958 /end MEASUREMENT
/begin MEASUREMENT B_ftks4 "" UWORD B_TRUE 1 100 0 1 BIT_MASK 0x10 FORMAT "%13.11" ECU_ADDRESS 0x38395A /end MEASUREMENT
/begin MEASUREMENT B_ftkuppl "" UWORD B_TRUE 1 100 0 1 BIT_MASK 0x10 FORMAT "%13.11" ECU_ADDRESS 0x38395C /end MEASUREMENT
/begin MEASUREMENT B_ftlde "Bedingung: Fehlereintrag durch Ladedrucksteuerventil (Tester)" UWORD B_TRUE 1 100 0 1 BIT_MASK 0x10 FORMAT "%13.11" ECU_ADDRESS 0x38396A /end MEASUREMENT
/begin MEASUREMENT B_ftldp "" UWORD B_TRUE 1 100 0 1 BIT_MASK 0x10 FORMAT "%13.11" ECU_ADDRESS 0x38396C /end MEASUREMENT
/begin MEASUREMENT B_ftldpe "" UWORD B_TRUE 1 100 0 1 BIT_MASK 0x10 FORMAT "%13.11" ECU_ADDRESS 0x38396E /end MEASUREMENT
/begin MEASUREMENT B_ftlm "Bedingung: Fehlereintrag durch Tester für Luftmassensensor (HFM/DSS/DK)" UWORD B_TRUE 1 100 0 1 BIT_MASK 0x10 FORMAT "%13.11" ECU_ADDRESS 0x383972 /end MEASUREMENT
/begin MEASUREMENT B_ftluea "Bedingung: Fehlereintrag durch Tester für Lüfter Endstufe A" UWORD B_TRUE 1 100 0 1 BIT_MASK 0x10 FORMAT "%13.11" ECU_ADDRESS 0x38397E /end MEASUREMENT
/begin MEASUREMENT B_ftmile "Bedingung: Fehlereintrag durch Tester für Endstufendiagnose Fehlerlampe" UWORD B_TRUE 1 100 0 1 BIT_MASK 0x10 FORMAT "%13.11" ECU_ADDRESS 0x383996 /end MEASUREMENT
/begin MEASUREMENT B_ftn "" UWORD B_TRUE 1 100 0 1 BIT_MASK 0x10 FORMAT "%13.11" ECU_ADDRESS 0x383998 /end MEASUREMENT
/begin MEASUREMENT B_ftnwse "Bedingung: Fehlereintrag durch Tester für Endstufe NWS" UWORD B_TRUE 1 100 0 1 BIT_MASK 0x10 FORMAT "%13.11" ECU_ADDRESS 0x38399E /end MEASUREMENT
/begin MEASUREMENT B_ftnwse2 "" UWORD B_TRUE 1 100 0 1 BIT_MASK 0x10 FORMAT "%13.11" ECU_ADDRESS 0x3839A0 /end MEASUREMENT
/begin MEASUREMENT B_ftrkat "Bedingung Fehlereintrag durch Tester für RKAT" UWORD B_TRUE 1 100 0 1 BIT_MASK 0x10 FORMAT "%13.11" ECU_ADDRESS 0x3839A6 /end MEASUREMENT
/begin MEASUREMENT B_ftrkat2 "Bedingung Fehlereintrag durch Tester für RKAT2" UWORD B_TRUE 1 100 0 1 BIT_MASK 0x10 FORMAT "%13.11" ECU_ADDRESS 0x3839A8 /end MEASUREMENT
/begin MEASUREMENT B_ftrkaz "Bedingung Fehlereintrag durch Tester für RKAZ" UWORD B_TRUE 1 100 0 1 BIT_MASK 0x10 FORMAT "%13.11" ECU_ADDRESS 0x3839AA /end MEASUREMENT
/begin MEASUREMENT B_ftrkaz2 "Bedingung Fehlereintrag durch Tester für RKAZ2" UWORD B_TRUE 1 100 0 1 BIT_MASK 0x10 FORMAT "%13.11" ECU_ADDRESS 0x3839AC /end MEASUREMENT
/begin MEASUREMENT B_ftslpe "Bedingung Fehlereintrag durch Tester Sekundärluftpumpe Endstufe" UWORD B_TRUE 1 100 0 1 BIT_MASK 0x10 FORMAT "%13.11" ECU_ADDRESS 0x3839AE /end MEASUREMENT
/begin MEASUREMENT B_ftslve "Bedingung Fehlereintrag durch Tester Sekundärluftventil Endstufe" UWORD B_TRUE 1 100 0 1 BIT_MASK 0x10 FORMAT "%13.11" ECU_ADDRESS 0x3839B8 /end MEASUREMENT
/begin MEASUREMENT B_ftstae "Bedingung: Fehlereintrag durch Tester für Endstufendiagnose Starter Relais" UWORD B_TRUE 1 100 0 1 BIT_MASK 0x10 FORMAT "%13.11" ECU_ADDRESS 0x3839BC /end MEASUREMENT
/begin MEASUREMENT B_fttesb "" UWORD B_TRUE 1 100 0 1 BIT_MASK 0x10 FORMAT "%13.11" ECU_ADDRESS 0x3839C6 /end MEASUREMENT
/begin MEASUREMENT B_fttesk "" UWORD B_TRUE 1 100 0 1 BIT_MASK 0x10 FORMAT "%13.11" ECU_ADDRESS 0x3839CA /end MEASUREMENT
/begin MEASUREMENT B_ftteve "Bedingung Fehlereintrag durch Tester Tankentlüftungsventil Endstufe" UWORD B_TRUE 1 100 0 1 BIT_MASK 0x10 FORMAT "%13.11" ECU_ADDRESS 0x3839CC /end MEASUREMENT
/begin MEASUREMENT B_mnanske "Fehlertype: Kurzschluss nach Masse Endstufe Ansaugklappe" UWORD B_TRUE 1 100 0 1 BIT_MASK 0x200 FORMAT "%13.11" ECU_ADDRESS 0x3838D2 /end MEASUREMENT
/begin MEASUREMENT B_mnbm "Fehlertyp: häufige Korrektur bei einem Zahn zuwenig" UWORD B_TRUE 1 100 0 1 BIT_MASK 0x200 FORMAT "%13.11" ECU_ADDRESS 0x3838D6 /end MEASUREMENT
/begin MEASUREMENT B_mndhdmte "Fehlerart: Kurzschluß Masse DM-TL Heizung (Endstufe)" UWORD B_TRUE 1 100 0 1 BIT_MASK 0x200 FORMAT "%13.11" ECU_ADDRESS 0x3838E6 /end MEASUREMENT
/begin MEASUREMENT B_mndmmve "Fehlerart: Kurzschluß Masse DM-TL Magnetventil (Endstufe)" UWORD B_TRUE 1 100 0 1 BIT_MASK 0x200 FORMAT "%13.11" ECU_ADDRESS 0x3838EE /end MEASUREMENT
/begin MEASUREMENT B_mndmpme "Fehlerart: Kurzschluß Masse DM-TL Pumpenmotor (Endstufe)" UWORD B_TRUE 1 100 0 1 BIT_MASK 0x200 FORMAT "%13.11" ECU_ADDRESS 0x3838F0 /end MEASUREMENT
/begin MEASUREMENT B_mndmtk "Fehlertyp 'Minimalwert' erkannt (Kleinstleck)" UWORD B_TRUE 1 100 0 1 BIT_MASK 0x200 FORMAT "%13.11" ECU_ADDRESS 0x3838F2 /end MEASUREMENT
/begin MEASUREMENT B_mndmtknm "Fehlertyp 'Minimalwert' erkannt (Kleinstleck; keine MIL on)" UWORD B_TRUE 1 100 0 1 BIT_MASK 0x200 FORMAT "%13.11" ECU_ADDRESS 0x3838F4 /end MEASUREMENT
/begin MEASUREMENT B_mndmtl "Fehlertyp 'Minimalwert' erkannt (DMTL-Modul)" UWORD B_TRUE 1 100 0 1 BIT_MASK 0x200 FORMAT "%13.11" ECU_ADDRESS 0x3838F6 /end MEASUREMENT
/begin MEASUREMENT B_mndpmee "Fehlerart: Kurzschluß Masse DM-TL Pumpenmotor (Endstufe)" UWORD B_TRUE 1 100 0 1 BIT_MASK 0x200 FORMAT "%13.11" ECU_ADDRESS 0x3838F8 /end MEASUREMENT
/begin MEASUREMENT B_mnets "Fehlertype: Kurzschluß nach Masse Endstufe Elektr. Thermostat" UWORD B_TRUE 1 100 0 1 BIT_MASK 0x200 FORMAT "%13.11" ECU_ADDRESS 0x383914 /end MEASUREMENT
/begin MEASUREMENT B_mnev1 "Fehlerart: Kurzschluß Masse an Endstufe EV1" UWORD B_TRUE 1 100 0 1 BIT_MASK 0x200 FORMAT "%13.11" ECU_ADDRESS 0x383916 /end MEASUREMENT
/begin MEASUREMENT B_mnev2 "Fehlerart: Kurzschluß Masse an Endstufe EV2" UWORD B_TRUE 1 100 0 1 BIT_MASK 0x200 FORMAT "%13.11" ECU_ADDRESS 0x383918 /end MEASUREMENT
/begin MEASUREMENT B_mnev3 "Fehlerart: Kurzschluß Masse an Endstufe EV3" UWORD B_TRUE 1 100 0 1 BIT_MASK 0x200 FORMAT "%13.11" ECU_ADDRESS 0x38391A /end MEASUREMENT
/begin MEASUREMENT B_mnev4 "Fehlerart: Kurzschluß Masse an Endstufe EV4" UWORD B_TRUE 1 100 0 1 BIT_MASK 0x200 FORMAT "%13.11" ECU_ADDRESS 0x38391C /end MEASUREMENT
/begin MEASUREMENT B_mnev5 "Fehlerart: Kurzschluß Masse an Endstufe EV5" UWORD B_TRUE 1 100 0 1 BIT_MASK 0x200 FORMAT "%13.11" ECU_ADDRESS 0x38391E /end MEASUREMENT
/begin MEASUREMENT B_mnev6 "Fehlerart: Kurzschluß Masse an Endstufe EV6" UWORD B_TRUE 1 100 0 1 BIT_MASK 0x200 FORMAT "%13.11" ECU_ADDRESS 0x383920 /end MEASUREMENT
/begin MEASUREMENT B_mnev7 "Fehlerart: Kurzschluß Masse an Endstufe EV7" UWORD B_TRUE 1 100 0 1 BIT_MASK 0x200 FORMAT "%13.11" ECU_ADDRESS 0x383922 /end MEASUREMENT
/begin MEASUREMENT B_mnev8 "Fehlerart: Kurzschluß Masse an Endstufe EV8" UWORD B_TRUE 1 100 0 1 BIT_MASK 0x200 FORMAT "%13.11" ECU_ADDRESS 0x383924 /end MEASUREMENT
/begin MEASUREMENT B_mnfrao "Bedingung untere Plausibilitätsschwelle unterschritten (obere Multipl.)" UWORD B_TRUE 1 100 0 1 BIT_MASK 0x200 FORMAT "%13.11" ECU_ADDRESS 0x38392C /end MEASUREMENT
/begin MEASUREMENT B_mnfrao2 "Bedingung untere Plausibilitätsschwelle unterschritten (Stereo)" UWORD B_TRUE 1 100 0 1 BIT_MASK 0x200 FORMAT "%13.11" ECU_ADDRESS 0x38392E /end MEASUREMENT
/begin MEASUREMENT B_mnfrau "Bedingung untere Plausibilitätsschwelle unterschritten (untere Multipl.)" UWORD B_TRUE 1 100 0 1 BIT_MASK 0x200 FORMAT "%13.11" ECU_ADDRESS 0x383930 /end MEASUREMENT
/begin MEASUREMENT B_mnfrau2 "Bedingung untere Plausibilitätsschwelle unterschritten (Stereo)" UWORD B_TRUE 1 100 0 1 BIT_MASK 0x200 FORMAT "%13.11" ECU_ADDRESS 0x383932 /end MEASUREMENT
/begin MEASUREMENT B_mnfrst "Bedingung untere Plausibilitätsschwelle unterschritten(short test)" UWORD B_TRUE 1 100 0 1 BIT_MASK 0x200 FORMAT "%13.11" ECU_ADDRESS 0x383934 /end MEASUREMENT
/begin MEASUREMENT B_mnfrst2 "Bedingung untere Plausibilitätsschwelle unterschritten(short test Stereo" UWORD B_TRUE 1 100 0 1 BIT_MASK 0x200 FORMAT "%13.11" ECU_ADDRESS 0x383936 /end MEASUREMENT
/begin MEASUREMENT B_mnfst "Fehlertyp: Kurzschluß nach Masse Tankfüllstandssensor" UWORD B_TRUE 1 100 0 1 BIT_MASK 0x200 FORMAT "%13.11" ECU_ADDRESS 0x383938 /end MEASUREMENT
/begin MEASUREMENT B_mnglor "" UWORD B_TRUE 1 100 0 1 BIT_MASK 0x200 FORMAT "%13.11" ECU_ADDRESS 0x38393A /end MEASUREMENT
/begin MEASUREMENT B_mnhsh "Kurzschluß Heizung Lambdasonde hinter Kat nach Masse" UWORD B_TRUE 1 100 0 1 BIT_MASK 0x200 FORMAT "%13.11" ECU_ADDRESS 0x38393C /end MEASUREMENT
/begin MEASUREMENT B_mnhsh2 "Kurzschluß Heizung Lambdasonde2 hinter Kat nach Masse" UWORD B_TRUE 1 100 0 1 BIT_MASK 0x200 FORMAT "%13.11" ECU_ADDRESS 0x38393E /end MEASUREMENT
/begin MEASUREMENT B_mnhsv "Kurzschluß Heizung Lambdasonde vor Kat nach Masse" UWORD B_TRUE 1 100 0 1 BIT_MASK 0x200 FORMAT "%13.11" ECU_ADDRESS 0x383940 /end MEASUREMENT
/begin MEASUREMENT B_mnhsv2 "Kurzschluß Heizung Lambdasonde2 vor Kat nach Masse" UWORD B_TRUE 1 100 0 1 BIT_MASK 0x200 FORMAT "%13.11" ECU_ADDRESS 0x383942 /end MEASUREMENT
/begin MEASUREMENT B_mnkat "Fehlertyp 'Minimalwert' erkannt (Katalysator defekt)" UWORD B_TRUE 1 100 0 1 BIT_MASK 0x200 FORMAT "%13.11" ECU_ADDRESS 0x383944 /end MEASUREMENT
/begin MEASUREMENT B_mnkat2 "Fehlertyp min.: Katalysator Bank2" UWORD B_TRUE 1 100 0 1 BIT_MASK 0x200 FORMAT "%13.11" ECU_ADDRESS 0x383946 /end MEASUREMENT
/begin MEASUREMENT B_mnkkue "" UWORD B_TRUE 1 100 0 1 BIT_MASK 0x200 FORMAT "%13.11" ECU_ADDRESS 0x383948 /end MEASUREMENT
/begin MEASUREMENT B_mnkos "Fehlertype: Kurzschluß nach Masse Endstufe Klimakompressor" UWORD B_TRUE 1 100 0 1 BIT_MASK 0x200 FORMAT "%13.11" ECU_ADDRESS 0x38394A /end MEASUREMENT
/begin MEASUREMENT B_mnkpe "Bedingung für Fehlertyp Kurzschluß nach Masse für EKP-Relais Endstufe erkannt" UWORD B_TRUE 1 100 0 1 BIT_MASK 0x200 FORMAT "%13.11" ECU_ADDRESS 0x38394C /end MEASUREMENT
/begin MEASUREMENT B_mnkrnt "Fehlertyp min.: Klopfregelung Nulltest" UWORD B_TRUE 1 100 0 1 BIT_MASK 0x200 FORMAT "%13.11" ECU_ADDRESS 0x38394E /end MEASUREMENT
/begin MEASUREMENT B_mnkrof "Fehlertyp min.: Klopfregelung Offset" UWORD B_TRUE 1 100 0 1 BIT_MASK 0x200 FORMAT "%13.11" ECU_ADDRESS 0x383950 /end MEASUREMENT
/begin MEASUREMENT B_mnkrtp "Fehlertyp min.: Klopfregelung Testimpuls" UWORD B_TRUE 1 100 0 1 BIT_MASK 0x200 FORMAT "%13.11" ECU_ADDRESS 0x383952 /end MEASUREMENT
/begin MEASUREMENT B_mnks1 "Bedingung: Min-Fehler Klopfsensor 1" UWORD B_TRUE 1 100 0 1 BIT_MASK 0x200 FORMAT "%13.11" ECU_ADDRESS 0x383954 /end MEASUREMENT
/begin MEASUREMENT B_mnks2 "Bedingung: Min-Fehler Klopfsensor 2" UWORD B_TRUE 1 100 0 1 BIT_MASK 0x200 FORMAT "%13.11" ECU_ADDRESS 0x383956 /end MEASUREMENT
/begin MEASUREMENT B_mnks3 "Bedingung: Min-Fehler Klopfsensor 3" UWORD B_TRUE 1 100 0 1 BIT_MASK 0x200 FORMAT "%13.11" ECU_ADDRESS 0x383958 /end MEASUREMENT
/begin MEASUREMENT B_mnks4 "Bedingung: Min-fehler Klopfsensor 4" UWORD B_TRUE 1 100 0 1 BIT_MASK 0x200 FORMAT "%13.11" ECU_ADDRESS 0x38395A /end MEASUREMENT
/begin MEASUREMENT B_mnkuppl "Fehlertyp KUPPL: Minimalwert unterschritten" UWORD B_TRUE 1 100 0 1 BIT_MASK 0x200 FORMAT "%13.11" ECU_ADDRESS 0x38395C /end MEASUREMENT
/begin MEASUREMENT B_mnlde "Fehlertyp: Kurzschluß Masse LDR-Taktventil" UWORD B_TRUE 1 100 0 1 BIT_MASK 0x200 FORMAT "%13.11" ECU_ADDRESS 0x38396A /end MEASUREMENT
/begin MEASUREMENT B_mnldp "Fehlertyp 'Minimalwert' erkannt (Reed-Switch öffnet nicht)" UWORD B_TRUE 1 100 0 1 BIT_MASK 0x200 FORMAT "%13.11" ECU_ADDRESS 0x38396C /end MEASUREMENT
/begin MEASUREMENT B_mnldpe "Fehlertype: Kurzschluß nach Masse LDP-Endstufe" UWORD B_TRUE 1 100 0 1 BIT_MASK 0x200 FORMAT "%13.11" ECU_ADDRESS 0x38396E /end MEASUREMENT
/begin MEASUREMENT B_mnlm "Bedingung: min-Fehler Hauptfüllungssensor" UWORD B_TRUE 1 100 0 1 BIT_MASK 0x200 FORMAT "%13.11" ECU_ADDRESS 0x383972 /end MEASUREMENT
/begin MEASUREMENT B_mnluea "Fehlertype: Kurzschluß nach Masse Endstufe Motor Lüfter A" UWORD B_TRUE 1 100 0 1 BIT_MASK 0x200 FORMAT "%13.11" ECU_ADDRESS 0x38397E /end MEASUREMENT
/begin MEASUREMENT B_mnmile "Fehlerart: Kurzschluß Masse an MIL-Endstufe" UWORD B_TRUE 1 100 0 1 BIT_MASK 0x200 FORMAT "%13.11" ECU_ADDRESS 0x383996 /end MEASUREMENT
/begin MEASUREMENT B_mnn "Fehlerart: Synchronisationsmarke häufig nicht gefunden" UWORD B_TRUE 1 100 0 1 BIT_MASK 0x200 FORMAT "%13.11" ECU_ADDRESS 0x383998 /end MEASUREMENT
/begin MEASUREMENT B_mnnwse "Fehlerart: Kurzschluß Masse Nockenwellensteuerungsventil Endstufe" UWORD B_TRUE 1 100 0 1 BIT_MASK 0x200 FORMAT "%13.11" ECU_ADDRESS 0x38399E /end MEASUREMENT
/begin MEASUREMENT B_mnnwse2 "Fehlertype: Kurzschluss nach Masse Nockenwellensteuerung Bank2 Endstufe" UWORD B_TRUE 1 100 0 1 BIT_MASK 0x200 FORMAT "%13.11" ECU_ADDRESS 0x3839A0 /end MEASUREMENT
/begin MEASUREMENT B_mnrkat "Bedingung untere Plausibilitätsschwelle unterschritten (add. pro Zeit)" UWORD B_TRUE 1 100 0 1 BIT_MASK 0x200 FORMAT "%13.11" ECU_ADDRESS 0x3839A6 /end MEASUREMENT
/begin MEASUREMENT B_mnrkat2 "Bedingung untere Plausibilitätsschwelle unterschritten (Stereo)" UWORD B_TRUE 1 100 0 1 BIT_MASK 0x200 FORMAT "%13.11" ECU_ADDRESS 0x3839A8 /end MEASUREMENT
/begin MEASUREMENT B_mnrkaz "Bedingung untere Plausibilitätsschwelle unterschritten (add. pro Zündung)" UWORD B_TRUE 1 100 0 1 BIT_MASK 0x200 FORMAT "%13.11" ECU_ADDRESS 0x3839AA /end MEASUREMENT
/begin MEASUREMENT B_mnrkaz2 "Bedingung untere Plausibilitätsschwelle unterschritten (Stereo)" UWORD B_TRUE 1 100 0 1 BIT_MASK 0x200 FORMAT "%13.11" ECU_ADDRESS 0x3839AC /end MEASUREMENT
/begin MEASUREMENT B_mnslpe "Fehlertype: Kurzschluß nach Masse Endstufe Sekundärluftpumpe" UWORD B_TRUE 1 100 0 1 BIT_MASK 0x200 FORMAT "%13.11" ECU_ADDRESS 0x3839AE /end MEASUREMENT
/begin MEASUREMENT B_mnslve "Fehlertype: Kurzschluß nach Masse Endstufe Sekundärluftventil" UWORD B_TRUE 1 100 0 1 BIT_MASK 0x200 FORMAT "%13.11" ECU_ADDRESS 0x3839B8 /end MEASUREMENT
/begin MEASUREMENT B_mnstae "Fehlertype: Kurzschluß nach Masse Endstufe Start Relais" UWORD B_TRUE 1 100 0 1 BIT_MASK 0x200 FORMAT "%13.11" ECU_ADDRESS 0x3839BC /end MEASUREMENT
/begin MEASUREMENT B_mntesb "Fehlertyp 'Minimalwert' erkannt" UWORD B_TRUE 1 100 0 1 BIT_MASK 0x200 FORMAT "%13.11" ECU_ADDRESS 0x3839C6 /end MEASUREMENT
/begin MEASUREMENT B_mntesk "Fehlertyp 'Minimalwert' erkannt (Kleinstleck)" UWORD B_TRUE 1 100 0 1 BIT_MASK 0x200 FORMAT "%13.11" ECU_ADDRESS 0x3839CA /end MEASUREMENT
/begin MEASUREMENT B_mnteve "Fehlertyp: Kurzschluß Masse Tankentlüftungsventil Endstufe" UWORD B_TRUE 1 100 0 1 BIT_MASK 0x200 FORMAT "%13.11" ECU_ADDRESS 0x3839CC /end MEASUREMENT
/begin MEASUREMENT B_mxanske "Fehlertype: Kurzschluss nach Ubatt Endstufe Ansaugklappe" UWORD B_TRUE 1 100 0 1 BIT_MASK 0x100 FORMAT "%13.11" ECU_ADDRESS 0x3838D2 /end MEASUREMENT
/begin MEASUREMENT B_mxbm "Fehlertyp: häufige Korrektur bei einem Zahn zuviel" UWORD B_TRUE 1 100 0 1 BIT_MASK 0x100 FORMAT "%13.11" ECU_ADDRESS 0x3838D6 /end MEASUREMENT
/begin MEASUREMENT B_mxdhdmte "Fehlerart: Kurzschluß Ubat DM-TL Heizung (Endstufe)" UWORD B_TRUE 1 100 0 1 BIT_MASK 0x100 FORMAT "%13.11" ECU_ADDRESS 0x3838E6 /end MEASUREMENT
/begin MEASUREMENT B_mxdmmve "Fehlerart: Kurzschluß Ubat DM-TL Magnetventil (Endstufe)" UWORD B_TRUE 1 100 0 1 BIT_MASK 0x100 FORMAT "%13.11" ECU_ADDRESS 0x3838EE /end MEASUREMENT
/begin MEASUREMENT B_mxdmpme "Fehlerart: Kurzschluß Ubat DM-TL Pumpenmotor (Endstufe)" UWORD B_TRUE 1 100 0 1 BIT_MASK 0x100 FORMAT "%13.11" ECU_ADDRESS 0x3838F0 /end MEASUREMENT
/begin MEASUREMENT B_mxdmtk "Fehlertyp 'Maximalwert' erkannt (Grobleck)" UWORD B_TRUE 1 100 0 1 BIT_MASK 0x100 FORMAT "%13.11" ECU_ADDRESS 0x3838F2 /end MEASUREMENT
/begin MEASUREMENT B_mxdmtknm "Fehlertyp 'Maximalwert' erkannt (Grobleck; keine MIL on)" UWORD B_TRUE 1 100 0 1 BIT_MASK 0x100 FORMAT "%13.11" ECU_ADDRESS 0x3838F4 /end MEASUREMENT
/begin MEASUREMENT B_mxdmtl "Fehlertyp 'Maximalwert' erkannt (DMTL-Modul)" UWORD B_TRUE 1 100 0 1 BIT_MASK 0x100 FORMAT "%13.11" ECU_ADDRESS 0x3838F6 /end MEASUREMENT
/begin MEASUREMENT B_mxdpmee "Fehlerart: Kurzschluß Ubat DM-TL Pumpenmotor (Endstufe)" UWORD B_TRUE 1 100 0 1 BIT_MASK 0x100 FORMAT "%13.11" ECU_ADDRESS 0x3838F8 /end MEASUREMENT
/begin MEASUREMENT B_mxets "Fehlertype: Kurzschluß nach Ubatt Endstufe Elektr. Thermostat" UWORD B_TRUE 1 100 0 1 BIT_MASK 0x100 FORMAT "%13.11" ECU_ADDRESS 0x383914 /end MEASUREMENT
/begin MEASUREMENT B_mxev1 "Fehlerart: Kurzschluß UBat an Endstufe EV1" UWORD B_TRUE 1 100 0 1 BIT_MASK 0x100 FORMAT "%13.11" ECU_ADDRESS 0x383916 /end MEASUREMENT
/begin MEASUREMENT B_mxev2 "Fehlerart: Kurzschluß UBat an Endstufe EV2" UWORD B_TRUE 1 100 0 1 BIT_MASK 0x100 FORMAT "%13.11" ECU_ADDRESS 0x383918 /end MEASUREMENT
/begin MEASUREMENT B_mxev3 "Fehlerart: Kurzschluß UBat an Endstufe EV3" UWORD B_TRUE 1 100 0 1 BIT_MASK 0x100 FORMAT "%13.11" ECU_ADDRESS 0x38391A /end MEASUREMENT
/begin MEASUREMENT B_mxev4 "Fehlerart: Kurzschluß UBat an Endstufe EV4" UWORD B_TRUE 1 100 0 1 BIT_MASK 0x100 FORMAT "%13.11" ECU_ADDRESS 0x38391C /end MEASUREMENT
/begin MEASUREMENT B_mxev5 "Fehlerart: Kurzschluß UBat an Endstufe EV5" UWORD B_TRUE 1 100 0 1 BIT_MASK 0x100 FORMAT "%13.11" ECU_ADDRESS 0x38391E /end MEASUREMENT
/begin MEASUREMENT B_mxev6 "Fehlerart: Kurzschluß UBat an Endstufe EV6" UWORD B_TRUE 1 100 0 1 BIT_MASK 0x100 FORMAT "%13.11" ECU_ADDRESS 0x383920 /end MEASUREMENT
/begin MEASUREMENT B_mxev7 "Fehlerart: Kurzschluß UBat an Endstufe EV7" UWORD B_TRUE 1 100 0 1 BIT_MASK 0x100 FORMAT "%13.11" ECU_ADDRESS 0x383922 /end MEASUREMENT
/begin MEASUREMENT B_mxev8 "Fehlerart: Kurzschluß UBat an Endstufe EV8" UWORD B_TRUE 1 100 0 1 BIT_MASK 0x100 FORMAT "%13.11" ECU_ADDRESS 0x383924 /end MEASUREMENT
/begin MEASUREMENT B_mxfrao "Bedingung obere Plausibilitätsschwelle überschritten (obere Multipl.)" UWORD B_TRUE 1 100 0 1 BIT_MASK 0x100 FORMAT "%13.11" ECU_ADDRESS 0x38392C /end MEASUREMENT
/begin MEASUREMENT B_mxfrao2 "Bedingung obere Plausibilitätsschwelle überschritten (Stereo)" UWORD B_TRUE 1 100 0 1 BIT_MASK 0x100 FORMAT "%13.11" ECU_ADDRESS 0x38392E /end MEASUREMENT
/begin MEASUREMENT B_mxfrau "Bedingung obere Plausiblitätsschwelle überschritten (untere Multipl.)" UWORD B_TRUE 1 100 0 1 BIT_MASK 0x100 FORMAT "%13.11" ECU_ADDRESS 0x383930 /end MEASUREMENT
/begin MEASUREMENT B_mxfrau2 "Bedingung obere Plausibilitätsschwelle überschritten (mult. 2. Bank)" UWORD B_TRUE 1 100 0 1 BIT_MASK 0x100 FORMAT "%13.11" ECU_ADDRESS 0x383932 /end MEASUREMENT
/begin MEASUREMENT B_mxfrst "Bedingung obere Plausiblitätsschwelle überschritten (short test" UWORD B_TRUE 1 100 0 1 BIT_MASK 0x100 FORMAT "%13.11" ECU_ADDRESS 0x383934 /end MEASUREMENT
/begin MEASUREMENT B_mxfrst2 "Bedingung obere Plausiblitätsschwelle überschritten (short test Stereo" UWORD B_TRUE 1 100 0 1 BIT_MASK 0x100 FORMAT "%13.11" ECU_ADDRESS 0x383936 /end MEASUREMENT
/begin MEASUREMENT B_mxfst "Fehlertyp: Kurzschluß nach Ubatt Tankfüllstandssensor" UWORD B_TRUE 1 100 0 1 BIT_MASK 0x100 FORMAT "%13.11" ECU_ADDRESS 0x383938 /end MEASUREMENT
/begin MEASUREMENT B_mxglor "" UWORD B_TRUE 1 100 0 1 BIT_MASK 0x100 FORMAT "%13.11" ECU_ADDRESS 0x38393A /end MEASUREMENT
/begin MEASUREMENT B_mxhsh "Kurzschluß Heizung Lambdasonde hinter Kat nach UB" UWORD B_TRUE 1 100 0 1 BIT_MASK 0x100 FORMAT "%13.11" ECU_ADDRESS 0x38393C /end MEASUREMENT
/begin MEASUREMENT B_mxhsh2 "Kurzschluß Heizung Lambdasonde2 hinter Kat nach UB" UWORD B_TRUE 1 100 0 1 BIT_MASK 0x100 FORMAT "%13.11" ECU_ADDRESS 0x38393E /end MEASUREMENT
/begin MEASUREMENT B_mxhsv "Kurzschluß Heizung Lambdasonde vor Kat nach UB" UWORD B_TRUE 1 100 0 1 BIT_MASK 0x100 FORMAT "%13.11" ECU_ADDRESS 0x383940 /end MEASUREMENT
/begin MEASUREMENT B_mxhsv2 "Kurzschluß Heizung Lambdasonde2 vor Kat nach UB" UWORD B_TRUE 1 100 0 1 BIT_MASK 0x100 FORMAT "%13.11" ECU_ADDRESS 0x383942 /end MEASUREMENT
/begin MEASUREMENT B_mxkat "Bedingung obere Plausibilitätsschwelle überschritten" UWORD B_TRUE 1 100 0 1 BIT_MASK 0x100 FORMAT "%13.11" ECU_ADDRESS 0x383944 /end MEASUREMENT
/begin MEASUREMENT B_mxkat2 "Bedingung obere Plausibilitätsschwelle überschritten (Stereo)" UWORD B_TRUE 1 100 0 1 BIT_MASK 0x100 FORMAT "%13.11" ECU_ADDRESS 0x383946 /end MEASUREMENT
/begin MEASUREMENT B_mxkkue "" UWORD B_TRUE 1 100 0 1 BIT_MASK 0x100 FORMAT "%13.11" ECU_ADDRESS 0x383948 /end MEASUREMENT
/begin MEASUREMENT B_mxkos "Fehlertype: Kurzschluß nach Ubatt Endstufe Klimakompressor" UWORD B_TRUE 1 100 0 1 BIT_MASK 0x100 FORMAT "%13.11" ECU_ADDRESS 0x38394A /end MEASUREMENT
/begin MEASUREMENT B_mxkpe "Fehlertyp Kurzschluß nach Ubat für EKP-Relais Endstufe erkannt" UWORD B_TRUE 1 100 0 1 BIT_MASK 0x100 FORMAT "%13.11" ECU_ADDRESS 0x38394C /end MEASUREMENT
/begin MEASUREMENT B_mxkrnt "Fehlertyp max.: Klopfregelung Nulltest" UWORD B_TRUE 1 100 0 1 BIT_MASK 0x100 FORMAT "%13.11" ECU_ADDRESS 0x38394E /end MEASUREMENT
/begin MEASUREMENT B_mxkrof "Fehlertyp max.: Klopfregelung Offset" UWORD B_TRUE 1 100 0 1 BIT_MASK 0x100 FORMAT "%13.11" ECU_ADDRESS 0x383950 /end MEASUREMENT
/begin MEASUREMENT B_mxkrtp "Fehlertyp max.: Klopfregelung Testimpuls" UWORD B_TRUE 1 100 0 1 BIT_MASK 0x100 FORMAT "%13.11" ECU_ADDRESS 0x383952 /end MEASUREMENT
/begin MEASUREMENT B_mxks1 "Bedingung: Max-Fehler Klopfsensor 1" UWORD B_TRUE 1 100 0 1 BIT_MASK 0x100 FORMAT "%13.11" ECU_ADDRESS 0x383954 /end MEASUREMENT
/begin MEASUREMENT B_mxks2 "Bedingung: Max-Fehler Klopfsensor 2" UWORD B_TRUE 1 100 0 1 BIT_MASK 0x100 FORMAT "%13.11" ECU_ADDRESS 0x383956 /end MEASUREMENT
/begin MEASUREMENT B_mxks3 "Bedingung: Max-Fehler Klopfsensor 3" UWORD B_TRUE 1 100 0 1 BIT_MASK 0x100 FORMAT "%13.11" ECU_ADDRESS 0x383958 /end MEASUREMENT
/begin MEASUREMENT B_mxks4 "Bedingung: Max-Fehler Klopfsensor 4" UWORD B_TRUE 1 100 0 1 BIT_MASK 0x100 FORMAT "%13.11" ECU_ADDRESS 0x38395A /end MEASUREMENT
/begin MEASUREMENT B_mxkuppl "Fehlertyp KUPPL: Maximalwert überschritten" UWORD B_TRUE 1 100 0 1 BIT_MASK 0x100 FORMAT "%13.11" ECU_ADDRESS 0x38395C /end MEASUREMENT
/begin MEASUREMENT B_mxlde "Fehlertyp: Kurzschluß Ubat LDR-Taktventil" UWORD B_TRUE 1 100 0 1 BIT_MASK 0x100 FORMAT "%13.11" ECU_ADDRESS 0x38396A /end MEASUREMENT
/begin MEASUREMENT B_mxldp "Fehlertyp 'Maximalwert' erkannt (Reed-Switch nicht geschlossen)" UWORD B_TRUE 1 100 0 1 BIT_MASK 0x100 FORMAT "%13.11" ECU_ADDRESS 0x38396C /end MEASUREMENT
/begin MEASUREMENT B_mxldpe "Fehlertype: Kurzschluß nach Ubatt Endstufe LDP" UWORD B_TRUE 1 100 0 1 BIT_MASK 0x100 FORMAT "%13.11" ECU_ADDRESS 0x38396E /end MEASUREMENT
/begin MEASUREMENT B_mxlm "Bedingung: max-Fehler Hauptfüllungssensor" UWORD B_TRUE 1 100 0 1 BIT_MASK 0x100 FORMAT "%13.11" ECU_ADDRESS 0x383972 /end MEASUREMENT
/begin MEASUREMENT B_mxluea "Fehlertype: Kurzschluß nach Ubat Endstufe Motor Lüfter A" UWORD B_TRUE 1 100 0 1 BIT_MASK 0x100 FORMAT "%13.11" ECU_ADDRESS 0x38397E /end MEASUREMENT
/begin MEASUREMENT B_mxmile "Fehlerart: Kurzschluß Ubat an MIL-Endstufe" UWORD B_TRUE 1 100 0 1 BIT_MASK 0x100 FORMAT "%13.11" ECU_ADDRESS 0x383996 /end MEASUREMENT
/begin MEASUREMENT B_mxn "Fehlerart: häufiger Lückenverlust beim Lückencheck" UWORD B_TRUE 1 100 0 1 BIT_MASK 0x100 FORMAT "%13.11" ECU_ADDRESS 0x383998 /end MEASUREMENT
/begin MEASUREMENT B_mxnwse "Fehlerart: Kurzschluß Ubat Nockenwellensteuerungsventil Endstufe" UWORD B_TRUE 1 100 0 1 BIT_MASK 0x100 FORMAT "%13.11" ECU_ADDRESS 0x38399E /end MEASUREMENT
/begin MEASUREMENT B_mxnwse2 "Fehlertype: Kurzschluss nach Ubat Nockenwellensteuerung Bank2 Endstufe" UWORD B_TRUE 1 100 0 1 BIT_MASK 0x100 FORMAT "%13.11" ECU_ADDRESS 0x3839A0 /end MEASUREMENT
/begin MEASUREMENT B_mxrkat "Bedingung obere Plausibilitätsschwelle überschritten (add. pro Zeit)" UWORD B_TRUE 1 100 0 1 BIT_MASK 0x100 FORMAT "%13.11" ECU_ADDRESS 0x3839A6 /end MEASUREMENT
/begin MEASUREMENT B_mxrkat2 "Bedingung obere Plausibilitätsschwelle überschritten (Stereo)" UWORD B_TRUE 1 100 0 1 BIT_MASK 0x100 FORMAT "%13.11" ECU_ADDRESS 0x3839A8 /end MEASUREMENT
/begin MEASUREMENT B_mxrkaz "Bedingung obere Plausibilitätsschwelle überschritten (add. pro Zündung)" UWORD B_TRUE 1 100 0 1 BIT_MASK 0x100 FORMAT "%13.11" ECU_ADDRESS 0x3839AA /end MEASUREMENT
/begin MEASUREMENT B_mxrkaz2 "Bedingung obere Plausibilitätsschwelle überschritten (Stereo)" UWORD B_TRUE 1 100 0 1 BIT_MASK 0x100 FORMAT "%13.11" ECU_ADDRESS 0x3839AC /end MEASUREMENT
/begin MEASUREMENT B_mxslpe "Fehlertype: Kurzschluß nach Ubatt Endstufe Sekundärluftpumpe" UWORD B_TRUE 1 100 0 1 BIT_MASK 0x100 FORMAT "%13.11" ECU_ADDRESS 0x3839AE /end MEASUREMENT
/begin MEASUREMENT B_mxslve "Fehlertype: Kurzschluß nach Masse Endstufe Sekundärluftventil" UWORD B_TRUE 1 100 0 1 BIT_MASK 0x100 FORMAT "%13.11" ECU_ADDRESS 0x3839B8 /end MEASUREMENT
/begin MEASUREMENT B_mxstae "Fehlertype: Kurzschluß nach Ubatt Endstufe Start Relais" UWORD B_TRUE 1 100 0 1 BIT_MASK 0x100 FORMAT "%13.11" ECU_ADDRESS 0x3839BC /end MEASUREMENT
/begin MEASUREMENT B_mxtesb "Fehlertyp 'Maximalwert' erkannt" UWORD B_TRUE 1 100 0 1 BIT_MASK 0x100 FORMAT "%13.11" ECU_ADDRESS 0x3839C6 /end MEASUREMENT
/begin MEASUREMENT B_mxtesk "Fehlertyp 'Maximalwert' erkannt (Kleinstleck)" UWORD B_TRUE 1 100 0 1 BIT_MASK 0x100 FORMAT "%13.11" ECU_ADDRESS 0x3839CA /end MEASUREMENT
/begin MEASUREMENT B_mxteve "Fehlertyp: Kurzschluß Ubat Tankentlüftungsventil Endstufe" UWORD B_TRUE 1 100 0 1 BIT_MASK 0x100 FORMAT "%13.11" ECU_ADDRESS 0x3839CC /end MEASUREMENT
/begin MEASUREMENT B_npanske "Fehlertype: Wert unplausibel Ansaugklappe Endstufe" UWORD B_TRUE 1 100 0 1 BIT_MASK 0x800 FORMAT "%13.11" ECU_ADDRESS 0x3838D2 /end MEASUREMENT
/begin MEASUREMENT B_npbm "Fehlertyp: Bezugsmarkenfehler beim Lückencheck" UWORD B_TRUE 1 100 0 1 BIT_MASK 0x800 FORMAT "%13.11" ECU_ADDRESS 0x3838D6 /end MEASUREMENT
/begin MEASUREMENT B_npdhdmte "Fehlertyp 'unplausibles Prüfresultat' erkannt (Endstufe DM-TL Heizung)" UWORD B_TRUE 1 100 0 1 BIT_MASK 0x800 FORMAT "%13.11" ECU_ADDRESS 0x3838E6 /end MEASUREMENT
/begin MEASUREMENT B_npdmmve "Fehlertyp 'unplausibles Prüfresultat' erkannt (Endstufe DM-TL Magnetventil)" UWORD B_TRUE 1 100 0 1 BIT_MASK 0x800 FORMAT "%13.11" ECU_ADDRESS 0x3838EE /end MEASUREMENT
/begin MEASUREMENT B_npdmpme "Fehlertyp 'unplausibles Prüfresultat' erkannt (Endstufe DM-TL Pumpenmotor)" UWORD B_TRUE 1 100 0 1 BIT_MASK 0x800 FORMAT "%13.11" ECU_ADDRESS 0x3838F0 /end MEASUREMENT
/begin MEASUREMENT B_npdmtk "" UWORD B_TRUE 1 100 0 1 BIT_MASK 0x800 FORMAT "%13.11" ECU_ADDRESS 0x3838F2 /end MEASUREMENT
/begin MEASUREMENT B_npdmtknm "" UWORD B_TRUE 1 100 0 1 BIT_MASK 0x800 FORMAT "%13.11" ECU_ADDRESS 0x3838F4 /end MEASUREMENT
/begin MEASUREMENT B_npdmtl "Fehlertyp 'unplausibles Prüfresultat' erkannt (DM-TL Modul)" UWORD B_TRUE 1 100 0 1 BIT_MASK 0x800 FORMAT "%13.11" ECU_ADDRESS 0x3838F6 /end MEASUREMENT
/begin MEASUREMENT B_npdpmee "Fehlertyp 'unplausibles Prüfresultat' erkannt (Endstufe DM-TL Pumpe)" UWORD B_TRUE 1 100 0 1 BIT_MASK 0x800 FORMAT "%13.11" ECU_ADDRESS 0x3838F8 /end MEASUREMENT
/begin MEASUREMENT B_npets "Bedingung für Fehlertyp 'Wert unplausibel' für el. Thermostat-Endstufe erkannt" UWORD B_TRUE 1 100 0 1 BIT_MASK 0x800 FORMAT "%13.11" ECU_ADDRESS 0x383914 /end MEASUREMENT
/begin MEASUREMENT B_npev1 "Fehlerart: Zustand nicht plausibel EV1" UWORD B_TRUE 1 100 0 1 BIT_MASK 0x800 FORMAT "%13.11" ECU_ADDRESS 0x383916 /end MEASUREMENT
/begin MEASUREMENT B_npev2 "Fehlerart: Zustand nicht plausibel EV2" UWORD B_TRUE 1 100 0 1 BIT_MASK 0x800 FORMAT "%13.11" ECU_ADDRESS 0x383918 /end MEASUREMENT
/begin MEASUREMENT B_npev3 "Fehlerart: Zustand nicht plausibel EV3" UWORD B_TRUE 1 100 0 1 BIT_MASK 0x800 FORMAT "%13.11" ECU_ADDRESS 0x38391A /end MEASUREMENT
/begin MEASUREMENT B_npev4 "Fehlerart: Zustand nicht plausibel EV4" UWORD B_TRUE 1 100 0 1 BIT_MASK 0x800 FORMAT "%13.11" ECU_ADDRESS 0x38391C /end MEASUREMENT
/begin MEASUREMENT B_npev5 "Fehlerart: Zustand nicht plausibel EV5" UWORD B_TRUE 1 100 0 1 BIT_MASK 0x800 FORMAT "%13.11" ECU_ADDRESS 0x38391E /end MEASUREMENT
/begin MEASUREMENT B_npev6 "Fehlerart: Zustand nicht plausibel EV6" UWORD B_TRUE 1 100 0 1 BIT_MASK 0x800 FORMAT "%13.11" ECU_ADDRESS 0x383920 /end MEASUREMENT
/begin MEASUREMENT B_npev7 "Fehlerart: Zustand nicht plausibel EV7" UWORD B_TRUE 1 100 0 1 BIT_MASK 0x800 FORMAT "%13.11" ECU_ADDRESS 0x383922 /end MEASUREMENT
/begin MEASUREMENT B_npev8 "Fehlerart: Zustand nicht plausibel EV8" UWORD B_TRUE 1 100 0 1 BIT_MASK 0x800 FORMAT "%13.11" ECU_ADDRESS 0x383924 /end MEASUREMENT
/begin MEASUREMENT B_npfrao "Bedingung FRAO ist unplausibel" UWORD B_TRUE 1 100 0 1 BIT_MASK 0x800 FORMAT "%13.11" ECU_ADDRESS 0x38392C /end MEASUREMENT
/begin MEASUREMENT B_npfrao2 "Bedingung FRAO ist unplausibel Bank 2" UWORD B_TRUE 1 100 0 1 BIT_MASK 0x800 FORMAT "%13.11" ECU_ADDRESS 0x38392E /end MEASUREMENT
/begin MEASUREMENT B_npfrau "Bedingung FRAU ist unplausibel" UWORD B_TRUE 1 100 0 1 BIT_MASK 0x800 FORMAT "%13.11" ECU_ADDRESS 0x383930 /end MEASUREMENT
/begin MEASUREMENT B_npfrau2 "Bedingung FRAU ist unplausibel Bank 2" UWORD B_TRUE 1 100 0 1 BIT_MASK 0x800 FORMAT "%13.11" ECU_ADDRESS 0x383932 /end MEASUREMENT
/begin MEASUREMENT B_npfrst "Fehlertyp 'unplausibles Prüfresultat' erkannt (DKVS Kurztest)" UWORD B_TRUE 1 100 0 1 BIT_MASK 0x800 FORMAT "%13.11" ECU_ADDRESS 0x383934 /end MEASUREMENT
/begin MEASUREMENT B_npfrst2 "Fehlertyp 'unplausibles Prüfresultat' erkannt (DKVS Kurztest Bank 2)" UWORD B_TRUE 1 100 0 1 BIT_MASK 0x800 FORMAT "%13.11" ECU_ADDRESS 0x383936 /end MEASUREMENT
/begin MEASUREMENT B_npfst "Fehlertyp: Fuellstandssensor-Signal nicht plausibel" UWORD B_TRUE 1 100 0 1 BIT_MASK 0x800 FORMAT "%13.11" ECU_ADDRESS 0x383938 /end MEASUREMENT
/begin MEASUREMENT B_npglor "Bedingung: Fehler Low Range Berechnung unplausibel" UWORD B_TRUE 1 100 0 1 BIT_MASK 0x800 FORMAT "%13.11" ECU_ADDRESS 0x38393A /end MEASUREMENT
/begin MEASUREMENT B_nphsh "Nernstwiderstand Sonde hinter Kat zu groß" UWORD B_TRUE 1 100 0 1 BIT_MASK 0x800 FORMAT "%13.11" ECU_ADDRESS 0x38393C /end MEASUREMENT
/begin MEASUREMENT B_nphsh2 "Nernstwiderstand Sonde 2 hinter Kat zu groß" UWORD B_TRUE 1 100 0 1 BIT_MASK 0x800 FORMAT "%13.11" ECU_ADDRESS 0x38393E /end MEASUREMENT
/begin MEASUREMENT B_nphsv "Nernstwiderstand Sonde vor Kat zu groß" UWORD B_TRUE 1 100 0 1 BIT_MASK 0x800 FORMAT "%13.11" ECU_ADDRESS 0x383940 /end MEASUREMENT
/begin MEASUREMENT B_nphsv2 "Nernstwiderstand Sonde 2 vor Kat zu groß" UWORD B_TRUE 1 100 0 1 BIT_MASK 0x800 FORMAT "%13.11" ECU_ADDRESS 0x383942 /end MEASUREMENT
/begin MEASUREMENT B_npkat "Fehlertyp 'unplausibles Prüfresultat' erkannt (Katalysator)" UWORD B_TRUE 1 100 0 1 BIT_MASK 0x800 FORMAT "%13.11" ECU_ADDRESS 0x383944 /end MEASUREMENT
/begin MEASUREMENT B_npkat2 "Fehlertyp 'unplausibles Prüfresultat' erkannt (Katalysator)2" UWORD B_TRUE 1 100 0 1 BIT_MASK 0x800 FORMAT "%13.11" ECU_ADDRESS 0x383946 /end MEASUREMENT
/begin MEASUREMENT B_npkkue "" UWORD B_TRUE 1 100 0 1 BIT_MASK 0x800 FORMAT "%13.11" ECU_ADDRESS 0x383948 /end MEASUREMENT
/begin MEASUREMENT B_npkos "" UWORD B_TRUE 1 100 0 1 BIT_MASK 0x800 FORMAT "%13.11" ECU_ADDRESS 0x38394A /end MEASUREMENT
/begin MEASUREMENT B_npkpe "Bedingung für Fehlertyp 'Wert unplausibel' für EKP-Relais Endstufe erkannt" UWORD B_TRUE 1 100 0 1 BIT_MASK 0x800 FORMAT "%13.11" ECU_ADDRESS 0x38394C /end MEASUREMENT
/begin MEASUREMENT B_npkrnt "Bedingung Plausibilitätsfehler der KR-Diagnose Integratorsteigung" UWORD B_TRUE 1 100 0 1 BIT_MASK 0x800 FORMAT "%13.11" ECU_ADDRESS 0x38394E /end MEASUREMENT
/begin MEASUREMENT B_npkrof "Bedingung Plausibilitätsfehler der KR-Diagnose Resetwert" UWORD B_TRUE 1 100 0 1 BIT_MASK 0x800 FORMAT "%13.11" ECU_ADDRESS 0x383950 /end MEASUREMENT
/begin MEASUREMENT B_npkrtp "Bedingung Plausibilitätsfehler der KR-Diagnose Testimpuls" UWORD B_TRUE 1 100 0 1 BIT_MASK 0x800 FORMAT "%13.11" ECU_ADDRESS 0x383952 /end MEASUREMENT
/begin MEASUREMENT B_npks1 "Nicht plausibler Fehler: Klopfsensor 1" UWORD B_TRUE 1 100 0 1 BIT_MASK 0x800 FORMAT "%13.11" ECU_ADDRESS 0x383954 /end MEASUREMENT
/begin MEASUREMENT B_npks2 "Nicht plausibler Fehler: Klopfsensor 2" UWORD B_TRUE 1 100 0 1 BIT_MASK 0x800 FORMAT "%13.11" ECU_ADDRESS 0x383956 /end MEASUREMENT
/begin MEASUREMENT B_npks3 "Nicht plausibler Fehler: Klopfsensor 3" UWORD B_TRUE 1 100 0 1 BIT_MASK 0x800 FORMAT "%13.11" ECU_ADDRESS 0x383958 /end MEASUREMENT
/begin MEASUREMENT B_npks4 "Nicht plausibler Fehler: Klopfsensor 4" UWORD B_TRUE 1 100 0 1 BIT_MASK 0x800 FORMAT "%13.11" ECU_ADDRESS 0x38395A /end MEASUREMENT
/begin MEASUREMENT B_npkuppl "Fehlertyp KUPPL: Prüfresultat nicht plausibel" UWORD B_TRUE 1 100 0 1 BIT_MASK 0x800 FORMAT "%13.11" ECU_ADDRESS 0x38395C /end MEASUREMENT
/begin MEASUREMENT B_nplde "Nicht plausibler Fehler: Ladedrucksteuerventil Endstufe" UWORD B_TRUE 1 100 0 1 BIT_MASK 0x800 FORMAT "%13.11" ECU_ADDRESS 0x38396A /end MEASUREMENT
/begin MEASUREMENT B_npldp "Fehlertyp 'unplausibles Prüfresultat' Reed Switch schliesst nicht" UWORD B_TRUE 1 100 0 1 BIT_MASK 0x800 FORMAT "%13.11" ECU_ADDRESS 0x38396C /end MEASUREMENT
/begin MEASUREMENT B_npldpe "Nicht plausibler Fehler: Leckdiagnosemodul Endstufe" UWORD B_TRUE 1 100 0 1 BIT_MASK 0x800 FORMAT "%13.11" ECU_ADDRESS 0x38396E /end MEASUREMENT
/begin MEASUREMENT B_nplm "Bedingung Plausfehler Hauptfüllungssensor" UWORD B_TRUE 1 100 0 1 BIT_MASK 0x800 FORMAT "%13.11" ECU_ADDRESS 0x383972 /end MEASUREMENT
/begin MEASUREMENT B_npluea "Bedingung: Endstufe Motor-Lüfter A  Fehlertype nicht plausibel" UWORD B_TRUE 1 100 0 1 BIT_MASK 0x800 FORMAT "%13.11" ECU_ADDRESS 0x38397E /end MEASUREMENT
/begin MEASUREMENT B_npmile "Fehlerart: Zustand nicht plausibel an MIL-Endstufe" UWORD B_TRUE 1 100 0 1 BIT_MASK 0x800 FORMAT "%13.11" ECU_ADDRESS 0x383996 /end MEASUREMENT
/begin MEASUREMENT B_npn "Fehlerart: häufiger Bezugsmarkenfehler beim Lückencheck" UWORD B_TRUE 1 100 0 1 BIT_MASK 0x800 FORMAT "%13.11" ECU_ADDRESS 0x383998 /end MEASUREMENT
/begin MEASUREMENT B_npnwse "Nicht plausibler Fehler: Nockenwellenverstellung Endstufe" UWORD B_TRUE 1 100 0 1 BIT_MASK 0x800 FORMAT "%13.11" ECU_ADDRESS 0x38399E /end MEASUREMENT
/begin MEASUREMENT B_npnwse2 "Fehlertype: nicht plausibles Signal Nockenwellensteuerung Bank2 Endstufe" UWORD B_TRUE 1 100 0 1 BIT_MASK 0x800 FORMAT "%13.11" ECU_ADDRESS 0x3839A0 /end MEASUREMENT
/begin MEASUREMENT B_nprkat "Bedingung RKAT ist unplausibel" UWORD B_TRUE 1 100 0 1 BIT_MASK 0x800 FORMAT "%13.11" ECU_ADDRESS 0x3839A6 /end MEASUREMENT
/begin MEASUREMENT B_nprkat2 "Bedingung RKAT ist unplausibel Bank 2" UWORD B_TRUE 1 100 0 1 BIT_MASK 0x800 FORMAT "%13.11" ECU_ADDRESS 0x3839A8 /end MEASUREMENT
/begin MEASUREMENT B_nprkaz "Bedingung RKAZ ist unplausibel" UWORD B_TRUE 1 100 0 1 BIT_MASK 0x800 FORMAT "%13.11" ECU_ADDRESS 0x3839AA /end MEASUREMENT
/begin MEASUREMENT B_nprkaz2 "Bedingung RKAZ ist unplausibel Bank 2" UWORD B_TRUE 1 100 0 1 BIT_MASK 0x800 FORMAT "%13.11" ECU_ADDRESS 0x3839AC /end MEASUREMENT
/begin MEASUREMENT B_npslpe "Nicht plausibler Fehler: Sekundärluftpumpe Endstufe" UWORD B_TRUE 1 100 0 1 BIT_MASK 0x800 FORMAT "%13.11" ECU_ADDRESS 0x3839AE /end MEASUREMENT
/begin MEASUREMENT B_npslve "Fehlerart: Offsetwert Sekundärluftmasse Endstufe" UWORD B_TRUE 1 100 0 1 BIT_MASK 0x800 FORMAT "%13.11" ECU_ADDRESS 0x3839B8 /end MEASUREMENT
/begin MEASUREMENT B_npstae "Bedingung für Fehlertyp ""Wert bunplausibel"" für Starter Relais Endstufe erkannt" UWORD B_TRUE 1 100 0 1 BIT_MASK 0x800 FORMAT "%13.11" ECU_ADDRESS 0x3839BC /end MEASUREMENT
/begin MEASUREMENT B_nptesb "Fehlertyp 'unplausibles Prüfresultat' erkannt (verstopfte Leitung)" UWORD B_TRUE 1 100 0 1 BIT_MASK 0x800 FORMAT "%13.11" ECU_ADDRESS 0x3839C6 /end MEASUREMENT
/begin MEASUREMENT B_nptesk "Fehlertyp 'unplausibles Prüfresultat' erkannt (Kleinstleck)" UWORD B_TRUE 1 100 0 1 BIT_MASK 0x800 FORMAT "%13.11" ECU_ADDRESS 0x3839CA /end MEASUREMENT
/begin MEASUREMENT B_npteve "Nicht plausibler Fehler: Tankentlüftungsventil Endstufe" UWORD B_TRUE 1 100 0 1 BIT_MASK 0x800 FORMAT "%13.11" ECU_ADDRESS 0x3839CC /end MEASUREMENT
/begin MEASUREMENT B_sianske "Fehlertype: Leitungsabfall Endstufe Ansaugklappe" UWORD B_TRUE 1 100 0 1 BIT_MASK 0x400 FORMAT "%13.11" ECU_ADDRESS 0x3838D2 /end MEASUREMENT
/begin MEASUREMENT B_sibm "Fehlertyp: keine Bezugsmarke im Start gefunden" UWORD B_TRUE 1 100 0 1 BIT_MASK 0x400 FORMAT "%13.11" ECU_ADDRESS 0x3838D6 /end MEASUREMENT
/begin MEASUREMENT B_sidhdmte "Fehlerart: Leitungsabfall DM-TL Heizung (Endstufe)" UWORD B_TRUE 1 100 0 1 BIT_MASK 0x400 FORMAT "%13.11" ECU_ADDRESS 0x3838E6 /end MEASUREMENT
/begin MEASUREMENT B_sidmmve "Fehlerart: Leitungsabfall DM-TL Magnetventil (Endstufe)" UWORD B_TRUE 1 100 0 1 BIT_MASK 0x400 FORMAT "%13.11" ECU_ADDRESS 0x3838EE /end MEASUREMENT
/begin MEASUREMENT B_sidmpme "Fehlerart: Leitungsabfall DM-TL Pumpenmotor (Endstufe)" UWORD B_TRUE 1 100 0 1 BIT_MASK 0x400 FORMAT "%13.11" ECU_ADDRESS 0x3838F0 /end MEASUREMENT
/begin MEASUREMENT B_sidmtk "" UWORD B_TRUE 1 100 0 1 BIT_MASK 0x400 FORMAT "%13.11" ECU_ADDRESS 0x3838F2 /end MEASUREMENT
/begin MEASUREMENT B_sidmtknm "" UWORD B_TRUE 1 100 0 1 BIT_MASK 0x400 FORMAT "%13.11" ECU_ADDRESS 0x3838F4 /end MEASUREMENT
/begin MEASUREMENT B_sidmtl "Fehlertyp 'Signalfehler' erkannt (DMTL-Modul)" UWORD B_TRUE 1 100 0 1 BIT_MASK 0x400 FORMAT "%13.11" ECU_ADDRESS 0x3838F6 /end MEASUREMENT
/begin MEASUREMENT B_sidpmee "Fehlerart: Leitungsabfall DM-TL Pumpenmotor (Endstufe)" UWORD B_TRUE 1 100 0 1 BIT_MASK 0x400 FORMAT "%13.11" ECU_ADDRESS 0x3838F8 /end MEASUREMENT
/begin MEASUREMENT B_siets "Fehlertype: Leitungsabfall Endstufe Elektr. Thermostat" UWORD B_TRUE 1 100 0 1 BIT_MASK 0x400 FORMAT "%13.11" ECU_ADDRESS 0x383914 /end MEASUREMENT
/begin MEASUREMENT B_siev1 "Fehlerart: Unterbrechung an Endstufe EV1" UWORD B_TRUE 1 100 0 1 BIT_MASK 0x400 FORMAT "%13.11" ECU_ADDRESS 0x383916 /end MEASUREMENT
/begin MEASUREMENT B_siev2 "Fehlerart: Unterbrechung an Endstufe EV2" UWORD B_TRUE 1 100 0 1 BIT_MASK 0x400 FORMAT "%13.11" ECU_ADDRESS 0x383918 /end MEASUREMENT
/begin MEASUREMENT B_siev3 "Fehlerart: Unterbrechung an Endstufe EV3" UWORD B_TRUE 1 100 0 1 BIT_MASK 0x400 FORMAT "%13.11" ECU_ADDRESS 0x38391A /end MEASUREMENT
/begin MEASUREMENT B_siev4 "Fehlerart: Unterbrechung an Endstufe EV4" UWORD B_TRUE 1 100 0 1 BIT_MASK 0x400 FORMAT "%13.11" ECU_ADDRESS 0x38391C /end MEASUREMENT
/begin MEASUREMENT B_siev5 "Fehlerart: Unterbrechung an Endstufe EV5" UWORD B_TRUE 1 100 0 1 BIT_MASK 0x400 FORMAT "%13.11" ECU_ADDRESS 0x38391E /end MEASUREMENT
/begin MEASUREMENT B_siev6 "Fehlerart: Unterbrechung an Endstufe EV6" UWORD B_TRUE 1 100 0 1 BIT_MASK 0x400 FORMAT "%13.11" ECU_ADDRESS 0x383920 /end MEASUREMENT
/begin MEASUREMENT B_siev7 "Fehlerart: Unterbrechung an Endstufe EV7" UWORD B_TRUE 1 100 0 1 BIT_MASK 0x400 FORMAT "%13.11" ECU_ADDRESS 0x383922 /end MEASUREMENT
/begin MEASUREMENT B_siev8 "Fehlerart: Unterbrechung an Endstufe EV8" UWORD B_TRUE 1 100 0 1 BIT_MASK 0x400 FORMAT "%13.11" ECU_ADDRESS 0x383924 /end MEASUREMENT
/begin MEASUREMENT B_sifrao "Fehlertyp 'Signal fehlt' for FRAO erkannt" UWORD B_TRUE 1 100 0 1 BIT_MASK 0x400 FORMAT "%13.11" ECU_ADDRESS 0x38392C /end MEASUREMENT
/begin MEASUREMENT B_sifrao2 "Fehlertyp 'Signal fehlt' for FRAO erkannt Bank 2" UWORD B_TRUE 1 100 0 1 BIT_MASK 0x400 FORMAT "%13.11" ECU_ADDRESS 0x38392E /end MEASUREMENT
/begin MEASUREMENT B_sifrau "Fehlertyp 'Signal fehlt' für FRAU erkannt" UWORD B_TRUE 1 100 0 1 BIT_MASK 0x400 FORMAT "%13.11" ECU_ADDRESS 0x383930 /end MEASUREMENT
/begin MEASUREMENT B_sifrau2 "Fehlertyp 'Signal fehlt' für FRAU erkannt Bank 2" UWORD B_TRUE 1 100 0 1 BIT_MASK 0x400 FORMAT "%13.11" ECU_ADDRESS 0x383932 /end MEASUREMENT
/begin MEASUREMENT B_sifrst "Fehlerart: LR-Abweichung" UWORD B_TRUE 1 100 0 1 BIT_MASK 0x400 FORMAT "%13.11" ECU_ADDRESS 0x383934 /end MEASUREMENT
/begin MEASUREMENT B_sifrst2 "Fehlerart: LR-Abweichung Bank 2" UWORD B_TRUE 1 100 0 1 BIT_MASK 0x400 FORMAT "%13.11" ECU_ADDRESS 0x383936 /end MEASUREMENT
/begin MEASUREMENT B_sifst "Fehlertyp: Fuellstandssensor - Signal nicht in Ordnung" UWORD B_TRUE 1 100 0 1 BIT_MASK 0x400 FORMAT "%13.11" ECU_ADDRESS 0x383938 /end MEASUREMENT
/begin MEASUREMENT B_siglor "Bedingung: Fehler Low Range Signal Fehler" UWORD B_TRUE 1 100 0 1 BIT_MASK 0x400 FORMAT "%13.11" ECU_ADDRESS 0x38393A /end MEASUREMENT
/begin MEASUREMENT B_sihsh "Lastabfall Sondenheizung hinter Kat" UWORD B_TRUE 1 100 0 1 BIT_MASK 0x400 FORMAT "%13.11" ECU_ADDRESS 0x38393C /end MEASUREMENT
/begin MEASUREMENT B_sihsh2 "Lastabfall Sondenheizung2 hinter Kat" UWORD B_TRUE 1 100 0 1 BIT_MASK 0x400 FORMAT "%13.11" ECU_ADDRESS 0x38393E /end MEASUREMENT
/begin MEASUREMENT B_sihsv "Lastabfall Sondenheizung vor Kat" UWORD B_TRUE 1 100 0 1 BIT_MASK 0x400 FORMAT "%13.11" ECU_ADDRESS 0x383940 /end MEASUREMENT
/begin MEASUREMENT B_sihsv2 "Lastabfall Sondenheizung2 vor Kat" UWORD B_TRUE 1 100 0 1 BIT_MASK 0x400 FORMAT "%13.11" ECU_ADDRESS 0x383942 /end MEASUREMENT
/begin MEASUREMENT B_sikat "Fehlertyp 'Signal fehlt' für DKAT erkannt" UWORD B_TRUE 1 100 0 1 BIT_MASK 0x400 FORMAT "%13.11" ECU_ADDRESS 0x383944 /end MEASUREMENT
/begin MEASUREMENT B_sikat2 "Fehlertyp 'Signal fehlt' für DKAT 2 erkannt" UWORD B_TRUE 1 100 0 1 BIT_MASK 0x400 FORMAT "%13.11" ECU_ADDRESS 0x383946 /end MEASUREMENT
/begin MEASUREMENT B_sikkue "" UWORD B_TRUE 1 100 0 1 BIT_MASK 0x400 FORMAT "%13.11" ECU_ADDRESS 0x383948 /end MEASUREMENT
/begin MEASUREMENT B_sikos "Fehlertype: Leitungsabfall Endstufe Klimakompressor" UWORD B_TRUE 1 100 0 1 BIT_MASK 0x400 FORMAT "%13.11" ECU_ADDRESS 0x38394A /end MEASUREMENT
/begin MEASUREMENT B_sikpe "Bedingung für Fehlertyp Leitungsabfall für EKP-Relais Endstufe erkannt" UWORD B_TRUE 1 100 0 1 BIT_MASK 0x400 FORMAT "%13.11" ECU_ADDRESS 0x38394C /end MEASUREMENT
/begin MEASUREMENT B_sikrnt "Fehlertyp: Klopfregelung Nulltest" UWORD B_TRUE 1 100 0 1 BIT_MASK 0x400 FORMAT "%13.11" ECU_ADDRESS 0x38394E /end MEASUREMENT
/begin MEASUREMENT B_sikrof "Fehlertyp: Klopfregelung Offset" UWORD B_TRUE 1 100 0 1 BIT_MASK 0x400 FORMAT "%13.11" ECU_ADDRESS 0x383950 /end MEASUREMENT
/begin MEASUREMENT B_sikrtp "Fehlertyp: Klopfregelung Testimpuls" UWORD B_TRUE 1 100 0 1 BIT_MASK 0x400 FORMAT "%13.11" ECU_ADDRESS 0x383952 /end MEASUREMENT
/begin MEASUREMENT B_siks1 "Fehlertyp: Klopfsensor 1" UWORD B_TRUE 1 100 0 1 BIT_MASK 0x400 FORMAT "%13.11" ECU_ADDRESS 0x383954 /end MEASUREMENT
/begin MEASUREMENT B_siks2 "Fehlertyp: Klopfsensor 2" UWORD B_TRUE 1 100 0 1 BIT_MASK 0x400 FORMAT "%13.11" ECU_ADDRESS 0x383956 /end MEASUREMENT
/begin MEASUREMENT B_siks3 "Fehlertyp: Klopfsensor 3" UWORD B_TRUE 1 100 0 1 BIT_MASK 0x400 FORMAT "%13.11" ECU_ADDRESS 0x383958 /end MEASUREMENT
/begin MEASUREMENT B_siks4 "Fehlertyp: Klopfsensor 4" UWORD B_TRUE 1 100 0 1 BIT_MASK 0x400 FORMAT "%13.11" ECU_ADDRESS 0x38395A /end MEASUREMENT
/begin MEASUREMENT B_sikuppl "Fehlertyp KUPPL: Signal inaktiv" UWORD B_TRUE 1 100 0 1 BIT_MASK 0x400 FORMAT "%13.11" ECU_ADDRESS 0x38395C /end MEASUREMENT
/begin MEASUREMENT B_silde "Fehlertyp: Leitungsabfall LDR-Taktventil" UWORD B_TRUE 1 100 0 1 BIT_MASK 0x400 FORMAT "%13.11" ECU_ADDRESS 0x38396A /end MEASUREMENT
/begin MEASUREMENT B_sildp "Fehlertyp: Leckdiagnosemodul" UWORD B_TRUE 1 100 0 1 BIT_MASK 0x400 FORMAT "%13.11" ECU_ADDRESS 0x38396C /end MEASUREMENT
/begin MEASUREMENT B_sildpe "Fehlertype: Leitungsabfall Endstufe Leckage Pumpe" UWORD B_TRUE 1 100 0 1 BIT_MASK 0x400 FORMAT "%13.11" ECU_ADDRESS 0x38396E /end MEASUREMENT
/begin MEASUREMENT B_silm "Bedingung Signalfehler Hauptfüllungssensor" UWORD B_TRUE 1 100 0 1 BIT_MASK 0x400 FORMAT "%13.11" ECU_ADDRESS 0x383972 /end MEASUREMENT
/begin MEASUREMENT B_siluea "Fehlertype: Leitungsabfall Endstufe Motor Lüfter A" UWORD B_TRUE 1 100 0 1 BIT_MASK 0x400 FORMAT "%13.11" ECU_ADDRESS 0x38397E /end MEASUREMENT
/begin MEASUREMENT B_simile "Fehlerart: Unterbrechung an MIL-Endstufe" UWORD B_TRUE 1 100 0 1 BIT_MASK 0x400 FORMAT "%13.11" ECU_ADDRESS 0x383996 /end MEASUREMENT
/begin MEASUREMENT B_sin "Fehlertyp: kein Drehzahlsignal vorhanden" UWORD B_TRUE 1 100 0 1 BIT_MASK 0x400 FORMAT "%13.11" ECU_ADDRESS 0x383998 /end MEASUREMENT
/begin MEASUREMENT B_sinwse "Fehlerart: Leitungsabfall Nockenwellensteuerungsventil Endstufe" UWORD B_TRUE 1 100 0 1 BIT_MASK 0x400 FORMAT "%13.11" ECU_ADDRESS 0x38399E /end MEASUREMENT
/begin MEASUREMENT B_sinwse2 "Fehlertype: Leitungsabfall Nockenwellensteuerung Bank2 Endstufe" UWORD B_TRUE 1 100 0 1 BIT_MASK 0x400 FORMAT "%13.11" ECU_ADDRESS 0x3839A0 /end MEASUREMENT
/begin MEASUREMENT B_sirkat "Fehlertyp 'Signal fehlt' for RKAT erkannt" UWORD B_TRUE 1 100 0 1 BIT_MASK 0x400 FORMAT "%13.11" ECU_ADDRESS 0x3839A6 /end MEASUREMENT
/begin MEASUREMENT B_sirkat2 "Fehlertyp 'Signal fehlt' for RKAT erkannt Bank 2" UWORD B_TRUE 1 100 0 1 BIT_MASK 0x400 FORMAT "%13.11" ECU_ADDRESS 0x3839A8 /end MEASUREMENT
/begin MEASUREMENT B_sirkaz "Fehlertyp 'Signal fehlt' for RKAZ erkannt" UWORD B_TRUE 1 100 0 1 BIT_MASK 0x400 FORMAT "%13.11" ECU_ADDRESS 0x3839AA /end MEASUREMENT
/begin MEASUREMENT B_sirkaz2 "Fehlertyp 'Signal fehlt' for RKAZ erkannt Bank 2" UWORD B_TRUE 1 100 0 1 BIT_MASK 0x400 FORMAT "%13.11" ECU_ADDRESS 0x3839AC /end MEASUREMENT
/begin MEASUREMENT B_sislpe "Fehlertype: Leitungsabfall Endstufe Sekundärluftpumpe" UWORD B_TRUE 1 100 0 1 BIT_MASK 0x400 FORMAT "%13.11" ECU_ADDRESS 0x3839AE /end MEASUREMENT
/begin MEASUREMENT B_sislve "Fehlertype: Leitungsabfall Endstufe Sekundärluftventil" UWORD B_TRUE 1 100 0 1 BIT_MASK 0x400 FORMAT "%13.11" ECU_ADDRESS 0x3839B8 /end MEASUREMENT
/begin MEASUREMENT B_sistae "Fehlertype: Leitungsabfall Endstufe Start Relais" UWORD B_TRUE 1 100 0 1 BIT_MASK 0x400 FORMAT "%13.11" ECU_ADDRESS 0x3839BC /end MEASUREMENT
/begin MEASUREMENT B_sitesb "" UWORD B_TRUE 1 100 0 1 BIT_MASK 0x400 FORMAT "%13.11" ECU_ADDRESS 0x3839C6 /end MEASUREMENT
/begin MEASUREMENT B_sitesk "Fehlerart: Kleinstleck" UWORD B_TRUE 1 100 0 1 BIT_MASK 0x400 FORMAT "%13.11" ECU_ADDRESS 0x3839CA /end MEASUREMENT
/begin MEASUREMENT B_siteve "Fehlertyp: Leitungsabfall Tankentlüftungsventil Endstufe" UWORD B_TRUE 1 100 0 1 BIT_MASK 0x400 FORMAT "%13.11" ECU_ADDRESS 0x3839CC /end MEASUREMENT
/begin MEASUREMENT E_anske "Errorflag: Ansaugklappe, Endstufe" UWORD B_TRUE 1 100 0 1 BIT_MASK 0x1 FORMAT "%13.11" ECU_ADDRESS 0x3838D2 /end MEASUREMENT
/begin MEASUREMENT E_bm "Errorflag: Bezugsmarkengeber" UWORD B_TRUE 1 100 0 1 BIT_MASK 0x1 FORMAT "%13.11" ECU_ADDRESS 0x3838D6 /end MEASUREMENT
/begin MEASUREMENT E_dhdmte "Errorflag: DM-TL Heizung (Endstufe)" UWORD B_TRUE 1 100 0 1 BIT_MASK 0x1 FORMAT "%13.11" ECU_ADDRESS 0x3838E6 /end MEASUREMENT
/begin MEASUREMENT E_dmmve "Errorflag: DM-TL Magnetventil (Endstufe)" UWORD B_TRUE 1 100 0 1 BIT_MASK 0x1 FORMAT "%13.11" ECU_ADDRESS 0x3838EE /end MEASUREMENT
/begin MEASUREMENT E_dmpme "Errorflag: DM-TL Pumpenmotor (Endstufe)" UWORD B_TRUE 1 100 0 1 BIT_MASK 0x1 FORMAT "%13.11" ECU_ADDRESS 0x3838F0 /end MEASUREMENT
/begin MEASUREMENT E_dmtk "Errorflag: Tankentlüftungssystem Kleinstleck" UWORD B_TRUE 1 100 0 1 BIT_MASK 0x1 FORMAT "%13.11" ECU_ADDRESS 0x3838F2 /end MEASUREMENT
/begin MEASUREMENT E_dmtknm "Errorflag: Tankentlüftungssystem Kleinstleck (nicht MIL on)" UWORD B_TRUE 1 100 0 1 BIT_MASK 0x1 FORMAT "%13.11" ECU_ADDRESS 0x3838F4 /end MEASUREMENT
/begin MEASUREMENT E_dmtl "Errorflag: DMTL-Modul" UWORD B_TRUE 1 100 0 1 BIT_MASK 0x1 FORMAT "%13.11" ECU_ADDRESS 0x3838F6 /end MEASUREMENT
/begin MEASUREMENT E_dpmee "Errorflag: DM-TL Pumpenmotor (Endstufe)" UWORD B_TRUE 1 100 0 1 BIT_MASK 0x1 FORMAT "%13.11" ECU_ADDRESS 0x3838F8 /end MEASUREMENT
/begin MEASUREMENT E_ets "Errorflag: elektronisches Thermostat" UWORD B_TRUE 1 100 0 1 BIT_MASK 0x1 FORMAT "%13.11" ECU_ADDRESS 0x383914 /end MEASUREMENT
/begin MEASUREMENT E_ev1 "Errorflag: EV von Zyl. 1" UWORD B_TRUE 1 100 0 1 BIT_MASK 0x1 FORMAT "%13.11" ECU_ADDRESS 0x383916 /end MEASUREMENT
/begin MEASUREMENT E_ev2 "Errorflag: EV von Zyl. 2" UWORD B_TRUE 1 100 0 1 BIT_MASK 0x1 FORMAT "%13.11" ECU_ADDRESS 0x383918 /end MEASUREMENT
/begin MEASUREMENT E_ev3 "Errorflag: EV von Zyl. 3" UWORD B_TRUE 1 100 0 1 BIT_MASK 0x1 FORMAT "%13.11" ECU_ADDRESS 0x38391A /end MEASUREMENT
/begin MEASUREMENT E_ev4 "Errorflag: EV von Zyl. 4" UWORD B_TRUE 1 100 0 1 BIT_MASK 0x1 FORMAT "%13.11" ECU_ADDRESS 0x38391C /end MEASUREMENT
/begin MEASUREMENT E_ev5 "Errorflag: EV von Zyl. 5" UWORD B_TRUE 1 100 0 1 BIT_MASK 0x1 FORMAT "%13.11" ECU_ADDRESS 0x38391E /end MEASUREMENT
/begin MEASUREMENT E_ev6 "Errorflag: EV von Zyl. 6" UWORD B_TRUE 1 100 0 1 BIT_MASK 0x1 FORMAT "%13.11" ECU_ADDRESS 0x383920 /end MEASUREMENT
/begin MEASUREMENT E_ev7 "Errorflag: EV von Zyl. 7" UWORD B_TRUE 1 100 0 1 BIT_MASK 0x1 FORMAT "%13.11" ECU_ADDRESS 0x383922 /end MEASUREMENT
/begin MEASUREMENT E_ev8 "Errorflag: EV von Zyl. 8" UWORD B_TRUE 1 100 0 1 BIT_MASK 0x1 FORMAT "%13.11" ECU_ADDRESS 0x383924 /end MEASUREMENT
/begin MEASUREMENT E_frao "Errorflag: LR-Adaption oberer multiplikativer Bereich" UWORD B_TRUE 1 100 0 1 BIT_MASK 0x1 FORMAT "%13.11" ECU_ADDRESS 0x38392C /end MEASUREMENT
/begin MEASUREMENT E_frao2 "Errorflag: LR-Adaption oberer multiplikativer Bereich (Bank 2)" UWORD B_TRUE 1 100 0 1 BIT_MASK 0x1 FORMAT "%13.11" ECU_ADDRESS 0x38392E /end MEASUREMENT
/begin MEASUREMENT E_frau "Errorflag: LR-Adaption unterer multiplikativer Bereich" UWORD B_TRUE 1 100 0 1 BIT_MASK 0x1 FORMAT "%13.11" ECU_ADDRESS 0x383930 /end MEASUREMENT
/begin MEASUREMENT E_frau2 "Errorflag: LR-Adaption unterer multiplikativer Bereich (Bank 2)" UWORD B_TRUE 1 100 0 1 BIT_MASK 0x1 FORMAT "%13.11" ECU_ADDRESS 0x383932 /end MEASUREMENT
/begin MEASUREMENT E_frst "Errorflag: Fehler aus Diagnose Kraftstoffversorgungssystem (Kurztest)" UWORD B_TRUE 1 100 0 1 BIT_MASK 0x1 FORMAT "%13.11" ECU_ADDRESS 0x383934 /end MEASUREMENT
/begin MEASUREMENT E_frst2 "Errorflag: Fehler aus Diagnose Kraftstoffvers.-System (Kurztest Bank 2)" UWORD B_TRUE 1 100 0 1 BIT_MASK 0x1 FORMAT "%13.11" ECU_ADDRESS 0x383936 /end MEASUREMENT
/begin MEASUREMENT E_fst "Errorflag: Tankfüllstand" UWORD B_TRUE 1 100 0 1 BIT_MASK 0x1 FORMAT "%13.11" ECU_ADDRESS 0x383938 /end MEASUREMENT
/begin MEASUREMENT E_glor "Errorflag: Getriebe Low Range" UWORD B_TRUE 1 100 0 1 BIT_MASK 0x1 FORMAT "%13.11" ECU_ADDRESS 0x38393A /end MEASUREMENT
/begin MEASUREMENT E_hsh "Errorflag: Lambdasonden-Heizung hinter Katalysator" UWORD B_TRUE 1 100 0 1 BIT_MASK 0x1 FORMAT "%13.11" ECU_ADDRESS 0x38393C /end MEASUREMENT
/begin MEASUREMENT E_hsh2 "Errorflag: Lambdasonden-Heizung hinter Katalysator Bank 2" UWORD B_TRUE 1 100 0 1 BIT_MASK 0x1 FORMAT "%13.11" ECU_ADDRESS 0x38393E /end MEASUREMENT
/begin MEASUREMENT E_hsv "Errorflag: Lambdasonden-Heizung vor Katalysator" UWORD B_TRUE 1 100 0 1 BIT_MASK 0x1 FORMAT "%13.11" ECU_ADDRESS 0x383940 /end MEASUREMENT
/begin MEASUREMENT E_hsv2 "Errorflag: Lambdasonden-Heizung vor Katalysator Bank 2" UWORD B_TRUE 1 100 0 1 BIT_MASK 0x1 FORMAT "%13.11" ECU_ADDRESS 0x383942 /end MEASUREMENT
/begin MEASUREMENT E_kat "Errorflag: Katalysator-Konvertierung" UWORD B_TRUE 1 100 0 1 BIT_MASK 0x1 FORMAT "%13.11" ECU_ADDRESS 0x383944 /end MEASUREMENT
/begin MEASUREMENT E_kat2 "Errorflag: Katalysator-Konvertierung	(Bank 2)" UWORD B_TRUE 1 100 0 1 BIT_MASK 0x1 FORMAT "%13.11" ECU_ADDRESS 0x383946 /end MEASUREMENT
/begin MEASUREMENT E_kkue "Errorflag: Kraftstoffkreislauf-Umschaltung Endstufe" UWORD B_TRUE 1 100 0 1 BIT_MASK 0x1 FORMAT "%13.11" ECU_ADDRESS 0x383948 /end MEASUREMENT
/begin MEASUREMENT E_kos "Errorflag: Klimakompressorsteuerung" UWORD B_TRUE 1 100 0 1 BIT_MASK 0x1 FORMAT "%13.11" ECU_ADDRESS 0x38394A /end MEASUREMENT
/begin MEASUREMENT E_kpe "Errorflag: EKP-Relais Endstufe" UWORD B_TRUE 1 100 0 1 BIT_MASK 0x1 FORMAT "%13.11" ECU_ADDRESS 0x38394C /end MEASUREMENT
/begin MEASUREMENT E_krnt "Errorflag: Klopfregelung Nulltest" UWORD B_TRUE 1 100 0 1 BIT_MASK 0x1 FORMAT "%13.11" ECU_ADDRESS 0x38394E /end MEASUREMENT
/begin MEASUREMENT E_krof "Errorflag: Klopfregelung Offset" UWORD B_TRUE 1 100 0 1 BIT_MASK 0x1 FORMAT "%13.11" ECU_ADDRESS 0x383950 /end MEASUREMENT
/begin MEASUREMENT E_krtp "Errorflag: Klopfregelung Testimpuls" UWORD B_TRUE 1 100 0 1 BIT_MASK 0x1 FORMAT "%13.11" ECU_ADDRESS 0x383952 /end MEASUREMENT
/begin MEASUREMENT E_ks1 "Errorflag: Klopfsensor 1" UWORD B_TRUE 1 100 0 1 BIT_MASK 0x1 FORMAT "%13.11" ECU_ADDRESS 0x383954 /end MEASUREMENT
/begin MEASUREMENT E_ks2 "Errorflag: Klopfsensor 2" UWORD B_TRUE 1 100 0 1 BIT_MASK 0x1 FORMAT "%13.11" ECU_ADDRESS 0x383956 /end MEASUREMENT
/begin MEASUREMENT E_ks3 "Errorflag: Klopfsensor 3" UWORD B_TRUE 1 100 0 1 BIT_MASK 0x1 FORMAT "%13.11" ECU_ADDRESS 0x383958 /end MEASUREMENT
/begin MEASUREMENT E_ks4 "Errorflag: Klopfsensor 4" UWORD B_TRUE 1 100 0 1 BIT_MASK 0x1 FORMAT "%13.11" ECU_ADDRESS 0x38395A /end MEASUREMENT
/begin MEASUREMENT E_kuppl "Fehlerflag: Gebergröße Kupplung" UWORD B_TRUE 1 100 0 1 BIT_MASK 0x1 FORMAT "%13.11" ECU_ADDRESS 0x38395C /end MEASUREMENT
/begin MEASUREMENT E_lde "Errorflag: Ladedrucksteuerventil (Endstufe)" UWORD B_TRUE 1 100 0 1 BIT_MASK 0x1 FORMAT "%13.11" ECU_ADDRESS 0x38396A /end MEASUREMENT
/begin MEASUREMENT E_ldp "Errorflag: Leckdiagnosemodul" UWORD B_TRUE 1 100 0 1 BIT_MASK 0x1 FORMAT "%13.11" ECU_ADDRESS 0x38396C /end MEASUREMENT
/begin MEASUREMENT E_ldpe "Errorflag: Leckdiagnosepumpe Endstufe" UWORD B_TRUE 1 100 0 1 BIT_MASK 0x1 FORMAT "%13.11" ECU_ADDRESS 0x38396E /end MEASUREMENT
/begin MEASUREMENT E_lm "Errorflag: Hauptlastsensor" UWORD B_TRUE 1 100 0 1 BIT_MASK 0x1 FORMAT "%13.11" ECU_ADDRESS 0x383972 /end MEASUREMENT
/begin MEASUREMENT E_luea "Errorflag: Lüfterendstufe A" UWORD B_TRUE 1 100 0 1 BIT_MASK 0x1 FORMAT "%13.11" ECU_ADDRESS 0x38397E /end MEASUREMENT
/begin MEASUREMENT E_mile "Fehlerflag: MIL-Endstufe" UWORD B_TRUE 1 100 0 1 BIT_MASK 0x1 FORMAT "%13.11" ECU_ADDRESS 0x383996 /end MEASUREMENT
/begin MEASUREMENT E_n "Errorflag: Drehzahlsignalgeber" UWORD B_TRUE 1 100 0 1 BIT_MASK 0x1 FORMAT "%13.11" ECU_ADDRESS 0x383998 /end MEASUREMENT
/begin MEASUREMENT E_nwse "Errorflag: Nockenwellensteuerungsventil Endstufe" UWORD B_TRUE 1 100 0 1 BIT_MASK 0x1 FORMAT "%13.11" ECU_ADDRESS 0x38399E /end MEASUREMENT
/begin MEASUREMENT E_nwse2 "Errorflag: Nockenwellensteuerungsventil Endstufe (Bank 2)" UWORD B_TRUE 1 100 0 1 BIT_MASK 0x1 FORMAT "%13.11" ECU_ADDRESS 0x3839A0 /end MEASUREMENT
/begin MEASUREMENT E_rkat "Errorflag DKVS (additive Korrektur pro Zeit)" UWORD B_TRUE 1 100 0 1 BIT_MASK 0x1 FORMAT "%13.11" ECU_ADDRESS 0x3839A6 /end MEASUREMENT
/begin MEASUREMENT E_rkat2 "Errorflag DKVS (additive Korrektur pro Zeit Bank 2)" UWORD B_TRUE 1 100 0 1 BIT_MASK 0x1 FORMAT "%13.11" ECU_ADDRESS 0x3839A8 /end MEASUREMENT
/begin MEASUREMENT E_rkaz "Errorflag DKVS (additive Korrektur pro Zündung)" UWORD B_TRUE 1 100 0 1 BIT_MASK 0x1 FORMAT "%13.11" ECU_ADDRESS 0x3839AA /end MEASUREMENT
/begin MEASUREMENT E_rkaz2 "Errorflag DKVS (additive Korrektur pro Zündung Bank 2)" UWORD B_TRUE 1 100 0 1 BIT_MASK 0x1 FORMAT "%13.11" ECU_ADDRESS 0x3839AC /end MEASUREMENT
/begin MEASUREMENT E_slpe "Errorflag: Sekundärluftpumpe (Endstufe)" UWORD B_TRUE 1 100 0 1 BIT_MASK 0x1 FORMAT "%13.11" ECU_ADDRESS 0x3839AE /end MEASUREMENT
/begin MEASUREMENT E_slve "Errorflag: Sekundärluftventil (Endstufe)" UWORD B_TRUE 1 100 0 1 BIT_MASK 0x1 FORMAT "%13.11" ECU_ADDRESS 0x3839B8 /end MEASUREMENT
/begin MEASUREMENT E_stae "Errorflag: Startautomatik" UWORD B_TRUE 1 100 0 1 BIT_MASK 0x1 FORMAT "%13.11" ECU_ADDRESS 0x3839BC /end MEASUREMENT
/begin MEASUREMENT E_tesb "Errorrflag: Tankentlüftung verstopfte Leitung" UWORD B_TRUE 1 100 0 1 BIT_MASK 0x1 FORMAT "%13.11" ECU_ADDRESS 0x3839C6 /end MEASUREMENT
/begin MEASUREMENT E_tesk "Errorflag: Tankentlüftungssystem Kleinstleck" UWORD B_TRUE 1 100 0 1 BIT_MASK 0x1 FORMAT "%13.11" ECU_ADDRESS 0x3839CA /end MEASUREMENT
/begin MEASUREMENT E_teve "Errorflag: Tankentlüftungsventil Endstufe" UWORD B_TRUE 1 100 0 1 BIT_MASK 0x1 FORMAT "%13.11" ECU_ADDRESS 0x3839CC /end MEASUREMENT
/begin MEASUREMENT sfpaaa "Status Fehlerpfad: Tabellenanfang" UWORD dez 1 100 0 65535 FORMAT "%8.2" ECU_ADDRESS 0x3838C8 /end MEASUREMENT
/begin MEASUREMENT sfpanske "Status Fehlerpfad: Diagnose Ansaugklappe Endstufe" UWORD default 1 100 0 65535 FORMAT "%8.2" ECU_ADDRESS 0x3838D2 /end MEASUREMENT
/begin MEASUREMENT sfpbm "Status Fehlerpfad: Bezugsmarkengeber" UWORD dez 1 100 0 65535 FORMAT "%8.2" ECU_ADDRESS 0x3838D6 /end MEASUREMENT
/begin MEASUREMENT sfpdhdmte "Status Fehlerpfad ES-Diagnose DMTL-Heizung" UWORD default 1 100 0 65535 FORMAT "%8.2" ECU_ADDRESS 0x3838E6 /end MEASUREMENT
/begin MEASUREMENT sfpdmmve "Status Fehlerpfad ES-Diagnose DMTL-Ventil" UWORD default 1 100 0 65535 FORMAT "%8.2" ECU_ADDRESS 0x3838EE /end MEASUREMENT
/begin MEASUREMENT sfpdmpme "Status Fehlerpfad ES-Diagnose DMTL-Pumpenmotor" UWORD default 1 100 0 65535 FORMAT "%8.2" ECU_ADDRESS 0x3838F0 /end MEASUREMENT
/begin MEASUREMENT sfpdmtk "" UWORD default 1 100 0 65535 FORMAT "%8.2" ECU_ADDRESS 0x3838F2 /end MEASUREMENT
/begin MEASUREMENT sfpdmtknm "" UWORD default 1 100 0 65535 FORMAT "%8.2" ECU_ADDRESS 0x3838F4 /end MEASUREMENT
/begin MEASUREMENT sfpdmtl "Status Fehlerpfad: Modul DM-TL" UWORD default 1 100 0 65535 FORMAT "%8.2" ECU_ADDRESS 0x3838F6 /end MEASUREMENT
/begin MEASUREMENT sfpdpmee "Status Fehlerpfad ES-Diagnose DMTL Pumpe" UWORD default 1 100 0 65535 FORMAT "%8.2" ECU_ADDRESS 0x3838F8 /end MEASUREMENT
/begin MEASUREMENT sfpets "Status Fehlerpfad: Diagnose el.Thermostat-Endstufe" UWORD default 1 100 0 65535 FORMAT "%8.2" ECU_ADDRESS 0x383914 /end MEASUREMENT
/begin MEASUREMENT sfpev1 "Status Fehlerpfad: EV1" UWORD default 1 100 0 65535 FORMAT "%8.2" ECU_ADDRESS 0x383916 /end MEASUREMENT
/begin MEASUREMENT sfpev2 "Status Fehlerpfad: EV2" UWORD default 1 100 0 65535 FORMAT "%8.2" ECU_ADDRESS 0x383918 /end MEASUREMENT
/begin MEASUREMENT sfpev3 "Status Fehlerpfad: EV3" UWORD default 1 100 0 65535 FORMAT "%8.2" ECU_ADDRESS 0x38391A /end MEASUREMENT
/begin MEASUREMENT sfpev4 "Status Fehlerpfad: EV4" UWORD default 1 100 0 65535 FORMAT "%8.2" ECU_ADDRESS 0x38391C /end MEASUREMENT
/begin MEASUREMENT sfpev5 "Status Fehlerpfad: EV5" UWORD default 1 100 0 65535 FORMAT "%8.2" ECU_ADDRESS 0x38391E /end MEASUREMENT
/begin MEASUREMENT sfpev6 "Status Fehlerpfad: EV6" UWORD default 1 100 0 65535 FORMAT "%8.2" ECU_ADDRESS 0x383920 /end MEASUREMENT
/begin MEASUREMENT sfpev7 "Status Fehlerpfad: EV7" UWORD default 1 100 0 65535 FORMAT "%8.2" ECU_ADDRESS 0x383922 /end MEASUREMENT
/begin MEASUREMENT sfpev8 "Status Fehlerpfad: EV8" UWORD default 1 100 0 65535 FORMAT "%8.2" ECU_ADDRESS 0x383924 /end MEASUREMENT
/begin MEASUREMENT sfpfrao "Status Fehlerpfad: LR-Adaption oberer multiplikativer Bereich" UWORD dez 1 100 0 65535 FORMAT "%8.2" ECU_ADDRESS 0x38392C /end MEASUREMENT
/begin MEASUREMENT sfpfrao2 "Status Fehlerpfad: LR Adaption oberer multiplikativer Bereich (Bank2)" UWORD dez 1 100 0 65535 FORMAT "%8.2" ECU_ADDRESS 0x38392E /end MEASUREMENT
/begin MEASUREMENT sfpfrau "Status Fehlerpfad: LR Adaption unterer multiplikativer Bereich" UWORD dez 1 100 0 65535 FORMAT "%8.2" ECU_ADDRESS 0x383930 /end MEASUREMENT
/begin MEASUREMENT sfpfrau2 "Status Fehlerpfad: LR Adaption unterer multiplikativer Bereich (Bank2)" UWORD dez 1 100 0 65535 FORMAT "%8.2" ECU_ADDRESS 0x383932 /end MEASUREMENT
/begin MEASUREMENT sfpfrst "Status Fehlerpfad: LR-Abweichung" UWORD dez 1 100 0 65535 FORMAT "%8.2" ECU_ADDRESS 0x383934 /end MEASUREMENT
/begin MEASUREMENT sfpfrst2 "Status Fehlerpfad: LR-Abweichung Bank 2" UWORD dez 1 100 0 65535 FORMAT "%8.2" ECU_ADDRESS 0x383936 /end MEASUREMENT
/begin MEASUREMENT sfpfst "Status Fehlerpfad: Tankfüllstandssensor" UWORD default 1 100 0 65535 FORMAT "%8.2" ECU_ADDRESS 0x383938 /end MEASUREMENT
/begin MEASUREMENT sfpglor "" UWORD default 1 100 0 65535 FORMAT "%8.2" ECU_ADDRESS 0x38393A /end MEASUREMENT
/begin MEASUREMENT sfphsh "Status Fehlerpfad: Heizung Lambdasonde hinter Kat" UWORD dez 1 100 0 65535 FORMAT "%8.2" ECU_ADDRESS 0x38393C /end MEASUREMENT
/begin MEASUREMENT sfphsh2 "Status Fehlerpfad: Heizung Lambdasonde 2 hinter Kat" UWORD dez 1 100 0 65535 FORMAT "%8.2" ECU_ADDRESS 0x38393E /end MEASUREMENT
/begin MEASUREMENT sfphsv "Status Fehlerpfad: Heizung Lambdasonde vor Kat" UWORD dez 1 100 0 65535 FORMAT "%8.2" ECU_ADDRESS 0x383940 /end MEASUREMENT
/begin MEASUREMENT sfphsv2 "Status Fehlerpfad: Heizung Lambdasonde 2 vor Kat" UWORD dez 1 100 0 65535 FORMAT "%8.2" ECU_ADDRESS 0x383942 /end MEASUREMENT
/begin MEASUREMENT sfpkat "Status Fehlerpfad: Katalysator-Überwachung" UWORD dez 1 100 0 65535 FORMAT "%8.2" ECU_ADDRESS 0x383944 /end MEASUREMENT
/begin MEASUREMENT sfpkat2 "Status Fehlerpfad: Katalysator-Überwachung Bank 2" UWORD dez 1 100 0 65535 FORMAT "%8.2" ECU_ADDRESS 0x383946 /end MEASUREMENT
/begin MEASUREMENT sfpkkue "" UWORD default 1 100 0 65535 FORMAT "%8.2" ECU_ADDRESS 0x383948 /end MEASUREMENT
/begin MEASUREMENT sfpkos "Status Fehlerpfad: Klimakompressorsteuerung" UWORD default 1 100 0 65535 FORMAT "%8.2" ECU_ADDRESS 0x38394A /end MEASUREMENT
/begin MEASUREMENT sfpkpe "Status Fehlerpfad: EKP-Relais Endstufe" UWORD default 1 100 0 65535 FORMAT "%8.2" ECU_ADDRESS 0x38394C /end MEASUREMENT
/begin MEASUREMENT sfpkrnt "Status Fehlerpfad: Klopfregelung Nulltest" UWORD dez 1 100 0 65535 FORMAT "%8.2" ECU_ADDRESS 0x38394E /end MEASUREMENT
/begin MEASUREMENT sfpkrof "Status Fehlerpfad: Klopfregelung Offset" UWORD dez 1 100 0 65535 FORMAT "%8.2" ECU_ADDRESS 0x383950 /end MEASUREMENT
/begin MEASUREMENT sfpkrtp "Status Fehlerpfad: Klopfregelung Testimpuls" UWORD dez 1 100 0 65535 FORMAT "%8.2" ECU_ADDRESS 0x383952 /end MEASUREMENT
/begin MEASUREMENT sfpks1 "Status Fehlerpfad: Klopfsensor 1" UWORD dez 1 100 0 65535 FORMAT "%8.2" ECU_ADDRESS 0x383954 /end MEASUREMENT
/begin MEASUREMENT sfpks2 "Status Fehlerpfad: Klopfsensor 2" UWORD dez 1 100 0 65535 FORMAT "%8.2" ECU_ADDRESS 0x383956 /end MEASUREMENT
/begin MEASUREMENT sfpks3 "Status Fehlerpfad: Klopfsensor 3" UWORD dez 1 100 0 65535 FORMAT "%8.2" ECU_ADDRESS 0x383958 /end MEASUREMENT
/begin MEASUREMENT sfpks4 "Status Fehlerpfad: Klopfsensor 4" UWORD dez 1 100 0 65535 FORMAT "%8.2" ECU_ADDRESS 0x38395A /end MEASUREMENT
/begin MEASUREMENT sfpkuppl "Status Fehlerpfad KUPPL: Gebergröße Kupplung" UWORD dez 1 100 0 65535 FORMAT "%8.2" ECU_ADDRESS 0x38395C /end MEASUREMENT
/begin MEASUREMENT sfplde "Status Fehlerpfad: Ladedrucksteuerventil Endstufe" UWORD default 1 100 0 65535 FORMAT "%8.2" ECU_ADDRESS 0x38396A /end MEASUREMENT
/begin MEASUREMENT sfpldp "Status Fehlerpfad:Leckdiagnosemodul" UWORD dez 1 100 0 65535 FORMAT "%8.2" ECU_ADDRESS 0x38396C /end MEASUREMENT
/begin MEASUREMENT sfpldpe "Status Fehlerpfad: Leckdiagnosepumpe - Endstufe" UWORD default 1 100 0 65535 FORMAT "%8.2" ECU_ADDRESS 0x38396E /end MEASUREMENT
/begin MEASUREMENT sfplm "Status Fehlerpfad: Hauptfüllungssensor" UWORD dez 1 100 0 65535 FORMAT "%8.2" ECU_ADDRESS 0x383972 /end MEASUREMENT
/begin MEASUREMENT sfpluea "Status Fehlerpfad: Endstufe Motor Lüfter A" UWORD default 1 100 0 65535 FORMAT "%8.2" ECU_ADDRESS 0x38397E /end MEASUREMENT
/begin MEASUREMENT sfpmile "Status Fehlerpfad: Mil - Endstufe" UWORD default 1 100 0 65535 FORMAT "%8.2" ECU_ADDRESS 0x383996 /end MEASUREMENT
/begin MEASUREMENT sfpn "Status Fehlerpfad: Drehzahlgeber" UWORD dez 1 100 0 65535 FORMAT "%8.2" ECU_ADDRESS 0x383998 /end MEASUREMENT
/begin MEASUREMENT sfpnwse "Status Fehlerpfad: Nockenwellensteuerungsventil Endstufe" UWORD default 1 100 0 65535 FORMAT "%8.2" ECU_ADDRESS 0x38399E /end MEASUREMENT
/begin MEASUREMENT sfpnwse2 "Status Fehlerpfad: Nockenwellensteuerung Bank2 Endstufe" UWORD default 1 100 0 65535 FORMAT "%8.2" ECU_ADDRESS 0x3839A0 /end MEASUREMENT
/begin MEASUREMENT sfprkat "Status Fehlerpfad: LR Adaption additive Korrektur pro Zeit" UWORD dez 1 100 0 65535 FORMAT "%8.2" ECU_ADDRESS 0x3839A6 /end MEASUREMENT
/begin MEASUREMENT sfprkat2 "Status Fehlerpfad: LR Adaption additive Korrektur pro Zeit (Bank 2)" UWORD dez 1 100 0 65535 FORMAT "%8.2" ECU_ADDRESS 0x3839A8 /end MEASUREMENT
/begin MEASUREMENT sfprkaz "Status Fehlerpfad: LR Adaption additive Korrektur pro Zündung" UWORD dez 1 100 0 65535 FORMAT "%8.2" ECU_ADDRESS 0x3839AA /end MEASUREMENT
/begin MEASUREMENT sfprkaz2 "Status Fehlerpfad: LR Adaption additive Korrektur pro Zündung (Bank 2)" UWORD dez 1 100 0 65535 FORMAT "%8.2" ECU_ADDRESS 0x3839AC /end MEASUREMENT
/begin MEASUREMENT sfpslpe "Status Fehlerpfad: Sekundärluftpumpe Endstufe" UWORD default 1 100 0 65535 FORMAT "%8.2" ECU_ADDRESS 0x3839AE /end MEASUREMENT
/begin MEASUREMENT sfpslve "Status Fehlerpfad: Sekundärluftventil Endstufe" UWORD default 1 100 0 65535 FORMAT "%8.2" ECU_ADDRESS 0x3839B8 /end MEASUREMENT
/begin MEASUREMENT sfpstae "Status Fehlerpfad: Starter Endstufe" UWORD default 1 100 0 65535 FORMAT "%8.2" ECU_ADDRESS 0x3839BC /end MEASUREMENT
/begin MEASUREMENT sfptesb "" UWORD dez 1 100 0 65535 FORMAT "%8.2" ECU_ADDRESS 0x3839C6 /end MEASUREMENT
/begin MEASUREMENT sfptesk "Status Fehlerpfad: Tankdiagnose, Kleinstleck" UWORD dez 1 100 0 65535 FORMAT "%8.2" ECU_ADDRESS 0x3839CA /end MEASUREMENT
/begin MEASUREMENT sfpteve "Status Fehlerpfad: Tanklüftungsventil Endstufe" UWORD default 1 100 0 65535 FORMAT "%8.2" ECU_ADDRESS 0x3839CC /end MEASUREMENT
/begin MEASUREMENT sfpzzz "Dummy: Tabellenende" UWORD dez 1 100 0 65535 FORMAT "%8.2" ECU_ADDRESS 0x3839EC /end MEASUREMENT
/begin MEASUREMENT TYP_anske "" UWORD B_TRUE 1 100 0 1 BIT_MASK 0xf00 FORMAT "%13.11" ECU_ADDRESS 0x3838D2 /end MEASUREMENT
/begin MEASUREMENT TYP_bm "" UWORD B_TRUE 1 100 0 1 BIT_MASK 0xf00 FORMAT "%13.11" ECU_ADDRESS 0x3838D6 /end MEASUREMENT
/begin MEASUREMENT TYP_dhdmte "" UWORD B_TRUE 1 100 0 1 BIT_MASK 0xf00 FORMAT "%13.11" ECU_ADDRESS 0x3838E6 /end MEASUREMENT
/begin MEASUREMENT TYP_DMMVE "" UWORD B_TRUE 1 100 0 1 BIT_MASK 0xf00 FORMAT "%13.11" ECU_ADDRESS 0x3838EE /end MEASUREMENT
/begin MEASUREMENT TYP_DMPME "" UWORD B_TRUE 1 100 0 1 BIT_MASK 0xf00 FORMAT "%13.11" ECU_ADDRESS 0x3838F0 /end MEASUREMENT
/begin MEASUREMENT TYP_dmtk "" UWORD B_TRUE 1 100 0 1 BIT_MASK 0xf00 FORMAT "%13.11" ECU_ADDRESS 0x3838F2 /end MEASUREMENT
/begin MEASUREMENT TYP_dmtknm "" UWORD B_TRUE 1 100 0 1 BIT_MASK 0xf00 FORMAT "%13.11" ECU_ADDRESS 0x3838F4 /end MEASUREMENT
/begin MEASUREMENT TYP_dmtl "" UWORD B_TRUE 1 100 0 1 BIT_MASK 0xf00 FORMAT "%13.11" ECU_ADDRESS 0x3838F6 /end MEASUREMENT
/begin MEASUREMENT TYP_DPMEE "" UWORD B_TRUE 1 100 0 1 BIT_MASK 0xf00 FORMAT "%13.11" ECU_ADDRESS 0x3838F8 /end MEASUREMENT
/begin MEASUREMENT TYP_ets "" UWORD B_TRUE 1 100 0 1 BIT_MASK 0xf00 FORMAT "%13.11" ECU_ADDRESS 0x383914 /end MEASUREMENT
/begin MEASUREMENT TYP_ev1 "" UWORD B_TRUE 1 100 0 1 BIT_MASK 0xf00 FORMAT "%13.11" ECU_ADDRESS 0x383916 /end MEASUREMENT
/begin MEASUREMENT TYP_ev2 "" UWORD B_TRUE 1 100 0 1 BIT_MASK 0xf00 FORMAT "%13.11" ECU_ADDRESS 0x383918 /end MEASUREMENT
/begin MEASUREMENT TYP_ev3 "" UWORD B_TRUE 1 100 0 1 BIT_MASK 0xf00 FORMAT "%13.11" ECU_ADDRESS 0x38391A /end MEASUREMENT
/begin MEASUREMENT TYP_ev4 "" UWORD B_TRUE 1 100 0 1 BIT_MASK 0xf00 FORMAT "%13.11" ECU_ADDRESS 0x38391C /end MEASUREMENT
/begin MEASUREMENT TYP_ev5 "" UWORD B_TRUE 1 100 0 1 BIT_MASK 0xf00 FORMAT "%13.11" ECU_ADDRESS 0x38391E /end MEASUREMENT
/begin MEASUREMENT TYP_ev6 "" UWORD B_TRUE 1 100 0 1 BIT_MASK 0xf00 FORMAT "%13.11" ECU_ADDRESS 0x383920 /end MEASUREMENT
/begin MEASUREMENT TYP_ev7 "" UWORD B_TRUE 1 100 0 1 BIT_MASK 0xf00 FORMAT "%13.11" ECU_ADDRESS 0x383922 /end MEASUREMENT
/begin MEASUREMENT TYP_ev8 "" UWORD B_TRUE 1 100 0 1 BIT_MASK 0xf00 FORMAT "%13.11" ECU_ADDRESS 0x383924 /end MEASUREMENT
/begin MEASUREMENT TYP_frao "" UWORD B_TRUE 1 100 0 1 BIT_MASK 0xf00 FORMAT "%13.11" ECU_ADDRESS 0x38392C /end MEASUREMENT
/begin MEASUREMENT TYP_frao2 "" UWORD B_TRUE 1 100 0 1 BIT_MASK 0xf00 FORMAT "%13.11" ECU_ADDRESS 0x38392E /end MEASUREMENT
/begin MEASUREMENT TYP_frau "" UWORD B_TRUE 1 100 0 1 BIT_MASK 0xf00 FORMAT "%13.11" ECU_ADDRESS 0x383930 /end MEASUREMENT
/begin MEASUREMENT TYP_frau2 "" UWORD B_TRUE 1 100 0 1 BIT_MASK 0xf00 FORMAT "%13.11" ECU_ADDRESS 0x383932 /end MEASUREMENT
/begin MEASUREMENT TYP_frst "" UWORD B_TRUE 1 100 0 1 BIT_MASK 0xf00 FORMAT "%13.11" ECU_ADDRESS 0x383934 /end MEASUREMENT
/begin MEASUREMENT TYP_frst2 "" UWORD B_TRUE 1 100 0 1 BIT_MASK 0xf00 FORMAT "%13.11" ECU_ADDRESS 0x383936 /end MEASUREMENT
/begin MEASUREMENT TYP_fst "" UWORD B_TRUE 1 100 0 1 BIT_MASK 0xf00 FORMAT "%13.11" ECU_ADDRESS 0x383938 /end MEASUREMENT
/begin MEASUREMENT TYP_glor "" UWORD B_TRUE 1 100 0 1 BIT_MASK 0xf00 FORMAT "%13.11" ECU_ADDRESS 0x38393A /end MEASUREMENT
/begin MEASUREMENT TYP_hsh "Fehlertyp: Heizung Lambdasonde 1 hinter Kat" UWORD B_TRUE 1 100 0 1 BIT_MASK 0xf00 FORMAT "%13.11" ECU_ADDRESS 0x38393C /end MEASUREMENT
/begin MEASUREMENT TYP_hsh2 "Fehlertyp: Heizung Lambdasonde 2 hinter Kat" UWORD B_TRUE 1 100 0 1 BIT_MASK 0xf00 FORMAT "%13.11" ECU_ADDRESS 0x38393E /end MEASUREMENT
/begin MEASUREMENT TYP_hsv "Fehlertyp: Heizung Lambdasonde 1 vor Kat" UWORD B_TRUE 1 100 0 1 BIT_MASK 0xf00 FORMAT "%13.11" ECU_ADDRESS 0x383940 /end MEASUREMENT
/begin MEASUREMENT TYP_hsv2 "Fehlertyp: Heizung Lambdasonde 2 vor Kat" UWORD B_TRUE 1 100 0 1 BIT_MASK 0xf00 FORMAT "%13.11" ECU_ADDRESS 0x383942 /end MEASUREMENT
/begin MEASUREMENT TYP_kat "Fehlertyp: Katalysator-Diagnose" UWORD B_TRUE 1 100 0 1 BIT_MASK 0xf00 FORMAT "%13.11" ECU_ADDRESS 0x383944 /end MEASUREMENT
/begin MEASUREMENT TYP_kat2 "" UWORD B_TRUE 1 100 0 1 BIT_MASK 0xf00 FORMAT "%13.11" ECU_ADDRESS 0x383946 /end MEASUREMENT
/begin MEASUREMENT TYP_kkue "" UWORD B_TRUE 1 100 0 1 BIT_MASK 0xf00 FORMAT "%13.11" ECU_ADDRESS 0x383948 /end MEASUREMENT
/begin MEASUREMENT TYP_kos "" UWORD B_TRUE 1 100 0 1 BIT_MASK 0xf00 FORMAT "%13.11" ECU_ADDRESS 0x38394A /end MEASUREMENT
/begin MEASUREMENT TYP_kpe "Fehlertyp: EKP-Relais Endstufe" UWORD B_TRUE 1 100 0 1 BIT_MASK 0xf00 FORMAT "%13.11" ECU_ADDRESS 0x38394C /end MEASUREMENT
/begin MEASUREMENT TYP_krnt "" UWORD B_TRUE 1 100 0 1 BIT_MASK 0xf00 FORMAT "%13.11" ECU_ADDRESS 0x38394E /end MEASUREMENT
/begin MEASUREMENT TYP_krof "" UWORD B_TRUE 1 100 0 1 BIT_MASK 0xf00 FORMAT "%13.11" ECU_ADDRESS 0x383950 /end MEASUREMENT
/begin MEASUREMENT TYP_krtp "" UWORD B_TRUE 1 100 0 1 BIT_MASK 0xf00 FORMAT "%13.11" ECU_ADDRESS 0x383952 /end MEASUREMENT
/begin MEASUREMENT TYP_ks1 "" UWORD B_TRUE 1 100 0 1 BIT_MASK 0xf00 FORMAT "%13.11" ECU_ADDRESS 0x383954 /end MEASUREMENT
/begin MEASUREMENT TYP_ks2 "" UWORD B_TRUE 1 100 0 1 BIT_MASK 0xf00 FORMAT "%13.11" ECU_ADDRESS 0x383956 /end MEASUREMENT
/begin MEASUREMENT TYP_ks3 "" UWORD B_TRUE 1 100 0 1 BIT_MASK 0xf00 FORMAT "%13.11" ECU_ADDRESS 0x383958 /end MEASUREMENT
/begin MEASUREMENT TYP_ks4 "" UWORD B_TRUE 1 100 0 1 BIT_MASK 0xf00 FORMAT "%13.11" ECU_ADDRESS 0x38395A /end MEASUREMENT
/begin MEASUREMENT TYP_kuppl "Fehlertyp: Gebergröße Kupplungsschalter" UWORD B_TRUE 1 100 0 1 BIT_MASK 0xf00 FORMAT "%13.11" ECU_ADDRESS 0x38395C /end MEASUREMENT
/begin MEASUREMENT TYP_lde "" UWORD B_TRUE 1 100 0 1 BIT_MASK 0xf00 FORMAT "%13.11" ECU_ADDRESS 0x38396A /end MEASUREMENT
/begin MEASUREMENT TYP_ldp "" UWORD B_TRUE 1 100 0 1 BIT_MASK 0xf00 FORMAT "%13.11" ECU_ADDRESS 0x38396C /end MEASUREMENT
/begin MEASUREMENT TYP_ldpe "" UWORD B_TRUE 1 100 0 1 BIT_MASK 0xf00 FORMAT "%13.11" ECU_ADDRESS 0x38396E /end MEASUREMENT
/begin MEASUREMENT TYP_lm "" UWORD B_TRUE 1 100 0 1 BIT_MASK 0xf00 FORMAT "%13.11" ECU_ADDRESS 0x383972 /end MEASUREMENT
/begin MEASUREMENT TYP_luea "" UWORD B_TRUE 1 100 0 1 BIT_MASK 0xf00 FORMAT "%13.11" ECU_ADDRESS 0x38397E /end MEASUREMENT
/begin MEASUREMENT TYP_mile "" UWORD B_TRUE 1 100 0 1 BIT_MASK 0xf00 FORMAT "%13.11" ECU_ADDRESS 0x383996 /end MEASUREMENT
/begin MEASUREMENT TYP_n "" UWORD B_TRUE 1 100 0 1 BIT_MASK 0xf00 FORMAT "%13.11" ECU_ADDRESS 0x383998 /end MEASUREMENT
/begin MEASUREMENT TYP_nwse "" UWORD B_TRUE 1 100 0 1 BIT_MASK 0xf00 FORMAT "%13.11" ECU_ADDRESS 0x38399E /end MEASUREMENT
/begin MEASUREMENT TYP_nwse2 "" UWORD B_TRUE 1 100 0 1 BIT_MASK 0xf00 FORMAT "%13.11" ECU_ADDRESS 0x3839A0 /end MEASUREMENT
/begin MEASUREMENT TYP_rkat "" UWORD B_TRUE 1 100 0 1 BIT_MASK 0xf00 FORMAT "%13.11" ECU_ADDRESS 0x3839A6 /end MEASUREMENT
/begin MEASUREMENT TYP_rkat2 "" UWORD B_TRUE 1 100 0 1 BIT_MASK 0xf00 FORMAT "%13.11" ECU_ADDRESS 0x3839A8 /end MEASUREMENT
/begin MEASUREMENT TYP_rkaz "" UWORD B_TRUE 1 100 0 1 BIT_MASK 0xf00 FORMAT "%13.11" ECU_ADDRESS 0x3839AA /end MEASUREMENT
/begin MEASUREMENT TYP_rkaz2 "" UWORD B_TRUE 1 100 0 1 BIT_MASK 0xf00 FORMAT "%13.11" ECU_ADDRESS 0x3839AC /end MEASUREMENT
/begin MEASUREMENT TYP_slpe "" UWORD B_TRUE 1 100 0 1 BIT_MASK 0xf00 FORMAT "%13.11" ECU_ADDRESS 0x3839AE /end MEASUREMENT
/begin MEASUREMENT TYP_slve "" UWORD B_TRUE 1 100 0 1 BIT_MASK 0xf00 FORMAT "%13.11" ECU_ADDRESS 0x3839B8 /end MEASUREMENT
/begin MEASUREMENT TYP_stae "" UWORD B_TRUE 1 100 0 1 BIT_MASK 0xf00 FORMAT "%13.11" ECU_ADDRESS 0x3839BC /end MEASUREMENT
/begin MEASUREMENT TYP_tesb "" UWORD B_TRUE 1 100 0 1 BIT_MASK 0xf00 FORMAT "%13.11" ECU_ADDRESS 0x3839C6 /end MEASUREMENT
/begin MEASUREMENT TYP_tesk "Fehlertyp: Tankdiagnose, Kleinstleck" UWORD B_TRUE 1 100 0 1 BIT_MASK 0xf00 FORMAT "%13.11" ECU_ADDRESS 0x3839CA /end MEASUREMENT
/begin MEASUREMENT TYP_teve "" UWORD B_TRUE 1 100 0 1 BIT_MASK 0xf00 FORMAT "%13.11" ECU_ADDRESS 0x3839CC /end MEASUREMENT
/begin MEASUREMENT Z_anske "Zyklusflag: Ansaugklappe, Endstufe" UWORD B_TRUE 1 100 0 1 BIT_MASK 0x2 FORMAT "%13.11" ECU_ADDRESS 0x3838D2 /end MEASUREMENT
/begin MEASUREMENT Z_bm "Zyklusflag: Bezugsmarkengeber" UWORD B_TRUE 1 100 0 1 BIT_MASK 0x2 FORMAT "%13.11" ECU_ADDRESS 0x3838D6 /end MEASUREMENT
/begin MEASUREMENT Z_dhdmte "Zyklusflag: DM-TL Heizung (Endstufe)" UWORD B_TRUE 1 100 0 1 BIT_MASK 0x2 FORMAT "%13.11" ECU_ADDRESS 0x3838E6 /end MEASUREMENT
/begin MEASUREMENT Z_dmmve "Zyklusflag: DM-TL Magnetventil (Endstufe)" UWORD B_TRUE 1 100 0 1 BIT_MASK 0x2 FORMAT "%13.11" ECU_ADDRESS 0x3838EE /end MEASUREMENT
/begin MEASUREMENT Z_dmpme "Zyklusflag: DM-TL Pumpenmotor (Endstufe)" UWORD B_TRUE 1 100 0 1 BIT_MASK 0x2 FORMAT "%13.11" ECU_ADDRESS 0x3838F0 /end MEASUREMENT
/begin MEASUREMENT Z_dmtk "Zyklusflag: Tankentlüftungssystem Kleinstleck" UWORD B_TRUE 1 100 0 1 BIT_MASK 0x2 FORMAT "%13.11" ECU_ADDRESS 0x3838F2 /end MEASUREMENT
/begin MEASUREMENT Z_dmtknm "Zyklusflag: Tankentlüftungssystem Kleinstleck (keine MIL on)" UWORD B_TRUE 1 100 0 1 BIT_MASK 0x2 FORMAT "%13.11" ECU_ADDRESS 0x3838F4 /end MEASUREMENT
/begin MEASUREMENT Z_dmtl "Zyklusflag: DMTL-Modul" UWORD B_TRUE 1 100 0 1 BIT_MASK 0x2 FORMAT "%13.11" ECU_ADDRESS 0x3838F6 /end MEASUREMENT
/begin MEASUREMENT Z_dpmee "Zyklusflag: DM-TL Pumpenmotor aus DECJ (Endstufe)" UWORD B_TRUE 1 100 0 1 BIT_MASK 0x2 FORMAT "%13.11" ECU_ADDRESS 0x3838F8 /end MEASUREMENT
/begin MEASUREMENT Z_ets "Zyklusflag: elektronisches Thermostat" UWORD B_TRUE 1 100 0 1 BIT_MASK 0x2 FORMAT "%13.11" ECU_ADDRESS 0x383914 /end MEASUREMENT
/begin MEASUREMENT Z_ev1 "Zyklusflag: EV von Zyl. 1" UWORD B_TRUE 1 100 0 1 BIT_MASK 0x2 FORMAT "%13.11" ECU_ADDRESS 0x383916 /end MEASUREMENT
/begin MEASUREMENT Z_ev2 "Zyklusflag:	EV von Zyl. 2" UWORD B_TRUE 1 100 0 1 BIT_MASK 0x2 FORMAT "%13.11" ECU_ADDRESS 0x383918 /end MEASUREMENT
/begin MEASUREMENT Z_ev3 "Zyklusflag:	EV von Zyl. 3" UWORD B_TRUE 1 100 0 1 BIT_MASK 0x2 FORMAT "%13.11" ECU_ADDRESS 0x38391A /end MEASUREMENT
/begin MEASUREMENT Z_ev4 "Zyklusflag:	EV von Zyl. 4" UWORD B_TRUE 1 100 0 1 BIT_MASK 0x2 FORMAT "%13.11" ECU_ADDRESS 0x38391C /end MEASUREMENT
/begin MEASUREMENT Z_ev5 "Zyklusflag:	EV von Zyl. 5" UWORD B_TRUE 1 100 0 1 BIT_MASK 0x2 FORMAT "%13.11" ECU_ADDRESS 0x38391E /end MEASUREMENT
/begin MEASUREMENT Z_ev6 "Zyklusflag:	EV von Zyl. 6" UWORD B_TRUE 1 100 0 1 BIT_MASK 0x2 FORMAT "%13.11" ECU_ADDRESS 0x383920 /end MEASUREMENT
/begin MEASUREMENT Z_ev7 "Zyklusflag:	EV von Zyl. 7" UWORD B_TRUE 1 100 0 1 BIT_MASK 0x2 FORMAT "%13.11" ECU_ADDRESS 0x383922 /end MEASUREMENT
/begin MEASUREMENT Z_ev8 "Zyklusflag:	EV von Zyl. 8" UWORD B_TRUE 1 100 0 1 BIT_MASK 0x2 FORMAT "%13.11" ECU_ADDRESS 0x383924 /end MEASUREMENT
/begin MEASUREMENT Z_frao "Zyklusflag:LR-Adaption oberer multiplikativer Bereich" UWORD B_TRUE 1 100 0 1 BIT_MASK 0x2 FORMAT "%13.11" ECU_ADDRESS 0x38392C /end MEASUREMENT
/begin MEASUREMENT Z_frao2 "Zyklusflag:LR-Adaption oberer multiplikativer Bereich Bank2" UWORD B_TRUE 1 100 0 1 BIT_MASK 0x2 FORMAT "%13.11" ECU_ADDRESS 0x38392E /end MEASUREMENT
/begin MEASUREMENT Z_frau "Zyklusflag:LR-Adaption unterer multiplikativer Bereich" UWORD B_TRUE 1 100 0 1 BIT_MASK 0x2 FORMAT "%13.11" ECU_ADDRESS 0x383930 /end MEASUREMENT
/begin MEASUREMENT Z_frau2 "Zyklusflag:LR-Adaption unterer multiplikativer Bereich Bank 2" UWORD B_TRUE 1 100 0 1 BIT_MASK 0x2 FORMAT "%13.11" ECU_ADDRESS 0x383932 /end MEASUREMENT
/begin MEASUREMENT Z_frst "Zyklusmeldung Diagnose Kraftstoffversorgungssystem (Kurztest)" UWORD B_TRUE 1 100 0 1 BIT_MASK 0x2 FORMAT "%13.11" ECU_ADDRESS 0x383934 /end MEASUREMENT
/begin MEASUREMENT Z_frst2 "Zyklusmeldung Diagnose Kraftstoffversorgungssystem (Kurztest Bank 2)" UWORD B_TRUE 1 100 0 1 BIT_MASK 0x2 FORMAT "%13.11" ECU_ADDRESS 0x383936 /end MEASUREMENT
/begin MEASUREMENT Z_fst "Zyklusflag: Tankfüllstand" UWORD B_TRUE 1 100 0 1 BIT_MASK 0x2 FORMAT "%13.11" ECU_ADDRESS 0x383938 /end MEASUREMENT
/begin MEASUREMENT Z_glor "Zyklusflag: Getriebe Low Range" UWORD B_TRUE 1 100 0 1 BIT_MASK 0x2 FORMAT "%13.11" ECU_ADDRESS 0x38393A /end MEASUREMENT
/begin MEASUREMENT Z_hsh "Zyklusflag:Lambdasonden-Heizung hinter Katalysator" UWORD B_TRUE 1 100 0 1 BIT_MASK 0x2 FORMAT "%13.11" ECU_ADDRESS 0x38393C /end MEASUREMENT
/begin MEASUREMENT Z_hsh2 "Zyklusflag:Lambdasonden-Heizung hinter Katalysator, Bank2" UWORD B_TRUE 1 100 0 1 BIT_MASK 0x2 FORMAT "%13.11" ECU_ADDRESS 0x38393E /end MEASUREMENT
/begin MEASUREMENT Z_hsv "Zyklusflag:Lambdasonden-Heizung vor Katalysator" UWORD B_TRUE 1 100 0 1 BIT_MASK 0x2 FORMAT "%13.11" ECU_ADDRESS 0x383940 /end MEASUREMENT
/begin MEASUREMENT Z_hsv2 "Zyklusflag:Lambdasonden-Heizung vor Katalysator, Bank2" UWORD B_TRUE 1 100 0 1 BIT_MASK 0x2 FORMAT "%13.11" ECU_ADDRESS 0x383942 /end MEASUREMENT
/begin MEASUREMENT Z_kat "Zyklusflag:	Katalysator-Konvertierung" UWORD B_TRUE 1 100 0 1 BIT_MASK 0x2 FORMAT "%13.11" ECU_ADDRESS 0x383944 /end MEASUREMENT
/begin MEASUREMENT Z_kat2 "Zyklusflag:	Katalysator-Konvertierung	(Bank 2)" UWORD B_TRUE 1 100 0 1 BIT_MASK 0x2 FORMAT "%13.11" ECU_ADDRESS 0x383946 /end MEASUREMENT
/begin MEASUREMENT Z_kkue "Zyklusflag: Kraftstoffkreislauf-Umschaltung Endstufe" UWORD B_TRUE 1 100 0 1 BIT_MASK 0x2 FORMAT "%13.11" ECU_ADDRESS 0x383948 /end MEASUREMENT
/begin MEASUREMENT Z_kos "Zyklusflag:	Klimakompressorsteuerung" UWORD B_TRUE 1 100 0 1 BIT_MASK 0x2 FORMAT "%13.11" ECU_ADDRESS 0x38394A /end MEASUREMENT
/begin MEASUREMENT Z_kpe "Zyklusflag: EKP-Relais Endstufe" UWORD B_TRUE 1 100 0 1 BIT_MASK 0x2 FORMAT "%13.11" ECU_ADDRESS 0x38394C /end MEASUREMENT
/begin MEASUREMENT Z_krnt "Zyklusflag: Klopfregelung Nulltest" UWORD B_TRUE 1 100 0 1 BIT_MASK 0x2 FORMAT "%13.11" ECU_ADDRESS 0x38394E /end MEASUREMENT
/begin MEASUREMENT Z_krof "Zyklusflag: Klopfregelung Offset" UWORD B_TRUE 1 100 0 1 BIT_MASK 0x2 FORMAT "%13.11" ECU_ADDRESS 0x383950 /end MEASUREMENT
/begin MEASUREMENT Z_krtp "Zyklusflag: Klopfregelung Testimpuls" UWORD B_TRUE 1 100 0 1 BIT_MASK 0x2 FORMAT "%13.11" ECU_ADDRESS 0x383952 /end MEASUREMENT
/begin MEASUREMENT Z_ks1 "Zyklusflag: Klopfsensor 1" UWORD B_TRUE 1 100 0 1 BIT_MASK 0x2 FORMAT "%13.11" ECU_ADDRESS 0x383954 /end MEASUREMENT
/begin MEASUREMENT Z_ks2 "Zyklusflag:	Klopfsensor 2" UWORD B_TRUE 1 100 0 1 BIT_MASK 0x2 FORMAT "%13.11" ECU_ADDRESS 0x383956 /end MEASUREMENT
/begin MEASUREMENT Z_ks3 "Zyklusflag:	Klopfsensor 3" UWORD B_TRUE 1 100 0 1 BIT_MASK 0x2 FORMAT "%13.11" ECU_ADDRESS 0x383958 /end MEASUREMENT
/begin MEASUREMENT Z_ks4 "Zyklusflag:	Klopfsensor 4" UWORD B_TRUE 1 100 0 1 BIT_MASK 0x2 FORMAT "%13.11" ECU_ADDRESS 0x38395A /end MEASUREMENT
/begin MEASUREMENT Z_kuppl "Zyklusflag: Kupplung betaetigt" UWORD B_TRUE 1 100 0 1 BIT_MASK 0x2 FORMAT "%13.11" ECU_ADDRESS 0x38395C /end MEASUREMENT
/begin MEASUREMENT Z_lde "Zyklusflag: Ladedrucksteuerventil (Endstufe)" UWORD B_TRUE 1 100 0 1 BIT_MASK 0x2 FORMAT "%13.11" ECU_ADDRESS 0x38396A /end MEASUREMENT
/begin MEASUREMENT Z_ldp "Zyklusflag: Leckdiagnosemodul" UWORD B_TRUE 1 100 0 1 BIT_MASK 0x2 FORMAT "%13.11" ECU_ADDRESS 0x38396C /end MEASUREMENT
/begin MEASUREMENT Z_ldpe "Zyklusflag: Leckdiagnosepumpe Endstufe" UWORD B_TRUE 1 100 0 1 BIT_MASK 0x2 FORMAT "%13.11" ECU_ADDRESS 0x38396E /end MEASUREMENT
/begin MEASUREMENT Z_lm "Zyklusflag:	LMM/HLM/HFM" UWORD B_TRUE 1 100 0 1 BIT_MASK 0x2 FORMAT "%13.11" ECU_ADDRESS 0x383972 /end MEASUREMENT
/begin MEASUREMENT Z_luea "Zyklusflag: Lüfterendstufe A" UWORD B_TRUE 1 100 0 1 BIT_MASK 0x2 FORMAT "%13.11" ECU_ADDRESS 0x38397E /end MEASUREMENT
/begin MEASUREMENT Z_mile "Zyklusflag: MIL-Endstufe" UWORD B_TRUE 1 100 0 1 BIT_MASK 0x2 FORMAT "%13.11" ECU_ADDRESS 0x383996 /end MEASUREMENT
/begin MEASUREMENT Z_n "Zyklusflag: Drehzahlsignalgeber" UWORD B_TRUE 1 100 0 1 BIT_MASK 0x2 FORMAT "%13.11" ECU_ADDRESS 0x383998 /end MEASUREMENT
/begin MEASUREMENT Z_nwse "Zyklusflag: Nockenwellensteuerungsventil Endstufe" UWORD B_TRUE 1 100 0 1 BIT_MASK 0x2 FORMAT "%13.11" ECU_ADDRESS 0x38399E /end MEASUREMENT
/begin MEASUREMENT Z_nwse2 "Zyklusflag: Nockenwellensteuerungsventil Endstufe (Bank 2)" UWORD B_TRUE 1 100 0 1 BIT_MASK 0x2 FORMAT "%13.11" ECU_ADDRESS 0x3839A0 /end MEASUREMENT
/begin MEASUREMENT Z_rkat "Zyklusflag:LR-Adaption additiv pro Zeit" UWORD B_TRUE 1 100 0 1 BIT_MASK 0x2 FORMAT "%13.11" ECU_ADDRESS 0x3839A6 /end MEASUREMENT
/begin MEASUREMENT Z_rkat2 "Zyklusflag:LR-Adaption additiv pro Zeit Bank 2" UWORD B_TRUE 1 100 0 1 BIT_MASK 0x2 FORMAT "%13.11" ECU_ADDRESS 0x3839A8 /end MEASUREMENT
/begin MEASUREMENT Z_rkaz "Zyklusflag:LR-Adaption additiv pro Einspritzung" UWORD B_TRUE 1 100 0 1 BIT_MASK 0x2 FORMAT "%13.11" ECU_ADDRESS 0x3839AA /end MEASUREMENT
/begin MEASUREMENT Z_rkaz2 "Zyklusflag:LR-Adaption additiv pro Einspritzung Bank 2" UWORD B_TRUE 1 100 0 1 BIT_MASK 0x2 FORMAT "%13.11" ECU_ADDRESS 0x3839AC /end MEASUREMENT
/begin MEASUREMENT Z_slpe "Zyklusflag: Sekundärluftpumpe (Endstufe)" UWORD B_TRUE 1 100 0 1 BIT_MASK 0x2 FORMAT "%13.11" ECU_ADDRESS 0x3839AE /end MEASUREMENT
/begin MEASUREMENT Z_slve "Zyklusflag:	Sekundärluftventil (Endstufe)" UWORD B_TRUE 1 100 0 1 BIT_MASK 0x2 FORMAT "%13.11" ECU_ADDRESS 0x3839B8 /end MEASUREMENT
/begin MEASUREMENT Z_stae "Zyklusflag: Startautomatik (Endstufe)" UWORD B_TRUE 1 100 0 1 BIT_MASK 0x2 FORMAT "%13.11" ECU_ADDRESS 0x3839BC /end MEASUREMENT
/begin MEASUREMENT Z_tesb "Zyklusflag: Tankentlüftung verstopfte Leitung" UWORD B_TRUE 1 100 0 1 BIT_MASK 0x2 FORMAT "%13.11" ECU_ADDRESS 0x3839C6 /end MEASUREMENT
/begin MEASUREMENT Z_tesk "Zyklusflag: Tankentlüftungssystem Kleinstleck" UWORD B_TRUE 1 100 0 1 BIT_MASK 0x2 FORMAT "%13.11" ECU_ADDRESS 0x3839CA /end MEASUREMENT
/begin MEASUREMENT Z_teve "Zyklusflag:	Tankentlüftungsventil Endstufe" UWORD B_TRUE 1 100 0 1 BIT_MASK 0x2 FORMAT "%13.11" ECU_ADDRESS 0x3839CC /end MEASUREMENT
/begin FUNCTION DFPM_DDG ""
 /begin DEF_CHARACTERISTIC CDCBM CDCN CDKBM CDKN CDTBM CDTN CLABM CLAN FFTBM FFTN TSFBM TSFN /end DEF_CHARACTERISTIC
 /begin REF_CHARACTERISTIC /end REF_CHARACTERISTIC
 /begin IN_MEASUREMENT /end IN_MEASUREMENT
 /begin OUT_MEASUREMENT B_bebm B_ben B_bkbm B_bkn B_clbm B_cln B_ftbm B_ftn B_mnbm B_mnn B_mxbm B_mxn B_npbm B_npn B_sibm B_sin E_bm E_n sfpbm sfpn TYP_bm TYP_n Z_bm Z_n /end OUT_MEASUREMENT
 /begin LOC_MEASUREMENT /end LOC_MEASUREMENT
 /begin SUB_FUNCTION /end SUB_FUNCTION
/end FUNCTION
/begin FUNCTION DFPM_DDMPME "" /begin DEF_CHARACTERISTIC CDCDMPME CDKDMPME CDTDMPME CLADMPME FFTDMPME TSFDMPME /end DEF_CHARACTERISTIC /begin REF_CHARACTERISTIC /end REF_CHARACTERISTIC /begin IN_MEASUREMENT /end IN_MEASUREMENT
 /begin OUT_MEASUREMENT B_bedmpme B_bkdmpme B_cldmpme B_ftdmpme B_mndmpme B_mxdmpme B_npdmpme B_sidmpme E_dmpme sfpdmpme TYP_DMPME Z_dmpme /end OUT_MEASUREMENT
 /begin LOC_MEASUREMENT /end LOC_MEASUREMENT
 /begin SUB_FUNCTION /end SUB_FUNCTION
/end FUNCTION
/begin FUNCTION DFPM_DDMTL ""
 /begin DEF_CHARACTERISTIC CDCDMTK CDCDMTKNM CDCDMTL CDKDMTK CDKDMTKNM CDKDMTL CDTDMTK CDTDMTKNM CDTDMTL CLADMTK CLADMTKNM CLADMTL FFTDMTK FFTDMTKNM FFTDMTL TSFDMTK TSFDMTKNM TSFDMTL /end DEF_CHARACTERISTIC
 /begin REF_CHARACTERISTIC /end REF_CHARACTERISTIC
 /begin IN_MEASUREMENT /end IN_MEASUREMENT
 /begin OUT_MEASUREMENT B_bedmtk B_bedmtknm B_bedmtl B_bkdmtk B_bkdmtknm B_bkdmtl B_cldmtk B_cldmtknm B_cldmtl B_ftdmtk B_ftdmtknm B_ftdmtl B_mndmtk B_mndmtknm B_mndmtl B_mxdmtk B_mxdmtknm B_mxdmtl B_npdmtk B_npdmtknm B_npdmtl B_sidmtk B_sidmtknm B_sidmtl E_dmtk E_dmtknm E_dmtl sfpdmtk sfpdmtknm sfpdmtl TYP_dmtk TYP_dmtknm TYP_dmtl Z_dmtk Z_dmtknm Z_dmtl /end OUT_MEASUREMENT
 /begin LOC_MEASUREMENT /end LOC_MEASUREMENT
 /begin SUB_FUNCTION /end SUB_FUNCTION
/end FUNCTION
/begin FUNCTION DFPM_DEKON ""
 /begin DEF_CHARACTERISTIC CDCANSKE CDCDHDMTE CDCDMMVE CDCDPMEE CDCETS CDCEV1 CDCEV2 CDCEV3 CDCEV4 CDCEV5 CDCEV6 CDCEV7 CDCEV8 CDCKKUE CDCKOS CDCKPE CDCLDE CDCLDPE CDCLUEA CDCMILE CDCNWSE CDCNWSE2 CDCSLPE CDCSLVE CDCSTAE CDCTEVE CDKANSKE CDKDHDMTE CDKDMMVE CDKDPMEE CDKETS CDKEV1 CDKEV2 CDKEV3 CDKEV4 CDKEV5 CDKEV6 CDKEV7 CDKEV8 CDKKKUE CDKKOS CDKKPE CDKLDE CDKLDPE CDKLUEA CDKMILE CDKNWSE CDKNWSE2 CDKSLPE CDKSLVE CDKSTAE CDKTEVE CDTANSKE CDTDHDMTE CDTDMMVE CDTDPMEE CDTETS CDTEV1 CDTEV2 CDTEV3 CDTEV4 CDTEV5 CDTEV6 CDTEV7 CDTEV8 CDTKKUE CDTKOS CDTKPE CDTLDE CDTLDPE CDTLUEA CDTMILE CDTNWSE CDTNWSE2 CDTSLPE CDTSLVE CDTSTAE CDTTEVE CLAANSKE CLADHDMTE CLADMMVE CLADPMEE CLAETS CLAEV1 CLAEV2 CLAEV3 CLAEV4 CLAEV5 CLAEV6 CLAEV7 CLAEV8 CLAKKUE CLAKOS CLAKPE CLALDE CLALDPE CLALUEA CLAMILE CLANWSE CLANWSE2 CLASLPE CLASLVE CLASTAE CLATEVE FFTANSKE FFTDHDMTE FFTDMMVE FFTDPMEE FFTETS FFTEV1 FFTEV2 FFTEV3 FFTEV4 FFTEV5 FFTEV6 FFTEV7 FFTEV8 FFTKKUE FFTKOS FFTKPE FFTLDE FFTLDPE FFTLUEA FFTMILE FFTNWSE FFTNWSE2 FFTSLPE FFTSLVE FFTSTAE FFTTEVE TSFANSKE TSFDHDMTE TSFDMMVE TSFDPMEE TSFETS TSFEV1 TSFEV2 TSFEV3 TSFEV4 TSFEV5 TSFEV6 TSFEV7 TSFEV8 TSFKKUE TSFKOS TSFKPE TSFLDE TSFLDPE TSFLUEA TSFMILE TSFNWSE TSFNWSE2 TSFSLPE TSFSLVE TSFSTAE TSFTEVE /end DEF_CHARACTERISTIC
 /begin REF_CHARACTERISTIC /end REF_CHARACTERISTIC
 /begin IN_MEASUREMENT /end IN_MEASUREMENT
 /begin OUT_MEASUREMENT B_beanske B_bedhdmte B_bedmmve B_bedpmee B_beets B_beev1 B_beev2 B_beev3 B_beev4 B_beev5 B_beev6 B_beev7 B_beev8 B_bekkue B_bekos B_bekpe B_belde B_beldpe B_beluea B_bemile B_benwse B_benwse2 B_beslpe B_beslve B_bestae B_beteve B_bkanske B_bkdhdmte B_bkdmmve B_bkdpmee B_bkets B_bkev1 B_bkev2 B_bkev3 B_bkev4 B_bkev5 B_bkev6 B_bkev7 B_bkev8 B_bkkkue B_bkkos B_bkkpe B_bklde B_bkldpe B_bkluea B_bkmile B_bknwse B_bknwse2 B_bkslpe B_bkslve B_bkstae B_bkteve B_clanske B_cldhdmte B_cldmmve B_cldpmee B_clets B_clev1 B_clev2 B_clev3 B_clev4 B_clev5 B_clev6 B_clev7 B_clev8 B_clkkue B_clkos B_clkpe B_cllde B_clldpe B_clluea B_clmile B_clnwse B_clnwse2 B_clslpe B_clslve B_clstae B_clteve B_ftanske B_ftdhdmte B_ftdmmve B_ftdpmee B_ftets B_ftev1 B_ftev2 B_ftev3 B_ftev4 B_ftev5 B_ftev6 B_ftev7 B_ftev8 B_ftkkue B_ftkos B_ftkpe B_ftlde B_ftldpe B_ftluea B_ftmile B_ftnwse B_ftnwse2 B_ftslpe B_ftslve B_ftstae B_ftteve B_mnanske B_mndhdmte B_mndmmve B_mndpmee B_mnets B_mnev1 B_mnev2 B_mnev3 B_mnev4 B_mnev5 B_mnev6 B_mnev7 B_mnev8 B_mnkkue B_mnkos B_mnkpe B_mnlde B_mnldpe B_mnluea B_mnmile B_mnnwse B_mnnwse2 B_mnslpe B_mnslve B_mnstae B_mnteve B_mxanske B_mxdhdmte B_mxdmmve B_mxdpmee B_mxets B_mxev1 B_mxev2 B_mxev3 B_mxev4 B_mxev5 B_mxev6 B_mxev7 B_mxev8 B_mxkkue B_mxkos B_mxkpe B_mxlde B_mxldpe B_mxluea B_mxmile B_mxnwse B_mxnwse2 B_mxslpe B_mxslve B_mxstae B_mxteve B_npanske B_npdhdmte B_npdmmve B_npdpmee B_npets B_npev1 B_npev2 B_npev3 B_npev4 B_npev5 B_npev6 B_npev7 B_npev8 B_npkkue B_npkos B_npkpe B_nplde B_npldpe B_npluea B_npmile B_npnwse B_npnwse2 B_npslpe B_npslve B_npstae B_npteve B_sianske B_sidhdmte B_sidmmve B_sidpmee B_siets B_siev1 B_siev2 B_siev3 B_siev4 B_siev5 B_siev6 B_siev7 B_siev8 B_sikkue B_sikos B_sikpe B_silde B_sildpe B_siluea B_simile B_sinwse B_sinwse2 B_sislpe B_sislve B_sistae B_siteve E_anske E_dhdmte E_dmmve E_dpmee E_ets E_ev1 E_ev2 E_ev3 E_ev4 E_ev5 E_ev6 E_ev7 E_ev8 E_kkue E_kos E_kpe E_lde E_ldpe E_luea E_mile E_nwse E_nwse2 E_slpe E_slve E_stae E_teve sfpanske sfpdhdmte sfpdmmve sfpdpmee sfpets sfpev1 sfpev2 sfpev3 sfpev4 sfpev5 sfpev6 sfpev7 sfpev8 sfpkkue sfpkos sfpkpe sfplde sfpldpe sfpluea sfpmile sfpnwse sfpnwse2 sfpslpe sfpslve sfpstae sfpteve TYP_anske TYP_dhdmte TYP_DMMVE TYP_DPMEE TYP_ets TYP_ev1 TYP_ev2 TYP_ev3 TYP_ev4 TYP_ev5 TYP_ev6 TYP_ev7 TYP_ev8 TYP_kkue TYP_kos TYP_kpe TYP_lde TYP_ldpe TYP_luea TYP_mile TYP_nwse TYP_nwse2 TYP_slpe TYP_slve TYP_stae TYP_teve Z_anske Z_dhdmte Z_dmmve Z_dpmee Z_ets Z_ev1 Z_ev2 Z_ev3 Z_ev4 Z_ev5 Z_ev6 Z_ev7 Z_ev8 Z_kkue Z_kos Z_kpe Z_lde Z_ldpe Z_luea Z_mile Z_nwse Z_nwse2 Z_slpe Z_slve Z_stae Z_teve /end OUT_MEASUREMENT
 /begin LOC_MEASUREMENT /end LOC_MEASUREMENT
 /begin SUB_FUNCTION /end SUB_FUNCTION
/end FUNCTION
/begin FUNCTION DFPM_DFPM ""
 /begin DEF_CHARACTERISTIC CDCAAA CDCZZZ CDKAAA CDKZZZ CDTAAA CDTZZZ CLAAAA CLAZZZ FFTAAA FFTZZZ TSFAAA TSFZZZ /end DEF_CHARACTERISTIC
 /begin REF_CHARACTERISTIC /end REF_CHARACTERISTIC
 /begin IN_MEASUREMENT /end IN_MEASUREMENT
 /begin OUT_MEASUREMENT sfpaaa sfpzzz /end OUT_MEASUREMENT
 /begin LOC_MEASUREMENT /end LOC_MEASUREMENT
 /begin SUB_FUNCTION /end SUB_FUNCTION
/end FUNCTION
/begin FUNCTION DFPM_DFSTT "" /begin DEF_CHARACTERISTIC CDCFST CDKFST CDTFST CLAFST FFTFST TSFFST /end DEF_CHARACTERISTIC /begin REF_CHARACTERISTIC /end REF_CHARACTERISTIC /begin IN_MEASUREMENT /end IN_MEASUREMENT
 /begin OUT_MEASUREMENT B_befst B_bkfst B_clfst B_ftfst B_mnfst B_mxfst B_npfst B_sifst E_fst sfpfst TYP_fst Z_fst /end OUT_MEASUREMENT
 /begin LOC_MEASUREMENT /end LOC_MEASUREMENT
 /begin SUB_FUNCTION /end SUB_FUNCTION
/end FUNCTION
/begin FUNCTION DFPM_DGLOR "" /begin DEF_CHARACTERISTIC CDCGLOR CDKGLOR CDTGLOR CLAGLOR FFTGLOR TSFGLOR /end DEF_CHARACTERISTIC /begin REF_CHARACTERISTIC /end REF_CHARACTERISTIC /begin IN_MEASUREMENT /end IN_MEASUREMENT
 /begin OUT_MEASUREMENT B_beglor B_bkglor B_clglor B_ftglor B_mnglor B_mxglor B_npglor B_siglor E_glor sfpglor TYP_glor Z_glor /end OUT_MEASUREMENT
 /begin LOC_MEASUREMENT /end LOC_MEASUREMENT
 /begin SUB_FUNCTION /end SUB_FUNCTION
/end FUNCTION
/begin FUNCTION DFPM_DHFM "" /begin DEF_CHARACTERISTIC CDCLM CDKLM CDTLM CLALM FFTLM TSFLM /end DEF_CHARACTERISTIC /begin REF_CHARACTERISTIC /end REF_CHARACTERISTIC /begin IN_MEASUREMENT /end IN_MEASUREMENT
 /begin OUT_MEASUREMENT B_belm B_bklm B_cllm B_ftlm B_mnlm B_mxlm B_nplm B_silm E_lm sfplm TYP_lm Z_lm /end OUT_MEASUREMENT
 /begin LOC_MEASUREMENT /end LOC_MEASUREMENT
 /begin SUB_FUNCTION /end SUB_FUNCTION
/end FUNCTION
/begin FUNCTION DFPM_DHLS ""
 /begin DEF_CHARACTERISTIC CDCHSH CDCHSH2 CDCHSV CDCHSV2 CDKHSH CDKHSH2 CDKHSV CDKHSV2 CDTHSH CDTHSH2 CDTHSV CDTHSV2 CLAHSH CLAHSH2 CLAHSV CLAHSV2 FFTHSH FFTHSH2 FFTHSV FFTHSV2 TSFHSH TSFHSH2 TSFHSV TSFHSV2 /end DEF_CHARACTERISTIC
 /begin REF_CHARACTERISTIC /end REF_CHARACTERISTIC
 /begin IN_MEASUREMENT /end IN_MEASUREMENT
 /begin OUT_MEASUREMENT B_behsh B_behsh2 B_behsv B_behsv2 B_bkhsh B_bkhsh2 B_bkhsv B_bkhsv2 B_clhsh B_clhsh2 B_clhsv B_clhsv2 B_fahsh B_fahsh2 B_fahsv B_fahsv2 B_mnhsh B_mnhsh2 B_mnhsv B_mnhsv2 B_mxhsh B_mxhsh2 B_mxhsv B_mxhsv2 B_nphsh B_nphsh2 B_nphsv B_nphsv2 B_sihsh B_sihsh2 B_sihsv B_sihsv2 E_hsh E_hsh2 E_hsv E_hsv2 sfphsh sfphsh2 sfphsv sfphsv2 TYP_hsh TYP_hsh2 TYP_hsv TYP_hsv2 Z_hsh Z_hsh2 Z_hsv Z_hsv2 /end OUT_MEASUREMENT
 /begin LOC_MEASUREMENT /end LOC_MEASUREMENT
 /begin SUB_FUNCTION /end SUB_FUNCTION
/end FUNCTION
/begin FUNCTION DFPM_DKAT ""
 /begin DEF_CHARACTERISTIC CDCKAT CDCKAT2 CDKKAT CDKKAT2 CDTKAT CDTKAT2 CLAKAT CLAKAT2 FFTKAT FFTKAT2 TSFKAT TSFKAT2 /end DEF_CHARACTERISTIC
 /begin REF_CHARACTERISTIC /end REF_CHARACTERISTIC
 /begin IN_MEASUREMENT /end IN_MEASUREMENT
 /begin OUT_MEASUREMENT B_bekat B_bekat2 B_bkkat B_bkkat2 B_clkat B_clkat2 B_ftkat B_ftkat2 B_mnkat B_mnkat2 B_mxkat B_mxkat2 B_npkat B_npkat2 B_sikat B_sikat2 E_kat E_kat2 sfpkat sfpkat2 TYP_kat TYP_kat2 Z_kat Z_kat2 /end OUT_MEASUREMENT
 /begin LOC_MEASUREMENT /end LOC_MEASUREMENT
 /begin SUB_FUNCTION /end SUB_FUNCTION
/end FUNCTION
/begin FUNCTION DFPM_DKRNT ""
 /begin DEF_CHARACTERISTIC CDCKRNT CDCKROF CDKKRNT CDKKROF CDTKRNT CDTKROF CLAKRNT CLAKROF FFTKRNT FFTKROF TSFKRNT TSFKROF /end DEF_CHARACTERISTIC
 /begin REF_CHARACTERISTIC /end REF_CHARACTERISTIC
 /begin IN_MEASUREMENT /end IN_MEASUREMENT
 /begin OUT_MEASUREMENT B_bekrnt B_bekrof B_bkkrnt B_bkkrof B_clkrnt B_clkrof B_ftkrnt B_ftkrof B_mnkrnt B_mnkrof B_mxkrnt B_mxkrof B_npkrnt B_npkrof B_sikrnt B_sikrof E_krnt E_krof sfpkrnt sfpkrof TYP_krnt TYP_krof Z_krnt Z_krof /end OUT_MEASUREMENT
 /begin LOC_MEASUREMENT /end LOC_MEASUREMENT
 /begin SUB_FUNCTION /end SUB_FUNCTION
/end FUNCTION
/begin FUNCTION DFPM_DKRS ""
 /begin DEF_CHARACTERISTIC CDCKS1 CDCKS2 CDCKS3 CDCKS4 CDKKS1 CDKKS2 CDKKS3 CDKKS4 CDTKS1 CDTKS2 CDTKS3 CDTKS4 CLAKS1 CLAKS2 CLAKS3 CLAKS4 FFTKS1 FFTKS2 FFTKS3 FFTKS4 TSFKS1 TSFKS2 TSFKS3 TSFKS4 /end DEF_CHARACTERISTIC
 /begin REF_CHARACTERISTIC /end REF_CHARACTERISTIC
 /begin IN_MEASUREMENT /end IN_MEASUREMENT
 /begin OUT_MEASUREMENT B_beks1 B_beks2 B_beks3 B_beks4 B_bkks1 B_bkks2 B_bkks3 B_bkks4 B_clks1 B_clks2 B_clks3 B_clks4 B_ftks1 B_ftks2 B_ftks3 B_ftks4 B_mnks1 B_mnks2 B_mnks3 B_mnks4 B_mxks1 B_mxks2 B_mxks3 B_mxks4 B_npks1 B_npks2 B_npks3 B_npks4 B_siks1 B_siks2 B_siks3 B_siks4 E_ks1 E_ks2 E_ks3 E_ks4 sfpks1 sfpks2 sfpks3 sfpks4 TYP_ks1 TYP_ks2 TYP_ks3 TYP_ks4 Z_ks1 Z_ks2 Z_ks3 Z_ks4 /end OUT_MEASUREMENT
 /begin LOC_MEASUREMENT /end LOC_MEASUREMENT
 /begin SUB_FUNCTION /end SUB_FUNCTION
/end FUNCTION
/begin FUNCTION DFPM_DKRTP "" /begin DEF_CHARACTERISTIC CDCKRTP CDKKRTP CDTKRTP CLAKRTP FFTKRTP TSFKRTP /end DEF_CHARACTERISTIC /begin REF_CHARACTERISTIC /end REF_CHARACTERISTIC /begin IN_MEASUREMENT /end IN_MEASUREMENT
 /begin OUT_MEASUREMENT B_bekrtp B_bkkrtp B_clkrtp B_ftkrtp B_mnkrtp B_mxkrtp B_npkrtp B_sikrtp E_krtp sfpkrtp TYP_krtp Z_krtp /end OUT_MEASUREMENT
 /begin LOC_MEASUREMENT /end LOC_MEASUREMENT
 /begin SUB_FUNCTION /end SUB_FUNCTION
/end FUNCTION
/begin FUNCTION DFPM_DKUPPL "" /begin DEF_CHARACTERISTIC CDCKUPPL CDKKUPPL CDTKUPPL CLAKUPPL FFTKUPPL TSFKUPPL /end DEF_CHARACTERISTIC /begin REF_CHARACTERISTIC /end REF_CHARACTERISTIC /begin IN_MEASUREMENT /end IN_MEASUREMENT
 /begin OUT_MEASUREMENT B_bekuppl B_bkkuppl B_clkuppl B_ftkuppl B_mnkuppl B_mxkuppl B_npkuppl B_sikuppl E_kuppl sfpkuppl TYP_kuppl Z_kuppl /end OUT_MEASUREMENT
 /begin LOC_MEASUREMENT /end LOC_MEASUREMENT
 /begin SUB_FUNCTION /end SUB_FUNCTION
/end FUNCTION
/begin FUNCTION DFPM_DKVS ""
 /begin DEF_CHARACTERISTIC CDCFRAO CDCFRAO2 CDCFRAU CDCFRAU2 CDCFRST CDCFRST2 CDCRKAT CDCRKAT2 CDCRKAZ CDCRKAZ2 CDKFRAO CDKFRAO2 CDKFRAU CDKFRAU2 CDKFRST CDKFRST2 CDKRKAT CDKRKAT2 CDKRKAZ CDKRKAZ2 CDTFRAO CDTFRAO2 CDTFRAU CDTFRAU2 CDTFRST CDTFRST2 CDTRKAT CDTRKAT2 CDTRKAZ CDTRKAZ2 CLAFRAO CLAFRAO2 CLAFRAU CLAFRAU2 CLAFRST CLAFRST2 CLARKAT CLARKAT2 CLARKAZ CLARKAZ2 FFTFRAO FFTFRAO2 FFTFRAU FFTFRAU2 FFTFRST FFTFRST2 FFTRKAT FFTRKAT2 FFTRKAZ FFTRKAZ2 TSFFRAO TSFFRAO2 TSFFRAU TSFFRAU2 TSFFRST TSFFRST2 TSFRKAT TSFRKAT2 TSFRKAZ TSFRKAZ2 /end DEF_CHARACTERISTIC
 /begin REF_CHARACTERISTIC /end REF_CHARACTERISTIC
 /begin IN_MEASUREMENT /end IN_MEASUREMENT
 /begin OUT_MEASUREMENT B_befrao B_befrao2 B_befrau B_befrau2 B_befrst B_befrst2 B_berkat B_berkat2 B_berkaz B_berkaz2 B_bkfrao B_bkfrao2 B_bkfrau B_bkfrau2 B_bkfrst B_bkfrst2 B_bkrkat B_bkrkat2 B_bkrkaz B_bkrkaz2 B_clfrao B_clfrao2 B_clfrau B_clfrau2 B_clfrst B_clfrst2 B_clrkat B_clrkat2 B_clrkaz B_clrkaz2 B_ftfrao B_ftfrao2 B_ftfrau B_ftfrau2 B_ftfrst B_ftfrst2 B_ftrkat B_ftrkat2 B_ftrkaz B_ftrkaz2 B_mnfrao B_mnfrao2 B_mnfrau B_mnfrau2 B_mnfrst B_mnfrst2 B_mnrkat B_mnrkat2 B_mnrkaz B_mnrkaz2 B_mxfrao B_mxfrao2 B_mxfrau B_mxfrau2 B_mxfrst B_mxfrst2 B_mxrkat B_mxrkat2 B_mxrkaz B_mxrkaz2 B_npfrao B_npfrao2 B_npfrau B_npfrau2 B_npfrst B_npfrst2 B_nprkat B_nprkat2 B_nprkaz B_nprkaz2 B_sifrao B_sifrao2 B_sifrau B_sifrau2 B_sifrst B_sifrst2 B_sirkat B_sirkat2 B_sirkaz B_sirkaz2 E_frao E_frao2 E_frau E_frau2 E_frst E_frst2 E_rkat E_rkat2 E_rkaz E_rkaz2 sfpfrao sfpfrao2 sfpfrau sfpfrau2 sfpfrst sfpfrst2 sfprkat sfprkat2 sfprkaz sfprkaz2 TYP_frao TYP_frao2 TYP_frau TYP_frau2 TYP_frst TYP_frst2 TYP_rkat TYP_rkat2 TYP_rkaz TYP_rkaz2 Z_frao Z_frao2 Z_frau Z_frau2 Z_frst Z_frst2 Z_rkat Z_rkat2 Z_rkaz Z_rkaz2 /end OUT_MEASUREMENT
 /begin LOC_MEASUREMENT /end LOC_MEASUREMENT
 /begin SUB_FUNCTION /end SUB_FUNCTION
/end FUNCTION
/begin FUNCTION DFPM_DLDP ""
 /begin DEF_CHARACTERISTIC CDCLDP CDCTESB CDCTESK CDKLDP CDKTESB CDKTESK CDTLDP CDTTESB CDTTESK CLALDP CLATESB CLATESK FFTLDP FFTTESB FFTTESK TSFLDP TSFTESB TSFTESK /end DEF_CHARACTERISTIC
 /begin REF_CHARACTERISTIC /end REF_CHARACTERISTIC
 /begin IN_MEASUREMENT /end IN_MEASUREMENT
 /begin OUT_MEASUREMENT B_beldp B_betesb B_betesk B_bkldp B_bktesb B_bktesk B_clldp B_cltesb B_cltesk B_ftldp B_fttesb B_fttesk B_mnldp B_mntesb B_mntesk B_mxldp B_mxtesb B_mxtesk B_npldp B_nptesb B_nptesk B_sildp B_sitesb B_sitesk E_ldp E_tesb E_tesk sfpldp sfptesb sfptesk TYP_ldp TYP_tesb TYP_tesk Z_ldp Z_tesb Z_tesk /end OUT_MEASUREMENT
 /begin LOC_MEASUREMENT /end LOC_MEASUREMENT
 /begin SUB_FUNCTION /end SUB_FUNCTION
/end FUNCTION
/begin COMPU_METHOD B_TRUE "boolsche Zustände, positive Logik" TAB_VERB "%6.3" "" COMPU_TAB_REF B_TRUE /end COMPU_METHOD
/begin COMPU_VTAB B_TRUE "boolsche Zustände, positive Logik" TAB_VERB 2 0 "----" 1 "TRUE" /end COMPU_VTAB
/begin COMPU_METHOD dez "1 : 1 Umrechnug (dez/hex)" RAT_FUNC "%6.2" "" COEFFS 0 1 0 0 0 1 /end COMPU_METHOD
/begin COMPU_METHOD default "" RAT_FUNC "%6.2" "" COEFFS 0 1 0 0 0 1 /end COMPU_METHOD
/begin RECORD_LAYOUT KwbUb FNC_VALUES 1 UBYTE COLUMN_DIR DIRECT /end RECORD_LAYOUT
/begin RECORD_LAYOUT KwbUw FNC_VALUES 1 UWORD COLUMN_DIR DIRECT /end RECORD_LAYOUT
/begin RECORD_LAYOUT KwUb FNC_VALUES 1 UBYTE COLUMN_DIR DIRECT /end RECORD_LAYOUT
/begin RECORD_LAYOUT KwUw FNC_VALUES 1 UWORD COLUMN_DIR DIRECT /end RECORD_LAYOUT
/end MODULE
/end PROJECT
