ASAP2_VERSION 1 3
/begin PROJECT basisme9 ""
/begin HEADER "" VERSION "basisme9" PROJECT_NO basisme9 /end HEADER
/begin MODULE DIM ""
/begin MOD_COMMON "" BYTE_ORDER MSB_FIRST ALIGNMENT_BYTE 1 ALIGNMENT_WORD 2 ALIGNMENT_LONG 2 ALIGNMENT_FLOAT32_IEEE 4 /end MOD_COMMON
/begin CHARACTERISTIC ABGMSIGV "Abgastemperaturschwelle f¸r Signalunterbrechung mit Ri-Diagnose vor KAT" VALUE 0x4E2C78 KwUb 1275. temp_ub_q5_o50 -50.00 1225. FORMAT "%5.0" /end CHARACTERISTIC
/begin CHARACTERISTIC ABWVFZG "max. zulaessige Abweichung der Fahrzeuggeschwindigkeit (in %)" VALUE 0x4E2D1C KwUb 0.9961 fak_ub_b1 0.00 0.9961 /end CHARACTERISTIC
/begin CHARACTERISTIC ADKATNF "Normierungsfaktor f¸r Signalamplitude der Sonde bzw. Katbelastung" VALUE 0x4E2C18 KwUb 23.87 spg_ub_b24 0.00 23.87 FORMAT "%5.2" /end CHARACTERISTIC
/begin CHARACTERISTIC AHKATMN "Schwellwert Katalysator gut,  AHKAT < AHKATMN" VALUE 0x4E2C19 KwUb 0.9961 fak_ub_b1 0.00 0.9961 /end CHARACTERISTIC
/begin CHARACTERISTIC AHKATMX "Schwellwert Katalysator defekt,  AHKAT > AHKATMX" VALUE 0x4E2C1A KwUb 0.9961 fak_ub_b1 0.00 0.9961 /end CHARACTERISTIC
/begin CHARACTERISTIC AHKATS "Schwellwert f¸r Summe AHKAT,AHKAT2 (Stereo )" VALUE 0x4E2C1B KwUb 1.992 fak_ub_b2 0.00 1.992 FORMAT "%5.3" /end CHARACTERISTIC
/begin CHARACTERISTIC AHKATSB "Schwellwert f¸r Summenbereichfehler (Stereo)" VALUE 0x4E2C1C KwUb 0.9961 fak_ub_b1 0.00 0.9961 /end CHARACTERISTIC
/begin CHARACTERISTIC AHKTTSW "Setztwert f¸r Zeitgeber in Signalauswertung" VALUE 0x4E2C50 KwUw 3276.750 t50msxs_uw_b3276p75 0.00 3276.750 FORMAT "%8.3" /end CHARACTERISTIC
/begin CHARACTERISTIC AIMDTED "Schwelle f¸r Stˆrerkennung Verlustmoment" VALUE 0x4E8870 KwUw 99.99847 rel_uw_b100 0.00 99.99847 FORMAT "%8.5" /end CHARACTERISTIC
/begin CHARACTERISTIC AIODTEX "Maximale Anzahl der i.O.-Pr¸fungen bei Tankentl¸ftungsdiagnose" VALUE 0x4EE4B6 KwUb 255.0 dez 0.00 255.0 FORMAT "%5.1" /end CHARACTERISTIC
/begin CHARACTERISTIC ANZDPVK "Anzahl der Perioden f¸r Ready-Flag der Usvk-Perioden¸berwachung" VALUE 0x4E2C60 KwUb 255.0 dez 0.00 255.0 FORMAT "%5.1" /end CHARACTERISTIC
/begin CHARACTERISTIC ANZGEM "Anzahl der Gemischfehler" VALUE 0x4E2C79 KwUb 255.0 dez 0.00 255.0 FORMAT "%5.1" /end CHARACTERISTIC
/begin CHARACTERISTIC ANZNWZ "Anzahl Nockenwellen Zaehne" VALUE 0x4E2C10 KwWU8 255.0 DEZ 0.00 255.0 FORMAT "%5.1" /end CHARACTERISTIC
/begin CHARACTERISTIC ANZTP "" VALUE 0x4E2C61 KwUb 255.0 dez 0.00 255.0 FORMAT "%5.1" /end CHARACTERISTIC
/begin CHARACTERISTIC APDTEX "max. Anzahl Pr¸fungen bei Tankentl¸ftungsdiagnose" VALUE 0x4EE4B7 KwUb 255.0 dez 0.00 255.0 FORMAT "%5.1" /end CHARACTERISTIC
/begin CHARACTERISTIC APEKTDX "max. Anzahl Fehlerpr¸fungen bei Kat-Diagnose" VALUE 0x4E2C1D KwUb 255.0 dez 0.00 255.0 FORMAT "%5.1" /end CHARACTERISTIC
/begin CHARACTERISTIC ATVFETTO "obere Grenze f¸r atvfett, CARB-Tester, DLSSA" VALUE 0x4EA90A KwUb 10.20 t40msxs_ub_q0p04 0.00 10.20 FORMAT "%5.2" /end CHARACTERISTIC
/begin CHARACTERISTIC ATVFETTU "untere Grenze f¸r atvfett, CARB-Tester, DLSSA" VALUE 0x4EA90B KwUb 10.20 t40msxs_ub_q0p04 0.00 10.20 FORMAT "%5.2" /end CHARACTERISTIC
/begin CHARACTERISTIC ATVMAGO "obere Grenze f¸r atvmager, CARB-Tester, DLSSA" VALUE 0x4EA90C KwUb 10.20 t40msxs_ub_q0p04 0.00 10.20 FORMAT "%5.2" /end CHARACTERISTIC
/begin CHARACTERISTIC ATVMAGU "untere Grenze f¸r atvmager, CARB-Tester, DLSSA" VALUE 0x4EA90D KwUb 10.20 t40msxs_ub_q0p04 0.00 10.20 FORMAT "%5.2" /end CHARACTERISTIC
/begin CHARACTERISTIC AVKATFS "Setztwert f¸r AVKATF wenn Powerfail" VALUE 0x4E2C1E KwUb 0.9961 fak_ub_b1 0.00 0.9961 /end CHARACTERISTIC
/begin CHARACTERISTIC CDCAGRF "Codewort CARB: ‹berwachung AGR-FLOW" VAL_BLK 0x4F01C2 KwbWU16 65535.00 dez 0.00 65535.00 FORMAT "%8.2" NUMBER 4 /end CHARACTERISTIC
/begin CHARACTERISTIC CDCDMTK "Codewort CARB: Tankentl¸ftungssystem Feinstleck" VAL_BLK 0x4F022A KwbWU16 65535.00 dez 0.00 65535.00 FORMAT "%8.2" NUMBER 4 /end CHARACTERISTIC
/begin CHARACTERISTIC CDCDMTL "Codewort CARB: Tankentl¸ftungssystem Modulfehler (Hardware)" VAL_BLK 0x4F0232 KwbWU16 65535.00 dez 0.00 65535.00 FORMAT "%8.2" NUMBER 4 /end CHARACTERISTIC
/begin CHARACTERISTIC CDCHSVSA "Codewort CARB:	Lambdasonden-Heizung vor Katalysator" VAL_BLK 0x4F02DA KwbWU16 65535.00 dez 0.00 65535.00 FORMAT "%8.2" NUMBER 4 /end CHARACTERISTIC
/begin CHARACTERISTIC CDCKAT2 "Codewort CARB:	Katalysator-Konvertierung	(Bank 2)" VAL_BLK 0x4F02EA KwbWU16 65535.00 dez 0.00 65535.00 FORMAT "%8.2" NUMBER 4 /end CHARACTERISTIC
/begin CHARACTERISTIC CDCKATSP "Codewort CARB:	Katalysator-Konvertierung" VAL_BLK 0x4F02F2 KwbWU16 65535.00 dez 0.00 65535.00 FORMAT "%8.2" NUMBER 4 /end CHARACTERISTIC
/begin CHARACTERISTIC CDCMDB "Codewort CARB: Momentbegrenzung Sollmoment" VAL_BLK 0x4F038A KwbUw 65535.00 dez 0.00 65535.00 FORMAT "%8.2" NUMBER 4 /end CHARACTERISTIC
/begin CHARACTERISTIC CDCTESK "Codewort CARB: Tankentl¸ftungssystem Kleinstleck" VAL_BLK 0x4F046A KwbWU16 65535.00 dez 0.00 65535.00 FORMAT "%8.2" NUMBER 4 /end CHARACTERISTIC
/begin CHARACTERISTIC CDKAGRF "Codewort Kunde: ‹berwachung AGR-FLOW" VALUE 0x4F04E4 KwWU16 65535.00 dez 0.00 65535.00 FORMAT "%8.2" /end CHARACTERISTIC
/begin CHARACTERISTIC CDKATLK "Codewort f¸r B_lrka aktiv" VALUE 0x4E2C1F KwUb 255.0 dez 0.00 255.0 FORMAT "%5.1" /end CHARACTERISTIC
/begin CHARACTERISTIC CDKDMTK "Codewort Kunde: Tankentl¸ftungssystem, Feinstleck" VALUE 0x4F04FE KwWU16 65535.00 dez 0.00 65535.00 FORMAT "%8.2" /end CHARACTERISTIC
/begin CHARACTERISTIC CDKDMTL "Codewort Kunde: Tankentl¸ftungssystem, Modulefehler (Hardware)" VALUE 0x4F0500 KwWU16 65535.00 dez 0.00 65535.00 FORMAT "%8.2" /end CHARACTERISTIC
/begin CHARACTERISTIC CDKHSVSA "" VALUE 0x4F052A KwWU16 65535.00 dez 0.00 65535.00 FORMAT "%8.2" /end CHARACTERISTIC
/begin CHARACTERISTIC CDKKAT2 "Codewort Kunde:	Katalysator-Konvertierung	(Bank 2)" VALUE 0x4F052E KwWU16 65535.00 dez 0.00 65535.00 FORMAT "%8.2" /end CHARACTERISTIC
/begin CHARACTERISTIC CDKKATSP "Codewort Kunde:	Katalysator-Konvertierung" VALUE 0x4F0530 KwWU16 65535.00 dez 0.00 65535.00 FORMAT "%8.2" /end CHARACTERISTIC
/begin CHARACTERISTIC CDKMDB "Codewort Kunde: Momentbegrenzung Sollmoment" VALUE 0x4F0556 KwUw 65535.00 dez 0.00 65535.00 FORMAT "%8.2" /end CHARACTERISTIC
/begin CHARACTERISTIC CDKTESK "Codewort Kunde: Tankentl¸ftungssystem Kleinstleck" VALUE 0x4F058E KwWU16 65535.00 dez 0.00 65535.00 FORMAT "%8.2" /end CHARACTERISTIC
/begin CHARACTERISTIC CDTAGRF "Codewort Tester: ‹berwachung AGR-FLOW" VALUE 0x4F05AE KwWU16 65535.00 dez 0.00 65535.00 FORMAT "%8.2" /end CHARACTERISTIC
/begin CHARACTERISTIC CDTDMTK "Codewort Tester: Tankentl¸ftungssystem Feinstleck" VALUE 0x4F05C8 KwWU16 65535.00 dez 0.00 65535.00 FORMAT "%8.2" /end CHARACTERISTIC
/begin CHARACTERISTIC CDTDMTL "Codewort Tester: Tankentl¸ftungssystem Modulfehler (Hardware)" VALUE 0x4F05CA KwWU16 65535.00 dez 0.00 65535.00 FORMAT "%8.2" /end CHARACTERISTIC
/begin CHARACTERISTIC CDTHSVSA "Codewort Tester: Lambdasonden-Heizung vor Katalysator" VALUE 0x4F05F4 KwWU16 65535.00 dez 0.00 65535.00 FORMAT "%8.2" /end CHARACTERISTIC
/begin CHARACTERISTIC CDTKAT2 "Codewort Tester: Katalysator-Konvertierung (Bank 2)" VALUE 0x4F05F8 KwWU16 65535.00 dez 0.00 65535.00 FORMAT "%8.2" /end CHARACTERISTIC
/begin CHARACTERISTIC CDTKATSP "Codewort Tester: Katalysator-Konvertierung" VALUE 0x4F05FA KwWU16 65535.00 dez 0.00 65535.00 FORMAT "%8.2" /end CHARACTERISTIC
/begin CHARACTERISTIC CDTMDB "Codewort Tester: Momentbegrenzung Sollmoment" VALUE 0x4F0620 KwUw 65535.00 dez 0.00 65535.00 FORMAT "%8.2" /end CHARACTERISTIC
/begin CHARACTERISTIC CDTTESK "Codewort Tester: Tankentl¸ftungssystem Kleinstleck" VALUE 0x4F0658 KwWU16 65535.00 dez 0.00 65535.00 FORMAT "%8.2" /end CHARACTERISTIC
/begin CHARACTERISTIC CIDTHS "Component-ID f¸r Thermostatdiagnose" VALUE 0x4EF008 KwWU8 127.0 default 0.00 127.0 FORMAT "%5.1" /end CHARACTERISTIC
/begin CHARACTERISTIC CLAAGRF "Fehlerklasse: ‹berwachung AGR-Flow" VALUE 0x4EFF59 KwWU8 255.0 dez 0.00 255.0 FORMAT "%5.1" /end CHARACTERISTIC
/begin CHARACTERISTIC CLADMTK "Fehlerklasse: Tankdiagnose, Feinstleck" VALUE 0x4EFF66 KwWU8 255.0 dez 0.00 255.0 FORMAT "%5.1" /end CHARACTERISTIC
/begin CHARACTERISTIC CLADMTL "Fehlerklasse: Tankdiagnose, Modulfehler" VALUE 0x4EFF67 KwWU8 255.0 dez 0.00 255.0 FORMAT "%5.1" /end CHARACTERISTIC
/begin CHARACTERISTIC CLAHSVSA "Fehlerklasse: Heizung Lambdasonde vor Kat" VALUE 0x4EFF7C KwWU8 255.0 dez 0.00 255.0 FORMAT "%5.1" /end CHARACTERISTIC
/begin CHARACTERISTIC CLAKAT2 "Fehlerklasse: Katalysator Bank 2" VALUE 0x4EFF7E KwWU8 255.0 dez 0.00 255.0 FORMAT "%5.1" /end CHARACTERISTIC
/begin CHARACTERISTIC CLAKATSP "Fehlerklasse: Katalysator" VALUE 0x4EFF7F KwWU8 255.0 dez 0.00 255.0 FORMAT "%5.1" /end CHARACTERISTIC
/begin CHARACTERISTIC CLAMDB "Fehlerklasse: Momentbgrenzung Sollmoment" VALUE 0x4EFF92 KwUb 255.0 dez 0.00 255.0 FORMAT "%5.1" /end CHARACTERISTIC
/begin CHARACTERISTIC CLATESK "Fehlerklasse: Tankdiagnose, Kleinstleck" VALUE 0x4EFFAE KwWU8 255.0 dez 0.00 255.0 FORMAT "%5.1" /end CHARACTERISTIC
/begin CHARACTERISTIC CPLRA "Codewort f¸r Umschaltung DKVS von HFM- auf P-System" VALUE 0x4EB8A8 KwUb 255.0 dez 0.00 255.0 FORMAT "%5.1" /end CHARACTERISTIC
/begin CHARACTERISTIC CWDKRNT "Codewort: KR-Diagnose Integratorsteigung" VALUE 0x4E556E KwUb 255.0 dez 0.00 255.0 FORMAT "%5.1" /end CHARACTERISTIC
/begin CHARACTERISTIC CWDKROF "Codewort: KR-Diagnose Resetwert" VALUE 0x4E556F KwUb 255.0 dez 0.00 255.0 FORMAT "%5.1" /end CHARACTERISTIC
/begin CHARACTERISTIC CWDKRTP "Codewort: KR-Diagnose Testimpuls" VALUE 0x4E558E KwUb 255.0 dez 0.00 255.0 FORMAT "%5.1" /end CHARACTERISTIC
/begin CHARACTERISTIC CWDKS1 "Codewort: Klopfsensordiagnose Sensor1" VALUE 0x4ECFFE KwUb 255.0 dez 0.00 255.0 FORMAT "%5.1" /end CHARACTERISTIC
/begin CHARACTERISTIC CWDKS2 "Codewort: Klopfsensordiagnose Sensor 2" VALUE 0x4ECFFF KwUb 255.0 dez 0.00 255.0 FORMAT "%5.1" /end CHARACTERISTIC
/begin CHARACTERISTIC CWDKVSS "Codewort f¸r Error in DKVS sperren, wenn andere Fehler vorliegen" VALUE 0x4EB8A9 KwUb 255.0 dez 0.00 255.0 FORMAT "%5.1" /end CHARACTERISTIC
/begin CHARACTERISTIC CWDPH "CW Phasengeberdiagnose" VALUE 0x4E2C11 KwWU8 255.0 DEZ 0.00 255.0 FORMAT "%5.1" /end CHARACTERISTIC
/begin CHARACTERISTIC CWDSLSY "Codewort in der Diagnose Sekund‰rluftsystem" VALUE 0x4EEFC6 KwUb 255.0 dez 0.00 255.0 FORMAT "%5.1" /end CHARACTERISTIC
/begin CHARACTERISTIC CWDVVT "Code Wort f¸r Diagnose DKVS bei VVT-Motoren" VALUE 0x4EB8AA KwUb 255.0 dez 0.00 255.0 FORMAT "%5.1" /end CHARACTERISTIC
/begin CHARACTERISTIC CWLOWRA "Codewort LOWRA aktiv" VALUE 0x4EF009 KwWU8 1.000 default 0.00 1.000 FORMAT "%5.3" /end CHARACTERISTIC
/begin CHARACTERISTIC CWLSADS "" VALUE 0x4EA970 KwUb 255.0 dez 0.00 255.0 FORMAT "%5.1" /end CHARACTERISTIC
/begin CHARACTERISTIC CWMILCOD "Codewort MIL-Codierung aktiv" VALUE 0x4E2BE9 KwUb 255.0 dez 0.00 255.0 FORMAT "%5.1" /end CHARACTERISTIC
/begin CHARACTERISTIC CWNOMIL "Codewort MIL-Ansteuerung nicht aktiv" VALUE 0x4E2BEA KwUb 255.0 dez 0.00 255.0 FORMAT "%5.1" /end CHARACTERISTIC
/begin CHARACTERISTIC CWPSLSHVKE "Codewort f¸r Endstufendiagnose LSHVK" VAL_BLK 0x4E2D94 KwbUb 255.0 dez 0.00 255.0 FORMAT "%5.1" NUMBER 2 /end CHARACTERISTIC
/begin CHARACTERISTIC CWPSSLVE "Codewort f¸r Endstufendiagnose SLV" VAL_BLK 0x4E2D8C KwbUb 255.0 dez 0.00 255.0 FORMAT "%5.1" NUMBER 1 /end CHARACTERISTIC
/begin CHARACTERISTIC CWPSSSTE "" VAL_BLK 0x4E2D9C KwbUb 255.0 dez 0.00 255.0 FORMAT "%5.1" NUMBER 1 /end CHARACTERISTIC
/begin CHARACTERISTIC CWPSSTARTE "Codewort f¸r Endstufendiagnose START" VAL_BLK 0x4E2DA4 KwbUb 255.0 dez 0.00 255.0 FORMAT "%5.1" NUMBER 1 /end CHARACTERISTIC
/begin CHARACTERISTIC CWPSTDE "" VAL_BLK 0x4E2D6C KwbUb 255.0 dez 0.00 255.0 FORMAT "%5.1" NUMBER 1 /end CHARACTERISTIC
/begin CHARACTERISTIC CWPSTEVE "Codewort f¸r Endstufendiagnose TEV" VAL_BLK 0x4E2D7C KwbUb 255.0 dez 0.00 255.0 FORMAT "%5.1" NUMBER 1 /end CHARACTERISTIC
/begin CHARACTERISTIC CW_2sst "Codeword bei 2 Seitenstuetzenschalter: 1= verbaut, 0=nicht" VALUE 0x4E972E KwUb 1.000 dez 0.00 1.000 FORMAT "%5.3" /end CHARACTERISTIC
/begin CHARACTERISTIC CW_dkuppl "Codwort zum aktivieren der Kupplungschalter Diagnose (1 => aktiv)" VALUE 0x4E2D1D KwUb 1.000 dez 0.00 1.000 FORMAT "%5.3" /end CHARACTERISTIC
/begin CHARACTERISTIC CW_DSTP "" VALUE 0x4EA9D0 KwWU8 255.0 dez 0.00 255.0 FORMAT "%5.1" /end CHARACTERISTIC
/begin CHARACTERISTIC CW_DTHS "Codewort DTHS" VALUE 0x4EF00A KwWU8 1.000 DEZ 0.00 1.000 FORMAT "%5.3" /end CHARACTERISTIC
/begin CHARACTERISTIC DASA "Anzahl der SAS-Phasen zur Erkennung LLS Fehler" VALUE 0x4ED6CA KwUb 255.0 dez 0.00 255.0 FORMAT "%5.1" /end CHARACTERISTIC
/begin CHARACTERISTIC DELTAI_MLS "" VALUE 0x4E9718 KwWU16 99.98322 ii_uw_b2621 0.00 99.98322 FORMAT "%8.4" /end CHARACTERISTIC
/begin CHARACTERISTIC DFRMOFNX "frm-Offset-Schwelle (negativ): Kontrolle Vorsteuerproblem" VALUE 0x4EEFFC KwSw 1.999969 fak_sw_b1 -1.000000 0.9999695 FORMAT "%8.6" /end CHARACTERISTIC
/begin CHARACTERISTIC DFRMOFPX "frm-Offset-Schwelle (positiv): Kontrolle Vorsteuerproblem" VALUE 0x4EEFFE KwSw 1.999969 fak_sw_b1 -1.000000 0.9999695 FORMAT "%8.6" /end CHARACTERISTIC
/begin CHARACTERISTIC DFRMST "Delta frm-schwelle f¸r Erkennung der eingeschwungenen Grundadaption" VALUE 0x4EB8AB KwUb 1.992 fak_ub_b2 0.00 1.992 FORMAT "%5.3" /end CHARACTERISTIC
/begin CHARACTERISTIC DKATCW "einmaliger Lauf bzw. Initialisierung der DKAT-Funktion" VALUE 0x4E2C20 KwUb 255.0 dez 0.00 255.0 FORMAT "%5.1" /end CHARACTERISTIC
/begin CHARACTERISTIC DKROFN "Grenzwert der Integratorsteigung f¸r Nulltest" CURVE 0x4E5574 KlAUwSstUwWUw 6103.425 spgg_sw_b3052 0.00 6103.425 FORMAT "%8.3"
 /begin AXIS_DESCR STD_AXIS tmfln_w tus_uw_q3p2 6 0.00 209712.0 FORMAT "%8.1" DEPOSIT ABSOLUTE /end AXIS_DESCR
/end CHARACTERISTIC
/begin CHARACTERISTIC DKROKU "Untere Drehzahlschwelle f¸r Ermittlung Offsetkompensationswert" VALUE 0x4E5570 KwUb 10200. nmot_ub_q40 0.00 10200. FORMAT "%5.0" /end CHARACTERISTIC
/begin CHARACTERISTIC DMITED "Delta Schwelle F¸llungswunsch" VALUE 0x4E8872 KwUw 99.99847 rel_uw_b100 0.00 99.99847 FORMAT "%8.5" /end CHARACTERISTIC
/begin CHARACTERISTIC DMLSERRCLZ "" VALUE 0x4E971A KwWU16 6553.500 t100msxs_uw_b6553p5 0.00 6553.500 FORMAT "%8.3" /end CHARACTERISTIC
/begin CHARACTERISTIC DMRKTD "Momentenreserve f¸r Katalysator-Diagnose" VALUE 0x4EA908 KwUw 99.99847 rel_uw_b100 0.00 99.99847 FORMAT "%8.5" /end CHARACTERISTIC
/begin CHARACTERISTIC DNDLLRO "Maxmimale Drehzahlabweichung (Unterdrehzahl) f¸r Diagnose LLR" VALUE 0x4ED6CB KwUb 1270. nmot_ub_q10 0.00 1270. FORMAT "%5.0" /end CHARACTERISTIC
/begin CHARACTERISTIC DNDLLRU "Maxmimale Drehzahlabweichung (‹berdrehzahl) f¸r Diagnose LLR" VALUE 0x4ED6CC KwSb 1280. nmot_ub_q10 -1280. 0.00 FORMAT "%5.0" /end CHARACTERISTIC
/begin CHARACTERISTIC DNSTED "Schwelle Delta Nsoll f¸r Abbruch Diagnose Tankentl¸ftung" VALUE 0x4E886C KwUb 2550. nmot_ub_q10 0.00 2550. FORMAT "%5.0" /end CHARACTERISTIC
/begin CHARACTERISTIC DRAD_VMIN "" VALUE 0x4E9C8C KwUw 100.0000 vfzg_uw_b512 0.00 100.0000 FORMAT "%8.4" /end CHARACTERISTIC
/begin CHARACTERISTIC DRISIGV "" VALUE 0x4EA978 KwUw 131070.0 r_uw_q2 0.00 131070.0 FORMAT "%8.1" /end CHARACTERISTIC
/begin CHARACTERISTIC DRLKTDP "Schwelle f¸r Last‰nderung in Kat-Diagnose" VALUE 0x4E2C21 KwSb 191.3 rel_sb_q0p75 -96.00 95.25 FORMAT "%5.2" /end CHARACTERISTIC
/begin CHARACTERISTIC DRVSIT_OFF "" VALUE 0x4EF3CA KwUw 63.99902 fak_uw_b64 0.00 63.99902 FORMAT "%8.5" /end CHARACTERISTIC
/begin CHARACTERISTIC DTEBLEIN "Hystherese f¸r Temperaturschwelle f¸r E-Box L¸fter Ansteuerung" VALUE 0x4EF00F KwUb 191.3 temp_ub_q0p75_o48 -48.00 143.3 FORMAT "%5.1" /end CHARACTERISTIC
/begin CHARACTERISTIC DTKL1530 "max. Zeit einer Spannungsabweichung an Kl. 15" VALUE 0x4EF3C3 KwUb 25.50 t100msxs_ub_b25p5 0.00 25.50 FORMAT "%5.2" /end CHARACTERISTIC
/begin CHARACTERISTIC DTMWUC "Delta Motortemperaturschwelle f¸r Erf¸llung 'warm up cycle'" VALUE 0x4E2BED KwUb 191.3 temp_ub_b191p25 0.00 191.3 FORMAT "%5.1" /end CHARACTERISTIC
/begin CHARACTERISTIC DUKL1530H "obere Grenze der Spannungsabweichung an Kl. 15" VALUE 0x4EF3C4 KwUb 4.993 spg_ubatt 0.00 4.993 FORMAT "%5.3" /end CHARACTERISTIC
/begin CHARACTERISTIC DUKL1530L "untere Grenze der Spannungsabweichung an Kl. 15" VALUE 0x4EF3C5 KwUb 16.01 spg_ubatt 0.00 16.01 FORMAT "%5.2" /end CHARACTERISTIC
/begin CHARACTERISTIC EBEN "Bypass-Hauptschalter" VALUE 0x4E2BE2 KwWU8 1.000 dez 0.00 1.000 FORMAT "%5.3" /end CHARACTERISTIC
/begin CHARACTERISTIC EBMISS_T "" VALUE 0x4E2BDE KwWU16 65535.00 dez 0.00 65535.00 FORMAT "%8.2" /end CHARACTERISTIC
/begin CHARACTERISTIC EBMISS_Y "" VALUE 0x4E2BE0 KwWU16 65535.00 dez 0.00 65535.00 FORMAT "%8.2" /end CHARACTERISTIC
/begin CHARACTERISTIC FABSALU "Abregelfaktor Beschleunigungssignal bei Schlechtwegstrecken-Erkennung" VALUE 0x4E2D24 KwUb 553.4 accgrd_ub_b555p55 0.00 553.4 FORMAT "%5.1" /end CHARACTERISTIC
/begin CHARACTERISTIC FALRKTD "" VALUE 0x4E2C22 KwUb 7.969 fak_ub_b8 0.00 7.969 FORMAT "%5.3" /end CHARACTERISTIC
/begin CHARACTERISTIC FALRKTT "" VALUE 0x4E2C23 KwUb 7.969 fak_ub_b8 0.00 7.969 FORMAT "%5.3" /end CHARACTERISTIC
/begin CHARACTERISTIC FFTAGRF "Freeze Frame Tabelle: ‹berwachung AGR-Flow" VAL_BLK 0x4EFFC4 KwbWU8 255.0 dez 0.00 255.0 FORMAT "%5.1" NUMBER 4 /end CHARACTERISTIC
/begin CHARACTERISTIC FFTDMTK "Freeze Frame Tabelle: Tankdiagnose, Feinstleck" VAL_BLK 0x4EFFF8 KwbWU8 255.0 dez 0.00 255.0 FORMAT "%5.1" NUMBER 4 /end CHARACTERISTIC
/begin CHARACTERISTIC FFTDMTL "Freeze Frame Tabelle: Tankdiagnose, Modulfehler (Hardware)" VAL_BLK 0x4EFFFC KwbWU8 255.0 dez 0.00 255.0 FORMAT "%5.1" NUMBER 4 /end CHARACTERISTIC
/begin CHARACTERISTIC FFTHSVSA "Tabelle Umweltbedingungen Heizung Lambdasonde vor Kat" VAL_BLK 0x4F0050 KwbWU8 255.0 dez 0.00 255.0 FORMAT "%5.1" NUMBER 4 /end CHARACTERISTIC
/begin CHARACTERISTIC FFTKAT2 "Freeze Frame Tabelle: Katalysator" VAL_BLK 0x4F0058 KwbWU8 255.0 dez 0.00 255.0 FORMAT "%5.1" NUMBER 4 /end CHARACTERISTIC
/begin CHARACTERISTIC FFTKATSP "Freeze Frame Tabelle: Katalysator" VAL_BLK 0x4F005C KwbWU8 255.0 dez 0.00 255.0 FORMAT "%5.1" NUMBER 4 /end CHARACTERISTIC
/begin CHARACTERISTIC FFTMDB "Freeze Frame Tabelle: Momentbegrenzung Sollmoment" VAL_BLK 0x4F00A8 KwbUb 255.0 dez 0.00 255.0 FORMAT "%5.1" NUMBER 4 /end CHARACTERISTIC
/begin CHARACTERISTIC FFTTESK "Freeze Frame Tabelle: Tankdiagnose, Kleinstleck" VAL_BLK 0x4F0118 KwbWU8 255.0 dez 0.00 255.0 FORMAT "%5.1" NUMBER 4 /end CHARACTERISTIC
/begin CHARACTERISTIC FHDLLR "Hˆhenschwelle f¸r Durchf¸hrung Diagnose Leerlaufsteller" VALUE 0x4ED6CD KwUb 3.984 fak_ub_b4 0.00 3.984 FORMAT "%5.3" /end CHARACTERISTIC
/begin CHARACTERISTIC FHODSL "minimaler Hˆhenfaktor f¸r DSLS" VALUE 0x4EF000 KwUw 3.999939 fak_uw_b4 0.00 3.999939 FORMAT "%8.6" /end CHARACTERISTIC
/begin CHARACTERISTIC FIBSALU "Filterfaktor Beschleunigungssignal bei Schlechtwegstrecken-Erkennung" VALUE 0x4E2D25 KwUb 0.9961 fak_ub_b1 0.00 0.9961 /end CHARACTERISTIC
/begin CHARACTERISTIC FMSLAMN "minimaler Adaptionsfaktor Sekund‰rluftmasse" VALUE 0x4EEFC7 KwUb 1.992 fak_ub_b2 0.00 1.992 FORMAT "%5.3" /end CHARACTERISTIC
/begin CHARACTERISTIC FMSLAMX "maximaler Adaptionsfaktor Sekund‰rluftmasse" VALUE 0x4EEFC8 KwUb 1.992 fak_ub_b2 0.00 1.992 FORMAT "%5.3" /end CHARACTERISTIC
/begin CHARACTERISTIC FRAE "Delta-fra-Schwelle f¸r Erkennung der eingeschwungenen Grundadaption" VALUE 0x4EB8CC KwUw 1.999969 fak_uw_b2 0.00 1.999969 FORMAT "%8.6" /end CHARACTERISTIC
/begin CHARACTERISTIC FRAODN "untere Diagnoseschwelle des Korrekturfaktors frao" VALUE 0x4EB8CE KwUw 1.999969 fak_uw_b2 0.00 1.999969 FORMAT "%8.6" /end CHARACTERISTIC
/begin CHARACTERISTIC FRAODX "obere Diagnoseschwelle des Korrekturfaktors frao" VALUE 0x4EB8D0 KwUw 1.999969 fak_uw_b2 0.00 1.999969 FORMAT "%8.6" /end CHARACTERISTIC
/begin CHARACTERISTIC FRAUDN "untere Diagnoseschwelle des Korrekturfaktors frau" VALUE 0x4EB8D2 KwUw 1.999969 fak_uw_b2 0.00 1.999969 FORMAT "%8.6" /end CHARACTERISTIC
/begin CHARACTERISTIC FRAUDX "obere Diagnoseschwelle des Korrekturfaktors frau" VALUE 0x4EB8D4 KwUw 1.999969 fak_uw_b2 0.00 1.999969 FORMAT "%8.6" /end CHARACTERISTIC
/begin CHARACTERISTIC FRMSTTDN "untere Diagnoseschwelle (short test)" CURVE 0x4EB8AC KlAUbSstUbWUb 1.992 fak_ub_b2 0.00 1.992 FORMAT "%5.3"
 /begin AXIS_DESCR STD_AXIS tans temp_ub_q0p75_o48 4 -48.00 143.3 FORMAT "%5.1" DEPOSIT ABSOLUTE /end AXIS_DESCR
/end CHARACTERISTIC
/begin CHARACTERISTIC FRMSTTDX "obere Diagnoseschwelle (short test)" CURVE 0x4EB8B8 KlAUbSstUbWUb 1.992 fak_ub_b2 0.00 1.992 FORMAT "%5.3"
 /begin AXIS_DESCR STD_AXIS tans temp_ub_q0p75_o48 4 -48.00 143.3 FORMAT "%5.1" DEPOSIT ABSOLUTE /end AXIS_DESCR
/end CHARACTERISTIC
/begin CHARACTERISTIC FSPHGPOS "Fehlerschwehre Positionsfehler NW" VALUE 0x4E2C04 KwWU16 65535.00 dez 0.00 65535.00 FORMAT "%8.2" /end CHARACTERISTIC
/begin CHARACTERISTIC FSPHGSIG "Fehlerschwehre Signalfehler NW nach Synchronisation" VALUE 0x4E2C06 KwWU16 65535.00 dez 0.00 65535.00 FORMAT "%8.2" /end CHARACTERISTIC
/begin CHARACTERISTIC FSWALUV "Erkennungsschwelle Schlechtwegstrecke abh‰ngig von Fz.geschwindigkeit" CURVE 0x4E2D28 KlAUbSstUbWUb 55.34 acc_ub_b55p55 0.00 55.34 FORMAT "%5.2"
 /begin AXIS_DESCR STD_AXIS vfzg vfzg_ub_q1p25 4 0.00 318.8 FORMAT "%5.1" DEPOSIT ABSOLUTE /end AXIS_DESCR
/end CHARACTERISTIC
/begin CHARACTERISTIC FSZNWF "" VALUE 0x4E2C12 KwWU8 255.0 dez 0.00 255.0 FORMAT "%5.1" /end CHARACTERISTIC
/begin CHARACTERISTIC FTETEDF "Beladungsschwelle Fettkorrektur f¸r Pr¸fung i.O." VALUE 0x4EE4BC KwSw 127.9980 fak_sw_b64 -64.00000 63.99805 FORMAT "%8.5" /end CHARACTERISTIC
/begin CHARACTERISTIC FTETEDM "Beladungsschwelle Magerkorrektur f¸r Pr¸fung i.O." VALUE 0x4EE4BE KwSw 127.9980 fak_sw_b64 -64.00000 63.99805 FORMAT "%8.5" /end CHARACTERISTIC
/begin CHARACTERISTIC HTEDU "Untere Hˆhenschwelle f¸r Durchf¸hrung Tankentl¸ftungsdiagnose" VALUE 0x4EE4B8 KwUb 3.984 fak_ub_b4 0.00 3.984 FORMAT "%5.3" /end CHARACTERISTIC
/begin CHARACTERISTIC HZNWF "" VALUE 0x4E2C13 KwWU8 255.0 dez 0.00 255.0 FORMAT "%5.1" /end CHARACTERISTIC
/begin CHARACTERISTIC IMLATDSL "min. Luftmassenfluﬂ f¸r Adaption/Zusatzdiagnose" VALUE 0x4EF002 KwUw 23.30133 m_uw_b23p3 0.00 23.30133 FORMAT "%8.5" /end CHARACTERISTIC
/begin CHARACTERISTIC IMLATDSLK "min. Luftmassenfluﬂ f¸r Kurztest" VALUE 0x4EF004 KwUw 23.30133 m_uw_b23p3 0.00 23.30133 FORMAT "%8.5" /end CHARACTERISTIC
/begin CHARACTERISTIC IMLDSL "minimale durchgestrˆmte Luftmasse" VALUE 0x4EEFC9 KwUb 0.9961 fak_ub_b1 0.00 0.9961 /end CHARACTERISTIC
/begin CHARACTERISTIC IMLKVSMX "Maximale Integrationsschwelle f¸r Fehlerfreigabe in DKVS (Tank leer)" VALUE 0x4EB8D6 KwUw 233.0133 m_q0p00355 0.00 233.0133 FORMAT "%8.4" /end CHARACTERISTIC
/begin CHARACTERISTIC IMSLADAP "" VALUE 0x4EF006 KwUw 4660.267 m_uw_b4660 0.00 4660.267 FORMAT "%8.3" /end CHARACTERISTIC
/begin CHARACTERISTIC INTEDOFS "Obere Schwelle f¸r Tankentl¸ftungsdiagnose mit FS" VALUE 0x4E8874 KwSw 16383.75 nmot_sw_q0p25 -8192.000 8191.750 FORMAT "%8.3" /end CHARACTERISTIC
/begin CHARACTERISTIC INTEDOOFS "Obere Schwelle f¸r Tankentl¸ftungsdiagnose ohne FS" VALUE 0x4E8876 KwSw 16383.75 nmot_sw_q0p25 -8192.000 8191.750 FORMAT "%8.3" /end CHARACTERISTIC
/begin CHARACTERISTIC INTEDUFS "Untere Schwelle f¸r Tankentl¸ftungsdiagnose mit FS" VALUE 0x4E8878 KwSw 16383.75 nmot_sw_q0p25 -8192.000 8191.750 FORMAT "%8.3" /end CHARACTERISTIC
/begin CHARACTERISTIC INTEDUOFS "Untere Schwelle f¸r Tankentl¸ftungsventil ohne FS" VALUE 0x4E887A KwSw 16383.75 nmot_sw_q0p25 -8192.000 8191.750 FORMAT "%8.3" /end CHARACTERISTIC
/begin CHARACTERISTIC KATBFML "Filterzeitkonstante f¸r Signald‰mpfung in Katbelastung" CURVE 0x4E2C24 GklWUb 12.7498 zk50msxs_ub_b12p8 0.0501961 12.8000 FORMAT "%7.4" /begin AXIS_DESCR COM_AXIS ml m_ub_b1020 5 0.00 1020. AXIS_PTS_REF SML05DKUB /end AXIS_DESCR /end CHARACTERISTIC
/begin CHARACTERISTIC KATBFMN "Schwellwert f¸r kleine Katalysatorbelastung" VALUE 0x4E2C29 KwUb 0.9961 fak_ub_b1 0.00 0.9961 /end CHARACTERISTIC
/begin CHARACTERISTIC KATBFN "normierter Mittelwert der Sondenamplitude" VALUE 0x4E2C2A KwUb 0.9961 fak_ub_b1 0.00 0.9961 /end CHARACTERISTIC
/begin CHARACTERISTIC KATBFNM "Normierungsfaktor multiplikativ f¸r Katbelastung" VALUE 0x4E2C2B KwUb 1.330 spg_ub_b1p33 0.00 1.330 FORMAT "%5.3" /end CHARACTERISTIC
/begin CHARACTERISTIC KATBFNP "Normierungsfaktor additiv f¸r Katbelastung" VALUE 0x4E2C2C KwUb 1.330 spg_ub_b1p33 0.00 1.330 FORMAT "%5.3" /end CHARACTERISTIC
/begin CHARACTERISTIC KATBFSX "Max. Integrationsschwelle f¸r Stoppbedingung" VALUE 0x4E2C2D KwSb 1.992 fak_sb_b1 -1.000 0.9922 FORMAT "%5.3" /end CHARACTERISTIC
/begin CHARACTERISTIC KATBFXM "Maximale Katbelastungsschwelle f¸r Stoppbedingung" CURVE 0x4E2C52 GklWSw 1023.984 freq_sw_b512 -512.0000 511.9844 FORMAT "%8.4" /begin AXIS_DESCR COM_AXIS ml m_ub_b1020 5 0.00 1020. AXIS_PTS_REF SML05DKUB /end AXIS_DESCR /end CHARACTERISTIC
/begin CHARACTERISTIC KATBSG "Katalysatorspeichergrˆﬂe f¸r Katbelastung" VALUE 0x4E2C2E KwUb 220.5 m_ub_b221p35 0.8681 221.4 FORMAT "%5.1" /end CHARACTERISTIC
/begin CHARACTERISTIC KATBSH "Offset f¸r Lambdaregelung leicht im fetten Bereich" VALUE 0x4E2C2F KwUb 221.4 mgrad_ub_b221p35 0.00 221.4 FORMAT "%5.1" /end CHARACTERISTIC
/begin CHARACTERISTIC KATBSHF "Verst‰rkungsfaktor f¸r Regellagendifferenz" VALUE 0x4E2C30 KwUb 2653. mgrad_ub_b2652p5 0.00 2653. FORMAT "%5.0" /end CHARACTERISTIC
/begin CHARACTERISTIC KATBSHG "Begrenzungsfaktor der Regellagenkorrektur" VALUE 0x4E2C31 KwUb 0.9961 fak_ub_b1 0.00 0.9961 /end CHARACTERISTIC
/begin CHARACTERISTIC KFTPKOR "" MAP 0x4EA920 KfAxUbAyUbSstxUbSstyUbWUb 1.992 fak_ub_b2 0.00 1.992 FORMAT "%5.3"
 /begin AXIS_DESCR STD_AXIS nmot nmot_ub_q40 8 0.00 10200. FORMAT "%5.0" DEPOSIT ABSOLUTE /end AXIS_DESCR
 /begin AXIS_DESCR STD_AXIS rl rel_ub_q0p75 7 0.00 191.3 FORMAT "%5.1" DEPOSIT ABSOLUTE /end AXIS_DESCR
/end CHARACTERISTIC
/begin CHARACTERISTIC KILLERRCLZ "Anzahl der pos. Diagnosenphasen zur Fehlerloeschung" VALUE 0x4EF3C1 KwUb 255.0 dez 0.00 255.0 FORMAT "%5.1" /end CHARACTERISTIC
/begin CHARACTERISTIC KILLSIG100 "max. zulaessige Pegelwechselanzahl" VALUE 0x4EF3C2 KwUb 255.0 dez 0.00 255.0 FORMAT "%5.1" /end CHARACTERISTIC
/begin CHARACTERISTIC KL15ERRCLZ "Anzahl der pos. Diagnosenphasen zur Fehlerloeschung" VALUE 0x4EF3C6 KwUb 255.0 dez 0.00 255.0 FORMAT "%5.1" /end CHARACTERISTIC
/begin CHARACTERISTIC KRFHKS "Fehlerh‰ufigkeit Klopfsensoren" VALUE 0x4ED000 KwUb 255.0 dez 0.00 255.0 FORMAT "%5.1" /end CHARACTERISTIC
/begin CHARACTERISTIC KRFHT "Fehlerh‰ufigkeit Testimpuls" VALUE 0x4E5571 KwUb 254.0 dez 1.000 255.0 FORMAT "%5.1" /end CHARACTERISTIC
/begin CHARACTERISTIC KUPPLFEVFZ "Einstellbare Zeit bis zum Eintragen eines Fehlers" VALUE 0x4E2D1E KwUb 25.50 t100msxs_ub_b25p5 0.00 25.50 FORMAT "%5.2" /end CHARACTERISTIC
/begin CHARACTERISTIC KUPPLHESW "Einstellbare Zeit bis zur Heilung eines Fehlers" VALUE 0x4E2D1F KwUb 25.50 t100msxs_ub_b25p5 0.00 25.50 FORMAT "%5.2" /end CHARACTERISTIC
/begin CHARACTERISTIC KW_EepromChangedSaveEnable "" VALUE 0x4EA0F7 KwUb 1.000 dez 0.00 1.000 FORMAT "%5.3" /end CHARACTERISTIC
/begin CHARACTERISTIC KW_tsgEepMax "" VALUE 0x4EA0F8 KwUb 191.3 temp_ub_q0p75_o48 -48.00 143.3 FORMAT "%5.1" /end CHARACTERISTIC
/begin CHARACTERISTIC KW_ubEepMin "" VALUE 0x4EA0F9 KwUb 24.02 spg_ubatt 0.00 24.02 FORMAT "%5.2" /end CHARACTERISTIC
/begin CHARACTERISTIC LPHGHYS "Hyterrese Fehlerschwehrewert NWG-Diagnose" VALUE 0x4E2C08 KwWU16 65535.00 dez 0.00 65535.00 FORMAT "%8.2" /end CHARACTERISTIC
/begin CHARACTERISTIC LPHGMX "Max Fehlerschwehrewert NWG-Diagnose" VALUE 0x4E2C0A KwWU16 65535.00 dez 0.00 65535.00 FORMAT "%8.2" /end CHARACTERISTIC
/begin CHARACTERISTIC LPHNWFHYS "" VALUE 0x4E2C14 KwWU8 255.0 dez 0.00 255.0 FORMAT "%5.1" /end CHARACTERISTIC
/begin CHARACTERISTIC LPHNWFMX "" VALUE 0x4E2C15 KwWU8 255.0 dez 0.00 255.0 FORMAT "%5.1" /end CHARACTERISTIC
/begin CHARACTERISTIC LSHVKEFA "Entprellung Fehlerz‰hler Endstufendiagnose LSHVK" VAL_BLK 0x4E2D98 KwbUb 255.0 dez 0.00 255.0 FORMAT "%5.1" NUMBER 2 /end CHARACTERISTIC
/begin CHARACTERISTIC MLDKVSF "Luftmassenschwelle f¸r Fehlerfreigabe im DKVS (Tank leer)" VALUE 0x4EB8D8 KwUw 233.0133 m_q0p00355 0.00 233.0133 FORMAT "%8.4" /end CHARACTERISTIC
/begin CHARACTERISTIC MLDKVSG "Luftmassenschwelle f¸r Fehlerfreigabe Tank leer" VALUE 0x4EB8DA KwUw 233.0133 m_q0p00355 0.00 233.0133 FORMAT "%8.4" /end CHARACTERISTIC
/begin CHARACTERISTIC MLDSLAMN "" VALUE 0x4EEFCA KwUb 1020. m_ub_b1020 0.00 1020. FORMAT "%5.0" /end CHARACTERISTIC
/begin CHARACTERISTIC MLDSLAMX "" VALUE 0x4EEFCB KwUb 1020. m_ub_b1020 0.00 1020. FORMAT "%5.0" /end CHARACTERISTIC
/begin CHARACTERISTIC MLDSLKMN "" VALUE 0x4EEFCC KwUb 1020. m_ub_b1020 0.00 1020. FORMAT "%5.0" /end CHARACTERISTIC
/begin CHARACTERISTIC MLDSLKMX "" VALUE 0x4EEFCD KwUb 1020. m_ub_b1020 0.00 1020. FORMAT "%5.0" /end CHARACTERISTIC
/begin CHARACTERISTIC MLDSLMN "" VALUE 0x4EEFCE KwUb 1020. m_ub_b1020 0.00 1020. FORMAT "%5.0" /end CHARACTERISTIC
/begin CHARACTERISTIC MLDSLMX "" VALUE 0x4EEFCF KwUb 1020. m_ub_b1020 0.00 1020. FORMAT "%5.0" /end CHARACTERISTIC
/begin CHARACTERISTIC MLDSLOMN "" VALUE 0x4EEFD0 KwUb 1020. m_ub_b1020 0.00 1020. FORMAT "%5.0" /end CHARACTERISTIC
/begin CHARACTERISTIC MLDSLOMX "" VALUE 0x4EEFD1 KwUb 1020. m_ub_b1020 0.00 1020. FORMAT "%5.0" /end CHARACTERISTIC
/begin CHARACTERISTIC MSLBAS "Ini.- Sekund‰rluftmasse" VALUE 0x4EEFD2 KwUb 102.0 m_q0p4 0.00 102.0 FORMAT "%5.1" /end CHARACTERISTIC
/begin CHARACTERISTIC MSLVMX "Diagnoseschwelle f¸r Ventildichtheitspr¸fung" VALUE 0x4EEFD3 KwUb 102.0 m_q0p4 0.00 102.0 FORMAT "%5.1" /end CHARACTERISTIC
/begin CHARACTERISTIC NDKSO "Obere Diagnoseschwelle f¸r Klopfsensordiagnose" VALUE 0x4E556C KwWU8 10200. nmot_ub_q40 0.00 10200. FORMAT "%5.0" /end CHARACTERISTIC
/begin CHARACTERISTIC NDKSU "Untere Diagnoseschwelle f¸r Klopfsensordiagnose" VALUE 0x4E556D KwWU8 10200. nmot_ub_q40 0.00 10200. FORMAT "%5.0" /end CHARACTERISTIC
/begin CHARACTERISTIC NDKTSO "Obere Drehzahlgrenze f¸r DKAT-aktiv" VALUE 0x4E2C32 KwUb 10200. nmot_ub_q40 0.00 10200. FORMAT "%5.0" /end CHARACTERISTIC
/begin CHARACTERISTIC NDKTSOT "Obere Drehzahlgrenze f¸r Funktionsanforderung" VALUE 0x4E2C33 KwUb 10200. nmot_ub_q40 0.00 10200. FORMAT "%5.0" /end CHARACTERISTIC
/begin CHARACTERISTIC NDKTSU "untere Drehzahlgrenze f¸r DKAT-aktiv" VALUE 0x4E2C34 KwUb 10200. nmot_ub_q40 0.00 10200. FORMAT "%5.0" /end CHARACTERISTIC
/begin CHARACTERISTIC NDKTSUT "Untere Drehzahlgrenze f¸r Funktionsanforderung" VALUE 0x4E2C35 KwUb 10200. nmot_ub_q40 0.00 10200. FORMAT "%5.0" /end CHARACTERISTIC
/begin CHARACTERISTIC NEPH "" VALUE 0x4E2C16 KwWU8 10200. nmot_ub_q40 0.00 10200. FORMAT "%5.0" /end CHARACTERISTIC
/begin CHARACTERISTIC NKTDX "Maximale Drehzahlgrenze DKAT f¸r Berechnung" VALUE 0x4E2C36 KwUb 10200. nmot_ub_q40 0.00 10200. FORMAT "%5.0" /end CHARACTERISTIC
/begin CHARACTERISTIC NKUPPDIAG "" VALUE 0x4E2D20 KwUw 2200.000 nmot_uw_q0p25 1800.000 4000.000 FORMAT "%8.3" /end CHARACTERISTIC
/begin CHARACTERISTIC NMOTKL15 "NMOT-Grenze zum Start der Diagnose Klemme 15 Schalter" VALUE 0x4EF3C7 KwUb 10200. nmot_ub_q40 0.00 10200. FORMAT "%5.0" /end CHARACTERISTIC
/begin CHARACTERISTIC NMXTHS "Maximale Motordrehzahl f¸r DTHS" VALUE 0x4EF00B KwWU8 10200. nmot_ub_q40 0.00 10200. FORMAT "%5.0" /end CHARACTERISTIC
/begin CHARACTERISTIC NSTEDMX "Maximale Solldrehzahl-Schwelle f¸r Tankentl¸ftungsdiagnose" VALUE 0x4E886D KwUb 2550. nmot_ub_q10 0.00 2550. FORMAT "%5.0" /end CHARACTERISTIC
/begin CHARACTERISTIC NTPKTO "" VALUE 0x4E2C62 KwUb 10200. nmot_ub_q40 0.00 10200. FORMAT "%5.0" /end CHARACTERISTIC
/begin CHARACTERISTIC NTPKTU "" VALUE 0x4E2C63 KwUb 10200. nmot_ub_q40 0.00 10200. FORMAT "%5.0" /end CHARACTERISTIC
/begin CHARACTERISTIC NTPVKO "" VALUE 0x4E2C64 KwUb 10200. nmot_ub_q40 0.00 10200. FORMAT "%5.0" /end CHARACTERISTIC
/begin CHARACTERISTIC NTPVKU "" VALUE 0x4E2C65 KwUb 10200. nmot_ub_q40 0.00 10200. FORMAT "%5.0" /end CHARACTERISTIC
/begin CHARACTERISTIC NWE1POSRMN "max Fenster fuer Erkennung rueckwaertsdrehende NW" VALUE 0x4E2C0C KwWU16 6554. sprzi_q0p1 0.00 6554. FORMAT "%2.0" /end CHARACTERISTIC
/begin CHARACTERISTIC NWE1POSRMX "max Fenster fuer Erkennung rueckwaertsdrehende NW" VALUE 0x4E2C0E KwWU16 6554. sprzi_q0p1 0.00 6554. FORMAT "%2.0" /end CHARACTERISTIC
/begin CHARACTERISTIC PM_DS_NEG "" CURVE 0x4E9828 KlAUwSstUwWUw 65535.00 dez 0.00 65535.00 FORMAT "%8.2"
 /begin AXIS_DESCR STD_AXIS roadtype_w fak_uw_b16 7 0.00 15.99976 FORMAT "%8.5" DEPOSIT ABSOLUTE /end AXIS_DESCR
/end CHARACTERISTIC
/begin CHARACTERISTIC PM_DS_POS "" CURVE 0x4E9846 KlAUwSstUwWUw 65535.00 dez 0.00 65535.00 FORMAT "%8.2"
 /begin AXIS_DESCR STD_AXIS roadtype_w fak_uw_b16 7 0.00 15.99976 FORMAT "%8.5" DEPOSIT ABSOLUTE /end AXIS_DESCR
/end CHARACTERISTIC
/begin CHARACTERISTIC PM_D_S_Z1 "" MAP 0x4EF3CC KfAxUwAyUwSstxUwSstyUwWUw 63.99902 fak_uw_b64 0.00 63.99902 FORMAT "%8.5"
 /begin AXIS_DESCR STD_AXIS v_vradabs vfzg_uw_q0p00781 8 0.00 511.9922 FORMAT "%8.4" DEPOSIT ABSOLUTE /end AXIS_DESCR
 /begin AXIS_DESCR STD_AXIS roadtype_w fak_uw_b16 7 0.00 15.99976 FORMAT "%8.5" DEPOSIT ABSOLUTE /end AXIS_DESCR
/end CHARACTERISTIC
/begin CHARACTERISTIC PM_D_S_Z2 "" MAP 0x4EF45E KfAxUwAyUwSstxUwSstyUwWUw 63.99902 fak_uw_b64 0.00 63.99902 FORMAT "%8.5"
 /begin AXIS_DESCR STD_AXIS v_vradabs vfzg_uw_q0p00781 8 0.00 511.9922 FORMAT "%8.4" DEPOSIT ABSOLUTE /end AXIS_DESCR
 /begin AXIS_DESCR STD_AXIS roadtype_w fak_uw_b16 7 0.00 15.99976 FORMAT "%8.5" DEPOSIT ABSOLUTE /end AXIS_DESCR
/end CHARACTERISTIC
/begin CHARACTERISTIC PM_D_S_ZA "" CURVE 0x4E9864 KlAUwSstUwWUw 0.9999847 fak_uw_b1 0.00 0.9999847 FORMAT "%9.7"
 /begin AXIS_DESCR STD_AXIS gearatio_w fak_uw_b16 2 0.00 15.99976 FORMAT "%8.5" DEPOSIT ABSOLUTE /end AXIS_DESCR
/end CHARACTERISTIC
/begin CHARACTERISTIC PM_TAN_Z1 "" MAP 0x4EF4F0 KfAxUwAyUwSstxSwSstyUwWUw 63.99902 fak_uw_b64 0.00 63.99902 FORMAT "%8.5"
 /begin AXIS_DESCR STD_AXIS dk_pos_asc relDK_q0p02441 8 -800.0000 799.9756 FORMAT "%8.4" DEPOSIT ABSOLUTE /end AXIS_DESCR
 /begin AXIS_DESCR STD_AXIS roadtype_w fak_uw_b16 3 0.00 15.99976 FORMAT "%8.5" DEPOSIT ABSOLUTE /end AXIS_DESCR
/end CHARACTERISTIC
/begin CHARACTERISTIC PM_TAN_Z2 "" MAP 0x4EF53A KfAxUwAyUwSstxSwSstyUwWUw 63.99902 fak_uw_b64 0.00 63.99902 FORMAT "%8.5"
 /begin AXIS_DESCR STD_AXIS dk_pos_asc relDK_q0p02441 8 -800.0000 799.9756 FORMAT "%8.4" DEPOSIT ABSOLUTE /end AXIS_DESCR
 /begin AXIS_DESCR STD_AXIS roadtype_w fak_uw_b16 3 0.00 15.99976 FORMAT "%8.5" DEPOSIT ABSOLUTE /end AXIS_DESCR
/end CHARACTERISTIC
/begin CHARACTERISTIC PM_TAN_ZA "" CURVE 0x4E986E KlAUwSstSwWUw 0.9999847 fak_uw_b1 0.00 0.9999847 FORMAT "%9.7"
 /begin AXIS_DESCR STD_AXIS rai_w wink_uw_q0p1 2 -3276.800 3276.700 FORMAT "%8.3" DEPOSIT ABSOLUTE /end AXIS_DESCR
/end CHARACTERISTIC
/begin CHARACTERISTIC RISIGRESV "" VALUE 0x4EA97A KwUw 131070.0 r_uw_q2 0.00 131070.0 FORMAT "%8.1" /end CHARACTERISTIC
/begin CHARACTERISTIC RKAE "Delta rkat- bzw. rkaz-Schwelle f¸r Erkennung der eingeschwungenen Grundadaption" VALUE 0x4EB8DC KwSw 3071.953 rel_sw_b1536 -1536.000 1535.953 FORMAT "%8.3" /end CHARACTERISTIC
/begin CHARACTERISTIC RKATDN "untere Diagnoseschwelle additive Korrektur pro Zeit" VALUE 0x4EB8DE KwSw 3071.953 rel_sw_b1536 -1536.000 1535.953 FORMAT "%8.3" /end CHARACTERISTIC
/begin CHARACTERISTIC RKATDX "obere Diagnoseschwelle additive Korrektur pro Zeit" VALUE 0x4EB8E0 KwSw 3071.953 rel_sw_b1536 -1536.000 1535.953 FORMAT "%8.3" /end CHARACTERISTIC
/begin CHARACTERISTIC RKAZDN "untere Diagnoseschwelle additive Korrektur pro Z¸ndung" VALUE 0x4EB8E2 KwSw 3071.953 rel_sw_b1536 -1536.000 1535.953 FORMAT "%8.3" /end CHARACTERISTIC
/begin CHARACTERISTIC RKAZDX "obere Diagnoseschwelle additive Korrektur pro Z¸ndung" VALUE 0x4EB8E4 KwSw 3071.953 rel_sw_b1536 -1536.000 1535.953 FORMAT "%8.3" /end CHARACTERISTIC
/begin CHARACTERISTIC RLDKTOT "Obere Lastgrenze f¸r Funktionsanforderung" VALUE 0x4E2C37 KwUb 191.3 rel_ub_q0p75 0.00 191.3 FORMAT "%5.1" /end CHARACTERISTIC
/begin CHARACTERISTIC RLDKTSO "Obere Lastkennlinie f¸r DKAT-aktiv" CURVE 0x4E2C38 GklWUb 191.3 rel_ub_q0p75 0.00 191.3 FORMAT "%5.1"
 /begin AXIS_DESCR COM_AXIS nmot nmot_ub_q40 5 0.00 10200. AXIS_PTS_REF SNM05DKUB /end AXIS_DESCR
/end CHARACTERISTIC
/begin CHARACTERISTIC RLDKTSU "Untere Lastkennlinie f¸r DKAT-aktiv" CURVE 0x4E2C40 GklWUb 191.3 rel_ub_q0p75 0.00 191.3 FORMAT "%5.1"
 /begin AXIS_DESCR COM_AXIS nmot nmot_ub_q40 5 0.00 10200. AXIS_PTS_REF SNM05DKUB /end AXIS_DESCR
/end CHARACTERISTIC
/begin CHARACTERISTIC RLDKTUT "Untere Lastgrenze f¸r Funktionsanforderung" VALUE 0x4E2C45 KwUb 191.3 rel_ub_q0p75 0.00 191.3 FORMAT "%5.1" /end CHARACTERISTIC
/begin CHARACTERISTIC RLDLLR "F¸llungsschwelle f¸r Diagnose LLR" VALUE 0x4ED6CE KwUb 99.75 rel_ub_q0p75 0.00 99.75 FORMAT "%5.2" /end CHARACTERISTIC
/begin CHARACTERISTIC RLTEDMX "Maximale rl-Schwelle f¸r Tankentl¸ftungsdiagnose" VALUE 0x4E886E KwUb 191.3 rel_ub_q0p75 0.00 191.3 FORMAT "%5.1" /end CHARACTERISTIC
/begin CHARACTERISTIC RLTPKTO "" VALUE 0x4E2C66 KwUb 191.3 rel_ub_q0p75 0.00 191.3 FORMAT "%5.1" /end CHARACTERISTIC
/begin CHARACTERISTIC RLTPKTU "" VALUE 0x4E2C67 KwUb 191.3 rel_ub_q0p75 0.00 191.3 FORMAT "%5.1" /end CHARACTERISTIC
/begin CHARACTERISTIC RLTPVKO "" VALUE 0x4E2C68 KwUb 191.3 rel_ub_q0p75 0.00 191.3 FORMAT "%5.1" /end CHARACTERISTIC
/begin CHARACTERISTIC RLTPVKU "" VALUE 0x4E2C69 KwUb 191.3 rel_ub_q0p75 0.00 191.3 FORMAT "%5.1" /end CHARACTERISTIC
/begin CHARACTERISTIC RMSLADA "" VALUE 0x4EEFD4 KwUb 1.992 fak_ub_b2 0.00 1.992 FORMAT "%5.3" /end CHARACTERISTIC
/begin CHARACTERISTIC RMSLMN "Diagnoseschwelle: verringerte Sekund‰rluftmasse (Fehlerhaft)" VALUE 0x4EEFD5 KwUb 1.992 fak_ub_b2 0.00 1.992 FORMAT "%5.3" /end CHARACTERISTIC
/begin CHARACTERISTIC RMSLPMN "Diagnoseschwelle: Fehler Sekund‰rluftpumpe, nur Pulse Air" VALUE 0x4EEFD6 KwUb 1.992 fak_ub_b2 0.00 1.992 FORMAT "%5.3" /end CHARACTERISTIC
/begin CHARACTERISTIC RMSLTMN "Schwelle: sehr geringe Sekund‰rluftmasse, ohne Offset" VALUE 0x4EEFD7 KwUb 1.992 fak_ub_b2 0.00 1.992 FORMAT "%5.3" /end CHARACTERISTIC
/begin CHARACTERISTIC SAFK1 "Filterkonstante 1 f¸r Lambdasonden-Signalausgabe" VALUE 0x4EA91A KwUw 0.9999847 fak_uw_b1 0.00 0.9999847 FORMAT "%9.7" /end CHARACTERISTIC
/begin CHARACTERISTIC SAFK2 "Filterkonstante 2 f¸r Lambdasonden-Signalausgabe" VALUE 0x4EA90E KwUb 0.9961 fak_ub_b1 0.00 0.9961 /end CHARACTERISTIC
/begin CHARACTERISTIC SLVEFA "Entprellung Fehlerz‰hler Endstufendiagnose SLV" VAL_BLK 0x4E2D90 KwbUb 255.0 dez 0.00 255.0 FORMAT "%5.1" NUMBER 1 /end CHARACTERISTIC
/begin AXIS_PTS SML05DKUB "" 0x4E2A78 ml SstAUbSstUb 1020. m_ub_b1020 5 0.00 1020. FORMAT "%5.0" DEPOSIT ABSOLUTE /end AXIS_PTS
/begin AXIS_PTS SNM05DKUB "" 0x4E2A98 nmot SstAUbSstUb 10200. nmot_ub_q40 5 0.00 10200. FORMAT "%5.0" DEPOSIT ABSOLUTE /end AXIS_PTS
/begin CHARACTERISTIC SPI_PROT_STOP "" VALUE 0x4E2D58 KwUb 255.0 dez 0.00 255.0 FORMAT "%5.1" /end CHARACTERISTIC
/begin CHARACTERISTIC SRYHS "Schwelle f¸r Readiness-Bildung Sondenheizungs-Diagnose" VALUE 0x4E2BE5 KwUb 255.0 dez 0.00 255.0 FORMAT "%5.1" /end CHARACTERISTIC
/begin CHARACTERISTIC SRYKAT "Schwelle f¸r Readiness-Bildung Katalysator-Diagnose" VALUE 0x4E2BE6 KwUb 255.0 dez 0.00 255.0 FORMAT "%5.1" /end CHARACTERISTIC
/begin CHARACTERISTIC SRYLS "Schwelle f¸r Readiness-Bildung Lambdasonden-Diagnose" VALUE 0x4E2BE7 KwUb 255.0 dez 0.00 255.0 FORMAT "%5.1" /end CHARACTERISTIC
/begin CHARACTERISTIC SRYSLS "Schwelle f¸r Readiness-Bildung Sekund‰rluft-Diagnose" VALUE 0x4E2BE8 KwUb 255.0 dez 0.00 255.0 FORMAT "%5.1" /end CHARACTERISTIC
/begin CHARACTERISTIC SRYTES "Schwelle f¸r Readiness-Bildung Tankentl¸ftungs-Diagnose" VALUE 0x4EA2D2 KwUb 255.0 dez 0.00 255.0 FORMAT "%5.1" /end CHARACTERISTIC
/begin CHARACTERISTIC SSTEFA "" VAL_BLK 0x4E2DA0 KwbUb 255.0 dez 0.00 255.0 FORMAT "%5.1" NUMBER 1 /end CHARACTERISTIC
/begin CHARACTERISTIC STARTEFA "Entprellung Fehlerz‰hler Endstufendiagnose START" VAL_BLK 0x4E2DA8 KwbUb 255.0 dez 0.00 255.0 FORMAT "%5.1" NUMBER 1 /end CHARACTERISTIC
/begin CHARACTERISTIC STP_FSW_IN "" VAL_BLK 0x4EA9D4 KwbWU8 255.0 dez 0.00 255.0 FORMAT "%5.1" NUMBER 8 /end CHARACTERISTIC
/begin CHARACTERISTIC STP_FSW_OUT "" VAL_BLK 0x4EA9DC KwbWU8 255.0 dez 0.00 255.0 FORMAT "%5.1" NUMBER 8 /end CHARACTERISTIC
/begin CHARACTERISTIC TABGMCSD "Abgastemperaturschwelle f¸r CSD-Messung" VALUE 0x4E2C7A KwUb 1275. temp_ub_q5_o50 -50.00 1225. FORMAT "%5.0" /end CHARACTERISTIC
/begin CHARACTERISTIC TABGMSLAD "" VALUE 0x4EEFD8 KwUb 1275. temp_ub_q5_o50 -50.00 1225. FORMAT "%5.0" /end CHARACTERISTIC
/begin CHARACTERISTIC TADLLR "Ansauglufttemperaturschwelle f¸r Diagnose Leerlaufsteller" VALUE 0x4ED6CF KwUb 191.3 temp_ub_q0p75_o48 -48.00 143.3 FORMAT "%5.1" /end CHARACTERISTIC
/begin CHARACTERISTIC TANDSLMN "min. Ansauglufttemperatur f¸r SL- Diagnose" VALUE 0x4EEFD9 KwUb 191.3 temp_ub_q0p75_o48 -48.00 143.3 FORMAT "%5.1" /end CHARACTERISTIC
/begin CHARACTERISTIC TANDSLMX "max. Ansauglufttemperatur f¸r SL- Diagnose" VALUE 0x4EEFDA KwUb 191.3 temp_ub_q0p75_o48 -48.00 143.3 FORMAT "%5.1" /end CHARACTERISTIC
/begin CHARACTERISTIC TASIG "Zeit f¸r Ausblendung von Stˆrspitzen auﬂerhalb Band f¸r Erk. Signalunterbrechung" VALUE 0x4E2C7B KwUb 5.100 t20msxs_ub_b5p1 0.00 5.100 FORMAT "%5.3" /end CHARACTERISTIC
/begin CHARACTERISTIC TBTEVIO "Verzˆgerungszeit f¸r Beladungpr¸fung TEV i.O. Erkennung" VALUE 0x4EE4B9 KwUb 25.50 t100msxs_ub_b25p5 0.00 25.50 FORMAT "%5.2" /end CHARACTERISTIC
/begin CHARACTERISTIC TC6CSL "Mode 6: Component ID f¸r Pr¸fung Sekund‰rluftsystem" VALUE 0x4EEFDB KwUb 127.0 dez 0.00 127.0 FORMAT "%5.1" /end CHARACTERISTIC
/begin CHARACTERISTIC TC6CSL2 "Mode 6: Component ID f¸r Pr¸fung Sekund‰rluftsystem, Bank 2" VALUE 0x4EEFDC KwUb 127.0 dez 0.00 127.0 FORMAT "%5.1" /end CHARACTERISTIC
/begin CHARACTERISTIC TC6CSLN "Mode 6: Component ID f¸r Pr¸fung minimale Sekund‰rluft in Phase 1" VALUE 0x4EEFDD KwUb 127.0 dez 0.00 127.0 FORMAT "%5.1" /end CHARACTERISTIC
/begin CHARACTERISTIC TC6CSLN2 "Mode 6: Component ID f¸r Pr¸fung minimale Sekund‰rluft in Phase 1, Bank 2" VALUE 0x4EEFDE KwUb 127.0 dez 0.00 127.0 FORMAT "%5.1" /end CHARACTERISTIC
/begin CHARACTERISTIC TC6CSLV "Mode 6: Component ID f¸r Pr¸fung Dichtheit SL-Ventil" VALUE 0x4EEFDF KwUb 127.0 dez 0.00 127.0 FORMAT "%5.1" /end CHARACTERISTIC
/begin CHARACTERISTIC TC6CSLV2 "Mode 6: Component ID f¸r Pr¸fung Dichtheit SL-Ventil, Bank 2" VALUE 0x4EEFE0 KwUb 127.0 dez 0.00 127.0 FORMAT "%5.1" /end CHARACTERISTIC
/begin CHARACTERISTIC TDDMLS "" VALUE 0x4E971C KwWU16 6553.500 t100msxs_uw_b6553p5 0.00 6553.500 FORMAT "%8.3" /end CHARACTERISTIC
/begin CHARACTERISTIC TDEFA "" VAL_BLK 0x4E2D70 KwbUb 255.0 dez 0.00 255.0 FORMAT "%5.1" NUMBER 1 /end CHARACTERISTIC
/begin CHARACTERISTIC TDHDMLS "" VALUE 0x4E971E KwWU16 65535.00 t1sxs_uw_b65535 0.00 65535.00 FORMAT "%8.2" /end CHARACTERISTIC
/begin CHARACTERISTIC TDHKILL "Zeit f¸r Fehlerheilung Killschalter" VALUE 0x4E9756 KwWU16 655.3500 t10msxs_uw_b655p35 0.00 655.3500 FORMAT "%8.4" /end CHARACTERISTIC
/begin CHARACTERISTIC TDHKL15 "Zeit f¸r Fehlerheilung des Klemme 15 Schalter" VALUE 0x4E975A KwWU16 65535.00 t1sxs_uw_b65535 0.00 65535.00 FORMAT "%8.2" /end CHARACTERISTIC
/begin CHARACTERISTIC TDHSST "Zeit f¸r Fehlerheilung Seitenstuetzenschalter" VALUE 0x4E972A KwWU16 6553.500 t100msxs_uw_b6553p5 0.00 6553.500 FORMAT "%8.3" /end CHARACTERISTIC
/begin CHARACTERISTIC TDKATAKT "Schwellwert Zyklus fertig wenn aktive ‹berwachungszeit > TDKATAKT" VALUE 0x4E2C5C KwUw 3276.750 t50msxs_uw_b3276p75 0.00 3276.750 FORMAT "%8.3" /end CHARACTERISTIC
/begin CHARACTERISTIC TDKATATT "Schwellwert Zyklus fertig f¸r Funktionsanforderung" VALUE 0x4E2C5E KwUw 3276.750 t50msxs_uw_b3276p75 0.00 3276.750 FORMAT "%8.3" /end CHARACTERISTIC
/begin CHARACTERISTIC TDKILL "Zeit f¸r Fehlererkennung Killschalter" VALUE 0x4E9758 KwWU16 655.3500 t10msxs_uw_b655p35 0.00 655.3500 FORMAT "%8.4" /end CHARACTERISTIC
/begin CHARACTERISTIC TDKL15 "Zeit f¸r Fehlererkennung Klemme 15 Schalter" VALUE 0x4E975C KwWU16 6553.500 t100msxs_uw_b6553p5 0.00 6553.500 FORMAT "%8.3" /end CHARACTERISTIC
/begin CHARACTERISTIC TDLLR "Wartezeit bis setzten der Bedingung Diagnose Leerlaufsteller" VALUE 0x4ED6D2 KwUw 255.0000 t200msxs_ub_b51 0.00 255.0000 FORMAT "%8.4" /end CHARACTERISTIC
/begin CHARACTERISTIC TDLLRMN "Wartezeit bis Fehlereintrag Steller geschlossen" VALUE 0x4ED6D4 KwUw 255.0000 t200msxs_ub_b51 0.00 255.0000 FORMAT "%8.4" /end CHARACTERISTIC
/begin CHARACTERISTIC TDLLRMX "Wartezeit bis Fehlereintrag Steller offen" VALUE 0x4ED6D6 KwUw 255.0000 t200msxs_ub_b51 0.00 255.0000 FORMAT "%8.4" /end CHARACTERISTIC
/begin CHARACTERISTIC TDLLRNF "Wartezeit bis Meldung kein Fehler bei Leerlaufsteller" VALUE 0x4ED6D8 KwUw 255.0000 t200msxs_ub_b51 0.00 255.0000 FORMAT "%8.4" /end CHARACTERISTIC
/begin CHARACTERISTIC TDMSLMN1 "Mindestmeﬂzeit Sekund‰rluftmasse, Phase 1" VALUE 0x4EEFE1 KwUb 25.50 t100msxs_ub_b25p5 0.00 25.50 FORMAT "%5.2" /end CHARACTERISTIC
/begin CHARACTERISTIC TDMSLMN4 "Mindestmeﬂzeit Sekund‰rluftmasse, Phase 4" VALUE 0x4EEFE2 KwUb 25.50 t100msxs_ub_b25p5 0.00 25.50 FORMAT "%5.2" /end CHARACTERISTIC
/begin CHARACTERISTIC TDMSLMNK "Mindestmeﬂzeit Sekund‰rluftmasse, Phase 1 bei Kurztest" VALUE 0x4EEFE3 KwUb 25.50 t100msxs_ub_b25p5 0.00 25.50 FORMAT "%5.2" /end CHARACTERISTIC
/begin CHARACTERISTIC TDMSLOF3 "Meﬂzeit Offset Sekund‰rluftmasse, Phase 3" VALUE 0x4EEFE4 KwUb 25.50 t100msxs_ub_b25p5 0.00 25.50 FORMAT "%5.2" /end CHARACTERISTIC
/begin CHARACTERISTIC TDMSLOF5 "Meﬂzeit Offset sekund‰rluftmasse, Phase 5" VALUE 0x4EEFE5 KwUb 25.50 t100msxs_ub_b25p5 0.00 25.50 FORMAT "%5.2" /end CHARACTERISTIC
/begin CHARACTERISTIC TDMSLOFK "Meﬂzeit Offset Sekund‰rluftmasse, Phase 3 bei Kurztest" VALUE 0x4EEFE6 KwUb 25.50 t100msxs_ub_b25p5 0.00 25.50 FORMAT "%5.2" /end CHARACTERISTIC
/begin CHARACTERISTIC TDMSLV "Messzeit f¸r Ventildichtheitspr¸fung" VALUE 0x4EEFE7 KwUb 25.50 t100msxs_ub_b25p5 0.00 25.50 FORMAT "%5.2" /end CHARACTERISTIC
/begin CHARACTERISTIC TDMSLVK "Meﬂzeit f¸r Ventildichtheitspr¸fung bei Kurztest" VALUE 0x4EEFE8 KwUb 25.50 t100msxs_ub_b25p5 0.00 25.50 FORMAT "%5.2" /end CHARACTERISTIC
/begin CHARACTERISTIC TDPHSLOF "Zeit Einschaltverzˆgerung Bit B_slsoff in Phase 2, 3 und 5 nach" VALUE 0x4EEFE9 KwUb 25.50 t100msxs_ub_b25p5 0.00 25.50 FORMAT "%5.2" /end CHARACTERISTIC
/begin CHARACTERISTIC TDRADV "" VALUE 0x4E9C8E KwUw 100.0000 t10msxs_sb_q0p01 0.00 100.0000 FORMAT "%8.4" /end CHARACTERISTIC
/begin CHARACTERISTIC TDSLMVBA "Einschaltverzˆgerung BA-/VA-Sperre bei Bildung B_dslmes" VALUE 0x4EEFEA KwUb 25.50 t100msxs_ub_b25p5 0.00 25.50 FORMAT "%5.2" /end CHARACTERISTIC
/begin CHARACTERISTIC TDSST "" VALUE 0x4E972C KwWU16 655.3500 t10msxs_uw_b655p35 0.00 655.3500 FORMAT "%8.4" /end CHARACTERISTIC
/begin CHARACTERISTIC TDSSTWE "" VALUE 0x4EF389 KwUb 2.550 t10msxs_ub_b2p55 0.00 2.550 FORMAT "%5.3" /end CHARACTERISTIC
/begin CHARACTERISTIC TDUDIAG "" VALUE 0x4EA9CD KwUb 25.40 t100msxs_ub_b25p5 0.1000 25.50 FORMAT "%5.2" /end CHARACTERISTIC
/begin CHARACTERISTIC TDV "Fehlererkennung Tachosignal / Zeitdauer f¸r Abfrage" VALUE 0x4EA9CB KwUb 12.75 t50msxs_ub_b12p75 0.00 12.75 FORMAT "%5.2" /end CHARACTERISTIC
/begin CHARACTERISTIC TEBLEIN "Temperaturschwelle f¸r E-Box L¸fter Ansteuerung" VALUE 0x4EF010 KwUb 191.3 temp_ub_q0p75_o48 -48.00 143.3 FORMAT "%5.1" /end CHARACTERISTIC
/begin CHARACTERISTIC TERRDMLS "" VALUE 0x4E9720 KwWU16 6553.500 t100msxs_uw_b6553p5 0.00 6553.500 FORMAT "%8.3" /end CHARACTERISTIC
/begin CHARACTERISTIC TEVEFA "Entprellung Fehlerz‰hler Endstufendiagnose TEV" VAL_BLK 0x4E2D80 KwbUb 255.0 dez 0.00 255.0 FORMAT "%5.1" NUMBER 1 /end CHARACTERISTIC
/begin CHARACTERISTIC TFDLLRO "Obere Schwelle f¸r Zeitfenster f¸r DLLR" VALUE 0x4ED6DA KwUw 6553.500 t100msxs_uw_b6553p5 0.00 6553.500 FORMAT "%8.3" /end CHARACTERISTIC
/begin CHARACTERISTIC TFDLLRU "Untere Schwelle f¸r Zeitfenster f¸r DLLR" VALUE 0x4ED6DC KwUw 6553.500 t100msxs_uw_b6553p5 0.00 6553.500 FORMAT "%8.3" /end CHARACTERISTIC
/begin CHARACTERISTIC TFIMSLI "Zeitkonstante f¸r msli- und msln-Filter" VALUE 0x4EEFEB KwUb 12.6996 zk100msxs_ub_b25p5 0.100392 12.8000 FORMAT "%7.4" /end CHARACTERISTIC
/begin CHARACTERISTIC TFIMSLIK "Zeitkonstante f¸r msli- und msln-Filter bei Kurztest" VALUE 0x4EEFEC KwUb 12.6996 zk100msxs_ub_b25p5 0.100392 12.8000 FORMAT "%7.4" /end CHARACTERISTIC
/begin CHARACTERISTIC TFIMSLO "Zeitkonstante f¸r mslo- Filter" VALUE 0x4EEFED KwUb 12.6996 zk100msxs_ub_b25p5 0.100392 12.8000 FORMAT "%7.4" /end CHARACTERISTIC
/begin CHARACTERISTIC TFIMSLOK "Zeitkonstante f¸r mslo- Filter bei Kurztest" VALUE 0x4EEFEE KwUb 12.6996 zk100msxs_ub_b25p5 0.100392 12.8000 FORMAT "%7.4" /end CHARACTERISTIC
/begin CHARACTERISTIC TFIMSLV "Zeitkonstante f¸r mslv- Filter" VALUE 0x4EEFEF KwUb 12.6996 zk100msxs_ub_b25p5 0.100392 12.8000 FORMAT "%7.4" /end CHARACTERISTIC
/begin CHARACTERISTIC TFIMSLVK "Zeitkonstante f¸r mslv- Filter bei Kurztest" VALUE 0x4EEFF0 KwUb 12.6996 zk100msxs_ub_b25p5 0.100392 12.8000 FORMAT "%7.4" /end CHARACTERISTIC
/begin CHARACTERISTIC TFRA "Erkennungszeit f¸r eingeschwungene Grundadaption von fra" VALUE 0x4EB8C1 KwUb 51.00 t200msxs_ub_b51 0.00 51.00 FORMAT "%5.2" /end CHARACTERISTIC
/begin CHARACTERISTIC TFRAOZ "Verweilzeit in FRAO f¸r Zyklusflag bei nicht eingeschw. Adaption" VALUE 0x4EB8C2 KwUb 51.00 t200msxs_ub_b51 0.00 51.00 FORMAT "%5.2" /end CHARACTERISTIC
/begin CHARACTERISTIC TFRAUZ "Verweilzeit in FRAU f¸r Zyklusflag bei nicht eingeschw. Adaption" VALUE 0x4EB8C3 KwUb 51.00 t200msxs_ub_b51 0.00 51.00 FORMAT "%5.2" /end CHARACTERISTIC
/begin CHARACTERISTIC TFRMST "Erkennungszeit f¸r eingeschwungene Grundadaption von frm" VALUE 0x4EB8C4 KwUb 51.00 t200msxs_ub_b51 0.00 51.00 FORMAT "%5.2" /end CHARACTERISTIC
/begin CHARACTERISTIC TFRMZST "Verweilzeit f¸r unplausibles frm-Signal (Kurztest)" VALUE 0x4EB8C5 KwUb 51.00 t200msxs_ub_b51 0.00 51.00 FORMAT "%5.2" /end CHARACTERISTIC
/begin CHARACTERISTIC TKATDSL "maximale Katalysatortemperatur f¸r Freigabe SLS-Diagnose" VALUE 0x4EEFF1 KwUb 1275. temp_ub_q5_o50 -50.00 1225. FORMAT "%5.0" /end CHARACTERISTIC
/begin CHARACTERISTIC TKA_DELTA "Temperaturdifferenz f¸r Diagnosestart" VALUE 0x4EF00C KwWU8 191.3 temp_sb_q0p75 0.00 191.3 FORMAT "%5.1" /end CHARACTERISTIC
/begin CHARACTERISTIC TKTPVK "" VALUE 0x4E2C6A KwUb 1275. temp_ub_q5_o50 -50.00 1225. FORMAT "%5.0" /end CHARACTERISTIC
/begin CHARACTERISTIC TLAED "Wartezeit bis Fehlerlampe aus nach Start" VALUE 0x4E2BEB KwUb 51.00 t200msxs_ub_b51 0.00 51.00 FORMAT "%5.2" /end CHARACTERISTIC
/begin CHARACTERISTIC TLAEDI "Wartezeit bis Fehlerlampe aus nach INI" VALUE 0x4E2BEC KwUb 51.00 t200msxs_ub_b51 0.00 51.00 FORMAT "%5.2" /end CHARACTERISTIC
/begin CHARACTERISTIC TMASO "" VALUE 0x4EA971 KwUb 25.50 t100msxs_ub_b25p5 0.00 25.50 FORMAT "%5.2" /end CHARACTERISTIC
/begin CHARACTERISTIC TMDLLR "Motortemperaturschwelle f¸r Diagnose Leerlaufsteller" VALUE 0x4ED6D0 KwUb 191.3 temp_ub_q0p75_o48 -48.00 143.3 FORMAT "%5.1" /end CHARACTERISTIC
/begin CHARACTERISTIC TMDSLAMN "min. Motortemperatur f¸r Zusatzdiagnose" VALUE 0x4EEFF2 KwUb 191.3 temp_ub_q0p75_o48 -48.00 143.3 FORMAT "%5.1" /end CHARACTERISTIC
/begin CHARACTERISTIC TMDSLMN "min. Motortemperatur f¸r DSLS" VALUE 0x4EEFF3 KwUb 191.3 temp_ub_q0p75_o48 -48.00 143.3 FORMAT "%5.1" /end CHARACTERISTIC
/begin CHARACTERISTIC TMDSLMX "max. Motortemperatur f¸r DSLS" VALUE 0x4EEFF4 KwUb 191.3 temp_ub_q0p75_o48 -48.00 143.3 FORMAT "%5.1" /end CHARACTERISTIC
/begin CHARACTERISTIC TMFRST "Einschalttemperatur LR- Kurztest" VALUE 0x4EB8C6 KwUb 191.3 temp_ub_q0p75_o48 -48.00 143.3 FORMAT "%5.1" /end CHARACTERISTIC
/begin CHARACTERISTIC TMINKAT "Minimale Kat-Temperatur f¸r ‹berwachung" VALUE 0x4E2C46 KwUb 1275. temp_ub_q5_o50 -50.00 1225. FORMAT "%5.0" /end CHARACTERISTIC
/begin CHARACTERISTIC TMNEB "" VALUE 0x4EA97C KwUw 49151.25 temp_ub_q0p75_o48 -48.00000 49103.25 FORMAT "%8.2" /end CHARACTERISTIC
/begin CHARACTERISTIC TMNKATT "Minimale Kat-Temperatur f¸r ‹berwachung bei Testerbetrieb" VALUE 0x4E2C47 KwUb 1275. temp_ub_q5_o50 -50.00 1225. FORMAT "%5.0" /end CHARACTERISTIC
/begin CHARACTERISTIC TMOT_SOLL "Motorsolltemperatur f¸r Diagnose DTHS" VALUE 0x4EF00D KwWU8 191.3 temp_ub_q0p75_o48 -48.00 143.3 FORMAT "%5.1" /end CHARACTERISTIC
/begin CHARACTERISTIC TMSV "" VALUE 0x4EA97E KwUw 49151.25 temp_ub_q0p75_o48 -48.00000 49103.25 FORMAT "%8.2" /end CHARACTERISTIC
/begin CHARACTERISTIC TMSVA "" VALUE 0x4EA980 KwUw 49151.25 temp_ub_q0p75_o48 -48.00000 49103.25 FORMAT "%8.2" /end CHARACTERISTIC
/begin CHARACTERISTIC TMTED "Tmot-Schwelle f¸r Tankentl¸ftungsdiagnose" VALUE 0x4EE4BA KwUb 191.3 temp_ub_q0p75_o48 -48.00 143.3 FORMAT "%5.1" /end CHARACTERISTIC
/begin CHARACTERISTIC TMWUC "Motortemperaturschwelle f¸r Erf¸llung 'warm up cycle'" VALUE 0x4E2BEE KwUb 191.3 temp_ub_q0p75_o48 -48.00 143.3 FORMAT "%5.1" /end CHARACTERISTIC
/begin CHARACTERISTIC TMWUCST "max. Motortemperatur im Start f¸r Erf¸llung 'warm up cycle'" VALUE 0x4E2BEF KwUb 191.3 temp_ub_q0p75_o48 -48.00 143.3 FORMAT "%5.1" /end CHARACTERISTIC
/begin CHARACTERISTIC TNODTEV "Zeit nach Motorstart f¸r Verbot DTEV" VALUE 0x4EE4C0 KwUw 6553.500 t100msxs_uw_b6553p5 0.00 6553.500 FORMAT "%8.3" /end CHARACTERISTIC
/begin CHARACTERISTIC TNODTEVT "Zeit f¸r Verbot DTEV bei Testerbetrieb" VALUE 0x4EE4C2 KwUw 6553.500 t100msxs_uw_b6553p5 0.00 6553.500 FORMAT "%8.3" /end CHARACTERISTIC
/begin CHARACTERISTIC TNOMF2 "zul‰ssige Zeit auﬂerhalb Meﬂfenster, Phase 2" VALUE 0x4EEFF5 KwUb 25.50 t100msxs_ub_b25p5 0.00 25.50 FORMAT "%5.2" /end CHARACTERISTIC
/begin CHARACTERISTIC TNOMF3 "zul‰ssige Zeit auﬂerhalb Meﬂfenster, Phase 3" VALUE 0x4EEFF6 KwUb 25.50 t100msxs_ub_b25p5 0.00 25.50 FORMAT "%5.2" /end CHARACTERISTIC
/begin CHARACTERISTIC TNOMF5 "zul‰ssige Zeit auﬂerhalb Meﬂfenster, Phase 5" VALUE 0x4EEFF7 KwUb 25.50 t100msxs_ub_b25p5 0.00 25.50 FORMAT "%5.2" /end CHARACTERISTIC
/begin CHARACTERISTIC TNSTDN "" VALUE 0x4E2C7C KwUb 5.100 t20msxs_ub_b5p1 0.00 5.100 FORMAT "%5.3" /end CHARACTERISTIC
/begin CHARACTERISTIC TPSVKMN "minimale Periodendauer der Lambdasonde vor Kat, DLSSA" VALUE 0x4EA90F KwUb 10.20 t40msxs_ub_q0p04 0.00 10.20 FORMAT "%5.2" /end CHARACTERISTIC
/begin CHARACTERISTIC TPSVKMX "maximale Periodendauer der Lambdasonde vor Kat, DLSSA" VALUE 0x4EA910 KwUb 10.20 t40msxs_ub_q0p04 0.00 10.20 FORMAT "%5.2" /end CHARACTERISTIC
/begin CHARACTERISTIC TRKA "Erkennungszeit f¸r eingeschwungene Grundadaption von rkat bzw. rkaz" VALUE 0x4EB8C7 KwUb 51.00 t200msxs_ub_b51 0.00 51.00 FORMAT "%5.2" /end CHARACTERISTIC
/begin CHARACTERISTIC TRKATZ "Aktivierungszeit von rkat bis Setzen Zyklusflag, wenn B_gae = FALSE" VALUE 0x4EB8C8 KwUb 51.00 t200msxs_ub_b51 0.00 51.00 FORMAT "%5.2" /end CHARACTERISTIC
/begin CHARACTERISTIC TRKAZZ "Aktivierungszeit von rkaz bis Setzen Zyklusflag, wenn B_gae = FALSE" VALUE 0x4EB8C9 KwUb 51.00 t200msxs_ub_b51 0.00 51.00 FORMAT "%5.2" /end CHARACTERISTIC
/begin CHARACTERISTIC TRSA "" VALUE 0x4EA982 KwUw 6553.500 t100msxs_ub_b25p5 0.00 6553.500 FORMAT "%8.3" /end CHARACTERISTIC
/begin CHARACTERISTIC TRSE "‹berwachungszeit -> Regelung ein" VALUE 0x4EA972 KwUb 25.50 t100msxs_ub_b25p5 0.00 25.50 FORMAT "%5.2" /end CHARACTERISTIC
/begin CHARACTERISTIC TSFAGRF "Fehlersummenzeit: ‹berwachung AGR-FLOW" VALUE 0x4F0155 KwWU8 255.0 dez 0.00 255.0 FORMAT "%5.1" /end CHARACTERISTIC
/begin CHARACTERISTIC TSFDMTK "Fehlersummenzeit: Tankentl¸ftungssystem, Feinstleck" VALUE 0x4F0162 KwWU8 255.0 dez 0.00 255.0 FORMAT "%5.1" /end CHARACTERISTIC
/begin CHARACTERISTIC TSFDMTL "Fehlersummenzeit: Tankentl¸ftungssystem, Modulfehler (Hardware)" VALUE 0x4F0163 KwWU8 255.0 dez 0.00 255.0 FORMAT "%5.1" /end CHARACTERISTIC
/begin CHARACTERISTIC TSFHSVSA "Fehlersummenzeit: Lambdasonden-Heizung vor Katalysator" VALUE 0x4F0178 KwWU8 255.0 dez 0.00 255.0 FORMAT "%5.1" /end CHARACTERISTIC
/begin CHARACTERISTIC TSFKAT2 "Fehlersummenzeit: Katalysator-Konvertierung (Bank 2)" VALUE 0x4F017A KwWU8 255.0 dez 0.00 255.0 FORMAT "%5.1" /end CHARACTERISTIC
/begin CHARACTERISTIC TSFKATSP "Fehlersummenzeit: Katalysator-Konvertierung" VALUE 0x4F017B KwWU8 255.0 dez 0.00 255.0 FORMAT "%5.1" /end CHARACTERISTIC
/begin CHARACTERISTIC TSFMDB "Fehlersummenzeit: Momentbegrenzung Sollmoment" VALUE 0x4F018E KwUb 255.0 dez 0.00 255.0 FORMAT "%5.1" /end CHARACTERISTIC
/begin CHARACTERISTIC TSFTESK "Fehlersummenzeit: Tankentl¸ftungssystem Leck vorhanden" VALUE 0x4F01AA KwWU8 255.0 dez 0.00 255.0 FORMAT "%5.1" /end CHARACTERISTIC
/begin CHARACTERISTIC TSTEAA "" VALUE 0x4EA969 KwUb 25.50 t100msxs_ub_b25p5 0.00 25.50 FORMAT "%5.2" /end CHARACTERISTIC
/begin CHARACTERISTIC TSVKKO "" VALUE 0x4E2C6C KwUw 655.3500 t10msxs_uw_b655p35 0.00 655.3500 FORMAT "%8.4" /end CHARACTERISTIC
/begin CHARACTERISTIC TSVKKTO "" VALUE 0x4E2C6E KwUw 655.3500 t10msxs_uw_b655p35 0.00 655.3500 FORMAT "%8.4" /end CHARACTERISTIC
/begin CHARACTERISTIC TSVKKTU "" VALUE 0x4E2C70 KwUw 655.3500 t10msxs_uw_b655p35 0.00 655.3500 FORMAT "%8.4" /end CHARACTERISTIC
/begin CHARACTERISTIC TSVKKU "" VALUE 0x4E2C72 KwUw 655.3500 t10msxs_uw_b655p35 0.00 655.3500 FORMAT "%8.4" /end CHARACTERISTIC
/begin CHARACTERISTIC TSVKO "" VALUE 0x4E2C74 KwUw 655.3500 t10msxs_uw_b655p35 0.00 655.3500 FORMAT "%8.4" /end CHARACTERISTIC
/begin CHARACTERISTIC TSVKU "" VALUE 0x4E2C76 KwUw 655.3500 t10msxs_uw_b655p35 0.00 655.3500 FORMAT "%8.4" /end CHARACTERISTIC
/begin CHARACTERISTIC TTBMH "Zeit f¸r theoretische Sondenbetriebsbereitschaft mit Heizung" VALUE 0x4EA984 KwUw 6553.500 t100msxs_uw_q100 0.00 6553.500 FORMAT "%8.3" /end CHARACTERISTIC
/begin CHARACTERISTIC TTEBL "Zeitdauer der Ansteuerung des E-Box L¸fters nach Start" VALUE 0x4EF011 KwUb 25.40 t100msxs_ub_b25p5 0.1000 25.50 FORMAT "%5.2" /end CHARACTERISTIC
/begin CHARACTERISTIC TTEDAFS "" VALUE 0x4E887C KwUw 1310.70 t20msxs_uw_b1310 0.00 1310.70 FORMAT "%7.2" /end CHARACTERISTIC
/begin CHARACTERISTIC TTEDAOFS "" VALUE 0x4E887E KwUw 1310.70 t20msxs_uw_b1310 0.00 1310.70 FORMAT "%7.2" /end CHARACTERISTIC
/begin CHARACTERISTIC TTEDBA "Zeitschwelle f¸r Beginn der TEV-Aufsteuerung bei Tankentl¸ftungsdiagnose" VALUE 0x4E8880 KwUw 1310.70 t20msxs_uw_b1310 0.00 1310.70 FORMAT "%7.2" /end CHARACTERISTIC
/begin CHARACTERISTIC TTEDIVFS "" VALUE 0x4E8882 KwUw 1310.70 t20msxs_uw_b1310 0.00 1310.70 FORMAT "%7.2" /end CHARACTERISTIC
/begin CHARACTERISTIC TTEDIVOFS "" VALUE 0x4E8884 KwUw 1310.70 t20msxs_uw_b1310 0.00 1310.70 FORMAT "%7.2" /end CHARACTERISTIC
/begin CHARACTERISTIC TTEDNFS "" VALUE 0x4E8886 KwUw 1310.70 t20msxs_uw_b1310 0.00 1310.70 FORMAT "%7.2" /end CHARACTERISTIC
/begin CHARACTERISTIC TTEDNOFS "" VALUE 0x4E8888 KwUw 1310.70 t20msxs_uw_b1310 0.00 1310.70 FORMAT "%7.2" /end CHARACTERISTIC
/begin CHARACTERISTIC TUSDU "" VALUE 0x4EA986 KwUw 6553.500 t100msxs_uw_q100 0.00 6553.500 FORMAT "%8.3" /end CHARACTERISTIC
/begin CHARACTERISTIC TUSDUC "" VALUE 0x4EA988 KwUw 6553.500 t100msxs_uw_q100 0.00 6553.500 FORMAT "%8.3" /end CHARACTERISTIC
/begin CHARACTERISTIC TUSEINV "" VALUE 0x4EA973 KwUb 255.0 t1sxs_ub_b255 0.00 255.0 FORMAT "%5.1" /end CHARACTERISTIC
/begin CHARACTERISTIC TUSFETT "" VALUE 0x4EA98A KwUw 6553.500 t100msxs_uw_q100 0.00 6553.500 FORMAT "%8.3" /end CHARACTERISTIC
/begin CHARACTERISTIC TUSKS "Verzˆgerungszeit bei Kurzschluﬂerkennung der Lambdasonde" VALUE 0x4E2C7D KwUb 5.100 t20msxs_ub_b5p1 0.00 5.100 FORMAT "%5.3" /end CHARACTERISTIC
/begin CHARACTERISTIC TUSMAX "‹berwachungszeit f¸r Usmax" VALUE 0x4EA974 KwUb 25.50 t100msxs_ub_b25p5 0.00 25.50 FORMAT "%5.2" /end CHARACTERISTIC
/begin CHARACTERISTIC TUSPNMN "min. Zeit der Sondenspannung zwischen pos. und neg. Flanke" VALUE 0x4EA911 KwUb 10.20 t40msxs_ub_q0p04 0.00 10.20 FORMAT "%5.2" /end CHARACTERISTIC
/begin CHARACTERISTIC TUSPNMX "max. Zeit der Sondenspannung zwischen pos. und neg. Flanke" VALUE 0x4EA912 KwUb 10.20 t40msxs_ub_q0p04 0.00 10.20 FORMAT "%5.2" /end CHARACTERISTIC
/begin CHARACTERISTIC TVLRHMN "" VALUE 0x4EA96A KwSb 2.550 t100msxs_sb_q0p01 -1.280 1.270 FORMAT "%5.3" /end CHARACTERISTIC
/begin CHARACTERISTIC TVLRHMN2 "" VALUE 0x4EA96B KwSb 2.550 t100msxs_sb_q0p01 -1.280 1.270 FORMAT "%5.3" /end CHARACTERISTIC
/begin CHARACTERISTIC TVLRHMX "" VALUE 0x4EA96C KwSb 2.550 t100msxs_sb_q0p01 -1.280 1.270 FORMAT "%5.3" /end CHARACTERISTIC
/begin CHARACTERISTIC TVLRHMX2 "" VALUE 0x4EA96D KwSb 2.550 t100msxs_sb_q0p01 -1.280 1.270 FORMAT "%5.3" /end CHARACTERISTIC
/begin CHARACTERISTIC TWDDTV "" VALUE 0x4EA96E KwUw 65525.00 t1sxs_uw_b65535 10.00000 65535.00 FORMAT "%8.2" /end CHARACTERISTIC
/begin CHARACTERISTIC TWDKATST "Wartezeit nach Stoppbedingung f¸r Filter und Integrator" VALUE 0x4E2C48 KwUb 12.75 t50msxs_ub_b12p75 0.00 12.75 FORMAT "%5.2" /end CHARACTERISTIC
/begin CHARACTERISTIC TWDLSSA "Mindestpr¸fzeit f¸r DLSSA-Extremwertbestimmung" VALUE 0x4EA91C KwUw 3276.750 t50msxs_uw_b3276p75 0.00 3276.750 FORMAT "%8.3" /end CHARACTERISTIC
/begin CHARACTERISTIC TWHLSLP "Wartezeit f¸r Hochlauf Sekund‰rluftpumpe" VALUE 0x4EEFF8 KwUb 25.50 t100msxs_ub_b25p5 0.00 25.50 FORMAT "%5.2" /end CHARACTERISTIC
/begin CHARACTERISTIC TWKODTE "Wartezeit nach Kompressor schalten f¸r DTEVN" VALUE 0x4EE4BB KwUb 25.50 t100msxs_ub_b25p5 0.00 25.50 FORMAT "%5.2" /end CHARACTERISTIC
/begin CHARACTERISTIC TWKTDLP "Wartezeit nach Parameterumschaltung in Lambdaregelung" VALUE 0x4E2C49 KwUb 12.75 t50msxs_ub_b12p75 0.00 12.75 FORMAT "%5.2" /end CHARACTERISTIC
/begin CHARACTERISTIC TWMLFE "Mindestzeit f¸r ml im Diagnosebereich" VALUE 0x4EEFF9 KwUb 25.50 t100msxs_ub_b25p5 0.00 25.50 FORMAT "%5.2" /end CHARACTERISTIC
/begin CHARACTERISTIC TWMSLMIN "Entprellzeit f¸r Fehlermeldung B_mslmin" VALUE 0x4EEFFA KwUb 25.50 t100msxs_ub_b25p5 0.00 25.50 FORMAT "%5.2" /end CHARACTERISTIC
/begin CHARACTERISTIC T_SA_MAX "Maximale Schubdauer f¸r DTHS" VALUE 0x4EF00E KwWU8 255.0 t1sxs_ub_q1 0.00 255.0 FORMAT "%5.1" /end CHARACTERISTIC
/begin CHARACTERISTIC UBDLS "Batteriespannungsschwelle zur Freigabe der Sonden-Diagnose" VALUE 0x4EA975 KwUb 24.02 spg_ubatt 0.00 24.02 FORMAT "%5.2" /end CHARACTERISTIC
/begin CHARACTERISTIC UBDLSMX "obere Batteriespannungsschwelle f¸r die  Sonden-Diagnose" VALUE 0x4EA976 KwUb 24.02 spg_ub 0.00 24.02 FORMAT "%5.2" /end CHARACTERISTIC
/begin CHARACTERISTIC UDKRGOFS "Spannungsschwelle f¸r DIA/KR Grundoffset Verst‰rker" VALUE 0x4E5572 KwUb 4.980 spg_ub_b5 0.00 4.980 FORMAT "%5.3" /end CHARACTERISTIC
/begin CHARACTERISTIC UDKRTP "Integratorspannungsschwelle f¸r Dia KS - Auswerteschaltung Testimpuls" VALUE 0x4E558F KwUb 4.980 spg_ub_b5 0.00 4.980 FORMAT "%5.3" /end CHARACTERISTIC
/begin CHARACTERISTIC UDKSNO "Obere Referenzspannungsschwelle DIA KS" CURVE 0x4E54E8 KlAxU8SstxU16WU16 319.976 spg_uw_b1280 0.00 319.976 FORMAT "%7.3"
 /begin AXIS_DESCR STD_AXIS nmot nmot_ub_q40 16 0.00 2621400. FORMAT "%8.0" DEPOSIT ABSOLUTE /end AXIS_DESCR
/end CHARACTERISTIC
/begin CHARACTERISTIC UDKSNU "untere Referenzspannungsschwelle DIA KS" CURVE 0x4E552A KlAxU8SstxU16WU16 319.976 spg_uw_b1280 0.00 319.976 FORMAT "%7.3"
 /begin AXIS_DESCR STD_AXIS nmot nmot_ub_q40 16 0.00 2621400. FORMAT "%8.0" DEPOSIT ABSOLUTE /end AXIS_DESCR
/end CHARACTERISTIC
/begin CHARACTERISTIC UMIN_DE "" VALUE 0x4EA9CE KwUb 24.02 spg_ubatt 0.00 24.02 FORMAT "%5.2" /end CHARACTERISTIC
/begin CHARACTERISTIC USDBO "" VALUE 0x4E2C7E KwUw 319.9951 spg_uw_q0p00488_o1 -1.000000 318.9951 FORMAT "%8.4" /end CHARACTERISTIC
/begin CHARACTERISTIC USDBU "" VALUE 0x4E2C80 KwUw 319.9951 spg_uw_q0p00488_o1 -1.000000 318.9951 FORMAT "%8.4" /end CHARACTERISTIC
/begin CHARACTERISTIC USIVMAXV "Init value f¸r max. Sondenspg. vor Kat nach Powerfail u. Fehlersp. lˆschen" VALUE 0x4EA913 KwUb 1.330 spg_ub_b1p33 0.00 1.330 FORMAT "%5.3" /end CHARACTERISTIC
/begin CHARACTERISTIC USIVMINV "Init value f¸r min. Sondenspg. vor Kat nach Powerfail u. Fehlersp. lˆschen" VALUE 0x4EA914 KwUb 1.330 spg_ub_b1p33 0.00 1.330 FORMAT "%5.3" /end CHARACTERISTIC
/begin CHARACTERISTIC USMASO "" VALUE 0x4E2C82 KwUw 319.9951 spg_uw_q0p00488_o1 -1.000000 318.9951 FORMAT "%8.4" /end CHARACTERISTIC
/begin CHARACTERISTIC USMAX "Schwelle f¸r Sondenkurzschluﬂ nach Ubat" VALUE 0x4E2C84 KwUw 319.9951 spg_uw_q0p00488_o1 -1.000000 318.9951 FORMAT "%8.4" /end CHARACTERISTIC
/begin CHARACTERISTIC USMIN "Schwelle f¸r Sondenkurzschluﬂ nach Masse" VALUE 0x4E2C86 KwUw 319.9951 spg_uw_q0p00488_o1 -1.000000 318.9951 FORMAT "%8.4" /end CHARACTERISTIC
/begin CHARACTERISTIC USMNSAMN "min. erkannte Sondenspannung f¸r Signalausgabe (min. plaus. Wert)" VALUE 0x4EA915 KwUb 1.330 spg_ub_b1p33 0.00 1.330 FORMAT "%5.3" /end CHARACTERISTIC
/begin CHARACTERISTIC USMNSAMX "min. erkannte Sondenspannung f¸r Signalausgabe (max. plaus. Wert)" VALUE 0x4EA916 KwUb 1.330 spg_ub_b1p33 0.00 1.330 FORMAT "%5.3" /end CHARACTERISTIC
/begin CHARACTERISTIC USMXSAMN "max. erkannte Sondenspannung f¸r Signalausgabe (min. plaus. Wert)" VALUE 0x4EA917 KwUb 1.330 spg_ub_b1p33 0.00 1.330 FORMAT "%5.3" /end CHARACTERISTIC
/begin CHARACTERISTIC USMXSAMX "max. erkannte Sondenspannung f¸r Signalausgabe (max. plaus. Wert)" VALUE 0x4EA918 KwUb 1.330 spg_ub_b1p33 0.00 1.330 FORMAT "%5.3" /end CHARACTERISTIC
/begin CHARACTERISTIC USREF "" VALUE 0x4E2C88 KwUw 319.9951 spg_uw_q0p00488_o1 -1.000000 318.9951 FORMAT "%8.4" /end CHARACTERISTIC
/begin CHARACTERISTIC USREM "" VALUE 0x4E2C8A KwUw 319.9951 spg_uw_q0p00488_o1 -1.000000 318.9951 FORMAT "%8.4" /end CHARACTERISTIC
/begin CHARACTERISTIC USRJ "" VALUE 0x4EA919 KwUb 1.330 spg_ub_b1p33 0.00 1.330 FORMAT "%5.3" /end CHARACTERISTIC
/begin CHARACTERISTIC VFZGKL15 "Geschwingigkeitgrenze zum Start der Diagnose Klemme 15 Schalter" VALUE 0x4EF3C8 KwUb 318.8 vfzg_ub_q1p25 0.00 318.8 FORMAT "%5.1" /end CHARACTERISTIC
/begin CHARACTERISTIC ZDKATAD "Filterzeitkonstante der Differenzierer f¸r Signalamplitude" VALUE 0x4E2C4A KwUb 12.7498 zk50msxs_ub_b12p8 0.0501961 12.8000 FORMAT "%7.4" /end CHARACTERISTIC
/begin CHARACTERISTIC ZDKATAF "Zeitkonstante Betrags-Filter f¸r Signalamplitude" VALUE 0x4E2C4B KwUb 12.7498 zk50msxs_ub_b12p8 0.0501961 12.8000 FORMAT "%7.4" /end CHARACTERISTIC
/begin CHARACTERISTIC ZDKATSH "Zeitkonstante Tiefpaﬂ, Regellagendifferenz" VALUE 0x4E2C4C KwUb 12.7498 zk50msxs_ub_b12p8 0.0501961 12.8000 FORMAT "%7.4" /end CHARACTERISTIC
/begin CHARACTERISTIC ZDKTBD "Zeitkonstante der Differenzierer f¸r FR-Wechselanteil" VALUE 0x4E2C4D KwUb 12.7498 zk50msxs_ub_b12p8 0.0501961 12.8000 FORMAT "%7.4" /end CHARACTERISTIC
/begin CHARACTERISTIC ZDKTBF "Zeitkonstante f¸r Gasvermischungsvorgang vor Katalysator" VALUE 0x4E2C4E KwUb 12.7498 zk50msxs_ub_b12p8 0.0501961 12.8000 FORMAT "%7.4" /end CHARACTERISTIC
/begin CHARACTERISTIC ZFRMST "Zeitkonstante f¸r frm-Filter (short test)" VALUE 0x4EB8CA KwUb 50.9992 zk200msxs_ub_b51p2 0.200784 51.2000 FORMAT "%7.4" /end CHARACTERISTIC
/begin CHARACTERISTIC ZFTSVK "" VALUE 0x4E2C6B KwUb 0.9961 fak_ub_b1 0.00 0.9961 /end CHARACTERISTIC
/begin CHARACTERISTIC ZKTDRL "Zeitkonstante Tiefpaﬂ, rl-Filterung" VALUE 0x4E2C4F KwUb 12.7498 zk50msxs_ub_b12p8 0.0501961 12.8000 FORMAT "%7.4" /end CHARACTERISTIC
/begin CHARACTERISTIC ZMVDTE "Zeitkonstante ‹berwachung Verlustmoment" VALUE 0x4E888A KwUw 3276.7499992 zk50msxs_uw_b3276p8 0.050000762951 3276.8000000 FORMAT "%12.7" /end CHARACTERISTIC
/begin CHARACTERISTIC ZNTED "Zeitkonstante Drehzahlfilterung bei TEV-Diagnose" VALUE 0x4E888C KwUw 655.350000 zk10msxs_uw_b655 0.0100001526 655.360000 FORMAT "%10.6" /end CHARACTERISTIC
/begin MEASUREMENT ahkat "Mittelwert der Amplitude Sondensignal hinter Kat. korrigiert mit KB" UBYTE fak_ub_b1 1 100 0 0.996094 ECU_ADDRESS 0x7FD8D5 /end MEASUREMENT
/begin MEASUREMENT ahkat2 "Mittelwert der Amplitude Sondensignal hinter Kat. korrigiert mit KB (2.Bank)" UBYTE fak_ub_b1 1 100 0 0.996094 ECU_ADDRESS 0x7FD8D6 /end MEASUREMENT
/begin MEASUREMENT ahkatn "" UBYTE fak_ub_b1 1 100 0 0.996094 ECU_ADDRESS 0x7FD8D7 /end MEASUREMENT
/begin MEASUREMENT ahkatn2 "" UBYTE fak_ub_b1 1 100 0 0.996094 ECU_ADDRESS 0x7FD8D8 /end MEASUREMENT
/begin MEASUREMENT ahktki2_w "" UWORD t50msxs_uw_b819p2 1 100 0 819.188 FORMAT "%8.4" ECU_ADDRESS 0x7FDB70 /end MEASUREMENT
/begin MEASUREMENT ahktki_w "" UWORD t50msxs_uw_b819p2 1 100 0 819.188 FORMAT "%8.4" ECU_ADDRESS 0x7FDB72 /end MEASUREMENT
/begin MEASUREMENT ahktnk "" UBYTE fak_ub_b1 1 100 0 0.996094 ECU_ADDRESS 0x7FD8D9 /end MEASUREMENT
/begin MEASUREMENT ahktnk2 "" UBYTE fak_ub_b1 1 100 0 0.996094 ECU_ADDRESS 0x7FD8DA /end MEASUREMENT
/begin MEASUREMENT akatbn "" UBYTE fak_ub_b1 1 100 0 0.996094 ECU_ADDRESS 0x7FD8DB /end MEASUREMENT
/begin MEASUREMENT akatbn2 "" UBYTE fak_ub_b1 1 100 0 0.996094 ECU_ADDRESS 0x7FD8DC /end MEASUREMENT
/begin MEASUREMENT Anznwz720 "Anzahl Nockenwellenz‰hne ¸ber 720 Grad KW (gemessen)" UWORD dez 1 100 0 65535 FORMAT "%8.2" ECU_ADDRESS 0x7FE11C /end MEASUREMENT
/begin MEASUREMENT apedkt "" UBYTE dez 1 100 0 255 FORMAT "%5.1" ECU_ADDRESS 0x7FD8DD /end MEASUREMENT
/begin MEASUREMENT apedkt2 "" UBYTE dez 1 100 0 255 FORMAT "%5.1" ECU_ADDRESS 0x7FD8DE /end MEASUREMENT
/begin MEASUREMENT atvfett "" UBYTE t40msxs_ub_q0p04 1 100 0 10.2 FORMAT "%5.2" ECU_ADDRESS 0x7FD550 /end MEASUREMENT
/begin MEASUREMENT atvfett2 "" UBYTE t40msxs_ub_q0p04 1 100 0 10.2 FORMAT "%5.2" ECU_ADDRESS 0x7FD551 /end MEASUREMENT
/begin MEASUREMENT atvmager "atv-Verschiebung nach MAGER, DLSSA" UBYTE t40msxs_ub_q0p04 1 100 0 10.2 FORMAT "%5.2" ECU_ADDRESS 0x7FD552 /end MEASUREMENT
/begin MEASUREMENT atvmager2 "atv-Verschiebung nach MAGER, DLSSA (Bank2)" UBYTE t40msxs_ub_q0p04 1 100 0 10.2 FORMAT "%5.2" ECU_ADDRESS 0x7FD553 /end MEASUREMENT
/begin MEASUREMENT avkatf "AmplitudenVerh‰ltnis laafh/laafv gefiltert" UBYTE fak_ub_b1 1 100 0 0.996094 ECU_ADDRESS 0x7F9B2B /end MEASUREMENT
/begin MEASUREMENT avkatf2 "Amplitudenverh‰ltnis laafh/laafv gefiltert Bank2" UBYTE fak_ub_b1 1 100 0 0.996094 ECU_ADDRESS 0x7F9B2C /end MEASUREMENT
/begin MEASUREMENT bbwuc "Byte f¸r Bedingung B_wuc als Triggerevent in DCLA" UBYTE dez 1 100 0 255 FORMAT "%5.1" ECU_ADDRESS 0x7FD8CD /end MEASUREMENT
/begin MEASUREMENT bssp "Speicherwert Signal Beschleunigungssensor" UWORD acc_uw_b55p55 1 100 0 55.5547 FORMAT "%8.5" ECU_ADDRESS 0x7FDB98 /end MEASUREMENT
/begin MEASUREMENT B_adcsd "Bedingung f¸r Pr¸fung Adernschluﬂ und CSD" UBYTE B_TRUE 1 100 0 1 BIT_MASK 0x1 FORMAT "%13.11" ECU_ADDRESS 0x7FB97D /end MEASUREMENT
/begin MEASUREMENT B_adcsd2 "Bedingung f¸r Pr¸fung Adernschluﬂ und CSD Bank2" UBYTE B_TRUE 1 100 0 1 BIT_MASK 0x1 FORMAT "%13.11" ECU_ADDRESS 0x7FB97E /end MEASUREMENT
/begin MEASUREMENT B_adde "Bedingung Adernschluﬂ oder defekte Sonde mit begrenztem Spannungshub" UBYTE B_TRUE 1 100 0 1 BIT_MASK 0x1 FORMAT "%13.11" ECU_ADDRESS 0x7FB97F /end MEASUREMENT
/begin MEASUREMENT B_adde2 "Bedingung Adernschluﬂ oder defekte Sonde mit begrenztem Spannungshub Bank2" UBYTE B_TRUE 1 100 0 1 BIT_MASK 0x1 FORMAT "%13.11" ECU_ADDRESS 0x7FB980 /end MEASUREMENT
/begin MEASUREMENT B_adsvb "Verbot Betriebsbereitschaft wegen Adernschluﬂ" UWORD B_TRUE 1 100 0 1 BIT_MASK 0x100 FORMAT "%13.11" ECU_ADDRESS 0x7F9B4A /end MEASUREMENT
/begin MEASUREMENT B_adsvb2 "Verbot Betriebsbereitschaft wegen Adernschluﬂ Bank2" UWORD B_TRUE 1 100 0 1 BIT_MASK 0x200 FORMAT "%13.11" ECU_ADDRESS 0x7F9B4A /end MEASUREMENT
/begin MEASUREMENT B_agrrdy "Bedingung AGR gepr¸ft f¸r 'ready-Byte'" UBYTE B_TRUE 1 100 0 1 BIT_MASK 0x80 FORMAT "%13.11" ECU_ADDRESS 0x7F9AE6 /end MEASUREMENT
/begin MEASUREMENT B_anznwzko "Anzahl der Nockewellenflanken innerhalb einer Umdrehung nicht OK" UBYTE B_TRUE 1 100 0 1 BIT_MASK 0x1 FORMAT "%13.11" ECU_ADDRESS 0x7FB94C /end MEASUREMENT
/begin MEASUREMENT B_ascFreig "" UBYTE B_TRUE 1 100 0 1 BIT_MASK 0x1 FORMAT "%13.11" ECU_ADDRESS 0x7FBCAD /end MEASUREMENT
/begin MEASUREMENT B_asla "Anforderung Sekund‰rluftadaption Bank 1" UWORD B_TRUE 1 100 0 1 BIT_MASK 0x8 FORMAT "%13.11" ECU_ADDRESS 0x7FE0A6 /end MEASUREMENT
/begin MEASUREMENT B_asla2 "Anforderung Sekund‰rluftadaption Bank 2" UWORD B_TRUE 1 100 0 1 BIT_MASK 0x4000 FORMAT "%13.11" ECU_ADDRESS 0x7FE0A4 /end MEASUREMENT
/begin MEASUREMENT B_bemdb "Bedingung Bandende-Funktionsanforderung MDB" UWORD B_TRUE 1 100 0 1 BIT_MASK 0x20 FORMAT "%13.11" ECU_ADDRESS 0x7F9650 /end MEASUREMENT
/begin MEASUREMENT B_bkmdb "Bedingung: Momentan¸berwachung (bergrenzt dauerhaft) aktiv" UWORD B_TRUE 1 100 0 1 BIT_MASK 0x40 FORMAT "%13.11" ECU_ADDRESS 0x7F9650 /end MEASUREMENT
/begin MEASUREMENT B_blkeb "MIL-Ansteuerung blinkend eigenbestimmt" UBYTE B_TRUE 1 100 0 1 BIT_MASK 0x4 FORMAT "%13.11" ECU_ADDRESS 0x7FD8CB /end MEASUREMENT
/begin MEASUREMENT B_btekp "Bedingung Bauteileansteuerung; Elektrokraftstoffpumpe" UBYTE B_TRUE 1 100 0 1 FORMAT "%13.11" ECU_ADDRESS 0x7F9F1C /end MEASUREMENT
/begin MEASUREMENT B_canoff "CAN Controller Zustand: BUS_OFF" UBYTE B_TRUE 1 100 0 1 BIT_MASK 0x1 FORMAT "%13.11" ECU_ADDRESS 0x7FD7EF /end MEASUREMENT
/begin MEASUREMENT B_cdiagoff "Bedingung: CAN-Diagnose aus, bei Flashprogrammierung ¸ber CAN" UBYTE B_TRUE 1 100 0 1 BIT_MASK 0x1 FORMAT "%13.11" ECU_ADDRESS 0x7FD7F0 /end MEASUREMENT
/begin MEASUREMENT B_clmdb "Flag f¸r Lˆschung: Momentenbegrenzung begrenzt dauerhaft" UWORD B_TRUE 1 100 0 1 BIT_MASK 0x80 FORMAT "%13.11" ECU_ADDRESS 0x7F9650 /end MEASUREMENT
/begin MEASUREMENT B_cwdslt "Bedingung: Freigabe Ventildichtheitspr¸fung" UWORD B_TRUE 1 100 0 1 BIT_MASK 0x1 FORMAT "%13.11" ECU_ADDRESS 0x7FE0A2 /end MEASUREMENT
/begin MEASUREMENT B_cwdthm "Bedingung: Diagnose Thermostat Motor-K¸hlmittel eingeschaltet" UBYTE B_TRUE 1 100 0 1 BIT_MASK 0x40 FORMAT "%13.11" ECU_ADDRESS 0x7FD7C8 /end MEASUREMENT
/begin MEASUREMENT B_cwsla "Bedingung: Freigabe der Adaptionsphase/Zusatzdiagnose" UWORD B_TRUE 1 100 0 1 BIT_MASK 0x8000 FORMAT "%13.11" ECU_ADDRESS 0x7FE0A4 /end MEASUREMENT
/begin MEASUREMENT B_dfrmoff "frm-Offset-Schwelle ¸berschritten: zeigt Vorsteuerproblem" UWORD B_TRUE 1 100 0 1 BIT_MASK 0x2000 FORMAT "%13.11" ECU_ADDRESS 0x7FE0A6 /end MEASUREMENT
/begin MEASUREMENT B_dfrmoff2 "frm-Offset-Schwelle ¸berschritten: zeigt Vorsteuerproblem Bank 2" UWORD B_TRUE 1 100 0 1 BIT_MASK 0x4000 FORMAT "%13.11" ECU_ADDRESS 0x7FE0A6 /end MEASUREMENT
/begin MEASUREMENT B_diagtimeout "" UBYTE B_TRUE 1 100 0 1 BIT_MASK 0x1 FORMAT "%13.11" ECU_ADDRESS 0x7FD7F1 /end MEASUREMENT
/begin MEASUREMENT B_dkini "" UBYTE B_TRUE 1 100 0 1 BIT_MASK 0x1 FORMAT "%13.11" ECU_ADDRESS 0x7FB952 /end MEASUREMENT
/begin MEASUREMENT B_dkini2 "" UBYTE B_TRUE 1 100 0 1 BIT_MASK 0x1 FORMAT "%13.11" ECU_ADDRESS 0x7FB953 /end MEASUREMENT
/begin MEASUREMENT B_dklpi "interne Umschaltung d. Lambdregelungsparameter angefordert" UBYTE B_TRUE 1 100 0 1 BIT_MASK 0x1 FORMAT "%13.11" ECU_ADDRESS 0x7FB954 /end MEASUREMENT
/begin MEASUREMENT B_dklpi2 "interne Umschaltung d. Lambdregelungsparameter angefordert, Bank2" UBYTE B_TRUE 1 100 0 1 BIT_MASK 0x1 FORMAT "%13.11" ECU_ADDRESS 0x7FB955 /end MEASUREMENT
/begin MEASUREMENT B_dkten "" UBYTE B_TRUE 1 100 0 1 BIT_MASK 0x1 FORMAT "%13.11" ECU_ADDRESS 0x7FB956 /end MEASUREMENT
/begin MEASUREMENT B_dkten2 "DKAT f¸r diesen Trip nicht mehr aktiv (Bank2)" UBYTE B_TRUE 1 100 0 1 BIT_MASK 0x1 FORMAT "%13.11" ECU_ADDRESS 0x7FB957 /end MEASUREMENT
/begin MEASUREMENT B_dktlp "Umschaltung der Lambdaregelungsparameter angefordert" UBYTE B_TRUE 1 100 0 1 BIT_MASK 0x1 FORMAT "%13.11" ECU_ADDRESS 0x7FB958 /end MEASUREMENT
/begin MEASUREMENT B_dktnr "" UBYTE B_TRUE 1 100 0 1 BIT_MASK 0x1 FORMAT "%13.11" ECU_ADDRESS 0x7FB959 /end MEASUREMENT
/begin MEASUREMENT B_dktnr2 "" UBYTE B_TRUE 1 100 0 1 BIT_MASK 0x1 FORMAT "%13.11" ECU_ADDRESS 0x7FB95A /end MEASUREMENT
/begin MEASUREMENT B_dktsb "" UBYTE B_TRUE 1 100 0 1 BIT_MASK 0x1 FORMAT "%13.11" ECU_ADDRESS 0x7FB95B /end MEASUREMENT
/begin MEASUREMENT B_dktsb2 "" UBYTE B_TRUE 1 100 0 1 BIT_MASK 0x1 FORMAT "%13.11" ECU_ADDRESS 0x7FB95C /end MEASUREMENT
/begin MEASUREMENT B_dktsp "" UBYTE B_TRUE 1 100 0 1 BIT_MASK 0x1 FORMAT "%13.11" ECU_ADDRESS 0x7FB95D /end MEASUREMENT
/begin MEASUREMENT B_dktsp2 "" UBYTE B_TRUE 1 100 0 1 BIT_MASK 0x1 FORMAT "%13.11" ECU_ADDRESS 0x7FB95E /end MEASUREMENT
/begin MEASUREMENT B_dktst "" UBYTE B_TRUE 1 100 0 1 BIT_MASK 0x1 FORMAT "%13.11" ECU_ADDRESS 0x7FB95F /end MEASUREMENT
/begin MEASUREMENT B_dktst2 "" UBYTE B_TRUE 1 100 0 1 BIT_MASK 0x1 FORMAT "%13.11" ECU_ADDRESS 0x7FB960 /end MEASUREMENT
/begin MEASUREMENT B_dktt "" UBYTE B_TRUE 1 100 0 1 BIT_MASK 0x1 FORMAT "%13.11" ECU_ADDRESS 0x7FB961 /end MEASUREMENT
/begin MEASUREMENT B_dktt2 "DKAT-Aktiv-Zeit abgelaufen, Bank2" UBYTE B_TRUE 1 100 0 1 BIT_MASK 0x1 FORMAT "%13.11" ECU_ADDRESS 0x7FB962 /end MEASUREMENT
/begin MEASUREMENT B_dkvsef "Errorflag in DKVS trotz weitere Fehler im System freigeben" UBYTE B_TRUE 1 100 0 1 BIT_MASK 0x1 FORMAT "%13.11" ECU_ADDRESS 0x7FB9ED /end MEASUREMENT
/begin MEASUREMENT B_dkvsef2 "Erroflag in DKVS trotz weitere Fehler im System freigeben Bank 2" UBYTE B_TRUE 1 100 0 1 BIT_MASK 0x1 FORMAT "%13.11" ECU_ADDRESS 0x7FB9EE /end MEASUREMENT
/begin MEASUREMENT B_dkvsf "Bedingung: Freigabe des Fehlers" UBYTE B_TRUE 1 100 0 1 BIT_MASK 0x1 FORMAT "%13.11" ECU_ADDRESS 0x7FB9EF /end MEASUREMENT
/begin MEASUREMENT B_dkvsfm "Bedingung: Freigabe des Fehlers (Flipflop Ausgang)" UBYTE B_TRUE 1 100 0 1 BIT_MASK 0x1 FORMAT "%13.11" ECU_ADDRESS 0x7F9BBA /end MEASUREMENT
/begin MEASUREMENT B_dkvstr "Bedingung: Integrator bei Tankleer zur¸cksetzen" UBYTE B_TRUE 1 100 0 1 BIT_MASK 0x1 FORMAT "%13.11" ECU_ADDRESS 0x7FB9F0 /end MEASUREMENT
/begin MEASUREMENT B_dkvszf "Zyklusflag in DKVS trotz weitere Fehler im System freigeben" UBYTE B_TRUE 1 100 0 1 BIT_MASK 0x1 FORMAT "%13.11" ECU_ADDRESS 0x7FD5A5 /end MEASUREMENT
/begin MEASUREMENT B_dkvszf2 "" UBYTE B_TRUE 1 100 0 1 BIT_MASK 0x20 FORMAT "%13.11" ECU_ADDRESS 0x7FD5A5 /end MEASUREMENT
/begin MEASUREMENT B_dlaff "Anzahl der g¸ltigen Tp-Messungen erreicht seit B_dlatp=1" UBYTE B_TRUE 1 100 0 1 BIT_MASK 0x1 FORMAT "%13.11" ECU_ADDRESS 0x7FB971 /end MEASUREMENT
/begin MEASUREMENT B_dlaff2 "Anzahl der g¸ltigen Tp-Messungen erreicht seit B_dlatp2=1 Bank2" UBYTE B_TRUE 1 100 0 1 BIT_MASK 0x1 FORMAT "%13.11" ECU_ADDRESS 0x7FB972 /end MEASUREMENT
/begin MEASUREMENT B_dlatp "" UBYTE B_TRUE 1 100 0 1 BIT_MASK 0x1 FORMAT "%13.11" ECU_ADDRESS 0x7FB973 /end MEASUREMENT
/begin MEASUREMENT B_dlatp2 "" UBYTE B_TRUE 1 100 0 1 BIT_MASK 0x1 FORMAT "%13.11" ECU_ADDRESS 0x7FB974 /end MEASUREMENT
/begin MEASUREMENT B_dlatv "" UBYTE B_TRUE 1 100 0 1 BIT_MASK 0x1 FORMAT "%13.11" ECU_ADDRESS 0x7FB975 /end MEASUREMENT
/begin MEASUREMENT B_dlatv2 "" UBYTE B_TRUE 1 100 0 1 BIT_MASK 0x1 FORMAT "%13.11" ECU_ADDRESS 0x7FB976 /end MEASUREMENT
/begin MEASUREMENT B_dllr "Aktive diagnose: Leerlaufstellerdiagnose" UBYTE B_TRUE 1 100 0 1 BIT_MASK 0x1 FORMAT "%13.11" ECU_ADDRESS 0x7FBB22 /end MEASUREMENT
/begin MEASUREMENT B_dllra "Bedingung DLLR Anforderung" UBYTE B_TRUE 1 100 0 1 BIT_MASK 0x1 FORMAT "%13.11" ECU_ADDRESS 0x7FBB23 /end MEASUREMENT
/begin MEASUREMENT B_dlrstp "" UBYTE B_TRUE 1 100 0 1 BIT_MASK 0x1 FORMAT "%13.11" ECU_ADDRESS 0x7FB981 /end MEASUREMENT
/begin MEASUREMENT B_dlrstp2 "" UBYTE B_TRUE 1 100 0 1 BIT_MASK 0x1 FORMAT "%13.11" ECU_ADDRESS 0x7FB982 /end MEASUREMENT
/begin MEASUREMENT B_dmaso "Bedingung gemeinsame Sondenmasse offen" UBYTE B_TRUE 1 100 0 1 BIT_MASK 0x1 FORMAT "%13.11" ECU_ADDRESS 0x7FB983 /end MEASUREMENT
/begin MEASUREMENT B_dmaso2 "Bedingung gemeinsame Sondenmasse offen" UBYTE B_TRUE 1 100 0 1 BIT_MASK 0x1 FORMAT "%13.11" ECU_ADDRESS 0x7FB984 /end MEASUREMENT
/begin MEASUREMENT B_drad "" UBYTE B_TRUE 1 100 0 1 BIT_MASK 0x1 FORMAT "%13.11" ECU_ADDRESS 0x7FBCAE /end MEASUREMENT
/begin MEASUREMENT B_drvddmtl "" UBYTE B_TRUE 1 100 0 1 BIT_MASK 0x4 FORMAT "%13.11" ECU_ADDRESS 0x7FD8CA /end MEASUREMENT
/begin MEASUREMENT B_drvdldp "" UBYTE B_TRUE 1 100 0 1 BIT_MASK 0x2 FORMAT "%13.11" ECU_ADDRESS 0x7FD8CA /end MEASUREMENT
/begin MEASUREMENT B_drvdtev "" UBYTE B_TRUE 1 100 0 1 BIT_MASK 0x1 FORMAT "%13.11" ECU_ADDRESS 0x7FD8CA /end MEASUREMENT
/begin MEASUREMENT B_ds "KR: Sensordiagnose aktiv" UBYTE B_TRUE 1 100 0 1 FORMAT "%13.11" ARRAY_SIZE 2 ECU_ADDRESS 0x7FD6A4 /end MEASUREMENT
/begin MEASUREMENT B_dsl "Bedingung Diagnoseanforderung" UWORD B_TRUE 1 100 0 1 BIT_MASK 0x8000 FORMAT "%13.11" ECU_ADDRESS 0x7FE0A2 /end MEASUREMENT
/begin MEASUREMENT B_dsl1 "Diagnose Phase 1: Bestimmung Sekund‰rluftmasse" UWORD B_TRUE 1 100 0 1 BIT_MASK 0x20 FORMAT "%13.11" ECU_ADDRESS 0x7FE0A4 /end MEASUREMENT
/begin MEASUREMENT B_dsl1ab "Diagnose Phase 1: Abbruch Phase 1" UWORD B_TRUE 1 100 0 1 BIT_MASK 0x40 FORMAT "%13.11" ECU_ADDRESS 0x7FE0A4 /end MEASUREMENT
/begin MEASUREMENT B_dsl1e "Diagnose Phase 1, Meﬂfreigabe Sekund‰rluftmasse" UWORD B_TRUE 1 100 0 1 BIT_MASK 0x80 FORMAT "%13.11" ECU_ADDRESS 0x7FE0A4 /end MEASUREMENT
/begin MEASUREMENT B_dsl2 "Diagnose Phase 2: Ventildichtheit" UWORD B_TRUE 1 100 0 1 BIT_MASK 0x100 FORMAT "%13.11" ECU_ADDRESS 0x7FE0A4 /end MEASUREMENT
/begin MEASUREMENT B_dsl2ab "Diagnose Phase 2: Abbruch Phase 2" UWORD B_TRUE 1 100 0 1 BIT_MASK 0x200 FORMAT "%13.11" ECU_ADDRESS 0x7FE0A4 /end MEASUREMENT
/begin MEASUREMENT B_dsl2e "Diagnose Phase 2: Freigabe Messung" UWORD B_TRUE 1 100 0 1 BIT_MASK 0x400 FORMAT "%13.11" ECU_ADDRESS 0x7FE0A4 /end MEASUREMENT
/begin MEASUREMENT B_dsl3 "Diagnose Phase3: Offset Sekund‰rluftmasse" UWORD B_TRUE 1 100 0 1 BIT_MASK 0x800 FORMAT "%13.11" ECU_ADDRESS 0x7FE0A4 /end MEASUREMENT
/begin MEASUREMENT B_dsl3ab "Diagnose Phase 3: Abbruch" UWORD B_TRUE 1 100 0 1 BIT_MASK 0x1000 FORMAT "%13.11" ECU_ADDRESS 0x7FE0A4 /end MEASUREMENT
/begin MEASUREMENT B_dsl3e "Diagnose Phase 3: Freigabe Messung" UWORD B_TRUE 1 100 0 1 BIT_MASK 0x2000 FORMAT "%13.11" ECU_ADDRESS 0x7FE0A4 /end MEASUREMENT
/begin MEASUREMENT B_dsl4 "Bedingung Phase 4: Sekund‰rluftmasse aus Adaption/Zusatzdiagnose" UWORD B_TRUE 1 100 0 1 BIT_MASK 0x1 FORMAT "%13.11" ECU_ADDRESS 0x7FE0A6 /end MEASUREMENT
/begin MEASUREMENT B_dsl4ab "Bedingung: Abbruch Phase 4" UWORD B_TRUE 1 100 0 1 BIT_MASK 0x2 FORMAT "%13.11" ECU_ADDRESS 0x7FE0A6 /end MEASUREMENT
/begin MEASUREMENT B_dsl4e "Bedingung: Phase 4 Freigabe Messung" UWORD B_TRUE 1 100 0 1 BIT_MASK 0x4 FORMAT "%13.11" ECU_ADDRESS 0x7FE0A6 /end MEASUREMENT
/begin MEASUREMENT B_dsl5 "Diagnose Phase 5: Offset Sekund‰rluftmasse" UWORD B_TRUE 1 100 0 1 BIT_MASK 0x10 FORMAT "%13.11" ECU_ADDRESS 0x7FE0A6 /end MEASUREMENT
/begin MEASUREMENT B_dsl5ab "Diagnose Phase 5: Abbruch" UWORD B_TRUE 1 100 0 1 BIT_MASK 0x20 FORMAT "%13.11" ECU_ADDRESS 0x7FE0A6 /end MEASUREMENT
/begin MEASUREMENT B_dsl5e "Diagnose Phase 5: Freigabe Messung" UWORD B_TRUE 1 100 0 1 BIT_MASK 0x40 FORMAT "%13.11" ECU_ADDRESS 0x7FE0A6 /end MEASUREMENT
/begin MEASUREMENT B_dsla "Adaptionsphase: Bestimmung Sekund‰rluftmasse" UBYTE B_TRUE 1 100 0 1 BIT_MASK 0x1 FORMAT "%13.11" ECU_ADDRESS 0x7FBC58 /end MEASUREMENT
/begin MEASUREMENT B_dslerr "Zusammenfassung Abbruchmerkmale Sekund‰rluftdiagnose" UWORD B_TRUE 1 100 0 1 BIT_MASK 0x8 FORMAT "%13.11" ECU_ADDRESS 0x7FE0A2 /end MEASUREMENT
/begin MEASUREMENT B_dslfa "Bedingung: Anforderung SL-System f¸r Kurztest" UBYTE B_TRUE 1 100 0 1 BIT_MASK 0x1 FORMAT "%13.11" ECU_ADDRESS 0x7FBC59 /end MEASUREMENT
/begin MEASUREMENT B_dslm "Diagnose Sekund‰rluftmasse" UWORD B_TRUE 1 100 0 1 BIT_MASK 0x10 FORMAT "%13.11" ECU_ADDRESS 0x7FE0A2 /end MEASUREMENT
/begin MEASUREMENT B_dslmab "Diagnose Sekund‰rluftmasse, Meﬂabbruch" UWORD B_TRUE 1 100 0 1 BIT_MASK 0x20 FORMAT "%13.11" ECU_ADDRESS 0x7FE0A2 /end MEASUREMENT
/begin MEASUREMENT B_dslme "Diagnose Sekund‰rluftmasse, Meﬂfreigabe" UWORD B_TRUE 1 100 0 1 BIT_MASK 0x40 FORMAT "%13.11" ECU_ADDRESS 0x7FE0A2 /end MEASUREMENT
/begin MEASUREMENT B_dslmes "Bedingung: Freigabe Meﬂfenster" UWORD B_TRUE 1 100 0 1 BIT_MASK 0x80 FORMAT "%13.11" ECU_ADDRESS 0x7FE0A2 /end MEASUREMENT
/begin MEASUREMENT B_dslo "Diagnose Sekund‰rluftmassenoffset" UWORD B_TRUE 1 100 0 1 BIT_MASK 0x100 FORMAT "%13.11" ECU_ADDRESS 0x7FE0A2 /end MEASUREMENT
/begin MEASUREMENT B_dsloab "Diagnose Sekund‰rluftoffset, Meﬂabbruch" UWORD B_TRUE 1 100 0 1 BIT_MASK 0x200 FORMAT "%13.11" ECU_ADDRESS 0x7FE0A2 /end MEASUREMENT
/begin MEASUREMENT B_dsloe "Diagnose Sekund‰rluftoffset, Meﬂfreigabe" UWORD B_TRUE 1 100 0 1 BIT_MASK 0x400 FORMAT "%13.11" ECU_ADDRESS 0x7FE0A2 /end MEASUREMENT
/begin MEASUREMENT B_dsls "Aktive Diagnose: Sekund‰rluft-System" UBYTE B_TRUE 1 100 0 1 BIT_MASK 0x1 FORMAT "%13.11" ECU_ADDRESS 0x7FBC5A /end MEASUREMENT
/begin MEASUREMENT B_dslsp4 "Bedingung: Anforderung SL-System f¸r Sekund‰rluftadaption/Zusatzdiagnose" UBYTE B_TRUE 1 100 0 1 BIT_MASK 0x1 FORMAT "%13.11" ECU_ADDRESS 0x7FBC5B /end MEASUREMENT
/begin MEASUREMENT B_dslsre "" UWORD B_TRUE 1 100 0 1 BIT_MASK 0x400 FORMAT "%13.11" ECU_ADDRESS 0x7FE0A6 /end MEASUREMENT
/begin MEASUREMENT B_dslsse "" UWORD B_TRUE 1 100 0 1 BIT_MASK 0x200 FORMAT "%13.11" ECU_ADDRESS 0x7FE0A6 /end MEASUREMENT
/begin MEASUREMENT B_dslt "" UWORD B_TRUE 1 100 0 1 BIT_MASK 0x800 FORMAT "%13.11" ECU_ADDRESS 0x7FE0A2 /end MEASUREMENT
/begin MEASUREMENT B_dsltab "Diagnose Ventilichtheit, Meﬂabbruch" UWORD B_TRUE 1 100 0 1 BIT_MASK 0x1 FORMAT "%13.11" ECU_ADDRESS 0x7FE0A4 /end MEASUREMENT
/begin MEASUREMENT B_dslte "Diagnose Ventildichtheit, Meﬂfreigabe" UWORD B_TRUE 1 100 0 1 BIT_MASK 0x2 FORMAT "%13.11" ECU_ADDRESS 0x7FE0A4 /end MEASUREMENT
/begin MEASUREMENT B_dspe "Bedingung Diagnose Sekund‰rluft ein" UBYTE B_TRUE 1 100 0 1 BIT_MASK 0x1 FORMAT "%13.11" ECU_ADDRESS 0x7FBC5C /end MEASUREMENT
/begin MEASUREMENT B_dsper "Bedingung R¸cksetzen ESP ein" UWORD B_TRUE 1 100 0 1 BIT_MASK 0x4 FORMAT "%13.11" ECU_ADDRESS 0x7FE0A4 /end MEASUREMENT
/begin MEASUREMENT B_dspes "Bedingung Setzen ESP ein" UWORD B_TRUE 1 100 0 1 BIT_MASK 0x8 FORMAT "%13.11" ECU_ADDRESS 0x7FE0A4 /end MEASUREMENT
/begin MEASUREMENT B_dsven "Bedingung Freigabe Sondendiagnose vor KAT" UBYTE B_TRUE 1 100 0 1 BIT_MASK 0x1 FORMAT "%13.11" ECU_ADDRESS 0x7FB985 /end MEASUREMENT
/begin MEASUREMENT B_dsven2 "Bedingung Freigabe Sondendiagnose vor KAT Bank2" UBYTE B_TRUE 1 100 0 1 BIT_MASK 0x1 FORMAT "%13.11" ECU_ADDRESS 0x7FB986 /end MEASUREMENT
/begin MEASUREMENT B_dteaa "Bedingung Aufsteuerpr¸fung f¸r TEV Diagnose aktiv" UBYTE B_TRUE 1 100 0 1 BIT_MASK 0x1 FORMAT "%13.11" ECU_ADDRESS 0x7FBC3B /end MEASUREMENT
/begin MEASUREMENT B_dteabr "Abbruch der TE-Diagnose durch Stˆreinfl¸sse (Beschreibungsvariable)" UBYTE B_TRUE 1 100 0 1 BIT_MASK 0x1 FORMAT "%13.11" ECU_ADDRESS 0x7FD788 /end MEASUREMENT
/begin MEASUREMENT B_dtean "Abbruch TE-Diagnose wegen ƒnderung der Solldrehzahl" UBYTE B_TRUE 1 100 0 1 BIT_MASK 0x2 FORMAT "%13.11" ECU_ADDRESS 0x7FD788 /end MEASUREMENT
/begin MEASUREMENT B_dteaq "Abbruch TE-Diagnose wegen ƒnderung der Vorsteuerluft" UBYTE B_TRUE 1 100 0 1 BIT_MASK 0x4 FORMAT "%13.11" ECU_ADDRESS 0x7FD788 /end MEASUREMENT
/begin MEASUREMENT B_dtebel "Eingangsbedingungen der Beladungspr¸fung erf¸llt" UBYTE B_TRUE 1 100 0 1 BIT_MASK 0x8 FORMAT "%13.11" ECU_ADDRESS 0x7FD788 /end MEASUREMENT
/begin MEASUREMENT B_dtebn "Beginn der Drehzahlpr¸fung" UBYTE B_TRUE 1 100 0 1 BIT_MASK 0x1 FORMAT "%13.11" ECU_ADDRESS 0x7FBC3C /end MEASUREMENT
/begin MEASUREMENT B_dtei "Steuerbit f¸r Integrator bei Tankentl¸ftungsdiagnose" UBYTE B_TRUE 1 100 0 1 BIT_MASK 0x1 FORMAT "%13.11" ECU_ADDRESS 0x7FBC3D /end MEASUREMENT
/begin MEASUREMENT B_dtes "Aktive Diagnose: Tankentl¸ftungssystem" UBYTE B_TRUE 1 100 0 1 BIT_MASK 0x1 FORMAT "%13.11" ECU_ADDRESS 0x7FBC3E /end MEASUREMENT
/begin MEASUREMENT B_dtesq "Abbruch der TE-Diagnose wegen Stˆrungen der Solluft" UBYTE B_TRUE 1 100 0 1 BIT_MASK 0x10 FORMAT "%13.11" ECU_ADDRESS 0x7FD788 /end MEASUREMENT
/begin MEASUREMENT B_dtest "Start f¸r TEV-Ansteuerung" UBYTE B_TRUE 1 100 0 1 BIT_MASK 0x1 FORMAT "%13.11" ECU_ADDRESS 0x7FBC3F /end MEASUREMENT
/begin MEASUREMENT B_dtevio "Bedingung TEV i.O. (Beschreibungsvariable)" UBYTE B_TRUE 1 100 0 1 BIT_MASK 0x20 FORMAT "%13.11" ECU_ADDRESS 0x7FD788 /end MEASUREMENT
/begin MEASUREMENT B_dths1 "Bedingung f¸r TKA-Diagnoseschwelle" UBYTE B_TRUE 1 100 0 1 BIT_MASK 0x1 FORMAT "%13.11" ECU_ADDRESS 0x7FD7C8 /end MEASUREMENT
/begin MEASUREMENT B_dthsab "Bedingung f¸r Abbruch der Diagnosefunktion" UBYTE B_TRUE 1 100 0 1 BIT_MASK 0x2 FORMAT "%13.11" ECU_ADDRESS 0x7FD7C8 /end MEASUREMENT
/begin MEASUREMENT B_dthsfr "Bedingung f¸r Freigabe der Diagnosefunktion" UBYTE B_TRUE 1 100 0 1 BIT_MASK 0x4 FORMAT "%13.11" ECU_ADDRESS 0x7FD7C8 /end MEASUREMENT
/begin MEASUREMENT B_dthsst "Bedindung f¸r Diagnosestop" UBYTE B_TRUE 1 100 0 1 BIT_MASK 0x8 FORMAT "%13.11" ECU_ADDRESS 0x7FD7C8 /end MEASUREMENT
/begin MEASUREMENT B_dtimer "" UBYTE B_TRUE 1 100 0 1 BIT_MASK 0x1 FORMAT "%13.11" ECU_ADDRESS 0x7FD7F2 /end MEASUREMENT
/begin MEASUREMENT B_ebDavT "Bedingung ETK_Bypass Daten verf¸gbar" UBYTE B_TRUE 1 100 0 1 BIT_MASK 0x1 FORMAT "%13.11" ECU_ADDRESS 0x7FD7F3 /end MEASUREMENT
/begin MEASUREMENT B_ebDavY "ETK-Bypass Daten vorhanden" UBYTE B_TRUE 1 100 0 1 BIT_MASK 0x1 FORMAT "%13.11" ECU_ADDRESS 0x7FD7F4 /end MEASUREMENT
/begin MEASUREMENT B_ebl "Bedingung Ansteuerung E-Box L¸fter" UBYTE B_TRUE 1 100 0 1 BIT_MASK 0x1 FORMAT "%13.11" ECU_ADDRESS 0x7FBC62 /end MEASUREMENT
/begin MEASUREMENT B_edkvs "Bedingung Adaptionsfehlerschwellen aktuell ¸berschritten" UBYTE B_TRUE 1 100 0 1 BIT_MASK 0x1 FORMAT "%13.11" ECU_ADDRESS 0x7FB9F1 /end MEASUREMENT
/begin MEASUREMENT B_edkvs2 "Bedingung Adaptionsfehlerschwellen Bank 2 aktuell ¸berschritten" UBYTE B_TRUE 1 100 0 1 BIT_MASK 0x1 FORMAT "%13.11" ECU_ADDRESS 0x7FB9F2 /end MEASUREMENT
/begin MEASUREMENT B_efrao "Bedingung Diagnoseschwellen obere multipl. Korrektur aktuell ¸berschritten" UBYTE B_TRUE 1 100 0 1 BIT_MASK 0x1 FORMAT "%13.11" ECU_ADDRESS 0x7FB9F3 /end MEASUREMENT
/begin MEASUREMENT B_efrao2 "Bedingung Diagnoseschwellen obere multipl. Korr. Bank 2 aktuell ¸berschritten" UBYTE B_TRUE 1 100 0 1 BIT_MASK 0x1 FORMAT "%13.11" ECU_ADDRESS 0x7FB9F4 /end MEASUREMENT
/begin MEASUREMENT B_efrau "Bedingung Diagnoseschwellen untere multipl. Korrektur aktuell ¸berschritten" UBYTE B_TRUE 1 100 0 1 BIT_MASK 0x1 FORMAT "%13.11" ECU_ADDRESS 0x7FB9F5 /end MEASUREMENT
/begin MEASUREMENT B_efrau2 "Bedingung Diagnoseschwellen untere multipl. Korr. Bank 2 aktuell ¸berschritten" UBYTE B_TRUE 1 100 0 1 BIT_MASK 0x1 FORMAT "%13.11" ECU_ADDRESS 0x7FB9F6 /end MEASUREMENT
/begin MEASUREMENT B_ekats "" UBYTE B_TRUE 1 100 0 1 BIT_MASK 0x1 FORMAT "%13.11" ECU_ADDRESS 0x7FB963 /end MEASUREMENT
/begin MEASUREMENT B_ekats2 "" UBYTE B_TRUE 1 100 0 1 BIT_MASK 0x1 FORMAT "%13.11" ECU_ADDRESS 0x7FB964 /end MEASUREMENT
/begin MEASUREMENT B_ekp "Freigabe der EKP-Versorgung" UBYTE B_TRUE 1 100 0 1 FORMAT "%13.11" ECU_ADDRESS 0x7F9F1E /end MEASUREMENT
/begin MEASUREMENT B_ekpbts "Bedingung EKP BTS aktiv / freigegeben" UBYTE B_TRUE 1 100 0 1 FORMAT "%13.11" ECU_ADDRESS 0x7F9F20 /end MEASUREMENT
/begin MEASUREMENT B_ekpbtssc "Bedingung EKP BTS Kurzschluss" UBYTE B_TRUE 1 100 0 1 FORMAT "%13.11" ECU_ADDRESS 0x7F9F22 /end MEASUREMENT
/begin MEASUREMENT B_Ekurz "Kurzschluﬂ UB" UBYTE B_TRUE 1 100 0 1 BIT_MASK 0x1 FORMAT "%13.11" ECU_ADDRESS 0x7F9B50 /end MEASUREMENT
/begin MEASUREMENT B_elshvke "Bedingung Endstufenfehler LSHVK" UBYTE B_TRUE 1 100 0 1 BIT_MASK 0x1 FORMAT "%13.11" ECU_ADDRESS 0x7FB9BA /end MEASUREMENT
/begin MEASUREMENT B_erdkt "" UBYTE B_TRUE 1 100 0 1 BIT_MASK 0x1 FORMAT "%13.11" ECU_ADDRESS 0x7FB965 /end MEASUREMENT
/begin MEASUREMENT B_erdkt2 "" UBYTE B_TRUE 1 100 0 1 BIT_MASK 0x1 FORMAT "%13.11" ECU_ADDRESS 0x7FB966 /end MEASUREMENT
/begin MEASUREMENT B_erkat "Bedingung Diagnoseschwellen additive Korr. pro Zeit aktuell ¸berschritten" UBYTE B_TRUE 1 100 0 1 BIT_MASK 0x1 FORMAT "%13.11" ECU_ADDRESS 0x7FB9F7 /end MEASUREMENT
/begin MEASUREMENT B_erkat2 "Bedingung Diagnoseschwellen additive Korr. pro Zeit Bank 2 aktuell ¸berschritten" UBYTE B_TRUE 1 100 0 1 BIT_MASK 0x1 FORMAT "%13.11" ECU_ADDRESS 0x7FB9F8 /end MEASUREMENT
/begin MEASUREMENT B_erkaz "Bedingung Diagnoseschwellen additive Korr. pro Einspr.  aktuell ¸berschritten" UBYTE B_TRUE 1 100 0 1 BIT_MASK 0x1 FORMAT "%13.11" ECU_ADDRESS 0x7FB9F9 /end MEASUREMENT
/begin MEASUREMENT B_erkaz2 "Bedingung Diagnoseschw. additive Korr. pro Einspr. Bank 2 aktuell ¸berschritten" UBYTE B_TRUE 1 100 0 1 BIT_MASK 0x1 FORMAT "%13.11" ECU_ADDRESS 0x7FB9FA /end MEASUREMENT
/begin MEASUREMENT B_errofs "Bedingung: zul‰ssige Sekund‰rluftmassen-Offset ¸berschritten" UWORD B_TRUE 1 100 0 1 BIT_MASK 0x10 FORMAT "%13.11" ECU_ADDRESS 0x7FE0A4 /end MEASUREMENT
/begin MEASUREMENT B_errofs2 "Bedingung: max. zul‰ssiger Offsetwert ¸berschritten, Bank 2" UWORD B_TRUE 1 100 0 1 BIT_MASK 0x1000 FORMAT "%13.11" ECU_ADDRESS 0x7FE0A2 /end MEASUREMENT
/begin MEASUREMENT B_esls "Bedingung Falschluft durch Fehler im Sekund‰rluftsystem" UBYTE B_TRUE 1 100 0 1 BIT_MASK 0x1 FORMAT "%13.11" ECU_ADDRESS 0x7FBC5D /end MEASUREMENT
/begin MEASUREMENT B_eslve "Bedingung Endstufenfehler SLV" UBYTE B_TRUE 1 100 0 1 BIT_MASK 0x1 FORMAT "%13.11" ECU_ADDRESS 0x7FB9B9 /end MEASUREMENT
/begin MEASUREMENT B_esste "" UBYTE B_TRUE 1 100 0 1 BIT_MASK 0x1 FORMAT "%13.11" ECU_ADDRESS 0x7FB9BB /end MEASUREMENT
/begin MEASUREMENT B_estarte "Bedingung Endstufenfehler START" UBYTE B_TRUE 1 100 0 1 BIT_MASK 0x1 FORMAT "%13.11" ECU_ADDRESS 0x7FB9BC /end MEASUREMENT
/begin MEASUREMENT B_estp "" UBYTE B_TRUE 1 100 0 1 BIT_MASK 0x1 FORMAT "%13.11" ECU_ADDRESS 0x7FB9BD /end MEASUREMENT
/begin MEASUREMENT B_etde "" UBYTE B_TRUE 1 100 0 1 BIT_MASK 0x1 FORMAT "%13.11" ECU_ADDRESS 0x7FB9B5 /end MEASUREMENT
/begin MEASUREMENT B_eteve "Bedingung Endstufenfehler TEV" UBYTE B_TRUE 1 100 0 1 BIT_MASK 0x1 FORMAT "%13.11" ECU_ADDRESS 0x7FB9B7 /end MEASUREMENT
/begin MEASUREMENT B_faslarq "Bedingung: lokale Anforderung Testdurchlauf Sekund‰rluft starten" UWORD B_TRUE 1 100 0 1 BIT_MASK 0x800 FORMAT "%13.11" ECU_ADDRESS 0x7FE0A6 /end MEASUREMENT
/begin MEASUREMENT B_frgAnl "Freigabe-Flag fuer Anlasser" UBYTE B_TRUE 1 100 0 1 FORMAT "%13.11" ECU_ADDRESS 0x7F9F24 /end MEASUREMENT
/begin MEASUREMENT B_frste "Bedingung frm_w eingeschwungen (Kurztest)" UBYTE B_TRUE 1 100 0 1 BIT_MASK 0x1 FORMAT "%13.11" ECU_ADDRESS 0x7FB9FB /end MEASUREMENT
/begin MEASUREMENT B_frste2 "Bedingung frm2_w eingeschwungen (Kurztest 2. Bank)" UBYTE B_TRUE 1 100 0 1 BIT_MASK 0x1 FORMAT "%13.11" ECU_ADDRESS 0x7FB9FC /end MEASUREMENT
/begin MEASUREMENT B_ftmdb "Bedingung: Fehlereintrag durch Tester f¸r MDB" UWORD B_TRUE 1 100 0 1 BIT_MASK 0x10 FORMAT "%13.11" ECU_ADDRESS 0x7F9650 /end MEASUREMENT
/begin MEASUREMENT B_gae "Bedingung Grundadaption eingeschwungen" UBYTE B_TRUE 1 100 0 1 BIT_MASK 0x1 FORMAT "%13.11" ECU_ADDRESS 0x7FB9FD /end MEASUREMENT
/begin MEASUREMENT B_gaefra "Bedingung Grundadaption (fra-Integrator) eingeschwungen" UBYTE B_TRUE 1 100 0 1 BIT_MASK 0x1 FORMAT "%13.11" ECU_ADDRESS 0x7FB9FE /end MEASUREMENT
/begin MEASUREMENT B_gaefra2 "Bedingung Grundadaption (fra2-Integrator) eingeschwungen" UBYTE B_TRUE 1 100 0 1 BIT_MASK 0x1 FORMAT "%13.11" ECU_ADDRESS 0x7FB9FF /end MEASUREMENT
/begin MEASUREMENT B_gaeing "Bedingung Grundadaption Bank 1 eingeschwungen" UBYTE B_TRUE 1 100 0 1 BIT_MASK 0x1 FORMAT "%13.11" ECU_ADDRESS 0x7FBA00 /end MEASUREMENT
/begin MEASUREMENT B_gaeing2 "Bedingung Grundadaption Bank 2 eingeschwungenen" UBYTE B_TRUE 1 100 0 1 BIT_MASK 0x1 FORMAT "%13.11" ECU_ADDRESS 0x7FBA01 /end MEASUREMENT
/begin MEASUREMENT B_heaths "Bedingung Fehler DTHS geheilt" UBYTE B_TRUE 1 100 0 1 BIT_MASK 0x10 FORMAT "%13.11" ECU_ADDRESS 0x7FD7C8 /end MEASUREMENT
/begin MEASUREMENT B_hsrdy "Bedingung Sondenheizung gepr¸ft f¸r 'ready-Byte'" UBYTE B_TRUE 1 100 0 1 BIT_MASK 0x40 FORMAT "%13.11" ECU_ADDRESS 0x7F9AE6 /end MEASUREMENT
/begin MEASUREMENT B_imlkvse "Bedingung Luftmassenintegral R¸cksetzen" UBYTE B_TRUE 1 100 0 1 BIT_MASK 0x2 FORMAT "%13.11" ECU_ADDRESS 0x7F9BBA /end MEASUREMENT
/begin MEASUREMENT B_kathrdy "Bedingung Katalysator-Heizungen gepr¸ft f¸r 'ready-Byte'" UBYTE B_TRUE 1 100 0 1 BIT_MASK 0x2 FORMAT "%13.11" ECU_ADDRESS 0x7F9AE6 /end MEASUREMENT
/begin MEASUREMENT B_katrdy "Bedingung Katalysatoren gepr¸ft f¸r 'ready-Byte'" UBYTE B_TRUE 1 100 0 1 BIT_MASK 0x1 FORMAT "%13.11" ECU_ADDRESS 0x7F9AE6 /end MEASUREMENT
/begin MEASUREMENT B_killdiag "Bedingung Killschalterdiagnosenphase aktiv" UBYTE B_TRUE 1 100 0 1 BIT_MASK 0x1 FORMAT "%13.11" ECU_ADDRESS 0x7FBCA2 /end MEASUREMENT
/begin MEASUREMENT B_kkrdy "Bedingung Klimak¸hlmittel gepr¸ft f¸r 'ready-Byte'" UBYTE B_TRUE 1 100 0 1 BIT_MASK 0x10 FORMAT "%13.11" ECU_ADDRESS 0x7F9AE6 /end MEASUREMENT
/begin MEASUREMENT B_kl15 "Bedingung Klemme 15" UBYTE B_TRUE 1 100 0 1 FORMAT "%13.11" ECU_ADDRESS 0x7F9F26 /end MEASUREMENT
/begin MEASUREMENT B_kmmil "MIL-Ansteuerung mit Relevanz zu Kilometererfassung" UBYTE B_TRUE 1 100 0 1 BIT_MASK 0x1 FORMAT "%13.11" ECU_ADDRESS 0x7FB940 /end MEASUREMENT
/begin MEASUREMENT B_krdws "Bedingung Klopfregelung Sicherheitssp‰tverstellung" UBYTE B_TRUE 1 100 0 1 BIT_MASK 0x1 FORMAT "%13.11" ECU_ADDRESS 0x7FBAD4 /end MEASUREMENT
/begin MEASUREMENT B_krntfv "KR: Fehlerverdacht Nulltest" UBYTE B_TRUE 1 100 0 1 BIT_MASK 0x1 FORMAT "%13.11" ECU_ADDRESS 0x7FBAD5 /end MEASUREMENT
/begin MEASUREMENT B_krtpfv "KR: Testimpuls Fehlerverdacht" UBYTE B_TRUE 1 100 0 1 BIT_MASK 0x1 FORMAT "%13.11" ECU_ADDRESS 0x7FBADA /end MEASUREMENT
/begin MEASUREMENT B_kvsffl "Bedingung: Freigabe des Fehlers trotz Tank leer" UBYTE B_TRUE 1 100 0 1 BIT_MASK 0x1 FORMAT "%13.11" ECU_ADDRESS 0x7FBA02 /end MEASUREMENT
/begin MEASUREMENT B_lldia "Diagnose Leerlaufregelung freigegeben" UBYTE B_TRUE 1 100 0 1 BIT_MASK 0x1 FORMAT "%13.11" ECU_ADDRESS 0x7FBB24 /end MEASUREMENT
/begin MEASUREMENT B_lsads "Bedingung Sonde hat Adernschluﬂ" UWORD B_TRUE 1 100 0 1 BIT_MASK 0x400 FORMAT "%13.11" ECU_ADDRESS 0x7F9B4A /end MEASUREMENT
/begin MEASUREMENT B_lsads2 "Bedingung Sonde hat Adernschluﬂ Bank2" UWORD B_TRUE 1 100 0 1 BIT_MASK 0x800 FORMAT "%13.11" ECU_ADDRESS 0x7F9B4A /end MEASUREMENT
/begin MEASUREMENT B_lsastp "allgemeine Stop-Bedingungen f¸r die DLSA" UBYTE B_TRUE 1 100 0 1 BIT_MASK 0x1 FORMAT "%13.11" ECU_ADDRESS 0x7FB977 /end MEASUREMENT
/begin MEASUREMENT B_lsastp2 "allgemeine Stop-Bedingungen f¸r die DLSA  Bank2" UBYTE B_TRUE 1 100 0 1 BIT_MASK 0x1 FORMAT "%13.11" ECU_ADDRESS 0x7FB978 /end MEASUREMENT
/begin MEASUREMENT B_lsfet "Bedingung Sondenspannung hat Nebenschluﬂ nach Ubatt" UWORD B_TRUE 1 100 0 1 BIT_MASK 0x4 FORMAT "%13.11" ECU_ADDRESS 0x7F9B4A /end MEASUREMENT
/begin MEASUREMENT B_lsfet2 "Bedingung Sondenspannung hat Nebenschluﬂ nach Ubatt Bank2" UWORD B_TRUE 1 100 0 1 BIT_MASK 0x8 FORMAT "%13.11" ECU_ADDRESS 0x7F9B4A /end MEASUREMENT
/begin MEASUREMENT B_lshub "Bedingung Sonde begrenzter Spannungshub" UWORD B_TRUE 1 100 0 1 BIT_MASK 0x40 FORMAT "%13.11" ECU_ADDRESS 0x7F9B4A /end MEASUREMENT
/begin MEASUREMENT B_lshub2 "Bedingung Sonde begrenzter Spannungshub Bank 2" UWORD B_TRUE 1 100 0 1 BIT_MASK 0x80 FORMAT "%13.11" ECU_ADDRESS 0x7F9B4A /end MEASUREMENT
/begin MEASUREMENT B_lsrdy "Bedingung Lambda-Sonden gepr¸ft f¸r 'ready-Byte'" UBYTE B_TRUE 1 100 0 1 BIT_MASK 0x20 FORMAT "%13.11" ECU_ADDRESS 0x7F9AE6 /end MEASUREMENT
/begin MEASUREMENT B_lsvklt "Bedingung Lambdasonde vor Kat kalt" UBYTE B_TRUE 1 100 0 1 BIT_MASK 0x1 FORMAT "%13.11" ECU_ADDRESS 0x7FB987 /end MEASUREMENT
/begin MEASUREMENT B_lsvklt2 "Bedingung Lambdasonde vor Kat kalt Bank2" UBYTE B_TRUE 1 100 0 1 BIT_MASK 0x1 FORMAT "%13.11" ECU_ADDRESS 0x7FB988 /end MEASUREMENT
/begin MEASUREMENT B_lsvn "Bedingung Nebenschluﬂ bei kalter Sonde vor Kat" UWORD B_TRUE 1 100 0 1 BIT_MASK 0x1 FORMAT "%13.11" ECU_ADDRESS 0x7F9B4A /end MEASUREMENT
/begin MEASUREMENT B_lsvn2 "Bedingung Nebenschluﬂ bei kalter Sonde vor Kat, Bank2" UWORD B_TRUE 1 100 0 1 BIT_MASK 0x2 FORMAT "%13.11" ECU_ADDRESS 0x7F9B4A /end MEASUREMENT
/begin MEASUREMENT B_m8te "Bedingung Fkt-Anforderung Tankentl¸ftung nach SAE J1979 Mode 8 TID $01" UBYTE B_TRUE 1 100 0 1 BIT_MASK 0x1 FORMAT "%13.11" ECU_ADDRESS 0x7FB93F /end MEASUREMENT
/begin MEASUREMENT B_maso "Bedingung gemeinsame Sondenmasse offen" UWORD B_TRUE 1 100 0 1 BIT_MASK 0x10 FORMAT "%13.11" ECU_ADDRESS 0x7F9B4A /end MEASUREMENT
/begin MEASUREMENT B_maso2 "Bedingung gemeinsame Sondenmasse offen Bank2" UWORD B_TRUE 1 100 0 1 BIT_MASK 0x20 FORMAT "%13.11" ECU_ADDRESS 0x7F9B4A /end MEASUREMENT
/begin MEASUREMENT B_maxflsv "Kurzsschluﬂ nach UBatt bei Sonde vor KAT erkannt" UBYTE B_TRUE 1 100 0 1 BIT_MASK 0x1 FORMAT "%13.11" ECU_ADDRESS 0x7FD568 /end MEASUREMENT
/begin MEASUREMENT B_maxflsv2 "Kurzsschluﬂ nach UBatt bei Sonde vor KAT erkannt Bank2" UBYTE B_TRUE 1 100 0 1 BIT_MASK 0x2 FORMAT "%13.11" ECU_ADDRESS 0x7FD568 /end MEASUREMENT
/begin MEASUREMENT B_mil "MIL-Ansteuerung" UBYTE B_TRUE 1 100 0 1 BIT_MASK 0x1 FORMAT "%13.11" ECU_ADDRESS 0x7FB941 /end MEASUREMENT
/begin MEASUREMENT B_milblk "MIL-Ansteuerung blinkend" UBYTE B_TRUE 1 100 0 1 BIT_MASK 0x8 FORMAT "%13.11" ECU_ADDRESS 0x7FD8CB /end MEASUREMENT
/begin MEASUREMENT B_mileb "MIL-Ansteuerung eigenbestimmt" UBYTE B_TRUE 1 100 0 1 BIT_MASK 0x2 FORMAT "%13.11" ECU_ADDRESS 0x7FD8CB /end MEASUREMENT
/begin MEASUREMENT B_milst "MIL-Ansteuerung Prueffunktion bei Start" UBYTE B_TRUE 1 100 0 1 BIT_MASK 0x1 FORMAT "%13.11" ECU_ADDRESS 0x7FD8CB /end MEASUREMENT
/begin MEASUREMENT B_milstat "MIL - Status f¸r Scan Tool Mode $01 PID $01" UBYTE B_TRUE 1 100 0 1 BIT_MASK 0x1 FORMAT "%13.11" ECU_ADDRESS 0x7FB942 /end MEASUREMENT
/begin MEASUREMENT B_minflsv "" UBYTE B_TRUE 1 100 0 1 BIT_MASK 0x4 FORMAT "%13.11" ECU_ADDRESS 0x7FD568 /end MEASUREMENT
/begin MEASUREMENT B_minflsv2 "" UBYTE B_TRUE 1 100 0 1 BIT_MASK 0x8 FORMAT "%13.11" ECU_ADDRESS 0x7FD568 /end MEASUREMENT
/begin MEASUREMENT B_minths "Bedingung Fehler DTHS erkannt" UBYTE B_TRUE 1 100 0 1 BIT_MASK 0x20 FORMAT "%13.11" ECU_ADDRESS 0x7FD7C8 /end MEASUREMENT
/begin MEASUREMENT B_mnmdb "Fehlertyp min.: Momentan¸berwachung begrenzt dauerhaft" UWORD B_TRUE 1 100 0 1 BIT_MASK 0x200 FORMAT "%13.11" ECU_ADDRESS 0x7F9650 /end MEASUREMENT
/begin MEASUREMENT B_MotorStp "Motor-Stop-Flag" UBYTE B_TRUE 1 100 0 1 FORMAT "%13.11" ECU_ADDRESS 0x7F9F28 /end MEASUREMENT
/begin MEASUREMENT B_mslmin "Bedingung sehr geringe Sekund‰rluftmasse aus Meﬂphase" UWORD B_TRUE 1 100 0 1 BIT_MASK 0x2 FORMAT "%13.11" ECU_ADDRESS 0x7FE0A2 /end MEASUREMENT
/begin MEASUREMENT B_mslmin2 "Bedingung sehr geringe Sekund‰rluftmasse aus Meﬂphase (Bank 2)" UWORD B_TRUE 1 100 0 1 BIT_MASK 0x4 FORMAT "%13.11" ECU_ADDRESS 0x7FE0A2 /end MEASUREMENT
/begin MEASUREMENT B_mslmn "Bedingung zu wenig Sekund‰rluftmasse" UBYTE B_TRUE 1 100 0 1 BIT_MASK 0x1 FORMAT "%13.11" ECU_ADDRESS 0x7FBC5E /end MEASUREMENT
/begin MEASUREMENT B_mslpmn "Fehlerbedingung: keine Sekund‰rluftpumpe, nur Pulse Air" UBYTE B_TRUE 1 100 0 1 BIT_MASK 0x1 FORMAT "%13.11" ECU_ADDRESS 0x7FBC5F /end MEASUREMENT
/begin MEASUREMENT B_mslpmn2 "Fehlerbedingung: keine Sekund‰rluftpumpe, nur Pulse Air, Bank 2" UBYTE B_TRUE 1 100 0 1 BIT_MASK 0x1 FORMAT "%13.11" ECU_ADDRESS 0x7FBC60 /end MEASUREMENT
/begin MEASUREMENT B_mxmdb "Fehlerart: Maximal zul‰ssiges Sollmoment wird dauerhaft ¸berschritten" UWORD B_TRUE 1 100 0 1 BIT_MASK 0x100 FORMAT "%13.11" ECU_ADDRESS 0x7F9650 /end MEASUREMENT
/begin MEASUREMENT B_neutral "Bedingung erfuellt bei Gangstellung NEUTRAL" UBYTE B_TRUE 1 100 0 1 FORMAT "%13.11" ECU_ADDRESS 0x7F9F2A /end MEASUREMENT
/begin MEASUREMENT B_nolatp "Bedingung Diagnosefunktion Perioden-Dauer mit i.O.-Meldung beendet." UBYTE B_TRUE 1 100 0 1 BIT_MASK 0x1 FORMAT "%13.11" ECU_ADDRESS 0x7FB979 /end MEASUREMENT
/begin MEASUREMENT B_nolatp2 "Bedingung Diagnosefunktion Perioden-Dauer mit i.O.-Meldung beendet. Bank2" UBYTE B_TRUE 1 100 0 1 BIT_MASK 0x1 FORMAT "%13.11" ECU_ADDRESS 0x7FB97A /end MEASUREMENT
/begin MEASUREMENT B_nolatv "Bedingung Diagnosefunktion ATV-Pr¸fung mit i.O.-Meldung beendet." UBYTE B_TRUE 1 100 0 1 BIT_MASK 0x1 FORMAT "%13.11" ECU_ADDRESS 0x7FB97B /end MEASUREMENT
/begin MEASUREMENT B_nolatv2 "Bedingung Diagnosefunktion ATV-Pr¸fung mit i.O.-Meldung beendet. Bank2" UBYTE B_TRUE 1 100 0 1 BIT_MASK 0x1 FORMAT "%13.11" ECU_ADDRESS 0x7FB97C /end MEASUREMENT
/begin MEASUREMENT B_nollrflr "Bedingung LLR-Diagnosefunktion mit i.O.-Meldung beendet." UBYTE B_TRUE 1 100 0 1 BIT_MASK 0x1 FORMAT "%13.11" ECU_ADDRESS 0x7FBB25 /end MEASUREMENT
/begin MEASUREMENT B_nolsv "Bedingung Diagnosefunktion mit i.O.-Meldung vor KAT beendet." UBYTE B_TRUE 1 100 0 1 BIT_MASK 0x1 FORMAT "%13.11" ECU_ADDRESS 0x7FB989 /end MEASUREMENT
/begin MEASUREMENT B_nolsv2 "Bedingung Diagnosefunktion mit i.O.-Meldung vor KATbeendet  Bank2" UBYTE B_TRUE 1 100 0 1 BIT_MASK 0x1 FORMAT "%13.11" ECU_ADDRESS 0x7FB98A /end MEASUREMENT
/begin MEASUREMENT B_nomil "MIL-Ansteuerung verriegelt" UBYTE B_TRUE 1 100 0 1 BIT_MASK 0x1 FORMAT "%13.11" ECU_ADDRESS 0x7FB943 /end MEASUREMENT
/begin MEASUREMENT B_norkam "Bedingung additive Korrektur der Adaption pro Zeit oder Z¸ndung abgeschaltet" UBYTE B_TRUE 1 100 0 1 BIT_MASK 0x1 FORMAT "%13.11" ECU_ADDRESS 0x7FBA03 /end MEASUREMENT
/begin MEASUREMENT B_nowuc "Bedingung 'kein warm up cycle' erkannt" UBYTE B_TRUE 1 100 0 1 BIT_MASK 0x1 FORMAT "%13.11" ECU_ADDRESS 0x7FB944 /end MEASUREMENT
/begin MEASUREMENT B_nplflsv "Adernschluﬂ bei Sonde vor KAT erkannt" UBYTE B_TRUE 1 100 0 1 BIT_MASK 0x40 FORMAT "%13.11" ECU_ADDRESS 0x7FD568 /end MEASUREMENT
/begin MEASUREMENT B_nplflsv2 "Adernschluﬂ bei Sonde vor KAT erkannt Bank2" UBYTE B_TRUE 1 100 0 1 BIT_MASK 0x80 FORMAT "%13.11" ECU_ADDRESS 0x7FD568 /end MEASUREMENT
/begin MEASUREMENT B_npmdb "Nicht plausibler Fehler: Momentan¸berwachung begrenzt dauerhaft" UWORD B_TRUE 1 100 0 1 BIT_MASK 0x800 FORMAT "%13.11" ECU_ADDRESS 0x7F9650 /end MEASUREMENT
/begin MEASUREMENT B_plra "Bedingung f¸r Umschaltung DKVS von HFM- auf P-System" UBYTE B_TRUE 1 100 0 1 BIT_MASK 0x1 FORMAT "%13.11" ECU_ADDRESS 0x7FBA04 /end MEASUREMENT
/begin MEASUREMENT B_rdytes "Bedingung ready-Info des Tankentl¸ftungssystems  zum ‹bertrag ins  'ready-Byte'" UBYTE B_TRUE 1 100 0 1 BIT_MASK 0x1 FORMAT "%13.11" ECU_ADDRESS 0x7F9AEA /end MEASUREMENT
/begin MEASUREMENT B_refmax "" UBYTE B_TRUE 1 100 0 1 BIT_MASK 0x1 FORMAT "%13.11" ECU_ADDRESS 0x7FB98B /end MEASUREMENT
/begin MEASUREMENT B_refmax2 "" UBYTE B_TRUE 1 100 0 1 BIT_MASK 0x1 FORMAT "%13.11" ECU_ADDRESS 0x7FB98C /end MEASUREMENT
/begin MEASUREMENT B_risigv "" UBYTE B_TRUE 1 100 0 1 BIT_MASK 0x1 FORMAT "%13.11" ECU_ADDRESS 0x7FB98D /end MEASUREMENT
/begin MEASUREMENT B_risigv2 "" UBYTE B_TRUE 1 100 0 1 BIT_MASK 0x1 FORMAT "%13.11" ECU_ADDRESS 0x7FB98E /end MEASUREMENT
/begin MEASUREMENT B_rkam "Bedingung einer der beiden additiven Bereiche aktiv" UBYTE B_TRUE 1 100 0 1 BIT_MASK 0x1 FORMAT "%13.11" ECU_ADDRESS 0x7FBA05 /end MEASUREMENT
/begin MEASUREMENT B_rkamr "Bedingung rkat oder rkaz auﬂerhalb reduzierter Schwellen" UBYTE B_TRUE 1 100 0 1 BIT_MASK 0x1 FORMAT "%13.11" ECU_ADDRESS 0x7FBA06 /end MEASUREMENT
/begin MEASUREMENT B_rkamr2 "Bedingung rkat2 oder rkaz2 auﬂerhalb reduzierter Schwellen" UBYTE B_TRUE 1 100 0 1 BIT_MASK 0x1 FORMAT "%13.11" ECU_ADDRESS 0x7FBA07 /end MEASUREMENT
/begin MEASUREMENT B_rueckdre "" UBYTE B_TRUE 1 100 0 1 BIT_MASK 0x1 FORMAT "%13.11" ECU_ADDRESS 0x7FB94D /end MEASUREMENT
/begin MEASUREMENT B_sbbvk "Bedingung Sonde betriebsbereit vor Kat" UBYTE B_TRUE 1 100 0 1 BIT_MASK 0x1 FORMAT "%13.11" ECU_ADDRESS 0x7FB98F /end MEASUREMENT
/begin MEASUREMENT B_sbbvk2 "Bedingung Sonde betriebsbereit vor Kat, Bank 2" UBYTE B_TRUE 1 100 0 1 BIT_MASK 0x1 FORMAT "%13.11" ECU_ADDRESS 0x7FB990 /end MEASUREMENT
/begin MEASUREMENT B_sigflsv "" UBYTE B_TRUE 1 100 0 1 BIT_MASK 0x10 FORMAT "%13.11" ECU_ADDRESS 0x7FD568 /end MEASUREMENT
/begin MEASUREMENT B_sigflsv2 "" UBYTE B_TRUE 1 100 0 1 BIT_MASK 0x20 FORMAT "%13.11" ECU_ADDRESS 0x7FD568 /end MEASUREMENT
/begin MEASUREMENT B_simdb "Fehlertyp: Momentan¸berwachung begrenzt dauerhaft" UWORD B_TRUE 1 100 0 1 BIT_MASK 0x400 FORMAT "%13.11" ECU_ADDRESS 0x7F9650 /end MEASUREMENT
/begin MEASUREMENT B_sla "Anforderung Sekund‰rluftadaptionsphase" UBYTE B_TRUE 1 100 0 1 BIT_MASK 0x1 FORMAT "%13.11" ECU_ADDRESS 0x7FBC61 /end MEASUREMENT
/begin MEASUREMENT B_slar "Anforderung Sekund‰rluftadaptionsphase zur¸cksetzen" UWORD B_TRUE 1 100 0 1 BIT_MASK 0x100 FORMAT "%13.11" ECU_ADDRESS 0x7FE0A6 /end MEASUREMENT
/begin MEASUREMENT B_slas "Anforderung Sekund‰rluftadaptionsphase setzen" UWORD B_TRUE 1 100 0 1 BIT_MASK 0x80 FORMAT "%13.11" ECU_ADDRESS 0x7FE0A6 /end MEASUREMENT
/begin MEASUREMENT B_slsofa "" UWORD B_TRUE 1 100 0 1 BIT_MASK 0x1000 FORMAT "%13.11" ECU_ADDRESS 0x7FE0A6 /end MEASUREMENT
/begin MEASUREMENT B_slsrdy "Bedingung SLS gepr¸ft f¸r 'ready-Byte'" UBYTE B_TRUE 1 100 0 1 BIT_MASK 0x8 FORMAT "%13.11" ECU_ADDRESS 0x7F9AE6 /end MEASUREMENT
/begin MEASUREMENT B_swe_c "Bedingung Schlechtwegstrecke erkannt aus %DSWEC" UBYTE B_TRUE 1 100 0 1 BIT_MASK 0x1 FORMAT "%13.11" ECU_ADDRESS 0x7FB9A3 /end MEASUREMENT
/begin MEASUREMENT B_sysbts "Bedingung System BTS aktiv / freigegeben" UBYTE B_TRUE 1 100 0 1 FORMAT "%13.11" ECU_ADDRESS 0x7F9F2C /end MEASUREMENT
/begin MEASUREMENT B_sysbtssc "Bedingung System BTS Kurzschluss" UBYTE B_TRUE 1 100 0 1 FORMAT "%13.11" ECU_ADDRESS 0x7F9F2E /end MEASUREMENT
/begin MEASUREMENT B_szkat "" UBYTE B_TRUE 1 100 0 1 BIT_MASK 0x1 FORMAT "%13.11" ECU_ADDRESS 0x7FB967 /end MEASUREMENT
/begin MEASUREMENT B_szkat2 "" UBYTE B_TRUE 1 100 0 1 BIT_MASK 0x1 FORMAT "%13.11" ECU_ADDRESS 0x7FB968 /end MEASUREMENT
/begin MEASUREMENT B_szsls "Bedingung Diagnose Sekund‰rluftsystem durchgef¸hrt, Summe" UWORD B_TRUE 1 100 0 1 BIT_MASK 0x2000 FORMAT "%13.11" ECU_ADDRESS 0x7FE0A2 /end MEASUREMENT
/begin MEASUREMENT B_tesrdy "Bedingung TES gepr¸ft f¸r 'ready-Byte'" UBYTE B_TRUE 1 100 0 1 BIT_MASK 0x4 FORMAT "%13.11" ECU_ADDRESS 0x7F9AE6 /end MEASUREMENT
/begin MEASUREMENT B_trig "" UBYTE B_TRUE 1 100 0 1 BIT_MASK 0x1 FORMAT "%13.11" ECU_ADDRESS 0x7FB969 /end MEASUREMENT
/begin MEASUREMENT B_trig2 "" UBYTE B_TRUE 1 100 0 1 BIT_MASK 0x1 FORMAT "%13.11" ECU_ADDRESS 0x7FB96A /end MEASUREMENT
/begin MEASUREMENT B_trsa "" UBYTE B_TRUE 1 100 0 1 BIT_MASK 0x4 FORMAT "%13.11" ECU_ADDRESS 0x7FD8F1 /end MEASUREMENT
/begin MEASUREMENT B_trsa2 "" UBYTE B_TRUE 1 100 0 1 BIT_MASK 0x8 FORMAT "%13.11" ECU_ADDRESS 0x7FD8F1 /end MEASUREMENT
/begin MEASUREMENT B_ttbmh "" UBYTE B_TRUE 1 100 0 1 BIT_MASK 0x1 FORMAT "%13.11" ECU_ADDRESS 0x7FB991 /end MEASUREMENT
/begin MEASUREMENT B_ttbmh2 "" UBYTE B_TRUE 1 100 0 1 BIT_MASK 0x1 FORMAT "%13.11" ECU_ADDRESS 0x7FB992 /end MEASUREMENT
/begin MEASUREMENT B_ttuse "" UBYTE B_TRUE 1 100 0 1 BIT_MASK 0x1 FORMAT "%13.11" ECU_ADDRESS 0x7FB993 /end MEASUREMENT
/begin MEASUREMENT B_ttuse2 "" UBYTE B_TRUE 1 100 0 1 BIT_MASK 0x1 FORMAT "%13.11" ECU_ADDRESS 0x7FB994 /end MEASUREMENT
/begin MEASUREMENT B_tuspn "Bedingung f¸r ‹bernahme der Halbperiode (Zeit zw. pos. und neg. Flanke)" UBYTE B_TRUE 1 100 0 1 BIT_MASK 0x1 FORMAT "%13.11" ECU_ADDRESS 0x7FD8EC /end MEASUREMENT
/begin MEASUREMENT B_tuspn2 "Bedingung f¸r ‹bernahme der Halbperiode (Zeit zw. pos. und neg. Flanke) Bank2" UBYTE B_TRUE 1 100 0 1 BIT_MASK 0x4 FORMAT "%13.11" ECU_ADDRESS 0x7FD8EC /end MEASUREMENT
/begin MEASUREMENT B_tusre "Bedingung Resultat f¸r gefilterte Halbperiode f¸r Sonde vor KAT" UBYTE B_TRUE 1 100 0 1 BIT_MASK 0x2 FORMAT "%13.11" ECU_ADDRESS 0x7FD8EC /end MEASUREMENT
/begin MEASUREMENT B_tusre2 "Bedingung Resultat f¸r gefilterte Halbperiode f¸r Sonde vor KAT Bank2" UBYTE B_TRUE 1 100 0 1 BIT_MASK 0x8 FORMAT "%13.11" ECU_ADDRESS 0x7FD8EC /end MEASUREMENT
/begin MEASUREMENT B_ueinv "" UBYTE B_TRUE 1 100 0 1 BIT_MASK 0x1 FORMAT "%13.11" ECU_ADDRESS 0x7FB995 /end MEASUREMENT
/begin MEASUREMENT B_ueinv2 "" UBYTE B_TRUE 1 100 0 1 BIT_MASK 0x1 FORMAT "%13.11" ECU_ADDRESS 0x7FB996 /end MEASUREMENT
/begin MEASUREMENT B_uuekp "" UBYTE B_TRUE 1 100 0 1 BIT_MASK 0x1 FORMAT "%13.11" ECU_ADDRESS 0x7FB9A7 /end MEASUREMENT
/begin MEASUREMENT B_uusys "" UBYTE B_TRUE 1 100 0 1 BIT_MASK 0x1 FORMAT "%13.11" ECU_ADDRESS 0x7FB9A8 /end MEASUREMENT
/begin MEASUREMENT B_uuzdg "" UBYTE B_TRUE 1 100 0 1 BIT_MASK 0x1 FORMAT "%13.11" ECU_ADDRESS 0x7FB9A9 /end MEASUREMENT
/begin MEASUREMENT B_uvsig "" UBYTE B_TRUE 1 100 0 1 BIT_MASK 0x1 FORMAT "%13.11" ECU_ADDRESS 0x7FD8F1 /end MEASUREMENT
/begin MEASUREMENT B_uvsig2 "" UBYTE B_TRUE 1 100 0 1 BIT_MASK 0x2 FORMAT "%13.11" ECU_ADDRESS 0x7FD8F1 /end MEASUREMENT
/begin MEASUREMENT B_vadge "" UBYTE B_TRUE 1 100 0 1 BIT_MASK 0x1 FORMAT "%13.11" ECU_ADDRESS 0x7FB997 /end MEASUREMENT
/begin MEASUREMENT B_vadge2 "" UBYTE B_TRUE 1 100 0 1 BIT_MASK 0x1 FORMAT "%13.11" ECU_ADDRESS 0x7FB998 /end MEASUREMENT
/begin MEASUREMENT B_vgeflr "" UWORD B_TRUE 1 100 0 1 BIT_MASK 0x1000 FORMAT "%13.11" ECU_ADDRESS 0x7F9B4A /end MEASUREMENT
/begin MEASUREMENT B_vgeflr2 "" UWORD B_TRUE 1 100 0 1 BIT_MASK 0x2000 FORMAT "%13.11" ECU_ADDRESS 0x7F9B4A /end MEASUREMENT
/begin MEASUREMENT B_vnull "Bedingung Fahrzeug steht" UBYTE B_TRUE 1 100 0 1 FORMAT "%13.11" ECU_ADDRESS 0x7F9F30 /end MEASUREMENT
/begin MEASUREMENT B_wuc "Bedingung 'warm up cycle' erkannt" UBYTE B_TRUE 1 100 0 1 BIT_MASK 0x1 FORMAT "%13.11" ECU_ADDRESS 0x7FD8CD /end MEASUREMENT
/begin MEASUREMENT B_zdgbts "Bedingung Z¸ndungs BTS aktiv / freigegeben" UBYTE B_TRUE 1 100 0 1 FORMAT "%13.11" ECU_ADDRESS 0x7F9F32 /end MEASUREMENT
/begin MEASUREMENT B_zdgbtssc "Bedingung Z¸ndungs BTS Kurzschluss" UBYTE B_TRUE 1 100 0 1 FORMAT "%13.11" ECU_ADDRESS 0x7F9F34 /end MEASUREMENT
/begin MEASUREMENT B_zfrao "wenn gleich TRUE, dann ist FRAO gepr¸ft" UBYTE B_TRUE 1 100 0 1 BIT_MASK 0x4 FORMAT "%13.11" ECU_ADDRESS 0x7FD5A5 /end MEASUREMENT
/begin MEASUREMENT B_zfrao2 "wenn gleich TRUE, dann ist FRAO2 gepr¸ft" UBYTE B_TRUE 1 100 0 1 BIT_MASK 0x80 FORMAT "%13.11" ECU_ADDRESS 0x7FD5A5 /end MEASUREMENT
/begin MEASUREMENT B_zfrau "wenn gleich TRUE, dann ist FRAU gepr¸ft" UBYTE B_TRUE 1 100 0 1 BIT_MASK 0x2 FORMAT "%13.11" ECU_ADDRESS 0x7FD5A5 /end MEASUREMENT
/begin MEASUREMENT B_zfrau2 "wenn gleich TRUE, dann ist FRAU2 gepr¸ft" UBYTE B_TRUE 1 100 0 1 BIT_MASK 0x40 FORMAT "%13.11" ECU_ADDRESS 0x7FD5A5 /end MEASUREMENT
/begin MEASUREMENT B_zkatb "" UBYTE B_TRUE 1 100 0 1 BIT_MASK 0x1 FORMAT "%13.11" ECU_ADDRESS 0x7FB96B /end MEASUREMENT
/begin MEASUREMENT B_zkatb2 "" UBYTE B_TRUE 1 100 0 1 BIT_MASK 0x1 FORMAT "%13.11" ECU_ADDRESS 0x7FB96C /end MEASUREMENT
/begin MEASUREMENT B_zkats "" UBYTE B_TRUE 1 100 0 1 BIT_MASK 0x1 FORMAT "%13.11" ECU_ADDRESS 0x7FB96D /end MEASUREMENT
/begin MEASUREMENT B_zkats2 "" UBYTE B_TRUE 1 100 0 1 BIT_MASK 0x1 FORMAT "%13.11" ECU_ADDRESS 0x7FB96E /end MEASUREMENT
/begin MEASUREMENT B_zkatz "" UBYTE B_TRUE 1 100 0 1 BIT_MASK 0x1 FORMAT "%13.11" ECU_ADDRESS 0x7FB96F /end MEASUREMENT
/begin MEASUREMENT B_zkatz2 "" UBYTE B_TRUE 1 100 0 1 BIT_MASK 0x1 FORMAT "%13.11" ECU_ADDRESS 0x7FB970 /end MEASUREMENT
/begin MEASUREMENT B_zrkat "wenn gleich TRUE, dann ist RKAT gepr¸ft" UBYTE B_TRUE 1 100 0 1 BIT_MASK 0x8 FORMAT "%13.11" ECU_ADDRESS 0x7FD5A5 /end MEASUREMENT
/begin MEASUREMENT B_zrkat2 "wenn gleich TRUE, dann ist RKAT2 gepr¸ft" UBYTE B_TRUE 1 100 0 1 BIT_MASK 0x1 FORMAT "%13.11" ECU_ADDRESS 0x7FD5A4 /end MEASUREMENT
/begin MEASUREMENT B_zrkaz "wenn gleich TRUE, dann ist RKAZ gepr¸ft" UBYTE B_TRUE 1 100 0 1 BIT_MASK 0x10 FORMAT "%13.11" ECU_ADDRESS 0x7FD5A5 /end MEASUREMENT
/begin MEASUREMENT B_zrkaz2 "wenn gleich TRUE, dann ist RKAZ2 gepr¸ft" UBYTE B_TRUE 1 100 0 1 BIT_MASK 0x2 FORMAT "%13.11" ECU_ADDRESS 0x7FD5A4 /end MEASUREMENT
/begin MEASUREMENT B_zsls "" UWORD B_TRUE 1 100 0 1 BIT_MASK 0x4000 FORMAT "%13.11" ECU_ADDRESS 0x7FE0A2 /end MEASUREMENT
/begin MEASUREMENT cntSIKODAprell "" UBYTE dez 1 100 0 255 FORMAT "%5.1" ECU_ADDRESS 0x7F9AC4 /end MEASUREMENT
/begin MEASUREMENT cryddmtl "Counter f¸r Readinessbildung Leckdiagnose DDMTL" UBYTE dez 1 100 0 255 FORMAT "%5.1" ECU_ADDRESS 0x7F9AE7 /end MEASUREMENT
/begin MEASUREMENT crydldp "Counter f¸r Readinessbildung Leckdiagnose DLDP" UBYTE dez 1 100 0 255 FORMAT "%5.1" ECU_ADDRESS 0x7F9AE8 /end MEASUREMENT
/begin MEASUREMENT crydtev "Counter f¸r Readinessbildung TEV-Diagnose DTEV" UBYTE dez 1 100 0 255 FORMAT "%5.1" ECU_ADDRESS 0x7F9AE9 /end MEASUREMENT
/begin MEASUREMENT cryhs "Counter f¸r Readinessbildung Sondenheizungs-Diagnose" UBYTE dez 1 100 0 255 FORMAT "%5.1" ECU_ADDRESS 0x7F9AE2 /end MEASUREMENT
/begin MEASUREMENT crykat "Counter f¸r Readinessbildung Katalysator-Diagnose" UBYTE dez 1 100 0 255 FORMAT "%5.1" ECU_ADDRESS 0x7F9AE3 /end MEASUREMENT
/begin MEASUREMENT cryls "Counter f¸r Readinessbildung Lambdasonden-Diagnose" UBYTE dez 1 100 0 255 FORMAT "%5.1" ECU_ADDRESS 0x7F9AE4 /end MEASUREMENT
/begin MEASUREMENT crysls "Counter f¸r Readinessbildung Sekund‰rluft-Diagnose" UBYTE dez 1 100 0 255 FORMAT "%5.1" ECU_ADDRESS 0x7F9AE5 /end MEASUREMENT
/begin MEASUREMENT cw_erfil "Status Codewort Filtervariante f¸r Ausgabe der AS-Fehler an GST" UBYTE dez 1 100 0 255 FORMAT "%5.1" ECU_ADDRESS 0x7FD8C6 /end MEASUREMENT
/begin MEASUREMENT dfrmoff2_w "frm-Offset: zur Kontrolle von Problemen der Vorsteuerung, Bank 2" SWORD fak_sw_b1 1 100 -1 0.999969 FORMAT "%8.6" ECU_ADDRESS 0x7FD7BC /end MEASUREMENT
/begin MEASUREMENT dfrmoff_w "frm-Offset: zur Kontrolle von Problemen der Vorsteuerung" SWORD fak_sw_b1 1 100 -1 0.999969 FORMAT "%8.6" ECU_ADDRESS 0x7FD7BE /end MEASUREMENT
/begin MEASUREMENT diagtime "" UBYTE dez 1 100 0 255 FORMAT "%5.1" ECU_ADDRESS 0x7FD80A /end MEASUREMENT
/begin MEASUREMENT diak_elue "" UBYTE B_TRUE 1 100 0 1 BIT_MASK 0x1 FORMAT "%13.11" ECU_ADDRESS 0x7FB90F /end MEASUREMENT
/begin MEASUREMENT DIMCTESausbits1 "" UBYTE dez 1 100 0 255 FORMAT "%5.1" ECU_ADDRESS 0x7FD8CA /end MEASUREMENT
/begin MEASUREMENT DIMCTESausbitsNOV1 "" UBYTE dez 1 100 0 255 FORMAT "%5.1" ECU_ADDRESS 0x7F9AEA /end MEASUREMENT
/begin MEASUREMENT dkatakt2_w "" UWORD t50msxs_uw_b3276p75 1 100 0 3276.75 FORMAT "%8.3" ECU_ADDRESS 0x7FDB74 /end MEASUREMENT
/begin MEASUREMENT dkatakt_w "" UWORD t50msxs_uw_b3276p75 1 100 0 3276.75 FORMAT "%8.3" ECU_ADDRESS 0x7FDB76 /end MEASUREMENT
/begin MEASUREMENT DKVS1lokbits "" UBYTE dez 1 100 0 255 FORMAT "%5.1" ECU_ADDRESS 0x7FD5A4 /end MEASUREMENT
/begin MEASUREMENT DKVSbits "" UBYTE dez 1 100 0 255 FORMAT "%5.1" ECU_ADDRESS 0x7F9BBA /end MEASUREMENT
/begin MEASUREMENT DKVSlokbits "" UBYTE dez 1 100 0 255 FORMAT "%5.1" ECU_ADDRESS 0x7FD5A5 /end MEASUREMENT
/begin MEASUREMENT dlssabits "" UBYTE dez 1 100 0 255 FORMAT "%5.1" ECU_ADDRESS 0x7FD8EC /end MEASUREMENT
/begin MEASUREMENT DLSVbits "" UWORD dez 1 100 0 65535 FORMAT "%8.2" ECU_ADDRESS 0x7F9B4A /end MEASUREMENT
/begin MEASUREMENT DLSVerrors "" UBYTE dez 1 100 0 255 FORMAT "%5.1" ECU_ADDRESS 0x7FD568 /end MEASUREMENT
/begin MEASUREMENT DLSVintbits "" UBYTE dez 1 100 0 255 FORMAT "%5.1" ECU_ADDRESS 0x7FD8F1 /end MEASUREMENT
/begin MEASUREMENT dmidte "F¸llungs‰nderung bezogen auf Referenzwert" UWORD rel_uw_b100 1 100 0 99.9985 FORMAT "%8.5" ECU_ADDRESS 0x7FE05A /end MEASUREMENT
/begin MEASUREMENT dmlserrz "" UWORD t100msxs_uw_b6553p5 1 100 0 6553.5 FORMAT "%8.3" ECU_ADDRESS 0x7FE0BA /end MEASUREMENT
/begin MEASUREMENT dmrdkt_w "Momenten-Reserve f¸r Katalysatordiagnose" UWORD rel_uw_b100 1 100 0 99.9985 FORMAT "%8.5" ECU_ADDRESS 0x7FD54E /end MEASUREMENT
/begin MEASUREMENT dndte "Delta n bei Tankentl¸ftungsdiagnose" SWORD nmot_sw_q0p25 1 100 -8192 8191.75 FORMAT "%8.3" ECU_ADDRESS 0x7FE05C /end MEASUREMENT
/begin MEASUREMENT dnsdte "ƒnderung der Solldrehzahl bezogen auf Referenzwert" UBYTE nmot_ub_q10 1 100 0 2550 FORMAT "%5.0" ECU_ADDRESS 0x7FDAD5 /end MEASUREMENT
/begin MEASUREMENT drvSit "" UWORD fak_uw_b64 1 100 0 63.999 FORMAT "%8.5" ECU_ADDRESS 0x7FE222 /end MEASUREMENT
/begin MEASUREMENT drvSitAdd "" UWORD fak_uw_b64 1 100 0 63.999 FORMAT "%8.5" ECU_ADDRESS 0x7FE224 /end MEASUREMENT
/begin MEASUREMENT drvSitLim "" UWORD fak_uw_b64 1 100 0 63.999 FORMAT "%8.5" ECU_ADDRESS 0x7FE226 /end MEASUREMENT
/begin MEASUREMENT drvSitPre "" UWORD fak_uw_b64 1 100 0 63.999 FORMAT "%8.5" ECU_ADDRESS 0x7FE228 /end MEASUREMENT
/begin MEASUREMENT drvSitPreO "" UWORD fak_uw_b64 1 100 0 63.999 FORMAT "%8.5" ECU_ADDRESS 0x7FE22A /end MEASUREMENT
/begin MEASUREMENT DSLSLRlokBits1 "" UWORD dez 1 100 0 65535 FORMAT "%8.2" ECU_ADDRESS 0x7FE0A2 /end MEASUREMENT
/begin MEASUREMENT DSLSLRlokBits2 "" UWORD dez 1 100 0 65535 FORMAT "%8.2" ECU_ADDRESS 0x7FE0A4 /end MEASUREMENT
/begin MEASUREMENT DSLSLRlokBits3 "" UWORD dez 1 100 0 65535 FORMAT "%8.2" ECU_ADDRESS 0x7FE0A6 /end MEASUREMENT
/begin MEASUREMENT DTEVNbits "" UBYTE dez 1 100 0 255 FORMAT "%5.1" ECU_ADDRESS 0x7FD788 /end MEASUREMENT
/begin MEASUREMENT dtevphc_w "" UWORD t100msxs_uw_b6553p5 1 100 0 6553.5 FORMAT "%8.3" ECU_ADDRESS 0x7FD78E /end MEASUREMENT
/begin MEASUREMENT dthsBits1_1000ms "" UBYTE dez 1 100 0 255 FORMAT "%5.1" ECU_ADDRESS 0x7FD7C8 /end MEASUREMENT
/begin MEASUREMENT dukl15 "Spannungsunterschied zwischen Klemme 15 und 30" UBYTE spg_ubatt 1 100 0 24.021 FORMAT "%5.2" ECU_ADDRESS 0x7FD7EB /end MEASUREMENT
/begin MEASUREMENT ebCtrNewT "" UBYTE dez 1 100 0 255 FORMAT "%5.1" ECU_ADDRESS 0x7FD80B /end MEASUREMENT
/begin MEASUREMENT ebCtrNewY "" UBYTE dez 1 100 0 255 FORMAT "%5.1" ECU_ADDRESS 0x7FD80C /end MEASUREMENT
/begin MEASUREMENT ebCtrOldT "" UBYTE dez 1 100 0 255 FORMAT "%5.1" ECU_ADDRESS 0x7FD80D /end MEASUREMENT
/begin MEASUREMENT ebCtrOldY "" UBYTE dez 1 100 0 255 FORMAT "%5.1" ECU_ADDRESS 0x7FD80E /end MEASUREMENT
/begin MEASUREMENT ebMissT "" UWORD dez 1 100 0 65535 FORMAT "%8.2" ECU_ADDRESS 0x7FE10C /end MEASUREMENT
/begin MEASUREMENT ebMissY "" UWORD dez 1 100 0 65535 FORMAT "%8.2" ECU_ADDRESS 0x7FE10E /end MEASUREMENT
/begin MEASUREMENT Edrad "" UBYTE B_TRUE 1 100 0 1 BIT_MASK 0x1 FORMAT "%13.11" ECU_ADDRESS 0x7FBCAF /end MEASUREMENT
/begin MEASUREMENT eepBankErrorCnt "" UBYTE dez 1 100 0 255 FORMAT "%5.1" ARRAY_SIZE 2 ECU_ADDRESS 0x7F9AC8 /end MEASUREMENT
/begin MEASUREMENT eepNLSpiTB "" ULONG dez 1 100 0 4.29497e+009 FORMAT "%13.2" ECU_ADDRESS 0x7FE430 /end MEASUREMENT
/begin MEASUREMENT eepNLState "" UBYTE dez 1 100 0 255 FORMAT "%5.1" ECU_ADDRESS 0x7FCC60 /end MEASUREMENT
/begin MEASUREMENT eepPageSize "" UWORD dez 1 100 0 65535 FORMAT "%8.2" ECU_ADDRESS 0x7FCC62 /end MEASUREMENT
/begin MEASUREMENT eepTimer "" SWORD t_q0p001 1 100 -32.768 32.767 FORMAT "%8.5" ECU_ADDRESS 0x7FCC64 /end MEASUREMENT
/begin MEASUREMENT errorCntAskTcsort "" UBYTE dez 1 100 0 255 FORMAT "%5.1" ECU_ADDRESS 0x7FD4A8 /end MEASUREMENT
/begin MEASUREMENT ES_kill "Eingabe-Flag von Killschalter" UBYTE B_TRUE 1 100 0 1 FORMAT "%13.11" ECU_ADDRESS 0x7F9F36 /end MEASUREMENT
/begin MEASUREMENT ES_kupp "Diagnostizierter Eingangswert des Kupplungsschalter" UBYTE B_TRUE 1 100 0 1 FORMAT "%13.11" ECU_ADDRESS 0x7F9F38 /end MEASUREMENT
/begin MEASUREMENT ES_oelniv "Flag zur Anzeige von Oelueberdruck" UBYTE B_TRUE 1 100 0 1 BIT_MASK 0x1 FORMAT "%13.11" ECU_ADDRESS 0x7FB910 /end MEASUREMENT
/begin MEASUREMENT ES_poel "Eingangsgroesse von Oeldruckschalter" UBYTE B_TRUE 1 100 0 1 BIT_MASK 0x1 FORMAT "%13.11" ECU_ADDRESS 0x7FB911 /end MEASUREMENT
/begin MEASUREMENT ES_sfmdk "" UBYTE B_TRUE 1 100 0 1 BIT_MASK 0x1 FORMAT "%13.11" ECU_ADDRESS 0x7FB912 /end MEASUREMENT
/begin MEASUREMENT ES_sst "" UBYTE B_TRUE 1 100 0 1 FORMAT "%13.11" ECU_ADDRESS 0x7F9F3A /end MEASUREMENT
/begin MEASUREMENT ES_sst1 "Eingabe-Flag von Seitenstaender" UBYTE B_TRUE 1 100 0 1 FORMAT "%13.11" ECU_ADDRESS 0x7F9F3C /end MEASUREMENT
/begin MEASUREMENT ES_sst2 "Eingangsignal von Seitenstaenderschalter 2" UBYTE B_TRUE 1 100 0 1 FORMAT "%13.11" ECU_ADDRESS 0x7F9F3E /end MEASUREMENT
/begin MEASUREMENT ES_start "wird bei Betaetigung des Startschalter gesetzt" UBYTE B_TRUE 1 100 0 1 FORMAT "%13.11" ECU_ADDRESS 0x7F9F40 /end MEASUREMENT
/begin MEASUREMENT ES_wda "" UBYTE B_TRUE 1 100 0 1 BIT_MASK 0x1 FORMAT "%13.11" ECU_ADDRESS 0x7FB913 /end MEASUREMENT
/begin MEASUREMENT evsup1 "Funktionskennungsbyte f¸r Ausgabe SAE J1979 Mode2" UBYTE dez 1 100 0 255 FORMAT "%5.1" ECU_ADDRESS 0x7FD8C9 /end MEASUREMENT
/begin MEASUREMENT E_agrf "Errorflag: ‹berwachung AGR-FLOW" UWORD B_TRUE 1 100 0 1 BIT_MASK 0x1 FORMAT "%13.11" ECU_ADDRESS 0x7F956C /end MEASUREMENT
/begin MEASUREMENT E_dmtk "Errorflag: Tankentl¸ftungssystem Kleinstleck" UWORD B_TRUE 1 100 0 1 BIT_MASK 0x1 FORMAT "%13.11" ECU_ADDRESS 0x7F95A0 /end MEASUREMENT
/begin MEASUREMENT E_dmtl "Errorflag: DMTL-Modul" UWORD B_TRUE 1 100 0 1 BIT_MASK 0x1 FORMAT "%13.11" ECU_ADDRESS 0x7F95A4 /end MEASUREMENT
/begin MEASUREMENT E_hlpkrnt "Hilfserrorflag: Klopfregelung Nulltest" UBYTE B_TRUE 1 100 0 1 BIT_MASK 0x1 FORMAT "%13.11" ECU_ADDRESS 0x7FBAD6 /end MEASUREMENT
/begin MEASUREMENT E_hlpkrof "Hilfserrorfleg: Klopfregelung Offset" UBYTE B_TRUE 1 100 0 1 BIT_MASK 0x1 FORMAT "%13.11" ECU_ADDRESS 0x7FBAD7 /end MEASUREMENT
/begin MEASUREMENT E_hlpkrtp "Hilfserrorflag: Klopfregelung Testimpuls" UBYTE B_TRUE 1 100 0 1 BIT_MASK 0x1 FORMAT "%13.11" ECU_ADDRESS 0x7FBADB /end MEASUREMENT
/begin MEASUREMENT E_hsvsa "Errorflag: reduzierte  LSU-Heizung oder LSU-Kennlinie abgeflacht" UWORD B_TRUE 1 100 0 1 BIT_MASK 0x1 FORMAT "%13.11" ECU_ADDRESS 0x7F95F8 /end MEASUREMENT
/begin MEASUREMENT E_kat2 "Errorflag: Katalysator-Konvertierung	(Bank 2)" UWORD B_TRUE 1 100 0 1 BIT_MASK 0x1 FORMAT "%13.11" ECU_ADDRESS 0x7F9600 /end MEASUREMENT
/begin MEASUREMENT E_katsp "Errorflag: Katalysator-Konvertierung" UWORD B_TRUE 1 100 0 1 BIT_MASK 0x1 FORMAT "%13.11" ECU_ADDRESS 0x7F9604 /end MEASUREMENT
/begin MEASUREMENT E_mdb "Errorflag: Momenten¸berwachung begrenzt dauerhaft" UWORD B_TRUE 1 100 0 1 BIT_MASK 0x1 FORMAT "%13.11" ECU_ADDRESS 0x7F9650 /end MEASUREMENT
/begin MEASUREMENT E_OS_LIMIT_ctr "" ULONG dez 1 100 0 4.29497e+009 FORMAT "%13.2" ECU_ADDRESS 0x7FC0D0 /end MEASUREMENT
/begin MEASUREMENT E_tesk "Errorflag: Tankentl¸ftungssystem Kleinstleck" UWORD B_TRUE 1 100 0 1 BIT_MASK 0x1 FORMAT "%13.11" ECU_ADDRESS 0x7F96C0 /end MEASUREMENT
/begin MEASUREMENT falrdkt "" UBYTE fak_ub_b8 1 100 0 7.96875 FORMAT "%5.3" ECU_ADDRESS 0x7FD8DF /end MEASUREMENT
/begin MEASUREMENT ffzdfp "Fehlerpfadidentifikationsnummer (dfp) zum Freeze-Frame Zero" UBYTE dez 1 100 0 255 FORMAT "%5.1" ECU_ADDRESS 0x7FD8CC /end MEASUREMENT
/begin MEASUREMENT fmsla "Korrekturfaktor Sekund‰rluftmasse adaptiv" UBYTE fak_ub_b2 1 100 0 1.99219 FORMAT "%5.3" ECU_ADDRESS 0x7FD7AC /end MEASUREMENT
/begin MEASUREMENT fmsla2 "Korrekturfaktor Sekund‰rluftmasse adaptiv Bank 2" UBYTE fak_ub_b2 1 100 0 1.99219 FORMAT "%5.3" ECU_ADDRESS 0x7FD7AD /end MEASUREMENT
/begin MEASUREMENT fmslav "Adaptionsfaktor Sekund‰rluftmasse" UBYTE fak_ub_b2 1 100 0 1.99219 FORMAT "%5.3" ECU_ADDRESS 0x7F9C80 /end MEASUREMENT
/begin MEASUREMENT fmslav2 "Adaptionsfaktor Sekund‰rluftmasse, Bank 2" UBYTE fak_ub_b2 1 100 0 1.99219 FORMAT "%5.3" ECU_ADDRESS 0x7F9C81 /end MEASUREMENT
/begin MEASUREMENT frauzs2_w "multipl. Gemischadaptionsfaktor unterer mult. Bereich (Stereo)" UWORD fak_uw_b2 1 100 0 1.99997 FORMAT "%8.6" ECU_ADDRESS 0x7FD5A6 /end MEASUREMENT
/begin MEASUREMENT frauzs_w "multiplikativer Gemischadaptionsfaktor unterer mult. Bereich (alter Wert)" UWORD fak_uw_b2 1 100 0 1.99997 FORMAT "%8.6" ECU_ADDRESS 0x7FD5A8 /end MEASUREMENT
/begin MEASUREMENT fswares "Erkennungsschwellwert Schlechtwegstrecke (aus einer KL)" UBYTE acc_ub_b55p55 1 100 0 55.335 FORMAT "%5.2" ECU_ADDRESS 0x7FD8F9 /end MEASUREMENT
/begin MEASUREMENT Fszph "Fehlerschwehrez‰hler NW unplausibel" UWORD dez 1 100 0 65535 FORMAT "%8.2" ECU_ADDRESS 0x7FE11E /end MEASUREMENT
/begin MEASUREMENT Fszph2 "Fehlerschwehrez‰hler NW Signalfehler" UWORD dez 1 100 0 65535 FORMAT "%8.2" ECU_ADDRESS 0x7FE120 /end MEASUREMENT
/begin MEASUREMENT iisysf_old "" UWORD ii_uw_b2621 1 100 0 2499.96 FORMAT "%8.3" ECU_ADDRESS 0x7FE0BC /end MEASUREMENT
/begin MEASUREMENT imlkvszs_w "Zwischenspeicher: Luftmasse nach Auftreten eines DKVS Fehles bei leerem Tank" UWORD m_q0p00355 1 100 0 233.013 FORMAT "%8.4" ECU_ADDRESS 0x7F9BB8 /end MEASUREMENT
/begin MEASUREMENT imlkvs_w "Luftmasse nach Auftreten eines DKVS Fehles bei leerem Tank" UWORD m_q0p00355 1 100 0 233.013 FORMAT "%8.4" ECU_ADDRESS 0x7FD5AA /end MEASUREMENT
/begin MEASUREMENT indte "Integrierte Drehzahl‰nderung" SWORD nmot_sw_q0p25 1 100 -8192 8191.75 FORMAT "%8.3" ECU_ADDRESS 0x7FE05E /end MEASUREMENT
/begin MEASUREMENT katbf "" UBYTE spg_ub_q0p0052_o0p2 1 100 -0.2 1.13 FORMAT "%5.3" ECU_ADDRESS 0x7FD8E0 /end MEASUREMENT
/begin MEASUREMENT katbf2 "" UBYTE spg_ub_q0p0052_o0p2 1 100 -0.2 1.13 FORMAT "%5.3" ECU_ADDRESS 0x7FD8E1 /end MEASUREMENT
/begin MEASUREMENT katbfi2_w "" SWORD freq_sw_b512 1 100 -512 511.984 FORMAT "%8.4" ECU_ADDRESS 0x7FDB78 /end MEASUREMENT
/begin MEASUREMENT katbfi_w "" SWORD freq_sw_b512 1 100 -512 511.984 FORMAT "%8.4" ECU_ADDRESS 0x7FDB7A /end MEASUREMENT
/begin MEASUREMENT katbfs "" SBYTE fak_sb_b1 1 100 -1 0.992188 FORMAT "%5.3" ECU_ADDRESS 0x7FD8E2 /end MEASUREMENT
/begin MEASUREMENT katbfs2 "" SBYTE fak_sb_b1 1 100 -1 0.992188 FORMAT "%5.3" ECU_ADDRESS 0x7FD8E3 /end MEASUREMENT
/begin MEASUREMENT katbftp "" UBYTE spg_ub_q0p0052 1 100 0 1.33 FORMAT "%5.3" ECU_ADDRESS 0x7FD8E4 /end MEASUREMENT
/begin MEASUREMENT katbftp2 "" UBYTE spg_ub_q0p0052 1 100 0 1.33 FORMAT "%5.3" ECU_ADDRESS 0x7FD8E5 /end MEASUREMENT
/begin MEASUREMENT katbshd2_w "Signal f¸r Fett-Verschiebung des Modells (Bank2)" SWORD mgrad_sw_b28p44 1 100 -28.4444 28.4436 FORMAT "%8.5" ECU_ADDRESS 0x7FDB7C /end MEASUREMENT
/begin MEASUREMENT katbshd_w "Signal f¸r Fett-Verschiebung des Modells" SWORD mgrad_sw_b28p44 1 100 -28.4444 28.4436 FORMAT "%8.5" ECU_ADDRESS 0x7FDB7E /end MEASUREMENT
/begin MEASUREMENT kbdkt2_w "" SWORD mgrad_sw_b28p44 1 100 -28.4444 28.4436 FORMAT "%8.5" ECU_ADDRESS 0x7FDB80 /end MEASUREMENT
/begin MEASUREMENT kbdkt_w "" SWORD mgrad_sw_b28p44 1 100 -28.4444 28.4436 FORMAT "%8.5" ECU_ADDRESS 0x7FDB82 /end MEASUREMENT
/begin MEASUREMENT killerrorz "Zaehler der diagnostizierten Killschalterfehler" UWORD dez 1 100 0 65535 FORMAT "%8.2" ECU_ADDRESS 0x7F9CB2 /end MEASUREMENT
/begin MEASUREMENT killsigz "Aufgetretene Pegelwechsel waehrend Diagnosenphase" UBYTE dez 1 100 0 255 FORMAT "%5.1" ECU_ADDRESS 0x7FD7EA /end MEASUREMENT
/begin MEASUREMENT m6amsl "Mode 6 - Speicher: Anzahl Werteblˆcke bei Pr¸fung Sekund‰rluftmasse" UBYTE dez 1 100 0 255 FORMAT "%5.1" ECU_ADDRESS 0x7F9C82 /end MEASUREMENT
/begin MEASUREMENT m6cmsl "Mode 6 - Speicher: Component ID f¸r Pr¸fung Sekund‰rluftsystem" UBYTE dez 1 100 0 255 FORMAT "%5.1" ECU_ADDRESS 0x7F9C83 /end MEASUREMENT
/begin MEASUREMENT m6cmsl2 "Mode 6 - Speicher: Component ID f¸r Pr¸fung Sekund‰rluftsystem (Bank 2)" UBYTE dez 1 100 0 255 FORMAT "%5.1" ECU_ADDRESS 0x7F9C84 /end MEASUREMENT
/begin MEASUREMENT m6cmslv "Mode 6 - Speicher: Component ID f¸r Pr¸fung Dichtheit Sekund‰rluftsystem" UBYTE dez 1 100 0 255 FORMAT "%5.1" ECU_ADDRESS 0x7F9C85 /end MEASUREMENT
/begin MEASUREMENT m6cmslv2 "Mode 6 - Speicher: Component ID f¸r Pr¸fung Dichtheit Sekund‰rluftsystem" UBYTE dez 1 100 0 255 FORMAT "%5.1" ECU_ADDRESS 0x7F9C86 /end MEASUREMENT
/begin MEASUREMENT m6cthm "Mode 6 - Speicher: Component ID f¸r Thermostat-Monitoring" UBYTE DEZ 1 100 0 255 FORMAT "%5.1" ECU_ADDRESS 0x7F9C9E /end MEASUREMENT
/begin MEASUREMENT m6smsl2_w "Mode 6 - Speicher: Schwellwert bei Pr¸fung Sekund‰rluftmasse, Bank 2" UWORD dez 1 100 0 65535 FORMAT "%8.2" ECU_ADDRESS 0x7F9C8A /end MEASUREMENT
/begin MEASUREMENT m6smslv2_w "Mode 6 - Speicher: Schwellwert bei Ventildichtheitspr¸fung, Bank 2" UWORD dez 1 100 0 65535 FORMAT "%8.2" ECU_ADDRESS 0x7F9C8C /end MEASUREMENT
/begin MEASUREMENT m6smslv_w "Mode 6 - Speicher: Schwellwert bei Ventildichtheitspr¸fung" UWORD dez 1 100 0 65535 FORMAT "%8.2" ECU_ADDRESS 0x7F9C8E /end MEASUREMENT
/begin MEASUREMENT m6smsl_w "Mode 6 - Speicher: Schwellwert bei Pr¸fung Sekund‰rluftmasse" UWORD dez 1 100 0 65535 FORMAT "%8.2" ECU_ADDRESS 0x7F9C90 /end MEASUREMENT
/begin MEASUREMENT m6sthm_w "Mode 6 - Speicher: Schwellwert f¸r Thermostat-Monitoring" UWORD DEZ 1 100 0 65535 FORMAT "%8.2" ECU_ADDRESS 0x7F9C9A /end MEASUREMENT
/begin MEASUREMENT m6wmsl2_w "Mode 6 - Speicher: Messwert Sekund‰rluftmasse bei SL-Einblasung, Bank 2" UWORD dez 1 100 0 65535 FORMAT "%8.2" ECU_ADDRESS 0x7F9C92 /end MEASUREMENT
/begin MEASUREMENT m6wmslv2_w "Mode 6 - Speicher: Messwert Ventildichtheit, Bank 2" UWORD dez 1 100 0 65535 FORMAT "%8.2" ECU_ADDRESS 0x7F9C94 /end MEASUREMENT
/begin MEASUREMENT m6wmslv_w "Mode 6 - Speicher: Messwert Ventildichtheit" UWORD dez 1 100 0 65535 FORMAT "%8.2" ECU_ADDRESS 0x7F9C96 /end MEASUREMENT
/begin MEASUREMENT m6wmsl_w "Mode 6 - Speicher: Messwert Sekund‰rluftmasse bei SL-Einblasung" UWORD dez 1 100 0 65535 FORMAT "%8.2" ECU_ADDRESS 0x7F9C98 /end MEASUREMENT
/begin MEASUREMENT m6wthm_w "Mode 6 - Speicher: Meﬂwert f¸r Thermostat-Monitoring" UWORD DEZ 1 100 0 65535 FORMAT "%8.2" ECU_ADDRESS 0x7F9C9C /end MEASUREMENT
/begin MEASUREMENT midter "" UWORD rel_uw_b100 1 100 0 99.9985 FORMAT "%8.5" ECU_ADDRESS 0x7FE060 /end MEASUREMENT
/begin MEASUREMENT mifa_w "indiziertes Motormoment Fahrerwunsch" UWORD rel_uw_b100 1 100 0 99.9985 FORMAT "%8.5" ECU_ADDRESS 0x7F9F46 /end MEASUREMENT
/begin MEASUREMENT miist_w "indiziertes Motormoment Hochdruckphase Istwert" UWORD rel_uw_b100 1 100 0 99.9985 FORMAT "%8.5" ECU_ADDRESS 0x7F9F4A /end MEASUREMENT
/begin MEASUREMENT milstat "" UBYTE dez 1 100 0 255 FORMAT "%5.1" ECU_ADDRESS 0x7FD8CB /end MEASUREMENT
/begin MEASUREMENT mslift "Istwert Sekund‰rluftmasse, gefiltert, tempor‰r" UBYTE m_q0p4 1 100 0 102 FORMAT "%5.1" ECU_ADDRESS 0x7FD7AE /end MEASUREMENT
/begin MEASUREMENT mslift2 "Istwert Sekund‰rluftmasse, gefiltert, tempor‰r (Bank 2)" UBYTE m_q0p4 1 100 0 102 FORMAT "%5.1" ECU_ADDRESS 0x7FD7AF /end MEASUREMENT
/begin MEASUREMENT mslnenn "Nennwert Sekund‰rluftmasse" UBYTE m_q0p4 1 100 0 102 FORMAT "%5.1" ECU_ADDRESS 0x7F9C87 /end MEASUREMENT
/begin MEASUREMENT mslnenn2 "Nennwert Sekund‰rluftmasse, Bank 2" UBYTE m_q0p4 1 100 0 102 FORMAT "%5.1" ECU_ADDRESS 0x7F9C88 /end MEASUREMENT
/begin MEASUREMENT mslnf "Nenn-Sekund‰rluftmasse, gefiltert" UBYTE m_q0p4 1 100 0 102 FORMAT "%5.1" ECU_ADDRESS 0x7FD7B0 /end MEASUREMENT
/begin MEASUREMENT mslnf2 "Nenn-Sekund‰rluftmasse, gefiltert, Bank 2" UBYTE m_q0p4 1 100 0 102 FORMAT "%5.1" ECU_ADDRESS 0x7FD7B1 /end MEASUREMENT
/begin MEASUREMENT mslnt "Nenn-Sekund‰rluftmasse, tempor‰r" UBYTE m_q0p4 1 100 0 102 FORMAT "%5.1" ECU_ADDRESS 0x7FD7B2 /end MEASUREMENT
/begin MEASUREMENT mslnt2 "Nenn-Sekund‰rluftmasse,tempor‰r, Bank 2" UBYTE m_q0p4 1 100 0 102 FORMAT "%5.1" ECU_ADDRESS 0x7FD7B3 /end MEASUREMENT
/begin MEASUREMENT mslt2_w "tempor‰re Sekund‰rluftmasse, Bank 2" UWORD m_uw_b6553p5 1 100 0 6553.5 FORMAT "%8.3" ECU_ADDRESS 0x7FD7C0 /end MEASUREMENT
/begin MEASUREMENT mslt_w "tempor‰re Sekund‰rluftmasse" UWORD m_uw_b6553p5 1 100 0 6553.5 FORMAT "%8.3" ECU_ADDRESS 0x7FD7C2 /end MEASUREMENT
/begin MEASUREMENT mslv "" UBYTE m_q0p4 1 100 0 102 FORMAT "%5.1" ECU_ADDRESS 0x7FD7B4 /end MEASUREMENT
/begin MEASUREMENT mslv2 "" UBYTE m_q0p4 1 100 0 102 FORMAT "%5.1" ECU_ADDRESS 0x7FD7B5 /end MEASUREMENT
/begin MEASUREMENT mslvft "" SBYTE m_q0p4 1 100 -51.2 50.8 FORMAT "%5.2" ECU_ADDRESS 0x7FD7B6 /end MEASUREMENT
/begin MEASUREMENT mslvft2 "Sekund‰rluftventilundichtheit, gefiltert, tempor‰r (Bank 2)" SBYTE m_q0p4 1 100 -51.2 50.8 FORMAT "%5.2" ECU_ADDRESS 0x7FD7B7 /end MEASUREMENT
/begin MEASUREMENT mslvt2_w "tempor‰re Ventilleckage, Bank 2" SWORD m_sw_q0p1 1 100 -3276.8 3276.7 FORMAT "%8.3" ECU_ADDRESS 0x7FD7C4 /end MEASUREMENT
/begin MEASUREMENT mslvt_w "tempor‰re Ventilleckage" SWORD m_sw_q0p1 1 100 -3276.8 3276.7 FORMAT "%8.3" ECU_ADDRESS 0x7FD7C6 /end MEASUREMENT
/begin MEASUREMENT mvdtehp "Hochpaﬂgefiltertes Verlustmoment" UWORD rel_uw_b100 1 100 0 99.9985 FORMAT "%8.5" ECU_ADDRESS 0x7FE062 /end MEASUREMENT
/begin MEASUREMENT nmot_w "Motordrehzahl" UWORD nmot_uw_q0p25 1 100 0 16000 FORMAT "%8.2" ECU_ADDRESS 0x7F9F4E /end MEASUREMENT
/begin MEASUREMENT nsdter "Solldrehzahl Referenz" UBYTE nmot_ub_q10 1 100 0 2550 FORMAT "%5.0" ECU_ADDRESS 0x7FDAD6 /end MEASUREMENT
/begin MEASUREMENT ntpdte "Tiefpaﬂgefilterte Drehzahl" UWORD nmot_uw_q0p25 1 100 0 16383.8 FORMAT "%8.2" ECU_ADDRESS 0x7FE064 /end MEASUREMENT
/begin MEASUREMENT ntpdter "Tiefpaﬂgefilterte Drehzahl, Referenzwert" UWORD nmot_uw_q0p25 1 100 0 16383.8 FORMAT "%8.2" ECU_ADDRESS 0x7FE066 /end MEASUREMENT
/begin MEASUREMENT ready "readiness-Byte f¸r Ausgabe SAE J1979 Mode2" UBYTE dez 1 100 0 255 FORMAT "%5.1" ECU_ADDRESS 0x7F9AE6 /end MEASUREMENT
/begin MEASUREMENT rememberP3Max "" ULONG dez 1 100 0 4.29497e+009 FORMAT "%13.2" ECU_ADDRESS 0x7FE294 /end MEASUREMENT
/begin MEASUREMENT rkam2_w "Auswahl additive Gemischkorrektur der Gemischadaption f¸r Bestimmung B_gae2" SWORD rel_sw_b1536 1 100 -1536 1535.95 FORMAT "%8.3" ECU_ADDRESS 0x7FD5AC /end MEASUREMENT
/begin MEASUREMENT rkamzs2_w "additive Gemischkorrektur (pro Zeit oder Z¸ndung) Bank 2 (alter Wert)" SWORD rel_sw_b1536 1 100 -1536 1535.95 FORMAT "%8.3" ECU_ADDRESS 0x7FD5AE /end MEASUREMENT
/begin MEASUREMENT rkamzs_w "additive Gemischkorrektur (pro Zeit oder Z¸ndung); alter Wert" SWORD rel_sw_b1536 1 100 -1536 1535.95 FORMAT "%8.3" ECU_ADDRESS 0x7FD5B0 /end MEASUREMENT
/begin MEASUREMENT rkam_w "Auswahl additive Gemischkorrektur der Gemischadaption f¸r Bestimmung B_gae" SWORD rel_sw_b1536 1 100 -1536 1535.95 FORMAT "%8.3" ECU_ADDRESS 0x7FD5B2 /end MEASUREMENT
/begin MEASUREMENT rkats_w "additive Gemischkorrektur pro Zeit Bank 1 und 2 zusammen" SWORD rel_sw_b1536 1 100 -1536 1535.95 FORMAT "%8.3" ECU_ADDRESS 0x7FD5B4 /end MEASUREMENT
/begin MEASUREMENT rkrn_w "normierter Referenzpegel Klopfregelung" UWORD spg_uw_b1280 1 100 0 1279.96 FORMAT "%7.2" ARRAY_SIZE 8 ECU_ADDRESS 0x7FD694 /end MEASUREMENT
/begin MEASUREMENT rldkthp "" SBYTE rel_sb_q0p75 1 100 -96 95.25 FORMAT "%5.2" ECU_ADDRESS 0x7FD8E6 /end MEASUREMENT
/begin MEASUREMENT rldkthp2 "" SBYTE rel_sb_q0p75 1 100 -96 95.25 FORMAT "%5.2" ECU_ADDRESS 0x7FD8E7 /end MEASUREMENT
/begin MEASUREMENT rmsl "relative Sekund‰rluftmasse" UBYTE fak_ub_b2 1 100 0 1.99219 FORMAT "%5.3" ECU_ADDRESS 0x7FD7B8 /end MEASUREMENT
/begin MEASUREMENT rmsl2 "relative Sekund‰rluftmasse, Bank 2" UBYTE fak_ub_b2 1 100 0 1.99219 FORMAT "%5.3" ECU_ADDRESS 0x7FD7B9 /end MEASUREMENT
/begin MEASUREMENT rmslt "relative Sekund‰rluftmasse ohne Offset- Korrektur" UBYTE fak_ub_b2 1 100 0 1.99219 FORMAT "%5.3" ECU_ADDRESS 0x7FD7BA /end MEASUREMENT
/begin MEASUREMENT rmslt2 "relative Sekund‰rluftmasse ohne Offset- Korrektur, Bank 2" UBYTE fak_ub_b2 1 100 0 1.99219 FORMAT "%5.3" ECU_ADDRESS 0x7FD7BB /end MEASUREMENT
/begin MEASUREMENT rstMon_um "" UWORD dez 1 100 0 65535 FORMAT "%8.2" ECU_ADDRESS 0x7F807E /end MEASUREMENT
/begin MEASUREMENT rstpfad "Reset-Pfad als Umweltbedingung f¸r Rechner¸berwachungs-Diagnoseeintrag" UBYTE dez 1 100 0 255 FORMAT "%5.1" ECU_ADDRESS 0x7FD87E /end MEASUREMENT
/begin MEASUREMENT sfpagrf "Status Fehlerpfad: ‹berwachung AGR-Flow" UWORD dez 1 100 0 65535 FORMAT "%8.2" ECU_ADDRESS 0x7F956C /end MEASUREMENT
/begin MEASUREMENT sfpdmtk "" UWORD dez 1 100 0 65535 FORMAT "%8.2" ECU_ADDRESS 0x7F95A0 /end MEASUREMENT
/begin MEASUREMENT sfpdmtl "Status Fehlerpfad: Modul DM-TL" UWORD dez 1 100 0 65535 FORMAT "%8.2" ECU_ADDRESS 0x7F95A4 /end MEASUREMENT
/begin MEASUREMENT sfphsvsa "Status Fehlerpfad: Heizung Lambdasonde vor Kat" UWORD dez 1 100 0 65535 FORMAT "%8.2" ECU_ADDRESS 0x7F95F8 /end MEASUREMENT
/begin MEASUREMENT sfpkat2 "Status Fehlerpfad: Katalysator-‹berwachung Bank 2" UWORD dez 1 100 0 65535 FORMAT "%8.2" ECU_ADDRESS 0x7F9600 /end MEASUREMENT
/begin MEASUREMENT sfpkatsp "Status Fehlerpfad: Katalysator-‹berwachung" UWORD dez 1 100 0 65535 FORMAT "%8.2" ECU_ADDRESS 0x7F9604 /end MEASUREMENT
/begin MEASUREMENT sfpmdb "Status Fehlerpfad: Momentan¸berwachung begrenzt dauerhaft" UWORD dez 1 100 0 65535 FORMAT "%8.2" ECU_ADDRESS 0x7F9650 /end MEASUREMENT
/begin MEASUREMENT sfptesk "Status Fehlerpfad: Tankdiagnose, Kleinstleck" UWORD dez 1 100 0 65535 FORMAT "%8.2" ECU_ADDRESS 0x7F96C0 /end MEASUREMENT
/begin MEASUREMENT spi_errors "" UBYTE dez 1 100 0 255 FORMAT "%5.1" ARRAY_SIZE 17 ECU_ADDRESS 0x7F9B54 /end MEASUREMENT
/begin MEASUREMENT sst1_tmp "" UBYTE B_TRUE 1 100 0 1 BIT_MASK 0x1 FORMAT "%13.11" ECU_ADDRESS 0x7FBC9D /end MEASUREMENT
/begin MEASUREMENT sst2_tmp "" UBYTE B_TRUE 1 100 0 1 BIT_MASK 0x1 FORMAT "%13.11" ECU_ADDRESS 0x7FBC9E /end MEASUREMENT
/begin MEASUREMENT St1_E_max "" UBYTE dez 1 100 0 255 FORMAT "%5.1" ECU_ADDRESS 0x7FD8FA /end MEASUREMENT
/begin MEASUREMENT St1_E_min "" UBYTE dez 1 100 0 255 FORMAT "%5.1" ECU_ADDRESS 0x7FD8FB /end MEASUREMENT
/begin MEASUREMENT St1_E_openl "" UBYTE dez 1 100 0 255 FORMAT "%5.1" ECU_ADDRESS 0x7FD8FC /end MEASUREMENT
/begin MEASUREMENT St1_E_ovtmp "" UBYTE dez 1 100 0 255 FORMAT "%5.1" ECU_ADDRESS 0x7FD8FD /end MEASUREMENT
/begin MEASUREMENT St1_E_temp "" UBYTE dez 1 100 0 255 FORMAT "%5.1" ECU_ADDRESS 0x7FD8FE /end MEASUREMENT
/begin MEASUREMENT St2_E_max "" UBYTE dez 1 100 0 255 FORMAT "%5.1" ECU_ADDRESS 0x7FD8FF /end MEASUREMENT
/begin MEASUREMENT St2_E_min "" UBYTE dez 1 100 0 255 FORMAT "%5.1" ECU_ADDRESS 0x7FD900 /end MEASUREMENT
/begin MEASUREMENT St2_E_openl "" UBYTE dez 1 100 0 255 FORMAT "%5.1" ECU_ADDRESS 0x7FD901 /end MEASUREMENT
/begin MEASUREMENT St2_E_ovtmp "" UBYTE dez 1 100 0 255 FORMAT "%5.1" ECU_ADDRESS 0x7FD902 /end MEASUREMENT
/begin MEASUREMENT St2_E_temp "" UBYTE dez 1 100 0 255 FORMAT "%5.1" ECU_ADDRESS 0x7FD903 /end MEASUREMENT
/begin MEASUREMENT stp_diag_act "" UWORD dez 1 100 0 65535 FORMAT "%8.2" ARRAY_SIZE 2 ECU_ADDRESS 0x7FDB9A /end MEASUREMENT
/begin MEASUREMENT S_bls "Schalter Bremslicht" UBYTE B_TRUE 1 100 0 1 BIT_MASK 0x1 FORMAT "%13.11" ECU_ADDRESS 0x7FB916 /end MEASUREMENT
/begin MEASUREMENT S_brs "Schalter Bremstest" UBYTE B_TRUE 1 100 0 1 BIT_MASK 0x1 FORMAT "%13.11" ECU_ADDRESS 0x7FB917 /end MEASUREMENT
/begin MEASUREMENT S_kl15 "Schalter Klemme 15" UBYTE B_TRUE 1 100 0 1 FORMAT "%13.11" ECU_ADDRESS 0x7F9F42 /end MEASUREMENT
/begin MEASUREMENT S_kupp "Schalter Kupplung" UBYTE B_TRUE 1 100 0 1 BIT_MASK 0x1 FORMAT "%13.11" ECU_ADDRESS 0x7FB918 /end MEASUREMENT
/begin MEASUREMENT tadtea "TEV-Tastverh‰ltnis aus Tankentl¸ftungsdiagnose" UBYTE rel_ub_b100 1 100 0 100 FORMAT "%5.1" ECU_ADDRESS 0x7FD789 /end MEASUREMENT
/begin MEASUREMENT tbtevio_c "" UBYTE t100msxs_ub_b25p5 1 100 0 25.5 FORMAT "%5.2" ECU_ADDRESS 0x7FD78A /end MEASUREMENT
/begin MEASUREMENT tc6kata "" UBYTE dez 1 100 0 255 FORMAT "%5.1" ECU_ADDRESS 0x7F9B2D /end MEASUREMENT
/begin MEASUREMENT tc6katc "Ausgabe-Code SCAN-Tool Mode 6 aus KAT-Diagnose" UBYTE dez 1 100 0 255 FORMAT "%5.1" ECU_ADDRESS 0x7F9B2E /end MEASUREMENT
/begin MEASUREMENT tc6katc2 "Ausgabe-Code SCAN-Tool Mode 6 aus KAT-Diagnose, Bank2" UBYTE dez 1 100 0 255 FORMAT "%5.1" ECU_ADDRESS 0x7F9B2F /end MEASUREMENT
/begin MEASUREMENT tc6kats "" UBYTE dez 1 100 0 255 FORMAT "%5.1" ECU_ADDRESS 0x7F9B30 /end MEASUREMENT
/begin MEASUREMENT tc6kats2 "" UBYTE dez 1 100 0 255 FORMAT "%5.1" ECU_ADDRESS 0x7F9B31 /end MEASUREMENT
/begin MEASUREMENT tc6katw "" UBYTE dez 1 100 0 255 FORMAT "%5.1" ECU_ADDRESS 0x7F9B32 /end MEASUREMENT
/begin MEASUREMENT tc6katw2 "" UBYTE dez 1 100 0 255 FORMAT "%5.1" ECU_ADDRESS 0x7F9B33 /end MEASUREMENT
/begin MEASUREMENT tc6tesc "Ausgabe-Code SCAN-Tool Mode 6 aus TES-Diagnose" UBYTE dez 1 100 0 255 FORMAT "%5.1" ECU_ADDRESS 0x7F9C78 /end MEASUREMENT
/begin MEASUREMENT tc6tess "Ausgabe Schwellwert SCAN-Tool Mode 6 aus TES-Diagnose" UWORD dez 1 100 0 65535 FORMAT "%8.2" ECU_ADDRESS 0x7F9C7A /end MEASUREMENT
/begin MEASUREMENT tc6tesw "Ausgabe Pr¸fwert SCAN-Tool Mode 6 aus TES-Diagnose" UWORD dez 1 100 0 65535 FORMAT "%8.2" ECU_ADDRESS 0x7F9C7C /end MEASUREMENT
/begin MEASUREMENT tdten_w "Berechnungszeit f¸r Drehzahlcheck" UWORD t20msxs_uw_b1310 1 100 0 1310.7 FORMAT "%7.2" ECU_ADDRESS 0x7FD790 /end MEASUREMENT
/begin MEASUREMENT tesstat "Funktionsstatus DTES bei Anforderung Systemcheck" UBYTE dez 1 100 0 255 FORMAT "%5.1" ECU_ADDRESS 0x7FD78B /end MEASUREMENT
/begin MEASUREMENT tka_loc "Lokale Variable f¸r TKA-Startwertberechnung" UBYTE temp_ub_q0p75_o48 1 100 -48 143.25 FORMAT "%5.1" ECU_ADDRESS 0x7FD7C9 /end MEASUREMENT
/begin MEASUREMENT tka_start "Startwert der K¸hleraustrittstemperatur" UBYTE temp_ub_q0p75_o48 1 100 -48 143.25 FORMAT "%5.1" ECU_ADDRESS 0x7FD7CA /end MEASUREMENT
/begin MEASUREMENT tmstem "Motortemperatur bei Startende in Memory" UBYTE temp_ub_q0p75_o48 1 100 -48 143.25 FORMAT "%5.1" ECU_ADDRESS 0x7FD4A9 /end MEASUREMENT
/begin MEASUREMENT top_w "Operating time seit powerfail" UWORD t6minxmin_q6 1 100 0 393210 FORMAT "%8.1" ECU_ADDRESS 0x7F9AEC /end MEASUREMENT
/begin MEASUREMENT tpsvkmf2_w "gefilterter Periodendauerwert des Sondensignals vor Kat, Bank2 (Word)" UWORD t10msxs_uw_b655p35 1 100 0 655.35 FORMAT "%8.4" ECU_ADDRESS 0x7F9B3C /end MEASUREMENT
/begin MEASUREMENT tpsvkmf_w "gefilterter Periodendauerwert des Sondensignals vor Kat. (Word)" UWORD t10msxs_uw_b655p35 1 100 0 655.35 FORMAT "%8.4" ECU_ADDRESS 0x7F9B3E /end MEASUREMENT
/begin MEASUREMENT tpsvkof2_w "" UWORD t10msxs_uw_b655p35 1 100 0 655.35 FORMAT "%8.4" ECU_ADDRESS 0x7FDB84 /end MEASUREMENT
/begin MEASUREMENT tpsvkof_w "" UWORD t10msxs_uw_b655p35 1 100 0 655.35 FORMAT "%8.4" ECU_ADDRESS 0x7FDB86 /end MEASUREMENT
/begin MEASUREMENT tpsvlssa "" UBYTE t40msxs_ub_q0p04 1 100 0 10.2 FORMAT "%5.2" ECU_ADDRESS 0x7F9B34 /end MEASUREMENT
/begin MEASUREMENT tpsvlssa2 "" UBYTE t40msxs_ub_q0p04 1 100 0 10.2 FORMAT "%5.2" ECU_ADDRESS 0x7F9B35 /end MEASUREMENT
/begin MEASUREMENT tuspnf "" UBYTE t40msxs_ub_q0p04 1 100 0 10.2 FORMAT "%5.2" ECU_ADDRESS 0x7F9B36 /end MEASUREMENT
/begin MEASUREMENT tuspnf2 "" UBYTE t40msxs_ub_q0p04 1 100 0 10.2 FORMAT "%5.2" ECU_ADDRESS 0x7F9B37 /end MEASUREMENT
/begin MEASUREMENT twdlssa2_w "Timer f¸r Mindestpr¸fzeit f¸r DLSSA-Extremwertbestimmung Bank2" UWORD t50msxs_uw_b3276p75 1 100 0 3276.75 FORMAT "%8.3" ECU_ADDRESS 0x7FD55C /end MEASUREMENT
/begin MEASUREMENT twdlssa_w "Timer f¸r Mindestpr¸fzeit f¸r DLSSA-Extremwertbestimmung" UWORD t50msxs_uw_b3276p75 1 100 0 3276.75 FORMAT "%8.3" ECU_ADDRESS 0x7FD55E /end MEASUREMENT
/begin MEASUREMENT twkodte_c "" UBYTE t100msxs_ub_b25p5 1 100 0 25.5 FORMAT "%5.2" ECU_ADDRESS 0x7FD78C /end MEASUREMENT
/begin MEASUREMENT TYP_mdb "Fehlertyp: Momentenbegrenzung (begrenzt dauerhaft) aktiv" UWORD B_TRUE 1 100 0 1 BIT_MASK 0xf00 FORMAT "%13.11" ECU_ADDRESS 0x7F9650 /end MEASUREMENT
/begin MEASUREMENT tzlsatv2_w "" UWORD t1sxs_uw_b65535 1 100 0 65535 FORMAT "%8.2" ECU_ADDRESS 0x7FD564 /end MEASUREMENT
/begin MEASUREMENT tzlsatv_w "" UWORD t1sxs_uw_b65535 1 100 0 65535 FORMAT "%8.2" ECU_ADDRESS 0x7FD566 /end MEASUREMENT
/begin MEASUREMENT t_sa "Timer Schubabschalten f¸r DTHS" UBYTE t1sxs_ub_q1 1 100 0 255 FORMAT "%5.1" ECU_ADDRESS 0x7FD7CB /end MEASUREMENT
/begin MEASUREMENT udkp1_w "Spannung DK-Poti 1" UWORD spg_uw_q0p001222 1 100 0 80.0838 FORMAT "%8.5" ECU_ADDRESS 0x7F9F52 /end MEASUREMENT
/begin MEASUREMENT udkpa_w "adapted closed throttle voltage" UWORD spg_uw_q0p001222 1 100 0 80.0838 FORMAT "%8.5" ECU_ADDRESS 0x7F9AC0 /end MEASUREMENT
/begin MEASUREMENT ukl15errz "Zaehler der diagnostizierten Klemme 15 Schalterfehler" UBYTE t100msxs_ub_b25p5 1 100 0 25.5 FORMAT "%5.2" ECU_ADDRESS 0x7FD7EC /end MEASUREMENT
/begin MEASUREMENT urddktp "Regelspannungsdifferenz, tiefpaﬂgefiltert" SBYTE spg_sb_q0p01043 1 100 -1.33522 1.32478 FORMAT "%5.3" ECU_ADDRESS 0x7FD8E8 /end MEASUREMENT
/begin MEASUREMENT urddktp2 "Regelspannungsdifferenz, tiefpaﬂgefiltert, Bank2" SBYTE spg_sb_q0p01043 1 100 -1.33522 1.32478 FORMAT "%5.3" ECU_ADDRESS 0x7FD8E9 /end MEASUREMENT
/begin MEASUREMENT ushdktp "Spannung Lambdsonde hinter KAt, tiefpassgefiltert" UBYTE spg_ub_q0p0052 1 100 0 1.33 FORMAT "%5.3" ECU_ADDRESS 0x7FD8EA /end MEASUREMENT
/begin MEASUREMENT ushdktp2 "Spannung Lambdsonde hinter KAt, tiefpassgefiltert" UBYTE spg_ub_q0p0052 1 100 0 1.33 FORMAT "%5.3" ECU_ADDRESS 0x7FD8EB /end MEASUREMENT
/begin MEASUREMENT usmnsaa "" UBYTE spg_ub_b1p33 1 100 0 1.33 FORMAT "%5.3" ECU_ADDRESS 0x7FD554 /end MEASUREMENT
/begin MEASUREMENT usmnsaa2 "" UBYTE spg_ub_b1p33 1 100 0 1.33 FORMAT "%5.3" ECU_ADDRESS 0x7FD555 /end MEASUREMENT
/begin MEASUREMENT usmnsan "" UBYTE spg_ub_b1p33 1 100 0 1.33 FORMAT "%5.3" ECU_ADDRESS 0x7F9B38 /end MEASUREMENT
/begin MEASUREMENT usmnsan2 "minimal erkannter Sondenspannungswert v.K. (neu), DLSSA (Bank2)" UBYTE spg_ub_b1p33 1 100 0 1.33 FORMAT "%5.3" ECU_ADDRESS 0x7F9B39 /end MEASUREMENT
/begin MEASUREMENT usmxsaa "" UBYTE spg_ub_b1p33 1 100 0 1.33 FORMAT "%5.3" ECU_ADDRESS 0x7FD556 /end MEASUREMENT
/begin MEASUREMENT usmxsaa2 "" UBYTE spg_ub_b1p33 1 100 0 1.33 FORMAT "%5.3" ECU_ADDRESS 0x7FD557 /end MEASUREMENT
/begin MEASUREMENT usmxsan "" UBYTE spg_ub_b1p33 1 100 0 1.33 FORMAT "%5.3" ECU_ADDRESS 0x7F9B3A /end MEASUREMENT
/begin MEASUREMENT usmxsan2 "maximal erkannter Sondenspannungswert v.K. (neu), DLSSA (Bank2)" UBYTE spg_ub_b1p33 1 100 0 1.33 FORMAT "%5.3" ECU_ADDRESS 0x7F9B3B /end MEASUREMENT
/begin MEASUREMENT usrj "" UBYTE spg_ub_b1p33 1 100 0 1.33 FORMAT "%5.3" ECU_ADDRESS 0x7FD558 /end MEASUREMENT
/begin MEASUREMENT usvkj "" UBYTE spg_ub_b1p33 1 100 0 1.33 FORMAT "%5.3" ECU_ADDRESS 0x7FD559 /end MEASUREMENT
/begin MEASUREMENT usvkj2 "" UBYTE spg_ub_b1p33 1 100 0 1.33 FORMAT "%5.3" ECU_ADDRESS 0x7FD55A /end MEASUREMENT
/begin MEASUREMENT usvkjf2_w "Gefilterte Spannung Lambdasonde vor Kat, ohne Offset, DLSSA (Bank2)" UWORD spg_uw_b1p33 1 100 0 1.33 FORMAT "%8.6" ECU_ADDRESS 0x7FD560 /end MEASUREMENT
/begin MEASUREMENT usvkjf_w "Gefilterte Spannung Lambdasonde vor Kat, ohne Offset, DLSSA" UWORD spg_uw_b1p33 1 100 0 1.33 FORMAT "%8.6" ECU_ADDRESS 0x7FD562 /end MEASUREMENT
/begin MEASUREMENT vstvvr "Erhˆhung des Sollwerts der VMAX-Regelung ¸ber Werkstatt-Tester" UBYTE dez 1 100 0 255 FORMAT "%5.1" ECU_ADDRESS 0x7FD8C7 /end MEASUREMENT
/begin MEASUREMENT wuccnt "Warm-up cycle - counter" UBYTE dez 1 100 0 255 FORMAT "%5.1" ECU_ADDRESS 0x7F9AEE /end MEASUREMENT
/begin MEASUREMENT xzkrznt "Z‰hler Klopfregelung Zyklusflag Z_krnt" UBYTE dez 1 100 0 255 FORMAT "%5.1" ECU_ADDRESS 0x7FD9ED /end MEASUREMENT
/begin MEASUREMENT xzkrzof "Z‰hler Klopfregelung Zyklusflag Z_krof" UBYTE dez 1 100 0 255 FORMAT "%5.1" ECU_ADDRESS 0x7FD9EE /end MEASUREMENT
/begin MEASUREMENT xzkrzs "" UBYTE dez 1 100 0 255 FORMAT "%5.1" ARRAY_SIZE 4 ECU_ADDRESS 0x7FD684 /end MEASUREMENT
/begin MEASUREMENT xzkrzs2 "Z‰hler Klopfregelung Zyklusflag Z_ks2" UBYTE dez 1 100 0 255 FORMAT "%5.1" ARRAY_SIZE 4 ECU_ADDRESS 0x7FD688 /end MEASUREMENT
/begin MEASUREMENT xzkrztp "Z‰hler Klopfregelung Zyklusflag Z_krtp" UBYTE dez 1 100 0 255 FORMAT "%5.1" ECU_ADDRESS 0x7FD9F1 /end MEASUREMENT
/begin MEASUREMENT xzsen "" UBYTE dez 1 100 0 255 FORMAT "%5.1" ARRAY_SIZE 4 ECU_ADDRESS 0x7FD68C /end MEASUREMENT
/begin MEASUREMENT xzsen2 "Sicherheitsz‰hler Klopfsensor 2" UBYTE dez 1 100 0 255 FORMAT "%5.1" ARRAY_SIZE 4 ECU_ADDRESS 0x7FD690 /end MEASUREMENT
/begin MEASUREMENT xzskrnt "Sicherheitsz‰hler Klopfregelung Nulltest" UBYTE dez 1 100 0 255 FORMAT "%5.1" ECU_ADDRESS 0x7FD9EF /end MEASUREMENT
/begin MEASUREMENT xzskrof "Sicherheitsz‰hler Klopfregelung Offset" UBYTE dez 1 100 0 255 FORMAT "%5.1" ECU_ADDRESS 0x7FD9F0 /end MEASUREMENT
/begin MEASUREMENT xzskrtp "Z‰hler Klopfregelung Errorflag E_krtp" UBYTE dez 1 100 0 255 FORMAT "%5.1" ECU_ADDRESS 0x7FD9F2 /end MEASUREMENT
/begin MEASUREMENT zdteio "I.O.-Z‰hler f¸r Tankentl¸ftungsdiagnose" UBYTE dez 1 100 0 255 FORMAT "%5.1" ECU_ADDRESS 0x7FDAD7 /end MEASUREMENT
/begin MEASUREMENT zdtev "Pr¸fungsz‰hler f¸r TEV-Diagnose" UBYTE dez 1 100 0 255 FORMAT "%5.1" ECU_ADDRESS 0x7FD78D /end MEASUREMENT
/begin MEASUREMENT zlsatp "" UBYTE dez 1 100 0 255 FORMAT "%5.1" ECU_ADDRESS 0x7FD8ED /end MEASUREMENT
/begin MEASUREMENT zlsatp2 "" UBYTE dez 1 100 0 255 FORMAT "%5.1" ECU_ADDRESS 0x7FD8EE /end MEASUREMENT
/begin MEASUREMENT zwgeflr "" UBYTE dez 1 100 0 255 FORMAT "%5.1" ECU_ADDRESS 0x7F9B48 /end MEASUREMENT
/begin MEASUREMENT zwgeflr2 "" UBYTE dez 1 100 0 255 FORMAT "%5.1" ECU_ADDRESS 0x7F9B49 /end MEASUREMENT
/begin MEASUREMENT zwout "Z¸ndwinkel-Ausgabe" SBYTE zw_sb_q0p75 1 100 -96 95.25 FORMAT "%5.2" ECU_ADDRESS 0x7F9F44 /end MEASUREMENT
/begin MEASUREMENT zwpvk "" UBYTE dez 1 100 0 255 FORMAT "%5.1" ECU_ADDRESS 0x7FD8EF /end MEASUREMENT
/begin MEASUREMENT zwpvk2 "" UBYTE dez 1 100 0 255 FORMAT "%5.1" ECU_ADDRESS 0x7FD8F0 /end MEASUREMENT
/begin MEASUREMENT Z_agrf "Zyklusflag: ‹berwachung AGR-FLOW" UWORD B_TRUE 1 100 0 1 BIT_MASK 0x2 FORMAT "%13.11" ECU_ADDRESS 0x7F956C /end MEASUREMENT
/begin MEASUREMENT Z_dmtk "Zyklusflag: Tankentl¸ftungssystem Kleinstleck" UWORD B_TRUE 1 100 0 1 BIT_MASK 0x2 FORMAT "%13.11" ECU_ADDRESS 0x7F95A0 /end MEASUREMENT
/begin MEASUREMENT Z_dmtl "Zyklusflag: DMTL-Modul" UWORD B_TRUE 1 100 0 1 BIT_MASK 0x2 FORMAT "%13.11" ECU_ADDRESS 0x7F95A4 /end MEASUREMENT
/begin MEASUREMENT Z_hlpkrnt "Hilfszyklusflag: Klopfregelung Nulltest" UBYTE B_TRUE 1 100 0 1 BIT_MASK 0x1 FORMAT "%13.11" ECU_ADDRESS 0x7FBAD8 /end MEASUREMENT
/begin MEASUREMENT Z_hlpkrof "Hilfszyklusflag: Klopfregelung Offset" UBYTE B_TRUE 1 100 0 1 BIT_MASK 0x1 FORMAT "%13.11" ECU_ADDRESS 0x7FBAD9 /end MEASUREMENT
/begin MEASUREMENT Z_hlpkrtp "Hilszyklusflag: Klopfregelung Testimpuls" UBYTE B_TRUE 1 100 0 1 BIT_MASK 0x1 FORMAT "%13.11" ECU_ADDRESS 0x7FBADC /end MEASUREMENT
/begin MEASUREMENT Z_hsvsa "Zyklusflag:  reduzierte  LSU-Heizung oder LSU-Kennlinie abgeflacht" UWORD B_TRUE 1 100 0 1 BIT_MASK 0x2 FORMAT "%13.11" ECU_ADDRESS 0x7F95F8 /end MEASUREMENT
/begin MEASUREMENT Z_kat2 "Zyklusflag:	Katalysator-Konvertierung	(Bank 2)" UWORD B_TRUE 1 100 0 1 BIT_MASK 0x2 FORMAT "%13.11" ECU_ADDRESS 0x7F9600 /end MEASUREMENT
/begin MEASUREMENT Z_katsp "Zyklusflag:	Katalysator-Konvertierung" UWORD B_TRUE 1 100 0 1 BIT_MASK 0x2 FORMAT "%13.11" ECU_ADDRESS 0x7F9604 /end MEASUREMENT
/begin MEASUREMENT Z_mdb "Zyklusflag: Momentenbegrenzung begrenzt dauerhaft" UWORD B_TRUE 1 100 0 1 BIT_MASK 0x2 FORMAT "%13.11" ECU_ADDRESS 0x7F9650 /end MEASUREMENT
/begin MEASUREMENT Z_nwfehler "" UBYTE dez 1 100 0 255 FORMAT "%5.1" ECU_ADDRESS 0x7F9AF6 /end MEASUREMENT
/begin MEASUREMENT Z_tesk "Zyklusflag: Tankentl¸ftungssystem Kleinstleck" UWORD B_TRUE 1 100 0 1 BIT_MASK 0x2 FORMAT "%13.11" ECU_ADDRESS 0x7F96C0 /end MEASUREMENT
/begin FUNCTION DFPM_MDKOG "" /begin DEF_CHARACTERISTIC CDCMDB CDKMDB CDTMDB CLAMDB FFTMDB TSFMDB /end DEF_CHARACTERISTIC /begin REF_CHARACTERISTIC /end REF_CHARACTERISTIC /begin IN_MEASUREMENT /end IN_MEASUREMENT
 /begin OUT_MEASUREMENT B_bemdb B_bkmdb B_clmdb B_ftmdb B_mnmdb B_mxmdb B_npmdb B_simdb E_mdb sfpmdb TYP_mdb Z_mdb /end OUT_MEASUREMENT
 /begin LOC_MEASUREMENT /end LOC_MEASUREMENT
 /begin SUB_FUNCTION /end SUB_FUNCTION
/end FUNCTION
/begin FUNCTION DFPM_SWADP ""
 /begin DEF_CHARACTERISTIC CDCAGRF CDCDMTK CDCDMTL CDCHSVSA CDCKAT2 CDCKATSP CDCTESK CDKAGRF CDKDMTK CDKDMTL CDKHSVSA CDKKAT2 CDKKATSP CDKTESK CDTAGRF CDTDMTK CDTDMTL CDTHSVSA CDTKAT2 CDTKATSP CDTTESK CLAAGRF CLADMTK CLADMTL CLAHSVSA CLAKAT2 CLAKATSP CLATESK FFTAGRF FFTDMTK FFTDMTL FFTHSVSA FFTKAT2 FFTKATSP FFTTESK TSFAGRF TSFDMTK TSFDMTL TSFHSVSA TSFKAT2 TSFKATSP TSFTESK /end DEF_CHARACTERISTIC
 /begin REF_CHARACTERISTIC /end REF_CHARACTERISTIC
 /begin IN_MEASUREMENT /end IN_MEASUREMENT
 /begin OUT_MEASUREMENT E_agrf E_dmtk E_dmtl E_hsvsa E_kat2 E_katsp E_tesk sfpagrf sfpdmtk sfpdmtl sfphsvsa sfpkat2 sfpkatsp sfptesk Z_agrf Z_dmtk Z_dmtl Z_hsvsa Z_kat2 Z_katsp Z_tesk /end OUT_MEASUREMENT
 /begin LOC_MEASUREMENT /end LOC_MEASUREMENT
 /begin SUB_FUNCTION /end SUB_FUNCTION
/end FUNCTION
/begin FUNCTION DFRZ "OBDII; Beschreibung 'freeze frame'" /begin DEF_CHARACTERISTIC /end DEF_CHARACTERISTIC /begin REF_CHARACTERISTIC /end REF_CHARACTERISTIC /begin IN_MEASUREMENT /end IN_MEASUREMENT /begin OUT_MEASUREMENT /end OUT_MEASUREMENT /begin LOC_MEASUREMENT /end LOC_MEASUREMENT /begin SUB_FUNCTION /end SUB_FUNCTION /end FUNCTION
/begin FUNCTION DIAGTIME "Deaktivierung CAN-Betrieb ¸ber Tester" /begin DEF_CHARACTERISTIC /end DEF_CHARACTERISTIC /begin REF_CHARACTERISTIC /end REF_CHARACTERISTIC /begin IN_MEASUREMENT /end IN_MEASUREMENT
 /begin OUT_MEASUREMENT B_canoff B_cdiagoff B_diagtimeout B_dtimer diagtime rememberP3Max /end OUT_MEASUREMENT
 /begin LOC_MEASUREMENT /end LOC_MEASUREMENT
 /begin SUB_FUNCTION /end SUB_FUNCTION
/end FUNCTION
/begin FUNCTION DIGIN "" /begin DEF_CHARACTERISTIC /end DEF_CHARACTERISTIC /begin REF_CHARACTERISTIC /end REF_CHARACTERISTIC /begin IN_MEASUREMENT ES_asc ES_kill ES_sst1 ES_sst2 ES_start S_kl15 /end IN_MEASUREMENT
 /begin OUT_MEASUREMENT diak_elue ES_oelniv ES_poel ES_sfmdk ES_wda S_bls S_brs S_kupp /end OUT_MEASUREMENT
 /begin LOC_MEASUREMENT /end LOC_MEASUREMENT
 /begin SUB_FUNCTION /end SUB_FUNCTION
/end FUNCTION
/begin FUNCTION DIGOUT "" /begin DEF_CHARACTERISTIC /end DEF_CHARACTERISTIC /begin REF_CHARACTERISTIC /end REF_CHARACTERISTIC
 /begin IN_MEASUREMENT B_akl B_aklet B_ascLampe B_btakl B_btelue B_bthsv B_bthsv2 B_btslv B_elue B_hsv2et B_hsve B_hsve2 B_hsvet B_k15_nab B_nl B_nl_rst B_psoff B_slv B_slvet taml /end IN_MEASUREMENT
 /begin OUT_MEASUREMENT /end OUT_MEASUREMENT
 /begin LOC_MEASUREMENT /end LOC_MEASUREMENT
 /begin SUB_FUNCTION /end SUB_FUNCTION
/end FUNCTION
/begin FUNCTION DIMC "OBDII; inspection/maintenance-ready" /begin DEF_CHARACTERISTIC SRYHS SRYKAT SRYLS SRYSLS /end DEF_CHARACTERISTIC /begin REF_CHARACTERISTIC /end REF_CHARACTERISTIC
 /begin IN_MEASUREMENT B_cdagr B_cddmtl B_cdhsv B_cdkat B_cdldp B_cdlsv B_cdsls B_cdtes B_katfz B_pwf B_rdytes cd_bits1_w cd_bits2_w /end IN_MEASUREMENT
 /begin OUT_MEASUREMENT B_agrrdy B_hsrdy B_kathrdy B_katrdy B_kkrdy B_lsrdy B_slsrdy B_tesrdy evsup1 ready /end OUT_MEASUREMENT
 /begin LOC_MEASUREMENT cryhs crykat cryls crysls /end LOC_MEASUREMENT
 /begin SUB_FUNCTION /end SUB_FUNCTION
/end FUNCTION
/begin FUNCTION DIMCTES "Diagnose; Inspection-Maintenance Code, Tankentl¸ftungssystem" /begin DEF_CHARACTERISTIC SRYTES /end DEF_CHARACTERISTIC /begin REF_CHARACTERISTIC /end REF_CHARACTERISTIC /begin IN_MEASUREMENT B_cddmtl B_cdtes /end IN_MEASUREMENT
 /begin OUT_MEASUREMENT B_drvddmtl B_drvdldp B_drvdtev B_rdytes cryddmtl crydldp crydtev DIMCTESausbits1 DIMCTESausbitsNOV1 /end OUT_MEASUREMENT
 /begin LOC_MEASUREMENT /end LOC_MEASUREMENT
 /begin SUB_FUNCTION /end SUB_FUNCTION
/end FUNCTION
/begin FUNCTION DISTAB "" /begin DEF_CHARACTERISTIC EBEN EBMISS_T EBMISS_Y /end DEF_CHARACTERISTIC /begin REF_CHARACTERISTIC /end REF_CHARACTERISTIC /begin IN_MEASUREMENT /end IN_MEASUREMENT
 /begin OUT_MEASUREMENT B_ebDavT B_ebDavY ebCtrNewT ebCtrNewY ebCtrOldT ebCtrOldY ebMissT ebMissY /end OUT_MEASUREMENT
 /begin LOC_MEASUREMENT /end LOC_MEASUREMENT
 /begin SUB_FUNCTION /end SUB_FUNCTION
/end FUNCTION
/begin FUNCTION DKAT ""
 /begin DEF_CHARACTERISTIC ADKATNF AHKATMN AHKATMX AHKATS AHKATSB AHKTTSW APEKTDX AVKATFS CDKATLK DKATCW DMRKTD DRLKTDP FALRKTD FALRKTT KATBFML KATBFMN KATBFN KATBFNM KATBFNP KATBFSX KATBFXM KATBSG KATBSH KATBSHF KATBSHG NDKTSO NDKTSOT NDKTSU NDKTSUT NKTDX RLDKTOT RLDKTSO RLDKTSU RLDKTUT TDKATAKT TDKATATT TMINKAT TMNKATT TWDKATST TWKTDLP ZDKATAD ZDKATAF ZDKATSH ZDKTBD ZDKTBF ZKTDRL /end DEF_CHARACTERISTIC
 /begin REF_CHARACTERISTIC SML05DKUB SNM05DKUB /end REF_CHARACTERISTIC
 /begin IN_MEASUREMENT B_adpini B_cdkat B_dtes B_edkvs B_edkvs2 B_fa B_fakat B_fakat2 B_ll B_lr B_lr2 B_lrka B_mdarv B_mdkat B_tehb B_ukg cd_bits1_w esst_sml05dkub esst_snm05dkub fr2_w fr_w ml ml_w nmot rl tkatm ushk ushk2 /end IN_MEASUREMENT
 /begin OUT_MEASUREMENT ahkat ahkat2 avkatf avkatf2 B_dktlp dmrdkt_w falrdkt tc6kata tc6katc tc6katc2 tc6kats tc6kats2 tc6katw tc6katw2 /end OUT_MEASUREMENT
 /begin LOC_MEASUREMENT ahkatn ahkatn2 ahktki2_w ahktki_w ahktnk ahktnk2 akatbn akatbn2 apedkt apedkt2 B_dkini B_dkini2 B_dklpi B_dklpi2 B_dkten B_dkten2 B_dktnr B_dktnr2 B_dktsb B_dktsb2 B_dktsp B_dktsp2 B_dktst B_dktst2 B_dktt B_dktt2 B_ekats B_ekats2 B_erdkt B_erdkt2 B_szkat B_szkat2 B_trig B_trig2 B_zkatb B_zkatb2 B_zkats B_zkats2 B_zkatz B_zkatz2 dkatakt2_w dkatakt_w katbf katbf2 katbfi2_w katbfi_w katbfs katbfs2 katbftp katbftp2 katbshd2_w katbshd_w kbdkt2_w kbdkt_w rldkthp rldkthp2 urddktp urddktp2 ushdktp ushdktp2 /end LOC_MEASUREMENT
 /begin SUB_FUNCTION /end SUB_FUNCTION
/end FUNCTION
/begin FUNCTION DKILL "" /begin DEF_CHARACTERISTIC KILLERRCLZ KILLSIG100 TDHKILL TDKILL /end DEF_CHARACTERISTIC /begin REF_CHARACTERISTIC /end REF_CHARACTERISTIC /begin IN_MEASUREMENT ES_kill /end IN_MEASUREMENT /begin OUT_MEASUREMENT B_killdiag killerrorz killsigz /end OUT_MEASUREMENT /begin LOC_MEASUREMENT /end LOC_MEASUREMENT /begin SUB_FUNCTION /end SUB_FUNCTION /end FUNCTION
/begin FUNCTION DKL15 ""
 /begin DEF_CHARACTERISTIC DTKL1530 DUKL1530H DUKL1530L KL15ERRCLZ NMOTKL15 TDHKL15 TDKL15 VFZGKL15 /end DEF_CHARACTERISTIC
 /begin REF_CHARACTERISTIC /end REF_CHARACTERISTIC
 /begin IN_MEASUREMENT B_ll ES_kupp nmot S_kl15 ukl15 uuzdg vfzg /end IN_MEASUREMENT
 /begin OUT_MEASUREMENT dukl15 ukl15errz /end OUT_MEASUREMENT
 /begin LOC_MEASUREMENT /end LOC_MEASUREMENT
 /begin SUB_FUNCTION /end SUB_FUNCTION
/end FUNCTION
/begin FUNCTION DKRNT "Diagnose; Klopfregelung, Nulltest (OBDII)" /begin DEF_CHARACTERISTIC CWDKRNT CWDKROF DKROFN DKROKU KRFHT UDKRGOFS /end DEF_CHARACTERISTIC /begin REF_CHARACTERISTIC DKROKD /end REF_CHARACTERISTIC /begin IN_MEASUREMENT B_dnt B_pwf B_stend igod_w ikrma nmot tmfln_w tpnt_aktiv /end IN_MEASUREMENT /begin OUT_MEASUREMENT B_krntfv xzskrnt xzskrof /end OUT_MEASUREMENT /begin LOC_MEASUREMENT E_hlpkrnt E_hlpkrof xzkrznt xzkrzof Z_hlpkrnt Z_hlpkrof /end LOC_MEASUREMENT /begin SUB_FUNCTION /end SUB_FUNCTION /end FUNCTION
/begin FUNCTION DKRS "Diagnose; Klopfsensor (OBDII)" /begin DEF_CHARACTERISTIC CWDKS1 CWDKS2 KRFHKS NDKSO NDKSU UDKSNO UDKSNU /end DEF_CHARACTERISTIC /begin REF_CHARACTERISTIC KSZA SENZZYL /end REF_CHARACTERISTIC
 /begin IN_MEASUREMENT B_kr B_krldy B_krndy B_pwf B_synph B_tmkr E_krnt E_krof E_krtp ks_sym nmot rkr sen_c95 vkr /end IN_MEASUREMENT
 /begin OUT_MEASUREMENT B_krdws rkrn_w xzkrzs xzkrzs2 xzsen xzsen2 /end OUT_MEASUREMENT
 /begin LOC_MEASUREMENT B_ds /end LOC_MEASUREMENT
 /begin SUB_FUNCTION /end SUB_FUNCTION
/end FUNCTION
/begin FUNCTION DKRTP "Diagnose; Klopfregelung, Testimpuls (OBDII)" /begin DEF_CHARACTERISTIC CWDKRTP UDKRTP /end DEF_CHARACTERISTIC /begin REF_CHARACTERISTIC KRFHT /end REF_CHARACTERISTIC /begin IN_MEASUREMENT B_dtp B_pwf ikrma ikrmet tpnt_aktiv /end IN_MEASUREMENT /begin OUT_MEASUREMENT B_krtpfv xzskrtp /end OUT_MEASUREMENT /begin LOC_MEASUREMENT E_hlpkrtp xzkrztp Z_hlpkrtp /end LOC_MEASUREMENT /begin SUB_FUNCTION /end SUB_FUNCTION /end FUNCTION
/begin FUNCTION DKUPPL "Diagnose Kupplungsschalter" /begin DEF_CHARACTERISTIC ABWVFZG CW_dkuppl KUPPLFEVFZ KUPPLHESW NKUPPDIAG /end DEF_CHARACTERISTIC /begin REF_CHARACTERISTIC /end REF_CHARACTERISTIC
 /begin IN_MEASUREMENT B_kl15 B_vnull ES_kupp gangi nmot_w S_kupp vfzggang_w vfzg_w /end IN_MEASUREMENT
 /begin OUT_MEASUREMENT B_Ekurz /end OUT_MEASUREMENT
 /begin LOC_MEASUREMENT /end LOC_MEASUREMENT
 /begin SUB_FUNCTION /end SUB_FUNCTION
/end FUNCTION
/begin FUNCTION DKVS "Diagnose; Plausibilit‰tspr¸fung Kraftstoffversorgungssysteme"
 /begin DEF_CHARACTERISTIC CPLRA CWDKVSS CWDVVT DFRMST FRAE FRAODN FRAODX FRAUDN FRAUDX FRMSTTDN FRMSTTDX IMLKVSMX MLDKVSF MLDKVSG RKAE RKATDN RKATDX RKAZDN RKAZDX TFRA TFRAOZ TFRAUZ TFRMST TFRMZST TMFRST TRKA TRKATZ TRKAZZ ZFRMST /end DEF_CHARACTERISTIC
 /begin REF_CHARACTERISTIC /end REF_CHARACTERISTIC
 /begin IN_MEASUREMENT B_adpini B_cdkvs B_fa B_fakvs B_falra B_frao B_frau B_fraur B_fraur2 B_lr B_lr2 B_lra B_lra2 B_lrare B_nofra B_norkat B_norkaz B_rkat B_rkatr B_rkatr2 B_rkaz B_rkazr B_rkazr2 B_sa B_tal B_talval B_te cd_bits1_w frao2_w frao_w frau2_w frau_w frm2_w frm_w ml rkat2_w rkat_w rkaz2_w rkaz_w tans tmot /end IN_MEASUREMENT
 /begin OUT_MEASUREMENT B_dkvsf B_dkvstr B_edkvs B_edkvs2 B_gae B_gaefra B_gaefra2 B_kvsffl rkats_w /end OUT_MEASUREMENT
 /begin LOC_MEASUREMENT B_dkvsef B_dkvsef2 B_dkvsfm B_dkvszf B_dkvszf2 B_efrao B_efrao2 B_efrau B_efrau2 B_erkat B_erkat2 B_erkaz B_erkaz2 B_frste B_frste2 B_gaeing B_gaeing2 B_imlkvse B_norkam B_plra B_rkam B_rkamr B_rkamr2 B_zfrao B_zfrao2 B_zfrau B_zfrau2 B_zrkat B_zrkat2 B_zrkaz B_zrkaz2 DKVS1lokbits DKVSbits DKVSlokbits frauzs2_w frauzs_w imlkvszs_w imlkvs_w rkam2_w rkamzs2_w rkamzs_w rkam_w /end LOC_MEASUREMENT
 /begin SUB_FUNCTION /end SUB_FUNCTION
/end FUNCTION
/begin FUNCTION DLLR "Diagnose: Leerlaufregelung Erkennung blockierter Steller"
 /begin DEF_CHARACTERISTIC DASA DNDLLRO DNDLLRU FHDLLR RLDLLR TADLLR TDLLR TDLLRMN TDLLRMX TDLLRNF TFDLLRO TFDLLRU TMDLLR /end DEF_CHARACTERISTIC
 /begin REF_CHARACTERISTIC /end REF_CHARACTERISTIC
 /begin IN_MEASUREMENT B_cdllr B_dknolu B_dkpu B_dsls B_dtes B_ffuest B_fkvs B_flamad B_ftev B_ll B_llr B_lrar B_nldg B_nmot B_nswo1 B_sa B_st B_tehb cd_bits2_w dmllri_w dns fho limax_w limin_w rl tans tmot tnse_w vfzg /end IN_MEASUREMENT
 /begin OUT_MEASUREMENT B_dllr B_dllra /end OUT_MEASUREMENT
 /begin LOC_MEASUREMENT B_lldia B_nollrflr /end LOC_MEASUREMENT
 /begin SUB_FUNCTION /end SUB_FUNCTION
/end FUNCTION
/begin FUNCTION DLSA ""
 /begin DEF_CHARACTERISTIC ANZDPVK ANZTP KFTPKOR NTPKTO NTPKTU NTPVKO NTPVKU RLTPKTO RLTPKTU RLTPVKO RLTPVKU TKTPVK TSTEAA TSVKKO TSVKKTO TSVKKTU TSVKKU TSVKO TSVKU TVLRHMN TVLRHMN2 TVLRHMX TVLRHMX2 TWDDTV ZFTSVK /end DEF_CHARACTERISTIC
 /begin REF_CHARACTERISTIC /end REF_CHARACTERISTIC
 /begin IN_MEASUREMENT atv B_cdlatp B_cdlatv B_dsls B_dtest B_edkvs B_edkvs2 B_fa B_fatp B_fatp2 B_fatv B_fatv2 B_gasp B_lr B_lr2 B_lrhk B_lrtpp B_lrtpp2 B_mdarv B_st B_te B_tehb cd_bits2_w nmot rl tabgm tkatm tplrvk2_w tplrvk_w /end IN_MEASUREMENT
 /begin OUT_MEASUREMENT B_dlatp B_dlatp2 B_lsastp tpsvkmf2_w tpsvkmf_w tpsvkof2_w tpsvkof_w tzlsatv2_w tzlsatv_w zlsatp zlsatp2 zwpvk zwpvk2 /end OUT_MEASUREMENT
 /begin LOC_MEASUREMENT B_dlaff B_dlaff2 B_dlatv B_dlatv2 B_lsastp2 B_nolatp B_nolatp2 B_nolatv B_nolatv2 /end LOC_MEASUREMENT
 /begin SUB_FUNCTION /end SUB_FUNCTION
/end FUNCTION
/begin FUNCTION DLSHVKE "" /begin DEF_CHARACTERISTIC CWPSLSHVKE LSHVKEFA /end DEF_CHARACTERISTIC /begin REF_CHARACTERISTIC /end REF_CHARACTERISTIC /begin IN_MEASUREMENT B_kl15 B_ttuse B_ttuse2 B_uusys E_kl15 nmot /end IN_MEASUREMENT /begin OUT_MEASUREMENT B_elshvke /end OUT_MEASUREMENT /begin LOC_MEASUREMENT /end LOC_MEASUREMENT /begin SUB_FUNCTION /end SUB_FUNCTION /end FUNCTION
/begin FUNCTION DLSSA "Signalausgabe Lambdasonden"
 /begin DEF_CHARACTERISTIC ATVFETTO ATVFETTU ATVMAGO ATVMAGU SAFK1 SAFK2 TPSVKMN TPSVKMX TUSPNMN TUSPNMX TWDLSSA USIVMAXV USIVMINV USMNSAMN USMNSAMX USMXSAMN USMXSAMX USRJ /end DEF_CHARACTERISTIC
 /begin REF_CHARACTERISTIC /end REF_CHARACTERISTIC
 /begin IN_MEASUREMENT atv atv2 B_adpini B_dlatp B_dlatp2 B_lrhk B_lrtpp B_lrtpp2 tfrn2_w tfrn_w tpsvkmf2_w tpsvkmf_w usvk usvk2 /end IN_MEASUREMENT
 /begin OUT_MEASUREMENT atvfett atvfett2 atvmager atvmager2 tpsvlssa tpsvlssa2 tuspnf tuspnf2 usmnsan usmnsan2 usmxsan usmxsan2 usrj usvkj usvkj2 /end OUT_MEASUREMENT
 /begin LOC_MEASUREMENT B_tuspn B_tuspn2 B_tusre B_tusre2 dlssabits twdlssa2_w twdlssa_w usmnsaa usmnsaa2 usmxsaa usmxsaa2 usvkjf2_w usvkjf_w /end LOC_MEASUREMENT
 /begin SUB_FUNCTION /end SUB_FUNCTION
/end FUNCTION
/begin FUNCTION DLSV ""
 /begin DEF_CHARACTERISTIC ABGMSIGV ANZGEM CWLSADS DRISIGV RISIGRESV TABGMCSD TASIG TMASO TMNEB TMSV TMSVA TNSTDN TRSA TRSE TTBMH TUSDU TUSDUC TUSEINV TUSFETT TUSKS TUSMAX UBDLS UBDLSMX USDBO USDBU USMASO USMAX USMIN USREF USREM /end DEF_CHARACTERISTIC
 /begin REF_CHARACTERISTIC /end REF_CHARACTERISTIC
 /begin IN_MEASUREMENT B_adpini B_atmtpa B_atmtpa2 B_cdlsh B_cdlsv B_dsls B_dslve B_dtes B_esls B_ffuerf B_ffuest B_fkvs B_fosb B_ftev B_hsve B_hsve2 B_lr B_lr2 B_nmot B_sa B_sls B_slste B_st cd_bits1_w E_akle E_dsu E_llr E_lshvk2e E_ph E_slv E_slv1e E_ta lamsons2_w lamsons_w rinv2_w rinv_w tabgmls tabgmls2 tabzyl_w tmotzyl_w ub usvk2_w usvk_w /end IN_MEASUREMENT
 /begin OUT_MEASUREMENT B_dsven B_dsven2 B_sbbvk B_sbbvk2 B_ttbmh B_ttbmh2 B_ttuse B_ttuse2 zwgeflr zwgeflr2 /end OUT_MEASUREMENT
 /begin LOC_MEASUREMENT B_adcsd B_adcsd2 B_adde B_adde2 B_adsvb B_adsvb2 B_dlrstp B_dlrstp2 B_dmaso B_dmaso2 B_lsads B_lsads2 B_lsfet B_lsfet2 B_lshub B_lshub2 B_lsvklt B_lsvklt2 B_lsvn B_lsvn2 B_maso B_maso2 B_maxflsv B_maxflsv2 B_minflsv B_minflsv2 B_nolsv B_nolsv2 B_nplflsv B_nplflsv2 B_refmax B_refmax2 B_risigv B_risigv2 B_sigflsv B_sigflsv2 B_trsa B_trsa2 B_ueinv B_ueinv2 B_uvsig B_uvsig2 B_vadge B_vadge2 B_vgeflr B_vgeflr2 DLSVbits DLSVerrors DLSVintbits /end LOC_MEASUREMENT
 /begin SUB_FUNCTION /end SUB_FUNCTION
/end FUNCTION
/begin FUNCTION DMIL "OBDII; MIL-Ansteuerung" /begin DEF_CHARACTERISTIC CWMILCOD CWNOMIL TLAED TLAEDI /end DEF_CHARACTERISTIC /begin REF_CHARACTERISTIC /end REF_CHARACTERISTIC
 /begin IN_MEASUREMENT B_blkfb B_blkmd B_bt B_btmil B_milet B_milfb B_milmd B_nmot B_nokatfz dfpmMilState /end IN_MEASUREMENT
 /begin OUT_MEASUREMENT B_kmmil B_mil B_milblk B_milst B_milstat B_nomil milstat /end OUT_MEASUREMENT
 /begin LOC_MEASUREMENT B_blkeb B_mileb /end LOC_MEASUREMENT
 /begin SUB_FUNCTION /end SUB_FUNCTION
/end FUNCTION
/begin FUNCTION DMLS "" /begin DEF_CHARACTERISTIC DELTAI_MLS DMLSERRCLZ TDDMLS TDHDMLS TERRDMLS /end DEF_CHARACTERISTIC /begin REF_CHARACTERISTIC /end REF_CHARACTERISTIC /begin IN_MEASUREMENT B_btelue B_elue B_sysbts iisysf_w /end IN_MEASUREMENT /begin OUT_MEASUREMENT dmlserrz iisysf_old /end OUT_MEASUREMENT /begin LOC_MEASUREMENT /end LOC_MEASUREMENT /begin SUB_FUNCTION /end SUB_FUNCTION /end FUNCTION
/begin FUNCTION Doppelablage "" /begin DEF_CHARACTERISTIC /end DEF_CHARACTERISTIC /begin REF_CHARACTERISTIC /end REF_CHARACTERISTIC /begin IN_MEASUREMENT /end IN_MEASUREMENT
 /begin OUT_MEASUREMENT B_btekp B_ekp B_ekpbts B_ekpbtssc B_frgAnl B_kl15 B_MotorStp B_neutral B_sysbts B_sysbtssc B_vnull B_zdgbts B_zdgbtssc cntSIKODAprell ES_kill ES_kupp ES_sst ES_sst1 ES_sst2 ES_start mifa_w miist_w nmot_w S_kl15 udkp1_w udkpa_w zwout /end OUT_MEASUREMENT
 /begin LOC_MEASUREMENT /end LOC_MEASUREMENT
 /begin SUB_FUNCTION /end SUB_FUNCTION
/end FUNCTION
/begin FUNCTION DPH "Diagnose; Plausibilit‰tspr¸fung Phasensensor"
 /begin DEF_CHARACTERISTIC ANZNWZ CWDPH FSPHGPOS FSPHGSIG FSZNWF HZNWF LPHGHYS LPHGMX LPHNWFHYS LPHNWFMX NEPH NWE1POSRMN NWE1POSRMX /end DEF_CHARACTERISTIC
 /begin REF_CHARACTERISTIC /end REF_CHARACTERISTIC
 /begin IN_MEASUREMENT B_nmaxsyn B_nmot B_nwcheck3 B_nwfehler nmot Nwe1poserr Nwe1_irq Nwe1_pos Segakt /end IN_MEASUREMENT
 /begin OUT_MEASUREMENT B_rueckdre Z_nwfehler /end OUT_MEASUREMENT
 /begin LOC_MEASUREMENT Anznwz720 B_anznwzko Fszph Fszph2 /end LOC_MEASUREMENT
 /begin SUB_FUNCTION /end SUB_FUNCTION
/end FUNCTION
/begin FUNCTION drad_v "" /begin DEF_CHARACTERISTIC DRAD_VMIN TDRADV /end DEF_CHARACTERISTIC /begin REF_CHARACTERISTIC /end REF_CHARACTERISTIC /begin IN_MEASUREMENT E_radv hr_v_w vr_v_w Z_radv /end IN_MEASUREMENT /begin OUT_MEASUREMENT B_ascFreig B_drad Edrad /end OUT_MEASUREMENT /begin LOC_MEASUREMENT /end LOC_MEASUREMENT /begin SUB_FUNCTION /end SUB_FUNCTION /end FUNCTION
/begin FUNCTION DRIV_SIT ""
 /begin DEF_CHARACTERISTIC DRVSIT_OFF PM_DS_NEG PM_DS_POS PM_D_S_Z1 PM_D_S_Z2 PM_D_S_ZA PM_TAN_Z1 PM_TAN_Z2 PM_TAN_ZA /end DEF_CHARACTERISTIC
 /begin REF_CHARACTERISTIC ASC_SMPL /end REF_CHARACTERISTIC
 /begin IN_MEASUREMENT dk_pos_asc gearatio_w rai_w roadtype_w v_vradabs /end IN_MEASUREMENT
 /begin OUT_MEASUREMENT drvSit drvSitAdd drvSitLim drvSitPre drvSitPreO /end OUT_MEASUREMENT
 /begin LOC_MEASUREMENT /end LOC_MEASUREMENT
 /begin SUB_FUNCTION /end SUB_FUNCTION
/end FUNCTION
/begin FUNCTION DSLSLR ""
 /begin DEF_CHARACTERISTIC CWDSLSY DFRMOFNX DFRMOFPX FHODSL FMSLAMN FMSLAMX IMLATDSL IMLATDSLK IMLDSL IMSLADAP MLDSLAMN MLDSLAMX MLDSLKMN MLDSLKMX MLDSLMN MLDSLMX MLDSLOMN MLDSLOMX MSLBAS MSLVMX RMSLADA RMSLMN RMSLPMN RMSLTMN TABGMSLAD TANDSLMN TANDSLMX TC6CSL TC6CSL2 TC6CSLN TC6CSLN2 TC6CSLV TC6CSLV2 TDMSLMN1 TDMSLMN4 TDMSLMNK TDMSLOF3 TDMSLOF5 TDMSLOFK TDMSLV TDMSLVK TDPHSLOF TDSLMVBA TFIMSLI TFIMSLIK TFIMSLO TFIMSLOK TFIMSLV TFIMSLVK TKATDSL TMDSLAMN TMDSLMN TMDSLMX TNOMF2 TNOMF3 TNOMF5 TWHLSLP TWMLFE TWMSLMIN /end DEF_CHARACTERISTIC
 /begin REF_CHARACTERISTIC /end REF_CHARACTERISTIC
 /begin IN_MEASUREMENT B_adpini B_bag B_cdsls B_dslste B_dslve B_edkvs B_edkvs2 B_evloc B_fasla B_gap B_hag B_kha B_lrnd B_lrnd2 B_lrnda B_lrnda2 B_mdarv B_nmot B_slp B_slpoff B_sls B_slsadap B_slsfz B_slsoff B_slste B_te B_vag fho_w frm2_w frm_w imlatm_w imlpr lamsons2_w lamsons_w ml mlbb2_w mlbb_w ml_w msabg2_w msabg_w msl msl2 tabgm tans tkatm tmot /end IN_MEASUREMENT
 /begin OUT_MEASUREMENT B_cwdslt B_dsl B_dsl1 B_dsl2e B_dsl4 B_dsla B_dslerr B_dslfa B_dslme B_dslo B_dsloab B_dsls B_dslsp4 B_dspe B_esls B_mslmn B_mslpmn B_mslpmn2 B_sla B_szsls dfrmoff2_w dfrmoff_w fmsla fmsla2 m6amsl m6cmsl m6cmsl2 m6cmslv m6cmslv2 m6smsl2_w m6smslv2_w m6smslv_w m6smsl_w m6wmsl2_w m6wmslv2_w m6wmslv_w m6wmsl_w /end OUT_MEASUREMENT
 /begin LOC_MEASUREMENT B_asla B_asla2 B_cwsla B_dfrmoff B_dfrmoff2 B_dsl1ab B_dsl1e B_dsl2 B_dsl2ab B_dsl3 B_dsl3ab B_dsl3e B_dsl4ab B_dsl4e B_dsl5 B_dsl5ab B_dsl5e B_dslm B_dslmab B_dslmes B_dsloe B_dslsre B_dslsse B_dslt B_dsltab B_dslte B_dsper B_dspes B_errofs B_errofs2 B_faslarq B_mslmin B_mslmin2 B_slar B_slas B_slsofa B_zsls DSLSLRlokBits1 DSLSLRlokBits2 DSLSLRlokBits3 fmslav fmslav2 mslift mslift2 mslnenn mslnenn2 mslnf mslnf2 mslnt mslnt2 mslt2_w mslt_w mslv mslv2 mslvft mslvft2 mslvt2_w mslvt_w rmsl rmsl2 rmslt rmslt2 /end LOC_MEASUREMENT
 /begin SUB_FUNCTION /end SUB_FUNCTION
/end FUNCTION
/begin FUNCTION DSLVE "" /begin DEF_CHARACTERISTIC CWPSSLVE SLVEFA /end DEF_CHARACTERISTIC /begin REF_CHARACTERISTIC /end REF_CHARACTERISTIC /begin IN_MEASUREMENT B_slvet B_uusys nmot /end IN_MEASUREMENT /begin OUT_MEASUREMENT B_eslve /end OUT_MEASUREMENT /begin LOC_MEASUREMENT /end LOC_MEASUREMENT /begin SUB_FUNCTION /end SUB_FUNCTION /end FUNCTION
/begin FUNCTION DSPI "" /begin DEF_CHARACTERISTIC SPI_PROT_STOP /end DEF_CHARACTERISTIC /begin REF_CHARACTERISTIC /end REF_CHARACTERISTIC /begin IN_MEASUREMENT /end IN_MEASUREMENT /begin OUT_MEASUREMENT spi_errors /end OUT_MEASUREMENT /begin LOC_MEASUREMENT /end LOC_MEASUREMENT /begin SUB_FUNCTION /end SUB_FUNCTION /end FUNCTION
/begin FUNCTION DSST "" /begin DEF_CHARACTERISTIC CW_2sst TDHSST TDSST TDSSTWE /end DEF_CHARACTERISTIC /begin REF_CHARACTERISTIC /end REF_CHARACTERISTIC /begin IN_MEASUREMENT ES_sst ES_sst1 ES_sst2 /end IN_MEASUREMENT /begin OUT_MEASUREMENT sst1_tmp sst2_tmp /end OUT_MEASUREMENT /begin LOC_MEASUREMENT /end LOC_MEASUREMENT /begin SUB_FUNCTION /end SUB_FUNCTION /end FUNCTION
/begin FUNCTION DSSTE "" /begin DEF_CHARACTERISTIC CWPSSSTE SSTEFA /end DEF_CHARACTERISTIC /begin REF_CHARACTERISTIC /end REF_CHARACTERISTIC /begin IN_MEASUREMENT B_uusys nmot /end IN_MEASUREMENT /begin OUT_MEASUREMENT B_esste /end OUT_MEASUREMENT /begin LOC_MEASUREMENT /end LOC_MEASUREMENT /begin SUB_FUNCTION /end SUB_FUNCTION /end FUNCTION
/begin FUNCTION DSTARTE "" /begin DEF_CHARACTERISTIC CWPSSTARTE STARTEFA /end DEF_CHARACTERISTIC /begin REF_CHARACTERISTIC /end REF_CHARACTERISTIC /begin IN_MEASUREMENT B_uusys B_uuzdg nmot /end IN_MEASUREMENT /begin OUT_MEASUREMENT B_estarte /end OUT_MEASUREMENT /begin LOC_MEASUREMENT /end LOC_MEASUREMENT /begin SUB_FUNCTION /end SUB_FUNCTION /end FUNCTION
/begin FUNCTION DSTP "" /begin DEF_CHARACTERISTIC CW_DSTP STP_FSW_IN STP_FSW_OUT /end DEF_CHARACTERISTIC /begin REF_CHARACTERISTIC /end REF_CHARACTERISTIC /begin IN_MEASUREMENT /end IN_MEASUREMENT
 /begin OUT_MEASUREMENT B_estp St1_E_max St1_E_min St1_E_openl St1_E_ovtmp St1_E_temp St2_E_max St2_E_min St2_E_openl St2_E_ovtmp St2_E_temp stp_diag_act /end OUT_MEASUREMENT
 /begin LOC_MEASUREMENT /end LOC_MEASUREMENT
 /begin SUB_FUNCTION /end SUB_FUNCTION
/end FUNCTION
/begin FUNCTION DSWEC "Schlechtwegerk. aus Rad-Beschl.,-> mittels CAN von ABS SG zu Motronic" /begin DEF_CHARACTERISTIC FABSALU FIBSALU FSWALUV /end DEF_CHARACTERISTIC /begin REF_CHARACTERISTIC /end REF_CHARACTERISTIC /begin IN_MEASUREMENT bsc B_cdswe cd_bits1_w vfzg /end IN_MEASUREMENT /begin OUT_MEASUREMENT B_swe_c /end OUT_MEASUREMENT /begin LOC_MEASUREMENT bssp fswares /end LOC_MEASUREMENT /begin SUB_FUNCTION /end SUB_FUNCTION /end FUNCTION
/begin FUNCTION DTDE "" /begin DEF_CHARACTERISTIC CWPSTDE TDEFA /end DEF_CHARACTERISTIC /begin REF_CHARACTERISTIC /end REF_CHARACTERISTIC /begin IN_MEASUREMENT /end IN_MEASUREMENT /begin OUT_MEASUREMENT B_etde /end OUT_MEASUREMENT /begin LOC_MEASUREMENT /end LOC_MEASUREMENT /begin SUB_FUNCTION /end SUB_FUNCTION /end FUNCTION
/begin FUNCTION DTEVE "Diagnose; Tankentl¸ftungsventil - Endstufe" /begin DEF_CHARACTERISTIC CWPSTEVE TEVEFA /end DEF_CHARACTERISTIC /begin REF_CHARACTERISTIC /end REF_CHARACTERISTIC /begin IN_MEASUREMENT B_uusys E_kl15 nmot /end IN_MEASUREMENT /begin OUT_MEASUREMENT B_eteve /end OUT_MEASUREMENT /begin LOC_MEASUREMENT /end LOC_MEASUREMENT /begin SUB_FUNCTION /end SUB_FUNCTION /end FUNCTION
/begin FUNCTION DTEVN "Diagnose Tankentl¸ftungsventil (OBDII)"
 /begin DEF_CHARACTERISTIC AIMDTED AIODTEX APDTEX DMITED DNSTED FTETEDF FTETEDM HTEDU INTEDOFS INTEDOOFS INTEDUFS INTEDUOFS NSTEDMX RLTEDMX TBTEVIO TMTED TNODTEV TNODTEVT TTEDAFS TTEDAOFS TTEDBA TTEDIVFS TTEDIVOFS TTEDNFS TTEDNOFS TWKODTE ZMVDTE ZNTED /end DEF_CHARACTERISTIC
 /begin REF_CHARACTERISTIC TTEGAI TTEINI /end REF_CHARACTERISTIC
 /begin IN_MEASUREMENT B_adpini B_cdtes B_dmtltz B_druck B_dsls B_edkvs B_edkvs2 B_fa B_fates B_frao B_frau B_fs B_kh B_ko B_kw B_ll B_lowra B_lr B_lr2 B_mdarv B_rkat B_rkaz B_stend B_tei cd_bits1_w fho ftead_w mdverl_w milsol_w mstesoll_w nmot_w nsol rl tmot vfzg /end IN_MEASUREMENT
 /begin OUT_MEASUREMENT B_dteaa B_dtebel B_dtebn B_dtes B_dtest tadtea tbtevio_c tc6tesc tc6tess tc6tesw tesstat twkodte_c zdteio zdtev /end OUT_MEASUREMENT
 /begin LOC_MEASUREMENT B_dteabr B_dtean B_dteaq B_dtei B_dtesq B_dtevio dmidte dndte dnsdte DTEVNbits dtevphc_w indte midter mvdtehp nsdter ntpdte ntpdter tdten_w /end LOC_MEASUREMENT
 /begin SUB_FUNCTION /end SUB_FUNCTION
/end FUNCTION
/begin FUNCTION DTHS "DTHS.     Diagnose Thermostat" /begin DEF_CHARACTERISTIC CIDTHS CWLOWRA CW_DTHS NMXTHS TKA_DELTA TMOT_SOLL T_SA_MAX /end DEF_CHARACTERISTIC /begin REF_CHARACTERISTIC /end REF_CHARACTERISTIC /begin IN_MEASUREMENT B_adpini B_etr B_hls B_lowra B_sa B_stend nmot tka tmot /end IN_MEASUREMENT
 /begin OUT_MEASUREMENT B_cwdthm B_dths1 B_dthsab B_dthsfr B_dthsst B_heaths B_minths dthsBits1_1000ms m6cthm m6sthm_w m6wthm_w tka_start t_sa /end OUT_MEASUREMENT
 /begin LOC_MEASUREMENT tka_loc /end LOC_MEASUREMENT
 /begin SUB_FUNCTION DFPM_DTHS INDEX_DTHS /end SUB_FUNCTION
/end FUNCTION
/begin FUNCTION DTIP "OBDII; Tester-Interface Package" /begin DEF_CHARACTERISTIC /end DEF_CHARACTERISTIC /begin REF_CHARACTERISTIC /end REF_CHARACTERISTIC /begin IN_MEASUREMENT cw_erfil fcmEnd FCMTab /end IN_MEASUREMENT /begin OUT_MEASUREMENT ffzdfp /end OUT_MEASUREMENT /begin LOC_MEASUREMENT /end LOC_MEASUREMENT /begin SUB_FUNCTION /end SUB_FUNCTION /end FUNCTION
/begin FUNCTION DTOP "Diagnose; Betriebszeit" /begin DEF_CHARACTERISTIC /end DEF_CHARACTERISTIC /begin REF_CHARACTERISTIC /end REF_CHARACTERISTIC /begin IN_MEASUREMENT B_nmot B_pwf /end IN_MEASUREMENT /begin OUT_MEASUREMENT top_w /end OUT_MEASUREMENT /begin LOC_MEASUREMENT /end LOC_MEASUREMENT /begin SUB_FUNCTION /end SUB_FUNCTION /end FUNCTION
/begin FUNCTION DTRIG "OBDII; Ausw‰hlbare Trigger f¸r Fehlerpfad-Management" /begin DEF_CHARACTERISTIC /end DEF_CHARACTERISTIC /begin REF_CHARACTERISTIC /end REF_CHARACTERISTIC /begin IN_MEASUREMENT bbdcy bbno bbsp1 bbsp2 bbsp3 bbtim bbwuc /end IN_MEASUREMENT /begin OUT_MEASUREMENT /end OUT_MEASUREMENT /begin LOC_MEASUREMENT /end LOC_MEASUREMENT /begin SUB_FUNCTION /end SUB_FUNCTION /end FUNCTION
/begin FUNCTION DUMMY_DFPM "" /begin DEF_CHARACTERISTIC /end DEF_CHARACTERISTIC /begin REF_CHARACTERISTIC /end REF_CHARACTERISTIC /begin IN_MEASUREMENT /end IN_MEASUREMENT /begin OUT_MEASUREMENT B_m8te cw_erfil errorCntAskTcsort vstvvr /end OUT_MEASUREMENT /begin LOC_MEASUREMENT /end LOC_MEASUREMENT /begin SUB_FUNCTION /end SUB_FUNCTION /end FUNCTION
/begin FUNCTION DUMWEX "Diagose; Erweiterte Umweltbedingumgen" /begin DEF_CHARACTERISTIC /end DEF_CHARACTERISTIC /begin REF_CHARACTERISTIC /end REF_CHARACTERISTIC /begin IN_MEASUREMENT kmstand /end IN_MEASUREMENT /begin OUT_MEASUREMENT /end OUT_MEASUREMENT /begin LOC_MEASUREMENT /end LOC_MEASUREMENT /begin SUB_FUNCTION /end SUB_FUNCTION /end FUNCTION
/begin FUNCTION DUR "Diagnose aus der Rechner¸berwachung" /begin DEF_CHARACTERISTIC /end DEF_CHARACTERISTIC /begin REF_CHARACTERISTIC /end REF_CHARACTERISTIC /begin IN_MEASUREMENT /end IN_MEASUREMENT /begin OUT_MEASUREMENT rstpfad /end OUT_MEASUREMENT /begin LOC_MEASUREMENT rstMon_um /end LOC_MEASUREMENT /begin SUB_FUNCTION /end SUB_FUNCTION /end FUNCTION
/begin FUNCTION DVFZ "Diagnose: Plausibilit‰tspr¸fung Fahrzeuggeschwindigkeit" /begin DEF_CHARACTERISTIC TDV /end DEF_CHARACTERISTIC /begin REF_CHARACTERISTIC /end REF_CHARACTERISTIC /begin IN_MEASUREMENT B_abs v_hrad v_vrad /end IN_MEASUREMENT /begin OUT_MEASUREMENT /end OUT_MEASUREMENT /begin LOC_MEASUREMENT /end LOC_MEASUREMENT /begin SUB_FUNCTION /end SUB_FUNCTION /end FUNCTION
/begin FUNCTION DWUC "OBDII; Erf¸llung Bedingung 'warm up cycle'" /begin DEF_CHARACTERISTIC DTMWUC TMWUC TMWUCST /end DEF_CHARACTERISTIC /begin REF_CHARACTERISTIC /end REF_CHARACTERISTIC /begin IN_MEASUREMENT B_pwf B_stend tmot /end IN_MEASUREMENT /begin OUT_MEASUREMENT bbwuc B_nowuc B_wuc wuccnt /end OUT_MEASUREMENT /begin LOC_MEASUREMENT tmstem /end LOC_MEASUREMENT /begin SUB_FUNCTION /end SUB_FUNCTION /end FUNCTION
/begin FUNCTION _EEPROM "" /begin DEF_CHARACTERISTIC /end DEF_CHARACTERISTIC /begin REF_CHARACTERISTIC /end REF_CHARACTERISTIC /begin IN_MEASUREMENT /end IN_MEASUREMENT /begin OUT_MEASUREMENT /end OUT_MEASUREMENT /begin LOC_MEASUREMENT /end LOC_MEASUREMENT /begin SUB_FUNCTION /end SUB_FUNCTION /end FUNCTION
/begin FUNCTION EEProm_Conf "" /begin DEF_CHARACTERISTIC KW_EepromChangedSaveEnable KW_tsgEepMax KW_ubEepMin /end DEF_CHARACTERISTIC /begin REF_CHARACTERISTIC CWPWF /end REF_CHARACTERISTIC /begin IN_MEASUREMENT B_adpini B_pwf eepNLState tsg ub /end IN_MEASUREMENT /begin OUT_MEASUREMENT eepBankErrorCnt /end OUT_MEASUREMENT /begin LOC_MEASUREMENT /end LOC_MEASUREMENT /begin SUB_FUNCTION /end SUB_FUNCTION /end FUNCTION
/begin FUNCTION EEProm_Priv "" /begin DEF_CHARACTERISTIC /end DEF_CHARACTERISTIC /begin REF_CHARACTERISTIC /end REF_CHARACTERISTIC /begin IN_MEASUREMENT /end IN_MEASUREMENT /begin OUT_MEASUREMENT eepNLSpiTB eepNLState eepTimer /end OUT_MEASUREMENT /begin LOC_MEASUREMENT eepPageSize /end LOC_MEASUREMENT /begin SUB_FUNCTION /end SUB_FUNCTION /end FUNCTION
/begin FUNCTION EEProm_Public "" /begin DEF_CHARACTERISTIC /end DEF_CHARACTERISTIC /begin REF_CHARACTERISTIC /end REF_CHARACTERISTIC /begin IN_MEASUREMENT eepNLSpiTB eepNLState eepTimer /end IN_MEASUREMENT /begin OUT_MEASUREMENT /end OUT_MEASUREMENT /begin LOC_MEASUREMENT /end LOC_MEASUREMENT /begin SUB_FUNCTION /end SUB_FUNCTION /end FUNCTION
/begin FUNCTION ELS "E-Box L¸fter Steuerung" /begin DEF_CHARACTERISTIC DTEBLEIN TEBLEIN TTEBL /end DEF_CHARACTERISTIC /begin REF_CHARACTERISTIC /end REF_CHARACTERISTIC /begin IN_MEASUREMENT B_nmot tsg /end IN_MEASUREMENT /begin OUT_MEASUREMENT B_ebl /end OUT_MEASUREMENT /begin LOC_MEASUREMENT /end LOC_MEASUREMENT /begin SUB_FUNCTION /end SUB_FUNCTION /end FUNCTION
/begin FUNCTION ENDSDIAG "" /begin DEF_CHARACTERISTIC TDUDIAG UMIN_DE /end DEF_CHARACTERISTIC /begin REF_CHARACTERISTIC /end REF_CHARACTERISTIC /begin IN_MEASUREMENT B_bthsv2 B_hsv2et B_hsve2 B_slvet uuekp uusys uuzdg /end IN_MEASUREMENT /begin OUT_MEASUREMENT B_uuekp B_uusys B_uuzdg /end OUT_MEASUREMENT /begin LOC_MEASUREMENT /end LOC_MEASUREMENT /begin SUB_FUNCTION /end SUB_FUNCTION /end FUNCTION
/begin FUNCTION ERCO_ERR "" /begin DEF_CHARACTERISTIC /end DEF_CHARACTERISTIC /begin REF_CHARACTERISTIC /end REF_CHARACTERISTIC /begin IN_MEASUREMENT /end IN_MEASUREMENT /begin OUT_MEASUREMENT E_OS_LIMIT_ctr /end OUT_MEASUREMENT /begin LOC_MEASUREMENT /end LOC_MEASUREMENT /begin SUB_FUNCTION /end SUB_FUNCTION /end FUNCTION
/begin COMPU_METHOD accgrd_ub_b555p55 "" RAT_FUNC "%6.2" "m/(s^3)" COEFFS 0 1 0 0 0 2.17 /end COMPU_METHOD
/begin COMPU_METHOD acc_ub_b55p55 "" RAT_FUNC "%6.3" "m/(s^2)" COEFFS 0 1 0 0 0 0.217 /end COMPU_METHOD
/begin COMPU_METHOD acc_uw_b55p55 "" RAT_FUNC "%6.5" "m/(s^2)" COEFFS 0 147456 0 0 0 125 /end COMPU_METHOD
/begin COMPU_METHOD B_TRUE "" TAB_VERB "%6.3" "" COMPU_TAB_REF B_TRUE /end COMPU_METHOD
/begin COMPU_VTAB B_TRUE "" TAB_VERB 2 0 "false" 1 "TRUE" /end COMPU_VTAB
/begin COMPU_METHOD DEZ "" RAT_FUNC "%6.2" "" COEFFS 0 1 0 0 0 1 /end COMPU_METHOD
/begin COMPU_METHOD dez "" RAT_FUNC "%6.2" "" COEFFS 0 1 0 0 0 1 /end COMPU_METHOD
/begin COMPU_METHOD fak_sb_b1 "" RAT_FUNC "%6.4" "-" COEFFS 0 256 0 0 0 2 /end COMPU_METHOD
/begin COMPU_METHOD fak_sw_b1 "" RAT_FUNC "%7.6" "-" COEFFS 0 65536 0 0 0 2 /end COMPU_METHOD
/begin COMPU_METHOD fak_sw_b64 "" RAT_FUNC "%6.4" "-" COEFFS 0 65536 0 0 0 128 /end COMPU_METHOD
/begin COMPU_METHOD fak_ub_b1 "" RAT_FUNC "%6.4" "-" COEFFS 0 256 0 0 0 1 /end COMPU_METHOD
/begin COMPU_METHOD fak_ub_b2 "" RAT_FUNC "%6.4" "-" COEFFS 0 256 0 0 0 2 /end COMPU_METHOD
/begin COMPU_METHOD fak_ub_b4 "" RAT_FUNC "%6.4" "-" COEFFS 0 256 0 0 0 4 /end COMPU_METHOD
/begin COMPU_METHOD fak_ub_b8 "" RAT_FUNC "%6.4" "-" COEFFS 0 256 0 0 0 8 /end COMPU_METHOD
/begin COMPU_METHOD fak_uw_b1 "" RAT_FUNC "%7.6" "-" COEFFS 0 65536 0 0 0 1 /end COMPU_METHOD
/begin COMPU_METHOD fak_uw_b16 "" RAT_FUNC "%6.5" "-" COEFFS 0 65536 0 0 0 16 /end COMPU_METHOD
/begin COMPU_METHOD fak_uw_b2 "" RAT_FUNC "%7.6" "-" COEFFS 0 65536 0 0 0 2 /end COMPU_METHOD
/begin COMPU_METHOD fak_uw_b4 "" RAT_FUNC "%7.6" "-" COEFFS 0 65536 0 0 0 4 /end COMPU_METHOD
/begin COMPU_METHOD fak_uw_b64 "" RAT_FUNC "%6.5" "-" COEFFS 0 65536 0 0 0 64 /end COMPU_METHOD
/begin COMPU_METHOD freq_sw_b512 "" RAT_FUNC "%6.4" "1/s" COEFFS 0 65536 0 0 0 1024 /end COMPU_METHOD
/begin COMPU_METHOD ii_uw_b2621 "" RAT_FUNC "%6.4" "A^2" COEFFS 0 655.36 0 0 0 25 /end COMPU_METHOD
/begin COMPU_METHOD mgrad_sw_b28p44 "" RAT_FUNC "%6.5" "g/s" COEFFS 0 230.4 0 0 0 0.2 /end COMPU_METHOD
/begin COMPU_METHOD mgrad_ub_b221p35 "" RAT_FUNC "%6.2" "mg/s" COEFFS 0 230.4 0 0 0 200 /end COMPU_METHOD
/begin COMPU_METHOD mgrad_ub_b2652p5 "" RAT_FUNC "%6.1" "mg/(V*s)" COEFFS 0 9805.82 0 0 0 102000 /end COMPU_METHOD
/begin COMPU_METHOD m_q0p00355 "" RAT_FUNC "%6.4" "kg" COEFFS 0 1125 0 0 0 4 /end COMPU_METHOD
/begin COMPU_METHOD m_q0p4 "" RAT_FUNC "%6.3" "kg/h" COEFFS 0 1 0 0 0 0.4 /end COMPU_METHOD
/begin COMPU_METHOD m_sw_q0p1 "" RAT_FUNC "%6.3" "kg/h" COEFFS 0 1 0 0 0 0.1 /end COMPU_METHOD
/begin COMPU_METHOD m_ub_b1020 "" RAT_FUNC "%6.2" "kg/h" COEFFS 0 1 0 0 0 4 /end COMPU_METHOD
/begin COMPU_METHOD m_ub_b221p35 "" RAT_FUNC "%6.2" "mg" COEFFS 0 230.4 0 0 0 200 /end COMPU_METHOD
/begin COMPU_METHOD m_uw_b23p3 "" RAT_FUNC "%6.5" "kg" COEFFS 0 2812.5 0 0 0 1 /end COMPU_METHOD
/begin COMPU_METHOD m_uw_b4660 "" RAT_FUNC "%6.4" "g" COEFFS 0 3600 0 0 0 256 /end COMPU_METHOD
/begin COMPU_METHOD m_uw_b6553p5 "" RAT_FUNC "%6.3" "kg/h" COEFFS 0 1 0 0 0 0.1 /end COMPU_METHOD
/begin COMPU_METHOD nmot_sw_q0p25 "" RAT_FUNC "%6.3" "1/min" COEFFS 0 1 0 0 0 0.25 /end COMPU_METHOD
/begin COMPU_METHOD nmot_ub_q10 "" RAT_FUNC "%6.1" "1/min" COEFFS 0 1 0 0 0 10 /end COMPU_METHOD
/begin COMPU_METHOD nmot_ub_q40 "" RAT_FUNC "%6.1" "1/min" COEFFS 0 1 0 0 0 40 /end COMPU_METHOD
/begin COMPU_METHOD nmot_uw_q0p25 "" RAT_FUNC "%6.3" "1/min" COEFFS 0 1 0 0 0 0.25 /end COMPU_METHOD
/begin COMPU_METHOD relDK_q0p02441 "" RAT_FUNC "%6.4" "%DK" COEFFS 0 65536 0 0 0 1600 /end COMPU_METHOD
/begin COMPU_METHOD rel_sb_q0p75 "" RAT_FUNC "%6.3" "%" COEFFS 0 1 0 0 0 0.75 /end COMPU_METHOD
/begin COMPU_METHOD rel_sw_b1536 "" RAT_FUNC "%6.4" "%" COEFFS 0 65536 0 0 0 3072 /end COMPU_METHOD
/begin COMPU_METHOD rel_ub_b100 "" RAT_FUNC "%6.3" "%" COEFFS 0 255 0 0 0 100 /end COMPU_METHOD
/begin COMPU_METHOD rel_ub_q0p75 "" RAT_FUNC "%6.3" "%" COEFFS 0 1 0 0 0 0.75 /end COMPU_METHOD
/begin COMPU_METHOD rel_uw_b100 "" RAT_FUNC "%6.4" "%" COEFFS 0 65536 0 0 0 100 /end COMPU_METHOD
/begin COMPU_METHOD r_uw_q2 "" RAT_FUNC "%6.2" "Ohm" COEFFS 0 1 0 0 0 2 /end COMPU_METHOD
/begin COMPU_METHOD spgg_sw_b3052 "" RAT_FUNC "%6.3" "V/s" COEFFS 0 1 0 0 0 0.0931323 /end COMPU_METHOD
/begin COMPU_METHOD spg_sb_q0p01043 "" RAT_FUNC "%6.4" "V" COEFFS 0 255 0 0 0 2.66 /end COMPU_METHOD
/begin COMPU_METHOD spg_ub "" RAT_FUNC "%6.3" "V" COEFFS 0 1 0 0 0 0.0942 /end COMPU_METHOD
/begin COMPU_METHOD spg_ubatt "" RAT_FUNC "%6.3" "V" COEFFS 0 1 0 0 0 0.0942 /end COMPU_METHOD
/begin COMPU_METHOD spg_ub_b1p33 "" RAT_FUNC "%6.4" "V" COEFFS 0 255 0 0 0 1.33 /end COMPU_METHOD
/begin COMPU_METHOD spg_ub_b24 "" RAT_FUNC "%6.3" "1/V" COEFFS 0 1 0 0 0 0.09362 /end COMPU_METHOD
/begin COMPU_METHOD spg_ub_b5 "" RAT_FUNC "%6.4" "V" COEFFS 0 256 0 0 0 5 /end COMPU_METHOD
/begin COMPU_METHOD spg_ub_q0p0052 "" RAT_FUNC "%6.4" "V" COEFFS 0 255 0 0 0 1.33 /end COMPU_METHOD
/begin COMPU_METHOD spg_ub_q0p0052_o0p2 "" RAT_FUNC "%6.3" "V" COEFFS 0 255 51 0 0 1.33 /end COMPU_METHOD
/begin COMPU_METHOD spg_uw_b1280 "" RAT_FUNC "%7.4" "V" COEFFS 0 1000 0 0 0 19.531 /end COMPU_METHOD
/begin COMPU_METHOD spg_uw_b1p33 "" RAT_FUNC "%7.6" "V" COEFFS 0 65535 0 0 0 1.33 /end COMPU_METHOD
/begin COMPU_METHOD spg_uw_q0p001222 "" RAT_FUNC "%6.4" "V" COEFFS 0 1 0 0 0 0.001222 /end COMPU_METHOD
/begin COMPU_METHOD spg_uw_q0p00488_o1 "" RAT_FUNC "%6.3" "V" COEFFS 0 1024 1024 0 0 5 /end COMPU_METHOD
/begin COMPU_METHOD sprzi_q0p1 "" RAT_FUNC "%3.2" "Grad KW" COEFFS 0 10 0 0 0 1 /end COMPU_METHOD
/begin COMPU_METHOD t100msxs_sb_q0p01 "" RAT_FUNC "%6.4" "s" COEFFS 0 1 0 0 0 0.01 /end COMPU_METHOD
/begin COMPU_METHOD t100msxs_ub_b25p5 "" RAT_FUNC "%6.3" "s" COEFFS 0 1 0 0 0 0.1 /end COMPU_METHOD
/begin COMPU_METHOD t100msxs_uw_b6553p5 "" RAT_FUNC "%6.3" "s" COEFFS 0 1 0 0 0 0.1 /end COMPU_METHOD
/begin COMPU_METHOD t100msxs_uw_q100 "" RAT_FUNC "%6.3" "s" COEFFS 0 1 0 0 0 0.1 /end COMPU_METHOD
/begin COMPU_METHOD t10msxs_sb_q0p01 "" RAT_FUNC "%6.4" "s" COEFFS 0 1 0 0 0 0.01 /end COMPU_METHOD
/begin COMPU_METHOD t10msxs_ub_b2p55 "" RAT_FUNC "%6.4" "s" COEFFS 0 1 0 0 0 0.01 /end COMPU_METHOD
/begin COMPU_METHOD t10msxs_uw_b655p35 "" RAT_FUNC "%6.4" "s" COEFFS 0 1 0 0 0 0.01 /end COMPU_METHOD
/begin COMPU_METHOD t1sxs_ub_b255 "" RAT_FUNC "%6.2" "s" COEFFS 0 1 0 0 0 1 /end COMPU_METHOD
/begin COMPU_METHOD t1sxs_ub_q1 "" RAT_FUNC "%6.2" "s" COEFFS 0 1 0 0 0 1 /end COMPU_METHOD
/begin COMPU_METHOD t1sxs_uw_b65535 "" RAT_FUNC "%6.2" "s" COEFFS 0 1 0 0 0 1 /end COMPU_METHOD
/begin COMPU_METHOD t200msxs_ub_b51 "" RAT_FUNC "%6.3" "s" COEFFS 0 1 0 0 0 0.2 /end COMPU_METHOD
/begin COMPU_METHOD t20msxs_ub_b5p1 "" RAT_FUNC "%6.4" "s" COEFFS 0 1 0 0 0 0.02 /end COMPU_METHOD
/begin COMPU_METHOD t20msxs_uw_b1310 "" RAT_FUNC "%7.4" "s" COEFFS 0 1 0 0 0 0.02 /end COMPU_METHOD
/begin COMPU_METHOD t40msxs_ub_q0p04 "" RAT_FUNC "%6.4" "s" COEFFS 0 1 0 0 0 0.04 /end COMPU_METHOD
/begin COMPU_METHOD t50msxs_ub_b12p75 "" RAT_FUNC "%6.4" "s" COEFFS 0 1 0 0 0 0.05 /end COMPU_METHOD
/begin COMPU_METHOD t50msxs_uw_b3276p75 "" RAT_FUNC "%6.4" "s" COEFFS 0 1 0 0 0 0.05 /end COMPU_METHOD
/begin COMPU_METHOD t50msxs_uw_b819p2 "" RAT_FUNC "%6.4" "s" COEFFS 0 1 0 0 0 0.0125 /end COMPU_METHOD
/begin COMPU_METHOD t6minxmin_q6 "" RAT_FUNC "%6.2" "min" COEFFS 0 1 0 0 0 6 /end COMPU_METHOD
/begin COMPU_METHOD temp_sb_q0p75 "" RAT_FUNC "%6.3" "Grad C" COEFFS 0 1 0 0 0 0.75 /end COMPU_METHOD
/begin COMPU_METHOD temp_ub_b191p25 "" RAT_FUNC "%6.3" "Grad C" COEFFS 0 1 0 0 0 0.75 /end COMPU_METHOD
/begin COMPU_METHOD temp_ub_q0p75_o48 "" RAT_FUNC "%6.2" "Grad C" COEFFS 0 1 48 0 0 0.75 /end COMPU_METHOD
/begin COMPU_METHOD temp_ub_q5_o50 "" RAT_FUNC "%6.2" "Grad C" COEFFS 0 1 50 0 0 5 /end COMPU_METHOD
/begin COMPU_METHOD tus_uw_q3p2 "" RAT_FUNC "%6.2" "us" COEFFS 0 1 0 0 0 3.2 /end COMPU_METHOD
/begin COMPU_METHOD t_q0p001 "" RAT_FUNC "%6.5" "s" COEFFS 0 1000 0 0 0 1 /end COMPU_METHOD
/begin COMPU_METHOD vfzg_ub_q1p25 "" RAT_FUNC "%6.2" "km/h" COEFFS 0 1 0 0 0 1.25 /end COMPU_METHOD
/begin COMPU_METHOD vfzg_uw_b512 "" RAT_FUNC "%6.4" "km/h" COEFFS 0 65536 0 0 0 512 /end COMPU_METHOD
/begin COMPU_METHOD vfzg_uw_q0p00781 "" RAT_FUNC "%6.4" "km/h" COEFFS 0 1 0 0 0 0.0078125 /end COMPU_METHOD
/begin COMPU_METHOD wink_uw_q0p1 "" RAT_FUNC "%6.3" "Grad" COEFFS 0 10 0 0 0 1 /end COMPU_METHOD
/begin COMPU_METHOD zk100msxs_ub_b25p5 "" RAT_FUNC "%6.3" "s" COEFFS 0 0 256 0 10 0 /end COMPU_METHOD
/begin COMPU_METHOD zk10msxs_uw_b655 "" RAT_FUNC "%10.4" "s" COEFFS 0 0 65536 0 100 0 /end COMPU_METHOD
/begin COMPU_METHOD zk200msxs_ub_b51p2 "" RAT_FUNC "%6.3" "s" COEFFS 0 0 51.2 0 1 0 /end COMPU_METHOD
/begin COMPU_METHOD zk50msxs_ub_b12p8 "" RAT_FUNC "%6.3" "s" COEFFS 0 0 128 0 10 0 /end COMPU_METHOD
/begin COMPU_METHOD zk50msxs_uw_b3276p8 "" RAT_FUNC "%6.1" "s" COEFFS 0 0 65536 0 20 0 /end COMPU_METHOD
/begin COMPU_METHOD zw_sb_q0p75 "" RAT_FUNC "%6.3" "Grad KW" COEFFS 0 255 0 0 0 191.25 /end COMPU_METHOD
/begin COMPU_METHOD default "" RAT_FUNC "%6.2" "" COEFFS 0 1 0 0 0 1 /end COMPU_METHOD
/begin RECORD_LAYOUT GklWSw FNC_VALUES 1 SWORD COLUMN_DIR DIRECT /end RECORD_LAYOUT
/begin RECORD_LAYOUT GklWUb FNC_VALUES 1 UBYTE COLUMN_DIR DIRECT /end RECORD_LAYOUT
/begin RECORD_LAYOUT KfAxUbAyUbSstxUbSstyUbWUb NO_AXIS_PTS_X 1 UBYTE NO_AXIS_PTS_Y 2 UBYTE AXIS_PTS_X 3 UBYTE INDEX_INCR DIRECT AXIS_PTS_Y 4 UBYTE INDEX_INCR DIRECT FNC_VALUES 5 UBYTE COLUMN_DIR DIRECT /end RECORD_LAYOUT
/begin RECORD_LAYOUT KfAxUwAyUwSstxSwSstyUwWUw NO_AXIS_PTS_X 1 UWORD NO_AXIS_PTS_Y 2 UWORD AXIS_PTS_X 3 SWORD INDEX_INCR DIRECT AXIS_PTS_Y 4 UWORD INDEX_INCR DIRECT FNC_VALUES 5 UWORD COLUMN_DIR DIRECT /end RECORD_LAYOUT
/begin RECORD_LAYOUT KfAxUwAyUwSstxUwSstyUwWUw NO_AXIS_PTS_X 1 UWORD NO_AXIS_PTS_Y 2 UWORD AXIS_PTS_X 3 UWORD INDEX_INCR DIRECT AXIS_PTS_Y 4 UWORD INDEX_INCR DIRECT FNC_VALUES 5 UWORD COLUMN_DIR DIRECT /end RECORD_LAYOUT
/begin RECORD_LAYOUT KlAUbSstUbWUb NO_AXIS_PTS_X 1 UBYTE AXIS_PTS_X 2 UBYTE INDEX_INCR DIRECT FNC_VALUES 3 UBYTE COLUMN_DIR DIRECT /end RECORD_LAYOUT
/begin RECORD_LAYOUT KlAUwSstSwWUw NO_AXIS_PTS_X 1 UWORD AXIS_PTS_X 2 SWORD INDEX_INCR DIRECT FNC_VALUES 3 UWORD COLUMN_DIR DIRECT /end RECORD_LAYOUT
/begin RECORD_LAYOUT KlAUwSstUwWUw NO_AXIS_PTS_X 1 UWORD AXIS_PTS_X 2 UWORD INDEX_INCR DIRECT FNC_VALUES 3 UWORD COLUMN_DIR DIRECT /end RECORD_LAYOUT
/begin RECORD_LAYOUT KlAxU8SstxU16WU16 NO_AXIS_PTS_X 1 UWORD AXIS_PTS_X 2 UWORD INDEX_INCR DIRECT FNC_VALUES 3 UWORD COLUMN_DIR DIRECT /end RECORD_LAYOUT
/begin RECORD_LAYOUT KwbUb FNC_VALUES 1 UBYTE COLUMN_DIR DIRECT /end RECORD_LAYOUT
/begin RECORD_LAYOUT KwbUw FNC_VALUES 1 UWORD COLUMN_DIR DIRECT /end RECORD_LAYOUT
/begin RECORD_LAYOUT KwbWU16 FNC_VALUES 1 UWORD COLUMN_DIR DIRECT /end RECORD_LAYOUT
/begin RECORD_LAYOUT KwbWU8 FNC_VALUES 1 UBYTE COLUMN_DIR DIRECT /end RECORD_LAYOUT
/begin RECORD_LAYOUT KwSb FNC_VALUES 1 SBYTE COLUMN_DIR DIRECT /end RECORD_LAYOUT
/begin RECORD_LAYOUT KwSw FNC_VALUES 1 SWORD COLUMN_DIR DIRECT /end RECORD_LAYOUT
/begin RECORD_LAYOUT KwUb FNC_VALUES 1 UBYTE COLUMN_DIR DIRECT /end RECORD_LAYOUT
/begin RECORD_LAYOUT KwUw FNC_VALUES 1 UWORD COLUMN_DIR DIRECT /end RECORD_LAYOUT
/begin RECORD_LAYOUT KwWU16 FNC_VALUES 1 UWORD COLUMN_DIR DIRECT /end RECORD_LAYOUT
/begin RECORD_LAYOUT KwWU8 FNC_VALUES 1 UBYTE COLUMN_DIR DIRECT /end RECORD_LAYOUT
/begin RECORD_LAYOUT SstAUbSstUb NO_AXIS_PTS_X 1 UBYTE AXIS_PTS_X 2 UBYTE INDEX_INCR DIRECT /end RECORD_LAYOUT
/end MODULE
/end PROJECT
