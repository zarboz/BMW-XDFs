ASAP2_VERSION 1 3
/begin PROJECT basisme9 ""
/begin HEADER "" VERSION "basisme9" PROJECT_NO basisme9 /end HEADER
/begin MODULE DIM ""
/begin MOD_COMMON "" BYTE_ORDER MSB_FIRST ALIGNMENT_BYTE 1 ALIGNMENT_WORD 2 ALIGNMENT_LONG 2 ALIGNMENT_FLOAT32_IEEE 4 /end MOD_COMMON
/begin CHARACTERISTIC CDCBREMS "Codewort CARB: Bremspedalgeber" VAL_BLK 0x4F01E2 KwbUw 65535.00 dez 0.00 65535.00 FORMAT "%8.2" NUMBER 4 /end CHARACTERISTIC
/begin CHARACTERISTIC CDCDMLS "" VAL_BLK 0x4F0222 KwbWU16 65535.00 dez 0.00 65535.00 FORMAT "%8.2" NUMBER 4 /end CHARACTERISTIC
/begin CHARACTERISTIC CDCDSU "Codewort CARB: Drucksensor Umgebung" VAL_BLK 0x4F023A KwbUw 65535.00 dez 0.00 65535.00 FORMAT "%8.2" NUMBER 4 /end CHARACTERISTIC
/begin CHARACTERISTIC CDCEGFE "Codewort CARB: Lasterfassung" VAL_BLK 0x4F0242 KwbUw 65535.00 dez 0.00 65535.00 FORMAT "%8.2" NUMBER 4 /end CHARACTERISTIC
/begin CHARACTERISTIC CDCFRAO "Codewort CARB: LR-Adaption obere multiplikativ" VAL_BLK 0x4F0282 KwbUw 65535.00 dez 0.00 65535.00 FORMAT "%8.2" NUMBER 4 /end CHARACTERISTIC
/begin CHARACTERISTIC CDCFRAO2 "Codewort CARB: LR-Adaption obere multiplikativ Bank 2" VAL_BLK 0x4F028A KwbUw 65535.00 dez 0.00 65535.00 FORMAT "%8.2" NUMBER 4 /end CHARACTERISTIC
/begin CHARACTERISTIC CDCFRAU "Codewort CARB: LR-Adaption untere multiplikativ" VAL_BLK 0x4F0292 KwbUw 65535.00 dez 0.00 65535.00 FORMAT "%8.2" NUMBER 4 /end CHARACTERISTIC
/begin CHARACTERISTIC CDCFRAU2 "Codewort CARB: LR-Adaption untere multiplikativ Bank 2" VAL_BLK 0x4F029A KwbUw 65535.00 dez 0.00 65535.00 FORMAT "%8.2" NUMBER 4 /end CHARACTERISTIC
/begin CHARACTERISTIC CDCFRPS "" VAL_BLK 0x4F02A2 KwbWU16 65535.00 dez 0.00 65535.00 FORMAT "%8.2" NUMBER 4 /end CHARACTERISTIC
/begin CHARACTERISTIC CDCFRST "Codewort CARB: LR-Abweichung" VAL_BLK 0x4F02AA KwbUw 65535.00 dez 0.00 65535.00 FORMAT "%8.2" NUMBER 4 /end CHARACTERISTIC
/begin CHARACTERISTIC CDCFRST2 "Codewort CARB: LR-Abweichung Bank 2" VAL_BLK 0x4F02B2 KwbUw 65535.00 dez 0.00 65535.00 FORMAT "%8.2" NUMBER 4 /end CHARACTERISTIC
/begin CHARACTERISTIC CDCGANG "Codewort CARB: Getriebeschaltwalzenpoti" VAL_BLK 0x4F02BA KwbWU16 65535.00 dez 0.00 65535.00 FORMAT "%8.2" NUMBER 4 /end CHARACTERISTIC
/begin CHARACTERISTIC CDCHSSEKP "" VAL_BLK 0x4F02C2 KwbUw 65535.00 dez 0.00 65535.00 FORMAT "%8.2" NUMBER 4 /end CHARACTERISTIC
/begin CHARACTERISTIC CDCHSSSYS "" VAL_BLK 0x4F02CA KwbUw 65535.00 dez 0.00 65535.00 FORMAT "%8.2" NUMBER 4 /end CHARACTERISTIC
/begin CHARACTERISTIC CDCHSSZDG "" VAL_BLK 0x4F02D2 KwbUw 65535.00 dez 0.00 65535.00 FORMAT "%8.2" NUMBER 4 /end CHARACTERISTIC
/begin CHARACTERISTIC CDCKUPPL "Codewort CARB: Kupplungspedalwertgeber" VAL_BLK 0x4F033A KwbUw 65535.00 dez 0.00 65535.00 FORMAT "%8.2" NUMBER 4 /end CHARACTERISTIC
/begin CHARACTERISTIC CDCLATP "" VAL_BLK 0x4F0342 KwbWU16 65535.00 dez 0.00 65535.00 FORMAT "%8.2" NUMBER 4 /end CHARACTERISTIC
/begin CHARACTERISTIC CDCLATP2 "" VAL_BLK 0x4F034A KwbWU16 65535.00 dez 0.00 65535.00 FORMAT "%8.2" NUMBER 4 /end CHARACTERISTIC
/begin CHARACTERISTIC CDCLATV "" VAL_BLK 0x4F0352 KwbWU16 65535.00 dez 0.00 65535.00 FORMAT "%8.2" NUMBER 4 /end CHARACTERISTIC
/begin CHARACTERISTIC CDCLATV2 "" VAL_BLK 0x4F035A KwbWU16 65535.00 dez 0.00 65535.00 FORMAT "%8.2" NUMBER 4 /end CHARACTERISTIC
/begin CHARACTERISTIC CDCLLR "Codewort CARB: Leerlaufregelung am Anschlag" VAL_BLK 0x4F0362 KwbUw 65535.00 dez 0.00 65535.00 FORMAT "%8.2" NUMBER 4 /end CHARACTERISTIC
/begin CHARACTERISTIC CDCLSHVK1E "Codewort CARB: LSHVK1E" VAL_BLK 0x4F036A KwbWU16 65535.00 dez 0.00 65535.00 FORMAT "%8.2" NUMBER 4 /end CHARACTERISTIC
/begin CHARACTERISTIC CDCLSHVK2E "Codewort CARB: LSHVK2E" VAL_BLK 0x4F0372 KwbWU16 65535.00 dez 0.00 65535.00 FORMAT "%8.2" NUMBER 4 /end CHARACTERISTIC
/begin CHARACTERISTIC CDCLSV "Codewort CARB: Lambda-Sonde vor Kat" VAL_BLK 0x4F037A KwbWU16 65535.00 dez 0.00 65535.00 FORMAT "%8.2" NUMBER 4 /end CHARACTERISTIC
/begin CHARACTERISTIC CDCLSV2 "Codewort CARB: Lambda-Sonde 2 vor Kat" VAL_BLK 0x4F0382 KwbWU16 65535.00 dez 0.00 65535.00 FORMAT "%8.2" NUMBER 4 /end CHARACTERISTIC
/begin CHARACTERISTIC CDCOS "" VAL_BLK 0x4F039A KwbWU16 65535.00 dez 0.00 65535.00 FORMAT "%8.2" NUMBER 4 /end CHARACTERISTIC
/begin CHARACTERISTIC CDCPH "Codewort CARB: Phasensensor" VAL_BLK 0x4F03A2 KwbUw 65535.00 dez 0.00 65535.00 FORMAT "%8.2" NUMBER 4 /end CHARACTERISTIC
/begin CHARACTERISTIC CDCPHW "" VAL_BLK 0x4F03AA KwbUw 65535.00 dez 0.00 65535.00 FORMAT "%8.2" NUMBER 4 /end CHARACTERISTIC
/begin CHARACTERISTIC CDCRADV "" VAL_BLK 0x4F03B2 KwbWU16 65535.00 dez 0.00 65535.00 FORMAT "%8.2" NUMBER 4 /end CHARACTERISTIC
/begin CHARACTERISTIC CDCRKAT "Codewort CARB: LR-Adaption QL-additiv" VAL_BLK 0x4F03BA KwbUw 65535.00 dez 0.00 65535.00 FORMAT "%8.2" NUMBER 4 /end CHARACTERISTIC
/begin CHARACTERISTIC CDCRKAT2 "Codewort CARB: LR-Adaption QL-additiv Bank 2" VAL_BLK 0x4F03C2 KwbUw 65535.00 dez 0.00 65535.00 FORMAT "%8.2" NUMBER 4 /end CHARACTERISTIC
/begin CHARACTERISTIC CDCRKAZ "Codewort CARB: LR-Adaption ti-additiv" VAL_BLK 0x4F03CA KwbUw 65535.00 dez 0.00 65535.00 FORMAT "%8.2" NUMBER 4 /end CHARACTERISTIC
/begin CHARACTERISTIC CDCRKAZ2 "Codewort CARB: LR-Adaption ti-additiv Bank 2" VAL_BLK 0x4F03D2 KwbUw 65535.00 dez 0.00 65535.00 FORMAT "%8.2" NUMBER 4 /end CHARACTERISTIC
/begin CHARACTERISTIC CDCSIKODA "Codewort CARB: SIKO-Doppelablage" VAL_BLK 0x4F03DA KwbWU16 65535.00 dez 0.00 65535.00 FORMAT "%8.2" NUMBER 4 /end CHARACTERISTIC
/begin CHARACTERISTIC CDCSLD "" VAL_BLK 0x4F03E2 KwbWU16 65535.00 dez 0.00 65535.00 FORMAT "%8.2" NUMBER 4 /end CHARACTERISTIC
/begin CHARACTERISTIC CDCSLS "Codewort CARB: Sekund‰rluft-System" VAL_BLK 0x4F03EA KwbWU16 65535.00 dez 0.00 65535.00 FORMAT "%8.2" NUMBER 4 /end CHARACTERISTIC
/begin CHARACTERISTIC CDCSLS2 "Codewort CARB: Sekund‰rluft-System Bank 2" VAL_BLK 0x4F03F2 KwbWU16 65535.00 dez 0.00 65535.00 FORMAT "%8.2" NUMBER 4 /end CHARACTERISTIC
/begin CHARACTERISTIC CDCSLV "Codewort CARB: Sekund‰rluftventil" VAL_BLK 0x4F03FA KwbWU16 65535.00 dez 0.00 65535.00 FORMAT "%8.2" NUMBER 4 /end CHARACTERISTIC
/begin CHARACTERISTIC CDCSLV1E "Codewort CARB: SLV1E" VAL_BLK 0x4F0402 KwbWU16 65535.00 dez 0.00 65535.00 FORMAT "%8.2" NUMBER 4 /end CHARACTERISTIC
/begin CHARACTERISTIC CDCSLV2 "Codewort CARB: Sekund‰rluftventil, Bank 2" VAL_BLK 0x4F040A KwbWU16 65535.00 dez 0.00 65535.00 FORMAT "%8.2" NUMBER 4 /end CHARACTERISTIC
/begin CHARACTERISTIC CDCSLV2E "Codewort CARB: SLV2E" VAL_BLK 0x4F0412 KwbWU16 65535.00 dez 0.00 65535.00 FORMAT "%8.2" NUMBER 4 /end CHARACTERISTIC
/begin CHARACTERISTIC CDCSST "Codewort CARB: Diagnose Seitenstuetzenschalter" VAL_BLK 0x4F041A KwbWU16 65535.00 dez 0.00 65535.00 FORMAT "%8.2" NUMBER 4 /end CHARACTERISTIC
/begin CHARACTERISTIC CDCSST2E "" VAL_BLK 0x4F0422 KwbWU16 65535.00 dez 0.00 65535.00 FORMAT "%8.2" NUMBER 4 /end CHARACTERISTIC
/begin CHARACTERISTIC CDCSTARTE "Codewort CARB: STARTE" VAL_BLK 0x4F042A KwbWU16 65535.00 dez 0.00 65535.00 FORMAT "%8.2" NUMBER 4 /end CHARACTERISTIC
/begin CHARACTERISTIC CDCSTP1 "" VAL_BLK 0x4F0432 KwbWU16 65535.00 dez 0.00 65535.00 FORMAT "%8.2" NUMBER 4 /end CHARACTERISTIC
/begin CHARACTERISTIC CDCSTP2 "" VAL_BLK 0x4F043A KwbWU16 65535.00 dez 0.00 65535.00 FORMAT "%8.2" NUMBER 4 /end CHARACTERISTIC
/begin CHARACTERISTIC CDCTA "Codewort CARB: TANS" VAL_BLK 0x4F0442 KwbUw 65535.00 dez 0.00 65535.00 FORMAT "%8.2" NUMBER 4 /end CHARACTERISTIC
/begin CHARACTERISTIC CDCTCJ945 "Codewort CARB: ‹bertemperatur CJ945" VAL_BLK 0x4F044A KwbWU16 65535.00 dez 0.00 65535.00 FORMAT "%8.2" NUMBER 4 /end CHARACTERISTIC
/begin CHARACTERISTIC CDCTCY315 "Codewort CARB: ‹bertemperatur CY315" VAL_BLK 0x4F0452 KwbWU16 65535.00 dez 0.00 65535.00 FORMAT "%8.2" NUMBER 4 /end CHARACTERISTIC
/begin CHARACTERISTIC CDCTDE "" VAL_BLK 0x4F045A KwbWU16 65535.00 dez 0.00 65535.00 FORMAT "%8.2" NUMBER 4 /end CHARACTERISTIC
/begin CHARACTERISTIC CDCTES "Codewort CARB: Tankentl¸ftungssystem" VAL_BLK 0x4F0462 KwbWU16 65535.00 dez 0.00 65535.00 FORMAT "%8.2" NUMBER 4 /end CHARACTERISTIC
/begin CHARACTERISTIC CDCTEVE "Codewort CARB: TEVE" VAL_BLK 0x4F0472 KwbWU16 65535.00 dez 0.00 65535.00 FORMAT "%8.2" NUMBER 4 /end CHARACTERISTIC
/begin CHARACTERISTIC CDCTHS "Codewort CARB DTHS" VAL_BLK 0x4F047A KwbWU16 65535.00 DEZ 0.00 65535.00 FORMAT "%8.2" NUMBER 4 /end CHARACTERISTIC
/begin CHARACTERISTIC CDCTM "Codewort CARB: Motortemperatur TMOT" VAL_BLK 0x4F0482 KwbUw 65535.00 dez 0.00 65535.00 FORMAT "%8.2" NUMBER 4 /end CHARACTERISTIC
/begin CHARACTERISTIC CDCTZYL1 "Codewort CARB: DFPM_TZYL1" VAL_BLK 0x4F048A KwbUw 65535.00 dez 0.00 65535.00 FORMAT "%8.2" NUMBER 4 /end CHARACTERISTIC
/begin CHARACTERISTIC CDCTZYL2 "Codewort CARB: DFPM_TZYL2" VAL_BLK 0x4F0492 KwbUw 65535.00 dez 0.00 65535.00 FORMAT "%8.2" NUMBER 4 /end CHARACTERISTIC
/begin CHARACTERISTIC CDCU5VG1 "Codewort CARB: Fehler Geberversorgung 1" VAL_BLK 0x4F049A KwbWU16 65535.00 dez 0.00 65535.00 FORMAT "%8.2" NUMBER 4 /end CHARACTERISTIC
/begin CHARACTERISTIC CDCU5VG2 "Codewort CARB: Fehler Geberversorgung 2" VAL_BLK 0x4F04A2 KwbWU16 65535.00 dez 0.00 65535.00 FORMAT "%8.2" NUMBER 4 /end CHARACTERISTIC
/begin CHARACTERISTIC CDCU5VG3 "Codewort CARB: Fehler Geberversorgung 3" VAL_BLK 0x4F04AA KwbWU16 65535.00 dez 0.00 65535.00 FORMAT "%8.2" NUMBER 4 /end CHARACTERISTIC
/begin CHARACTERISTIC CDCUB "Codewort CARB: Batteriespannung UB (Bordnetz)" VAL_BLK 0x4F04B2 KwbWU16 65535.00 dez 0.00 65535.00 FORMAT "%8.2" NUMBER 4 /end CHARACTERISTIC
/begin CHARACTERISTIC CDCURRAM "Codewort CARB: Rechner¸berwachung: RAM" VAL_BLK 0x4F04BA KwbUw 65535.00 dez 0.00 65535.00 FORMAT "%8.2" NUMBER 4 /end CHARACTERISTIC
/begin CHARACTERISTIC CDCURROM "Codewort CARB: Rechner¸berwachung: ROM" VAL_BLK 0x4F04C2 KwbUw 65535.00 dez 0.00 65535.00 FORMAT "%8.2" NUMBER 4 /end CHARACTERISTIC
/begin CHARACTERISTIC CDCURRST "Codewort CARB: Rechner¸berwachung: Reset" VAL_BLK 0x4F04CA KwbUw 65535.00 dez 0.00 65535.00 FORMAT "%8.2" NUMBER 4 /end CHARACTERISTIC
/begin CHARACTERISTIC CDCVFZ "Codewort CARB: Fahrzeug-Geschwindigkeit" VAL_BLK 0x4F04D2 KwbUw 65535.00 dez 0.00 65535.00 FORMAT "%8.2" NUMBER 4 /end CHARACTERISTIC
/begin CHARACTERISTIC CDKBREMS "Codewort Kunde: BREMS (Bremsschalter)" VALUE 0x4F04EC KwUw 65535.00 dez 0.00 65535.00 FORMAT "%8.2" /end CHARACTERISTIC
/begin CHARACTERISTIC CDKDMLS "" VALUE 0x4F04FC KwWU16 65535.00 dez 0.00 65535.00 FORMAT "%8.2" /end CHARACTERISTIC
/begin CHARACTERISTIC CDKDSU "Codewort Kunde: Drucksensor Umgebung" VALUE 0x4F0502 KwUw 65535.00 dez 0.00 65535.00 FORMAT "%8.2" /end CHARACTERISTIC
/begin CHARACTERISTIC CDKEGFE "Codewort Kunde: Lasterfassung" VALUE 0x4F0504 KwUw 65535.00 dez 0.00 65535.00 FORMAT "%8.2" /end CHARACTERISTIC
/begin CHARACTERISTIC CDKFRAO "Codewort Kunde: LR- Adaption multi. obere Schwelle" VALUE 0x4F0514 KwUw 65535.00 dez 0.00 65535.00 FORMAT "%8.2" /end CHARACTERISTIC
/begin CHARACTERISTIC CDKFRAO2 "Codewort Kunde: LR- Adaption mult. oderer Bereich" VALUE 0x4F0516 KwUw 65535.00 dez 0.00 65535.00 FORMAT "%8.2" /end CHARACTERISTIC
/begin CHARACTERISTIC CDKFRAU "Codewort Kunde: LR- Adaption multi. untere Schwelle" VALUE 0x4F0518 KwUw 65535.00 dez 0.00 65535.00 FORMAT "%8.2" /end CHARACTERISTIC
/begin CHARACTERISTIC CDKFRAU2 "Codewort Kunde: LR- Adaption mult. untere Schwelle Bank 2" VALUE 0x4F051A KwUw 65535.00 dez 0.00 65535.00 FORMAT "%8.2" /end CHARACTERISTIC
/begin CHARACTERISTIC CDKFRPS "" VALUE 0x4F051C KwWU16 65535.00 dez 0.00 65535.00 FORMAT "%8.2" /end CHARACTERISTIC
/begin CHARACTERISTIC CDKFRST "Codewort Kunde: LR- Abweichung" VALUE 0x4F051E KwUw 65535.00 dez 0.00 65535.00 FORMAT "%8.2" /end CHARACTERISTIC
/begin CHARACTERISTIC CDKFRST2 "Codewort Kunde: LR- Abweichung Bank 2" VALUE 0x4F0520 KwUw 65535.00 dez 0.00 65535.00 FORMAT "%8.2" /end CHARACTERISTIC
/begin CHARACTERISTIC CDKGANG "Codewort Kunde: Getriebeschaltwalzenpoti" VALUE 0x4F0522 KwWU16 65535.00 dez 0.00 65535.00 FORMAT "%8.2" /end CHARACTERISTIC
/begin CHARACTERISTIC CDKHSSEKP "" VALUE 0x4F0524 KwUw 65535.00 dez 0.00 65535.00 FORMAT "%8.2" /end CHARACTERISTIC
/begin CHARACTERISTIC CDKHSSSYS "" VALUE 0x4F0526 KwUw 65535.00 dez 0.00 65535.00 FORMAT "%8.2" /end CHARACTERISTIC
/begin CHARACTERISTIC CDKHSSZDG "" VALUE 0x4F0528 KwUw 65535.00 dez 0.00 65535.00 FORMAT "%8.2" /end CHARACTERISTIC
/begin CHARACTERISTIC CDKKUPPL "Codewort Kunde: Pedalwertgeber Kupplung" VALUE 0x4F0542 KwUw 65535.00 dez 0.00 65535.00 FORMAT "%8.2" /end CHARACTERISTIC
/begin CHARACTERISTIC CDKLATP "" VALUE 0x4F0544 KwWU16 65535.00 dez 0.00 65535.00 FORMAT "%8.2" /end CHARACTERISTIC
/begin CHARACTERISTIC CDKLATP2 "" VALUE 0x4F0546 KwWU16 65535.00 dez 0.00 65535.00 FORMAT "%8.2" /end CHARACTERISTIC
/begin CHARACTERISTIC CDKLATV "" VALUE 0x4F0548 KwWU16 65535.00 dez 0.00 65535.00 FORMAT "%8.2" /end CHARACTERISTIC
/begin CHARACTERISTIC CDKLATV2 "" VALUE 0x4F054A KwWU16 65535.00 dez 0.00 65535.00 FORMAT "%8.2" /end CHARACTERISTIC
/begin CHARACTERISTIC CDKLLR "Codewort Kunde: Leerlaufregelung am Anschlag" VALUE 0x4F054C KwUw 65535.00 dez 0.00 65535.00 FORMAT "%8.2" /end CHARACTERISTIC
/begin CHARACTERISTIC CDKLSHVK1E "Codewort Kunde: LSHVK1E" VALUE 0x4F054E KwWU16 65535.00 dez 0.00 65535.00 FORMAT "%8.2" /end CHARACTERISTIC
/begin CHARACTERISTIC CDKLSHVK2E "Codewort Kunde: LSHVK2E" VALUE 0x4F0550 KwWU16 65535.00 dez 0.00 65535.00 FORMAT "%8.2" /end CHARACTERISTIC
/begin CHARACTERISTIC CDKLSV "Codewort Kunde:	Lambda-Sonde vor Kat" VALUE 0x4F0552 KwWU16 65535.00 dez 0.00 65535.00 FORMAT "%8.2" /end CHARACTERISTIC
/begin CHARACTERISTIC CDKLSV2 "Codewort Kunde:	Lambda-Sonde 2 vor Kat" VALUE 0x4F0554 KwWU16 65535.00 dez 0.00 65535.00 FORMAT "%8.2" /end CHARACTERISTIC
/begin CHARACTERISTIC CDKOS "" VALUE 0x4F055A KwWU16 65535.00 dez 0.00 65535.00 FORMAT "%8.2" /end CHARACTERISTIC
/begin CHARACTERISTIC CDKPH "Codewort Kunde: Phasensensor" VALUE 0x4F055C KwUw 65535.00 dez 0.00 65535.00 FORMAT "%8.2" /end CHARACTERISTIC
/begin CHARACTERISTIC CDKPHW "" VALUE 0x4F055E KwUw 65535.00 dez 0.00 65535.00 FORMAT "%8.2" /end CHARACTERISTIC
/begin CHARACTERISTIC CDKRADV "" VALUE 0x4F0560 KwWU16 65535.00 dez 0.00 65535.00 FORMAT "%8.2" /end CHARACTERISTIC
/begin CHARACTERISTIC CDKRKAT "Codewort Kunde: LR- Adaption pro Zeit" VALUE 0x4F0562 KwUw 65535.00 dez 0.00 65535.00 FORMAT "%8.2" /end CHARACTERISTIC
/begin CHARACTERISTIC CDKRKAT2 "Codewort Kunde: LR- Adaption pro Zeit Bank 2" VALUE 0x4F0564 KwUw 65535.00 dez 0.00 65535.00 FORMAT "%8.2" /end CHARACTERISTIC
/begin CHARACTERISTIC CDKRKAZ "Codewort Kunde: LR- Adaption additiv pro Z¸ndung" VALUE 0x4F0566 KwUw 65535.00 dez 0.00 65535.00 FORMAT "%8.2" /end CHARACTERISTIC
/begin CHARACTERISTIC CDKRKAZ2 "Codewort Kunde: Lambdaregelungsadaption Kraftstoff (Bank 2)" VALUE 0x4F0568 KwUw 65535.00 dez 0.00 65535.00 FORMAT "%8.2" /end CHARACTERISTIC
/begin CHARACTERISTIC CDKSIKODA "Codewort Kunde: SIKO-Doppelablage" VALUE 0x4F056A KwWU16 65535.00 dez 0.00 65535.00 FORMAT "%8.2" /end CHARACTERISTIC
/begin CHARACTERISTIC CDKSLD "" VALUE 0x4F056C KwWU16 65535.00 dez 0.00 65535.00 FORMAT "%8.2" /end CHARACTERISTIC
/begin CHARACTERISTIC CDKSLS "Codewort Kunde: Sekund‰rluft-System" VALUE 0x4F056E KwWU16 65535.00 dez 0.00 65535.00 FORMAT "%8.2" /end CHARACTERISTIC
/begin CHARACTERISTIC CDKSLS2 "Codewort Kunde: Sekund‰rluft-System Bank 2" VALUE 0x4F0570 KwWU16 65535.00 dez 0.00 65535.00 FORMAT "%8.2" /end CHARACTERISTIC
/begin CHARACTERISTIC CDKSLV "Codewort Kunde:	Sekund‰rluftventil" VALUE 0x4F0572 KwWU16 65535.00 dez 0.00 65535.00 FORMAT "%8.2" /end CHARACTERISTIC
/begin CHARACTERISTIC CDKSLV1E "Codewort Kunde: SLV1E" VALUE 0x4F0574 KwWU16 65535.00 dez 0.00 65535.00 FORMAT "%8.2" /end CHARACTERISTIC
/begin CHARACTERISTIC CDKSLV2 "Codewort Kunde: Sekund‰rluftventil Bank 2" VALUE 0x4F0576 KwWU16 65535.00 dez 0.00 65535.00 FORMAT "%8.2" /end CHARACTERISTIC
/begin CHARACTERISTIC CDKSLV2E "Codewort Kunde: SLV2E" VALUE 0x4F0578 KwWU16 65535.00 dez 0.00 65535.00 FORMAT "%8.2" /end CHARACTERISTIC
/begin CHARACTERISTIC CDKSST "Codewort Kunde: Diagnose Seitenstuetzenschalter" VALUE 0x4F057A KwWU16 65535.00 dez 0.00 65535.00 FORMAT "%8.2" /end CHARACTERISTIC
/begin CHARACTERISTIC CDKSST2E "" VALUE 0x4F057C KwWU16 65535.00 dez 0.00 65535.00 FORMAT "%8.2" /end CHARACTERISTIC
/begin CHARACTERISTIC CDKSTARTE "Codewort Kunde: STARTE" VALUE 0x4F057E KwWU16 65535.00 dez 0.00 65535.00 FORMAT "%8.2" /end CHARACTERISTIC
/begin CHARACTERISTIC CDKSTP1 "" VALUE 0x4F0580 KwWU16 65535.00 dez 0.00 65535.00 FORMAT "%8.2" /end CHARACTERISTIC
/begin CHARACTERISTIC CDKSTP2 "" VALUE 0x4F0582 KwWU16 65535.00 dez 0.00 65535.00 FORMAT "%8.2" /end CHARACTERISTIC
/begin CHARACTERISTIC CDKTA "Codewort Kunde:	TANS" VALUE 0x4F0584 KwUw 65535.00 dez 0.00 65535.00 FORMAT "%8.2" /end CHARACTERISTIC
/begin CHARACTERISTIC CDKTCJ945 "Codewort Kunde: ‹bertemperatur CJ945" VALUE 0x4F0586 KwWU16 65535.00 dez 0.00 65535.00 FORMAT "%8.2" /end CHARACTERISTIC
/begin CHARACTERISTIC CDKTCY315 "Codewort Kunde: ‹bertemperatur CY315" VALUE 0x4F0588 KwWU16 65535.00 dez 0.00 65535.00 FORMAT "%8.2" /end CHARACTERISTIC
/begin CHARACTERISTIC CDKTDE "" VALUE 0x4F058A KwWU16 65535.00 dez 0.00 65535.00 FORMAT "%8.2" /end CHARACTERISTIC
/begin CHARACTERISTIC CDKTES "Codewort Kunde: Tankentl¸ftungssystem" VALUE 0x4F058C KwWU16 65535.00 dez 0.00 65535.00 FORMAT "%8.2" /end CHARACTERISTIC
/begin CHARACTERISTIC CDKTEVE "Codewort Kunde: TEVE" VALUE 0x4F0590 KwWU16 65535.00 dez 0.00 65535.00 FORMAT "%8.2" /end CHARACTERISTIC
/begin CHARACTERISTIC CDKTHS "Codewort Fehlerpfad DTHS" VALUE 0x4F0592 KwWU16 65535.00 DEZ 0.00 65535.00 FORMAT "%8.2" /end CHARACTERISTIC
/begin CHARACTERISTIC CDKTM "Codewort Kunde:	TMOT" VALUE 0x4F0594 KwUw 65535.00 dez 0.00 65535.00 FORMAT "%8.2" /end CHARACTERISTIC
/begin CHARACTERISTIC CDKTZYL1 "Codewort Kunde: DFPM_TZYL1" VALUE 0x4F0596 KwUw 65535.00 dez 0.00 65535.00 FORMAT "%8.2" /end CHARACTERISTIC
/begin CHARACTERISTIC CDKTZYL2 "Codewort Kunde: DFPM_TZYL2" VALUE 0x4F0598 KwUw 65535.00 dez 0.00 65535.00 FORMAT "%8.2" /end CHARACTERISTIC
/begin CHARACTERISTIC CDKU5VG1 "Codewort Kunde: Fehler Geberversorgung 1" VALUE 0x4F059A KwWU16 65535.00 dez 0.00 65535.00 FORMAT "%8.2" /end CHARACTERISTIC
/begin CHARACTERISTIC CDKU5VG2 "Codewort Kunde: Fehler Geberversorgung 2" VALUE 0x4F059C KwWU16 65535.00 dez 0.00 65535.00 FORMAT "%8.2" /end CHARACTERISTIC
/begin CHARACTERISTIC CDKU5VG3 "Codewort Kunde: Fehler Geberversorgung 3" VALUE 0x4F059E KwWU16 65535.00 dez 0.00 65535.00 FORMAT "%8.2" /end CHARACTERISTIC
/begin CHARACTERISTIC CDKUB "Codewort Kunde:	UB" VALUE 0x4F05A0 KwWU16 65535.00 dez 0.00 65535.00 FORMAT "%8.2" /end CHARACTERISTIC
/begin CHARACTERISTIC CDKURRAM "Codewort Kunde: Rechner¸berwachung: RAM" VALUE 0x4F05A2 KwUw 65535.00 dez 0.00 65535.00 FORMAT "%8.2" /end CHARACTERISTIC
/begin CHARACTERISTIC CDKURROM "Codewort Kunde: Rechner¸berwachung: ROM" VALUE 0x4F05A4 KwUw 65535.00 dez 0.00 65535.00 FORMAT "%8.2" /end CHARACTERISTIC
/begin CHARACTERISTIC CDKURRST "Codewort Kunde: Rechner¸berwachung: Reset" VALUE 0x4F05A6 KwUw 65535.00 dez 0.00 65535.00 FORMAT "%8.2" /end CHARACTERISTIC
/begin CHARACTERISTIC CDKVFZ "Codewort Kunde:	Fahrzeug-Geschwindigkeit" VALUE 0x4F05A8 KwUw 65535.00 dez 0.00 65535.00 FORMAT "%8.2" /end CHARACTERISTIC
/begin CHARACTERISTIC CDTBREMS "Fehlerpfadcode: BREMS (Bremsschalter)" VALUE 0x4F05B6 KwUw 65535.00 dez 0.00 65535.00 FORMAT "%8.2" /end CHARACTERISTIC
/begin CHARACTERISTIC CDTDMLS "" VALUE 0x4F05C6 KwWU16 65535.00 dez 0.00 65535.00 FORMAT "%8.2" /end CHARACTERISTIC
/begin CHARACTERISTIC CDTDSU "Codewort Tester: Drucksensor Umgebung" VALUE 0x4F05CC KwUw 65535.00 dez 0.00 65535.00 FORMAT "%8.2" /end CHARACTERISTIC
/begin CHARACTERISTIC CDTEGFE "Codeowort Tester: Eingangsgrˆﬂe F¸llungserfassung" VALUE 0x4F05CE KwUw 65535.00 dez 0.00 65535.00 FORMAT "%8.2" /end CHARACTERISTIC
/begin CHARACTERISTIC CDTFRAO "Codewort Tester: LR-Adaption multiplikativ obere Schwelle" VALUE 0x4F05DE KwUw 65535.00 dez 0.00 65535.00 FORMAT "%8.2" /end CHARACTERISTIC
/begin CHARACTERISTIC CDTFRAO2 "Codewort Tester: LR-Adaption multiplikativ obere Schwelle Bank 2" VALUE 0x4F05E0 KwUw 65535.00 dez 0.00 65535.00 FORMAT "%8.2" /end CHARACTERISTIC
/begin CHARACTERISTIC CDTFRAU "Codewort Tester: LR-Adaption multiplikativ untere Schwelle" VALUE 0x4F05E2 KwUw 65535.00 dez 0.00 65535.00 FORMAT "%8.2" /end CHARACTERISTIC
/begin CHARACTERISTIC CDTFRAU2 "Codewort Tester: LR-Adaption multiplikativ untere Schwelle Bank 2" VALUE 0x4F05E4 KwUw 65535.00 dez 0.00 65535.00 FORMAT "%8.2" /end CHARACTERISTIC
/begin CHARACTERISTIC CDTFRPS "" VALUE 0x4F05E6 KwWU16 65535.00 dez 0.00 65535.00 FORMAT "%8.2" /end CHARACTERISTIC
/begin CHARACTERISTIC CDTFRST "Codewort Tester: LR-Abweichung" VALUE 0x4F05E8 KwUw 65535.00 dez 0.00 65535.00 FORMAT "%8.2" /end CHARACTERISTIC
/begin CHARACTERISTIC CDTFRST2 "Codewort Tester: LR-Abweichung Bank 2" VALUE 0x4F05EA KwUw 65535.00 dez 0.00 65535.00 FORMAT "%8.2" /end CHARACTERISTIC
/begin CHARACTERISTIC CDTGANG "Fehlerpfadcode: Getriebeschaltwalzenpoti" VALUE 0x4F05EC KwWU16 65535.00 dez 0.00 65535.00 FORMAT "%8.2" /end CHARACTERISTIC
/begin CHARACTERISTIC CDTHSSEKP "" VALUE 0x4F05EE KwUw 65535.00 dez 0.00 65535.00 FORMAT "%8.2" /end CHARACTERISTIC
/begin CHARACTERISTIC CDTHSSSYS "" VALUE 0x4F05F0 KwUw 65535.00 dez 0.00 65535.00 FORMAT "%8.2" /end CHARACTERISTIC
/begin CHARACTERISTIC CDTHSSZDG "" VALUE 0x4F05F2 KwUw 65535.00 dez 0.00 65535.00 FORMAT "%8.2" /end CHARACTERISTIC
/begin CHARACTERISTIC CDTKUPPL "Fehlerpfadcode: Pedalwertgeber Kupplung" VALUE 0x4F060C KwUw 65535.00 dez 0.00 65535.00 FORMAT "%8.2" /end CHARACTERISTIC
/begin CHARACTERISTIC CDTLATP "" VALUE 0x4F060E KwWU16 65535.00 dez 0.00 65535.00 FORMAT "%8.2" /end CHARACTERISTIC
/begin CHARACTERISTIC CDTLATP2 "" VALUE 0x4F0610 KwWU16 65535.00 dez 0.00 65535.00 FORMAT "%8.2" /end CHARACTERISTIC
/begin CHARACTERISTIC CDTLATV "" VALUE 0x4F0612 KwWU16 65535.00 dez 0.00 65535.00 FORMAT "%8.2" /end CHARACTERISTIC
/begin CHARACTERISTIC CDTLATV2 "" VALUE 0x4F0614 KwWU16 65535.00 dez 0.00 65535.00 FORMAT "%8.2" /end CHARACTERISTIC
/begin CHARACTERISTIC CDTLLR "Codewort Tester: Leerlaufregelung am Anschlag" VALUE 0x4F0616 KwUw 65535.00 dez 0.00 65535.00 FORMAT "%8.2" /end CHARACTERISTIC
/begin CHARACTERISTIC CDTLSHVK1E "Codewort Tester: LSHVK1E" VALUE 0x4F0618 KwWU16 65535.00 dez 0.00 65535.00 FORMAT "%8.2" /end CHARACTERISTIC
/begin CHARACTERISTIC CDTLSHVK2E "Codewort Tester: LSHVK2E" VALUE 0x4F061A KwWU16 65535.00 dez 0.00 65535.00 FORMAT "%8.2" /end CHARACTERISTIC
/begin CHARACTERISTIC CDTLSV "Codewort Tester: Lambda-Sonde vor Kat" VALUE 0x4F061C KwWU16 65535.00 dez 0.00 65535.00 FORMAT "%8.2" /end CHARACTERISTIC
/begin CHARACTERISTIC CDTLSV2 "Codewort Tester: Lambda-Sonde 2 vor Kat" VALUE 0x4F061E KwWU16 65535.00 dez 0.00 65535.00 FORMAT "%8.2" /end CHARACTERISTIC
/begin CHARACTERISTIC CDTOS "" VALUE 0x4F0624 KwWU16 65535.00 dez 0.00 65535.00 FORMAT "%8.2" /end CHARACTERISTIC
/begin CHARACTERISTIC CDTPH "Codewort Tester: Phasensensor" VALUE 0x4F0626 KwUw 65535.00 dez 0.00 65535.00 FORMAT "%8.2" /end CHARACTERISTIC
/begin CHARACTERISTIC CDTPHW "" VALUE 0x4F0628 KwUw 65535.00 dez 0.00 65535.00 FORMAT "%8.2" /end CHARACTERISTIC
/begin CHARACTERISTIC CDTRADV "" VALUE 0x4F062A KwWU16 65535.00 dez 0.00 65535.00 FORMAT "%8.2" /end CHARACTERISTIC
/begin CHARACTERISTIC CDTRKAT "Codewort Tester: LR-Adaption additiv pro Zeit" VALUE 0x4F062C KwUw 65535.00 dez 0.00 65535.00 FORMAT "%8.2" /end CHARACTERISTIC
/begin CHARACTERISTIC CDTRKAT2 "Codewort Tester: LR-Adaption additiv pro Zeit bank 2" VALUE 0x4F062E KwUw 65535.00 dez 0.00 65535.00 FORMAT "%8.2" /end CHARACTERISTIC
/begin CHARACTERISTIC CDTRKAZ "Codewort Tester: LR-Adaption additiv pro Z¸ndung" VALUE 0x4F0630 KwUw 65535.00 dez 0.00 65535.00 FORMAT "%8.2" /end CHARACTERISTIC
/begin CHARACTERISTIC CDTRKAZ2 "Codewort Tester: LR-Adaption additiv pro Z¸ndung bank 2" VALUE 0x4F0632 KwUw 65535.00 dez 0.00 65535.00 FORMAT "%8.2" /end CHARACTERISTIC
/begin CHARACTERISTIC CDTSIKODA "Codewort Tester: SIKO-Doppelablage" VALUE 0x4F0634 KwWU16 65535.00 dez 0.00 65535.00 FORMAT "%8.2" /end CHARACTERISTIC
/begin CHARACTERISTIC CDTSLD "" VALUE 0x4F0636 KwWU16 65535.00 dez 0.00 65535.00 FORMAT "%8.2" /end CHARACTERISTIC
/begin CHARACTERISTIC CDTSLS "Codewort Tester: Sekund‰rluft-System" VALUE 0x4F0638 KwWU16 65535.00 dez 0.00 65535.00 FORMAT "%8.2" /end CHARACTERISTIC
/begin CHARACTERISTIC CDTSLS2 "Codewort Tester: Sekund‰rluft-System, Bank 2" VALUE 0x4F063A KwWU16 65535.00 dez 0.00 65535.00 FORMAT "%8.2" /end CHARACTERISTIC
/begin CHARACTERISTIC CDTSLV "Codewort Tester: Sekund‰rluftventil" VALUE 0x4F063C KwWU16 65535.00 dez 0.00 65535.00 FORMAT "%8.2" /end CHARACTERISTIC
/begin CHARACTERISTIC CDTSLV1E "Codewort Tester: SLV1E" VALUE 0x4F063E KwWU16 65535.00 dez 0.00 65535.00 FORMAT "%8.2" /end CHARACTERISTIC
/begin CHARACTERISTIC CDTSLV2 "Codewort Tester: Sekund‰rluftventil, Bank 2" VALUE 0x4F0640 KwWU16 65535.00 dez 0.00 65535.00 FORMAT "%8.2" /end CHARACTERISTIC
/begin CHARACTERISTIC CDTSLV2E "Codewort Tester: SLV2E" VALUE 0x4F0642 KwWU16 65535.00 dez 0.00 65535.00 FORMAT "%8.2" /end CHARACTERISTIC
/begin CHARACTERISTIC CDTSST "Codewort Tester: Diagnose Seitenstuetzenschalter" VALUE 0x4F0644 KwWU16 65535.00 dez 0.00 65535.00 FORMAT "%8.2" /end CHARACTERISTIC
/begin CHARACTERISTIC CDTSST2E "" VALUE 0x4F0646 KwWU16 65535.00 dez 0.00 65535.00 FORMAT "%8.2" /end CHARACTERISTIC
/begin CHARACTERISTIC CDTSTARTE "Codewort Tester: STARTE" VALUE 0x4F0648 KwWU16 65535.00 dez 0.00 65535.00 FORMAT "%8.2" /end CHARACTERISTIC
/begin CHARACTERISTIC CDTSTP1 "" VALUE 0x4F064A KwWU16 65535.00 dez 0.00 65535.00 FORMAT "%8.2" /end CHARACTERISTIC
/begin CHARACTERISTIC CDTSTP2 "" VALUE 0x4F064C KwWU16 65535.00 dez 0.00 65535.00 FORMAT "%8.2" /end CHARACTERISTIC
/begin CHARACTERISTIC CDTTA "Codewort Tester: TANS" VALUE 0x4F064E KwUw 65535.00 dez 0.00 65535.00 FORMAT "%8.2" /end CHARACTERISTIC
/begin CHARACTERISTIC CDTTCJ945 "Codewort Tester: ‹bertemperatur CJ945" VALUE 0x4F0650 KwWU16 65535.00 dez 0.00 65535.00 FORMAT "%8.2" /end CHARACTERISTIC
/begin CHARACTERISTIC CDTTCY315 "Codewort Tester: ‹bertemperatur CY315" VALUE 0x4F0652 KwWU16 65535.00 dez 0.00 65535.00 FORMAT "%8.2" /end CHARACTERISTIC
/begin CHARACTERISTIC CDTTDE "" VALUE 0x4F0654 KwWU16 65535.00 dez 0.00 65535.00 FORMAT "%8.2" /end CHARACTERISTIC
/begin CHARACTERISTIC CDTTES "Codewort Tester: Tankentl¸ftungssystem" VALUE 0x4F0656 KwWU16 65535.00 dez 0.00 65535.00 FORMAT "%8.2" /end CHARACTERISTIC
/begin CHARACTERISTIC CDTTEVE "Codewort Tester: TEVE" VALUE 0x4F065A KwWU16 65535.00 dez 0.00 65535.00 FORMAT "%8.2" /end CHARACTERISTIC
/begin CHARACTERISTIC CDTTHS "Codewort Standard-Fehlerpfad DTHS" VALUE 0x4F065C KwWU16 65535.00 DEZ 0.00 65535.00 FORMAT "%8.2" /end CHARACTERISTIC
/begin CHARACTERISTIC CDTTM "Codewort Tester: TMOT" VALUE 0x4F065E KwUw 65535.00 dez 0.00 65535.00 FORMAT "%8.2" /end CHARACTERISTIC
/begin CHARACTERISTIC CDTTZYL1 "Codewort Tester: DFPM_TZYL1" VALUE 0x4F0660 KwUw 65535.00 dez 0.00 65535.00 FORMAT "%8.2" /end CHARACTERISTIC
/begin CHARACTERISTIC CDTTZYL2 "Codewort Tester: DFPM_TZYL1" VALUE 0x4F0662 KwUw 65535.00 dez 0.00 65535.00 FORMAT "%8.2" /end CHARACTERISTIC
/begin CHARACTERISTIC CDTU5VG1 "Codewort Tester: Fehler Geberversorgung 1" VALUE 0x4F0664 KwWU16 65535.00 dez 0.00 65535.00 FORMAT "%8.2" /end CHARACTERISTIC
/begin CHARACTERISTIC CDTU5VG2 "Codewort Tester: Fehler Geberversorgung 2" VALUE 0x4F0666 KwWU16 65535.00 dez 0.00 65535.00 FORMAT "%8.2" /end CHARACTERISTIC
/begin CHARACTERISTIC CDTU5VG3 "Codewort Tester: Fehler Geberversorgung 3" VALUE 0x4F0668 KwWU16 65535.00 dez 0.00 65535.00 FORMAT "%8.2" /end CHARACTERISTIC
/begin CHARACTERISTIC CDTUB "Codewort Tester: UB" VALUE 0x4F066A KwWU16 65535.00 dez 0.00 65535.00 FORMAT "%8.2" /end CHARACTERISTIC
/begin CHARACTERISTIC CDTURRAM "Codewort Tester: Rechner¸berwachung: RAM" VALUE 0x4F066C KwUw 65535.00 dez 0.00 65535.00 FORMAT "%8.2" /end CHARACTERISTIC
/begin CHARACTERISTIC CDTURROM "Codewort Tester: Rechner¸berwachung: ROM" VALUE 0x4F066E KwUw 65535.00 dez 0.00 65535.00 FORMAT "%8.2" /end CHARACTERISTIC
/begin CHARACTERISTIC CDTURRST "Codewort Tester: Rechner¸berwachung: Reset" VALUE 0x4F0670 KwUw 65535.00 dez 0.00 65535.00 FORMAT "%8.2" /end CHARACTERISTIC
/begin CHARACTERISTIC CDTVFZ "Codewort Tester: Fahrzeug-Geschwindigkeit" VALUE 0x4F0672 KwUw 65535.00 dez 0.00 65535.00 FORMAT "%8.2" /end CHARACTERISTIC
/begin CHARACTERISTIC CLABREMS "Fehlerklasse: BREMS (Bremsschalter)" VALUE 0x4EFF5D KwUb 255.0 dez 0.00 255.0 FORMAT "%5.1" /end CHARACTERISTIC
/begin CHARACTERISTIC CLADMLS "" VALUE 0x4EFF65 KwWU8 255.0 dez 0.00 255.0 FORMAT "%5.1" /end CHARACTERISTIC
/begin CHARACTERISTIC CLADSU "Fehlerklasse: Umgebungsdrucksensor" VALUE 0x4EFF68 KwUb 255.0 dez 0.00 255.0 FORMAT "%5.1" /end CHARACTERISTIC
/begin CHARACTERISTIC CLAEGFE "Fehlerklasse: Lasterfassung" VALUE 0x4EFF69 KwUb 255.0 dez 0.00 255.0 FORMAT "%5.1" /end CHARACTERISTIC
/begin CHARACTERISTIC CLAFRAO "Fehlerklasse: LR-Adaption oberer Bereich" VALUE 0x4EFF71 KwUb 255.0 dez 0.00 255.0 FORMAT "%5.1" /end CHARACTERISTIC
/begin CHARACTERISTIC CLAFRAO2 "Fehlerklasse: LR-Adaption oberer Bereich Bank 2" VALUE 0x4EFF72 KwUb 255.0 dez 0.00 255.0 FORMAT "%5.1" /end CHARACTERISTIC
/begin CHARACTERISTIC CLAFRAU "Fehlerklasse: LR-Adaption unterer Bereich" VALUE 0x4EFF73 KwUb 255.0 dez 0.00 255.0 FORMAT "%5.1" /end CHARACTERISTIC
/begin CHARACTERISTIC CLAFRAU2 "Fehlerklasse: LR-Adaption unterer Bereich Bank 2" VALUE 0x4EFF74 KwUb 255.0 dez 0.00 255.0 FORMAT "%5.1" /end CHARACTERISTIC
/begin CHARACTERISTIC CLAFRPS "" VALUE 0x4EFF75 KwWU8 255.0 dez 0.00 255.0 FORMAT "%5.1" /end CHARACTERISTIC
/begin CHARACTERISTIC CLAFRST "Fehlerklasse: LR-Abweichung" VALUE 0x4EFF76 KwUb 255.0 dez 0.00 255.0 FORMAT "%5.1" /end CHARACTERISTIC
/begin CHARACTERISTIC CLAFRST2 "Fehlerklasse : LR-Abweichung Bank 2" VALUE 0x4EFF77 KwUb 255.0 dez 0.00 255.0 FORMAT "%5.1" /end CHARACTERISTIC
/begin CHARACTERISTIC CLAGANG "Fehlerklasse: Getriebeschaltwalzenpoti" VALUE 0x4EFF78 KwWU8 255.0 dez 0.00 255.0 FORMAT "%5.1" /end CHARACTERISTIC
/begin CHARACTERISTIC CLAHSSEKP "" VALUE 0x4EFF79 KwUb 255.0 dez 0.00 255.0 FORMAT "%5.1" /end CHARACTERISTIC
/begin CHARACTERISTIC CLAHSSSYS "" VALUE 0x4EFF7A KwUb 255.0 dez 0.00 255.0 FORMAT "%5.1" /end CHARACTERISTIC
/begin CHARACTERISTIC CLAHSSZDG "" VALUE 0x4EFF7B KwUb 255.0 dez 0.00 255.0 FORMAT "%5.1" /end CHARACTERISTIC
/begin CHARACTERISTIC CLAKUPPL "Fehlerklasse: Pedalwertgeber Kupplung" VALUE 0x4EFF88 KwUb 255.0 dez 0.00 255.0 FORMAT "%5.1" /end CHARACTERISTIC
/begin CHARACTERISTIC CLALATP "" VALUE 0x4EFF89 KwWU8 255.0 dez 0.00 255.0 FORMAT "%5.1" /end CHARACTERISTIC
/begin CHARACTERISTIC CLALATP2 "" VALUE 0x4EFF8A KwWU8 255.0 dez 0.00 255.0 FORMAT "%5.1" /end CHARACTERISTIC
/begin CHARACTERISTIC CLALATV "" VALUE 0x4EFF8B KwWU8 255.0 dez 0.00 255.0 FORMAT "%5.1" /end CHARACTERISTIC
/begin CHARACTERISTIC CLALATV2 "" VALUE 0x4EFF8C KwWU8 255.0 dez 0.00 255.0 FORMAT "%5.1" /end CHARACTERISTIC
/begin CHARACTERISTIC CLALLR "Fehlerklasse: Leerlaufregelung" VALUE 0x4EFF8D KwUb 255.0 dez 0.00 255.0 FORMAT "%5.1" /end CHARACTERISTIC
/begin CHARACTERISTIC CLALSHVK1E "Fehlerklasse: LSHVK1E" VALUE 0x4EFF8E KwWU8 255.0 dez 0.00 255.0 FORMAT "%5.1" /end CHARACTERISTIC
/begin CHARACTERISTIC CLALSHVK2E "Fehlerklasse: LSHVK2E" VALUE 0x4EFF8F KwWU8 255.0 dez 0.00 255.0 FORMAT "%5.1" /end CHARACTERISTIC
/begin CHARACTERISTIC CLALSV "Fehlerklasse: Lambdasonde vor Kat" VALUE 0x4EFF90 KwWU8 255.0 dez 0.00 255.0 FORMAT "%5.1" /end CHARACTERISTIC
/begin CHARACTERISTIC CLALSV2 "Fehlerklasse: Lambdasonde 2 vor Kat" VALUE 0x4EFF91 KwWU8 255.0 dez 0.00 255.0 FORMAT "%5.1" /end CHARACTERISTIC
/begin CHARACTERISTIC CLAOS "" VALUE 0x4EFF94 KwWU8 255.0 dez 0.00 255.0 FORMAT "%5.1" /end CHARACTERISTIC
/begin CHARACTERISTIC CLAPH "Fehlerklasse: Phasengeber" VALUE 0x4EFF95 KwUb 255.0 dez 0.00 255.0 FORMAT "%5.1" /end CHARACTERISTIC
/begin CHARACTERISTIC CLAPHW "" VALUE 0x4EFF96 KwUb 255.0 dez 0.00 255.0 FORMAT "%5.1" /end CHARACTERISTIC
/begin CHARACTERISTIC CLARADV "" VALUE 0x4EFF97 KwWU8 255.0 dez 0.00 255.0 FORMAT "%5.1" /end CHARACTERISTIC
/begin CHARACTERISTIC CLARKAT "Fehlerklasse: LR-Adaption additiver Bereich pro Zeit" VALUE 0x4EFF98 KwUb 255.0 dez 0.00 255.0 FORMAT "%5.1" /end CHARACTERISTIC
/begin CHARACTERISTIC CLARKAT2 "Fehlerklasse: LR-Adaption additiver Bereich pro Zeit Bank 2" VALUE 0x4EFF99 KwUb 255.0 dez 0.00 255.0 FORMAT "%5.1" /end CHARACTERISTIC
/begin CHARACTERISTIC CLARKAZ "Fehlerklasse: LR-Adaption additiver Bereich pro Z¸ndung" VALUE 0x4EFF9A KwUb 255.0 dez 0.00 255.0 FORMAT "%5.1" /end CHARACTERISTIC
/begin CHARACTERISTIC CLARKAZ2 "Fehlerklasse: LR-Adaption additiver Bereich pro Z¸ndung Bank 2" VALUE 0x4EFF9B KwUb 255.0 dez 0.00 255.0 FORMAT "%5.1" /end CHARACTERISTIC
/begin CHARACTERISTIC CLASIKODA "Fehlerklasse: SIKO-Doppelablage" VALUE 0x4EFF9C KwWU8 255.0 dez 0.00 255.0 FORMAT "%5.1" /end CHARACTERISTIC
/begin CHARACTERISTIC CLASLD "" VALUE 0x4EFF9D KwWU8 255.0 dez 0.00 255.0 FORMAT "%5.1" /end CHARACTERISTIC
/begin CHARACTERISTIC CLASLS "Fehlerklasse: Sekund‰rluftsystem" VALUE 0x4EFF9E KwWU8 255.0 dez 0.00 255.0 FORMAT "%5.1" /end CHARACTERISTIC
/begin CHARACTERISTIC CLASLS2 "Fehlerklasse: Sekund‰rluftsystem, Bank 2" VALUE 0x4EFF9F KwWU8 255.0 dez 0.00 255.0 FORMAT "%5.1" /end CHARACTERISTIC
/begin CHARACTERISTIC CLASLV "Fehlerklasse: Dichtheit Sekund‰rluftventil" VALUE 0x4EFFA0 KwWU8 255.0 dez 0.00 255.0 FORMAT "%5.1" /end CHARACTERISTIC
/begin CHARACTERISTIC CLASLV1E "Fehlerklasse: SLV1E" VALUE 0x4EFFA1 KwWU8 255.0 dez 0.00 255.0 FORMAT "%5.1" /end CHARACTERISTIC
/begin CHARACTERISTIC CLASLV2 "Fehlerklasse: Dichtheit Sekund‰rluftventil, Bank 2" VALUE 0x4EFFA2 KwWU8 255.0 dez 0.00 255.0 FORMAT "%5.1" /end CHARACTERISTIC
/begin CHARACTERISTIC CLASLV2E "Fehlerklasse: SLV2E" VALUE 0x4EFFA3 KwWU8 255.0 dez 0.00 255.0 FORMAT "%5.1" /end CHARACTERISTIC
/begin CHARACTERISTIC CLASST "Fehlerklasse: Diagnose Seitenstuetzenschalter" VALUE 0x4EFFA4 KwWU8 255.0 dez 0.00 255.0 FORMAT "%5.1" /end CHARACTERISTIC
/begin CHARACTERISTIC CLASST2E "" VALUE 0x4EFFA5 KwWU8 255.0 dez 0.00 255.0 FORMAT "%5.1" /end CHARACTERISTIC
/begin CHARACTERISTIC CLASTARTE "Fehlerklasse: STARTE" VALUE 0x4EFFA6 KwWU8 255.0 dez 0.00 255.0 FORMAT "%5.1" /end CHARACTERISTIC
/begin CHARACTERISTIC CLASTP1 "" VALUE 0x4EFFA7 KwWU8 255.0 dez 0.00 255.0 FORMAT "%5.1" /end CHARACTERISTIC
/begin CHARACTERISTIC CLASTP2 "" VALUE 0x4EFFA8 KwWU8 255.0 dez 0.00 255.0 FORMAT "%5.1" /end CHARACTERISTIC
/begin CHARACTERISTIC CLATA "Fehlerklasse: Ansauglufttemperatur TANS (/Ladeluft-)" VALUE 0x4EFFA9 KwUb 255.0 dez 0.00 255.0 FORMAT "%5.1" /end CHARACTERISTIC
/begin CHARACTERISTIC CLATCJ945 "Fehlerklasse: ‹bertemperatur CJ945" VALUE 0x4EFFAA KwWU8 255.0 dez 0.00 255.0 FORMAT "%5.1" /end CHARACTERISTIC
/begin CHARACTERISTIC CLATCY315 "Fehlerklasse: ‹bertemperatur CY315" VALUE 0x4EFFAB KwWU8 255.0 dez 0.00 255.0 FORMAT "%5.1" /end CHARACTERISTIC
/begin CHARACTERISTIC CLATDE "" VALUE 0x4EFFAC KwWU8 255.0 dez 0.00 255.0 FORMAT "%5.1" /end CHARACTERISTIC
/begin CHARACTERISTIC CLATES "Fehlerklasse: Tankdiagnose, TEV offen" VALUE 0x4EFFAD KwWU8 255.0 dez 0.00 255.0 FORMAT "%5.1" /end CHARACTERISTIC
/begin CHARACTERISTIC CLATEVE "Fehlerklasse: TEVE" VALUE 0x4EFFAF KwWU8 255.0 dez 0.00 255.0 FORMAT "%5.1" /end CHARACTERISTIC
/begin CHARACTERISTIC CLATHS "Codewort Fehlerklasse DTHS" VALUE 0x4EFFB0 KwWU8 255.0 DEZ 0.00 255.0 FORMAT "%5.1" /end CHARACTERISTIC
/begin CHARACTERISTIC CLATM "Fehlerklasse: Motortemperatur TMOT" VALUE 0x4EFFB1 KwUb 255.0 dez 0.00 255.0 FORMAT "%5.1" /end CHARACTERISTIC
/begin CHARACTERISTIC CLATZYL1 "Fehlerklasse: DFPM_TZYL1" VALUE 0x4EFFB2 KwUb 255.0 dez 0.00 255.0 FORMAT "%5.1" /end CHARACTERISTIC
/begin CHARACTERISTIC CLATZYL2 "Fehlerklasse: DFPM_TZYL2" VALUE 0x4EFFB3 KwUb 255.0 dez 0.00 255.0 FORMAT "%5.1" /end CHARACTERISTIC
/begin CHARACTERISTIC CLAU5VG1 "Fehlerklasse: Fehler Geberversorgung 1" VALUE 0x4EFFB4 KwWU8 255.0 dez 0.00 255.0 FORMAT "%5.1" /end CHARACTERISTIC
/begin CHARACTERISTIC CLAU5VG2 "Fehlerklasse: Fehler Geberversorgung 2" VALUE 0x4EFFB5 KwWU8 255.0 dez 0.00 255.0 FORMAT "%5.1" /end CHARACTERISTIC
/begin CHARACTERISTIC CLAU5VG3 "Fehlerklasse: Fehler Geberversorgung 3" VALUE 0x4EFFB6 KwWU8 255.0 dez 0.00 255.0 FORMAT "%5.1" /end CHARACTERISTIC
/begin CHARACTERISTIC CLAUB "Fehlerklasse: Batteriespannung UB (Bordnetz)" VALUE 0x4EFFB7 KwWU8 255.0 dez 0.00 255.0 FORMAT "%5.1" /end CHARACTERISTIC
/begin CHARACTERISTIC CLAURRAM "Fehlerklasse: Rechner¸berwachung: RAM" VALUE 0x4EFFB8 KwUb 255.0 dez 0.00 255.0 FORMAT "%5.1" /end CHARACTERISTIC
/begin CHARACTERISTIC CLAURROM "Fehlerklasse: Rechner¸berwachung: ROM" VALUE 0x4EFFB9 KwUb 255.0 dez 0.00 255.0 FORMAT "%5.1" /end CHARACTERISTIC
/begin CHARACTERISTIC CLAURRST "Fehlerklasse: Rechner¸berwachung: Reset" VALUE 0x4EFFBA KwUb 255.0 dez 0.00 255.0 FORMAT "%5.1" /end CHARACTERISTIC
/begin CHARACTERISTIC CLAVFZ "Fehlerklasse: Geschwindigkeitssignal" VALUE 0x4EFFBB KwUb 255.0 dez 0.00 255.0 FORMAT "%5.1" /end CHARACTERISTIC
/begin CHARACTERISTIC FFTBREMS "Freeze Frame Tabelle: Pedalwertgeber Bremse" VAL_BLK 0x4EFFD4 KwbUb 255.0 dez 0.00 255.0 FORMAT "%5.1" NUMBER 4 /end CHARACTERISTIC
/begin CHARACTERISTIC FFTDMLS "" VAL_BLK 0x4EFFF4 KwbWU8 255.0 dez 0.00 255.0 FORMAT "%5.1" NUMBER 4 /end CHARACTERISTIC
/begin CHARACTERISTIC FFTDSU "Freeze Frame Tabelle: Umgebungsdrucksensor" VAL_BLK 0x4F0000 KwbUb 255.0 dez 0.00 255.0 FORMAT "%5.1" NUMBER 4 /end CHARACTERISTIC
/begin CHARACTERISTIC FFTEGFE "Freeze Frame Tabelle: Lasterfassung" VAL_BLK 0x4F0004 KwbUb 255.0 dez 0.00 255.0 FORMAT "%5.1" NUMBER 4 /end CHARACTERISTIC
/begin CHARACTERISTIC FFTFRAO "Freeze Frame Tabelle: FRAO Gemischadaption" VAL_BLK 0x4F0024 KwbUb 255.0 dez 0.00 255.0 FORMAT "%5.1" NUMBER 4 /end CHARACTERISTIC
/begin CHARACTERISTIC FFTFRAO2 "Freeze Frame Tabelle: FRAO Gemischadaption Bank 2" VAL_BLK 0x4F0028 KwbUb 255.0 dez 0.00 255.0 FORMAT "%5.1" NUMBER 4 /end CHARACTERISTIC
/begin CHARACTERISTIC FFTFRAU "Freeze Frame Tabelle: FRAU Gemischadaption" VAL_BLK 0x4F002C KwbUb 255.0 dez 0.00 255.0 FORMAT "%5.1" NUMBER 4 /end CHARACTERISTIC
/begin CHARACTERISTIC FFTFRAU2 "Freeze Frame Tabelle: FRAU Gemischadaption Bank 2" VAL_BLK 0x4F0030 KwbUb 255.0 dez 0.00 255.0 FORMAT "%5.1" NUMBER 4 /end CHARACTERISTIC
/begin CHARACTERISTIC FFTFRPS "" VAL_BLK 0x4F0034 KwbWU8 255.0 dez 0.00 255.0 FORMAT "%5.1" NUMBER 4 /end CHARACTERISTIC
/begin CHARACTERISTIC FFTFRST "Freeze Frame Tabelle: LR-Abweichung" VAL_BLK 0x4F0038 KwbUb 255.0 dez 0.00 255.0 FORMAT "%5.1" NUMBER 4 /end CHARACTERISTIC
/begin CHARACTERISTIC FFTFRST2 "Freeze Frame Tabelle: LR-Abweichung Bank 2" VAL_BLK 0x4F003C KwbUb 255.0 dez 0.00 255.0 FORMAT "%5.1" NUMBER 4 /end CHARACTERISTIC
/begin CHARACTERISTIC FFTGANG "Freeze Frame Tabelle: Getriebeschaltwalzenpoti" VAL_BLK 0x4F0040 KwbWU8 255.0 dez 0.00 255.0 FORMAT "%5.1" NUMBER 4 /end CHARACTERISTIC
/begin CHARACTERISTIC FFTHSSEKP "" VAL_BLK 0x4F0044 KwbUb 255.0 dez 0.00 255.0 FORMAT "%5.1" NUMBER 4 /end CHARACTERISTIC
/begin CHARACTERISTIC FFTHSSSYS "" VAL_BLK 0x4F0048 KwbUb 255.0 dez 0.00 255.0 FORMAT "%5.1" NUMBER 4 /end CHARACTERISTIC
/begin CHARACTERISTIC FFTHSSZDG "" VAL_BLK 0x4F004C KwbUb 255.0 dez 0.00 255.0 FORMAT "%5.1" NUMBER 4 /end CHARACTERISTIC
/begin CHARACTERISTIC FFTKUPPL "Freeze Frame Tabelle: Pedalwertgeber Kupplung" VAL_BLK 0x4F0080 KwbUb 255.0 dez 0.00 255.0 FORMAT "%5.1" NUMBER 4 /end CHARACTERISTIC
/begin CHARACTERISTIC FFTLATP "" VAL_BLK 0x4F0084 KwbWU8 255.0 dez 0.00 255.0 FORMAT "%5.1" NUMBER 4 /end CHARACTERISTIC
/begin CHARACTERISTIC FFTLATP2 "" VAL_BLK 0x4F0088 KwbWU8 255.0 dez 0.00 255.0 FORMAT "%5.1" NUMBER 4 /end CHARACTERISTIC
/begin CHARACTERISTIC FFTLATV "" VAL_BLK 0x4F008C KwbWU8 255.0 dez 0.00 255.0 FORMAT "%5.1" NUMBER 4 /end CHARACTERISTIC
/begin CHARACTERISTIC FFTLATV2 "" VAL_BLK 0x4F0090 KwbWU8 255.0 dez 0.00 255.0 FORMAT "%5.1" NUMBER 4 /end CHARACTERISTIC
/begin CHARACTERISTIC FFTLLR "Freeze Frame Tabelle: Leerlaufregelung" VAL_BLK 0x4F0094 KwbUb 255.0 dez 0.00 255.0 FORMAT "%5.1" NUMBER 4 /end CHARACTERISTIC
/begin CHARACTERISTIC FFTLSHVK1E "Freeze Frame Tabelle: LSHVK1E" VAL_BLK 0x4F0098 KwbWU8 255.0 dez 0.00 255.0 FORMAT "%5.1" NUMBER 4 /end CHARACTERISTIC
/begin CHARACTERISTIC FFTLSHVK2E "Freeze Frame Tabelle: LSHVK2E" VAL_BLK 0x4F009C KwbWU8 255.0 dez 0.00 255.0 FORMAT "%5.1" NUMBER 4 /end CHARACTERISTIC
/begin CHARACTERISTIC FFTLSV "Tabelle Umweltbedingungen: Lambdasonde vor Kat" VAL_BLK 0x4F00A0 KwbWU8 255.0 dez 0.00 255.0 FORMAT "%5.1" NUMBER 4 /end CHARACTERISTIC
/begin CHARACTERISTIC FFTLSV2 "Tabelle Umweltbedingungen: Lambdasonde vor Kat Bank2" VAL_BLK 0x4F00A4 KwbWU8 255.0 dez 0.00 255.0 FORMAT "%5.1" NUMBER 4 /end CHARACTERISTIC
/begin CHARACTERISTIC FFTOS "" VAL_BLK 0x4F00B0 KwbWU8 255.0 dez 0.00 255.0 FORMAT "%5.1" NUMBER 4 /end CHARACTERISTIC
/begin CHARACTERISTIC FFTPH "Freeze Frame Tabelle: Phasensensor" VAL_BLK 0x4F00B4 KwbUb 255.0 dez 0.00 255.0 FORMAT "%5.1" NUMBER 4 /end CHARACTERISTIC
/begin CHARACTERISTIC FFTPHW "" VAL_BLK 0x4F00B8 KwbUb 255.0 dez 0.00 255.0 FORMAT "%5.1" NUMBER 4 /end CHARACTERISTIC
/begin CHARACTERISTIC FFTRADV "" VAL_BLK 0x4F00BC KwbWU8 255.0 dez 0.00 255.0 FORMAT "%5.1" NUMBER 4 /end CHARACTERISTIC
/begin CHARACTERISTIC FFTRKAT "Freeze Frame Tabelle: RKAT Gemischadaption" VAL_BLK 0x4F00C0 KwbUb 255.0 dez 0.00 255.0 FORMAT "%5.1" NUMBER 4 /end CHARACTERISTIC
/begin CHARACTERISTIC FFTRKAT2 "Freeze Frame Tabelle: RKAT Gemischadaption Bank 2" VAL_BLK 0x4F00C4 KwbUb 255.0 dez 0.00 255.0 FORMAT "%5.1" NUMBER 4 /end CHARACTERISTIC
/begin CHARACTERISTIC FFTRKAZ "Freeze Frame Tabelle: RKAZ Gemischadaption" VAL_BLK 0x4F00C8 KwbUb 255.0 dez 0.00 255.0 FORMAT "%5.1" NUMBER 4 /end CHARACTERISTIC
/begin CHARACTERISTIC FFTRKAZ2 "Freeze Frame Tabelle: RKAZ Gemischadaption Bank 2" VAL_BLK 0x4F00CC KwbUb 255.0 dez 0.00 255.0 FORMAT "%5.1" NUMBER 4 /end CHARACTERISTIC
/begin CHARACTERISTIC FFTSIKODA "Freeze Frame Tabelle: SIKO-Doppelablage" VAL_BLK 0x4F00D0 KwbWU8 255.0 dez 0.00 255.0 FORMAT "%5.1" NUMBER 4 /end CHARACTERISTIC
/begin CHARACTERISTIC FFTSLD "" VAL_BLK 0x4F00D4 KwbWU8 255.0 dez 0.00 255.0 FORMAT "%5.1" NUMBER 4 /end CHARACTERISTIC
/begin CHARACTERISTIC FFTSLS "Freeze Frame Tabelle: Sekund‰rluftsystem" VAL_BLK 0x4F00D8 KwbWU8 255.0 dez 0.00 255.0 FORMAT "%5.1" NUMBER 4 /end CHARACTERISTIC
/begin CHARACTERISTIC FFTSLS2 "Freeze Frame Tabelle: Sekund‰rluftsystem, Bank 2" VAL_BLK 0x4F00DC KwbWU8 255.0 dez 0.00 255.0 FORMAT "%5.1" NUMBER 4 /end CHARACTERISTIC
/begin CHARACTERISTIC FFTSLV "Freeze Frame Tabelle: Dichtheit Sekund‰rluftventil" VAL_BLK 0x4F00E0 KwbWU8 255.0 dez 0.00 255.0 FORMAT "%5.1" NUMBER 4 /end CHARACTERISTIC
/begin CHARACTERISTIC FFTSLV1E "Freeze Frame Tabelle: SLV1E" VAL_BLK 0x4F00E4 KwbWU8 255.0 dez 0.00 255.0 FORMAT "%5.1" NUMBER 4 /end CHARACTERISTIC
/begin CHARACTERISTIC FFTSLV2 "Freeze Frame Tabelle: Dichtheit Sekund‰rluftventil, Bank 2" VAL_BLK 0x4F00E8 KwbWU8 255.0 dez 0.00 255.0 FORMAT "%5.1" NUMBER 4 /end CHARACTERISTIC
/begin CHARACTERISTIC FFTSLV2E "Freeze Frame Tabelle: SLV2E" VAL_BLK 0x4F00EC KwbWU8 255.0 dez 0.00 255.0 FORMAT "%5.1" NUMBER 4 /end CHARACTERISTIC
/begin CHARACTERISTIC FFTSST "Freeze Frame Tabelle: Diagnose Seitenstuetzenschalter" VAL_BLK 0x4F00F0 KwbWU8 255.0 dez 0.00 255.0 FORMAT "%5.1" NUMBER 4 /end CHARACTERISTIC
/begin CHARACTERISTIC FFTSST2E "" VAL_BLK 0x4F00F4 KwbWU8 255.0 dez 0.00 255.0 FORMAT "%5.1" NUMBER 4 /end CHARACTERISTIC
/begin CHARACTERISTIC FFTSTARTE "Freeze Frame Tabelle: STARTE" VAL_BLK 0x4F00F8 KwbWU8 255.0 dez 0.00 255.0 FORMAT "%5.1" NUMBER 4 /end CHARACTERISTIC
/begin CHARACTERISTIC FFTSTP1 "" VAL_BLK 0x4F00FC KwbWU8 255.0 dez 0.00 255.0 FORMAT "%5.1" NUMBER 4 /end CHARACTERISTIC
/begin CHARACTERISTIC FFTSTP2 "" VAL_BLK 0x4F0100 KwbWU8 255.0 dez 0.00 255.0 FORMAT "%5.1" NUMBER 4 /end CHARACTERISTIC
/begin CHARACTERISTIC FFTTA "Freeze Frame Tabelle: Ansauglufttemperatur TANS (/Ladeluft-)" VAL_BLK 0x4F0104 KwbUb 255.0 dez 0.00 255.0 FORMAT "%5.1" NUMBER 4 /end CHARACTERISTIC
/begin CHARACTERISTIC FFTTCJ945 "Freeze Frame Tabelle: ‹bertemperatur CJ945" VAL_BLK 0x4F0108 KwbWU8 255.0 dez 0.00 255.0 FORMAT "%5.1" NUMBER 4 /end CHARACTERISTIC
/begin CHARACTERISTIC FFTTCY315 "Freeze Frame Tabelle: ‹bertemperatur CY315" VAL_BLK 0x4F010C KwbWU8 255.0 dez 0.00 255.0 FORMAT "%5.1" NUMBER 4 /end CHARACTERISTIC
/begin CHARACTERISTIC FFTTDE "" VAL_BLK 0x4F0110 KwbWU8 255.0 dez 0.00 255.0 FORMAT "%5.1" NUMBER 4 /end CHARACTERISTIC
/begin CHARACTERISTIC FFTTES "Freeze Frame Tabelle: Tankentl¸ftungsventil" VAL_BLK 0x4F0114 KwbWU8 255.0 dez 0.00 255.0 FORMAT "%5.1" NUMBER 4 /end CHARACTERISTIC
/begin CHARACTERISTIC FFTTEVE "Freeze Frame Tabelle: TEVE" VAL_BLK 0x4F011C KwbWU8 255.0 dez 0.00 255.0 FORMAT "%5.1" NUMBER 4 /end CHARACTERISTIC
/begin CHARACTERISTIC FFTTHS "Umweltbedingungen DTHS" VAL_BLK 0x4F0120 KwbWU8 255.0 DEZ 0.00 255.0 FORMAT "%5.1" NUMBER 4 /end CHARACTERISTIC
/begin CHARACTERISTIC FFTTM "Freeze Frame Tabelle: Motortemperatur TMOT" VAL_BLK 0x4F0124 KwbUb 255.0 dez 0.00 255.0 FORMAT "%5.1" NUMBER 4 /end CHARACTERISTIC
/begin CHARACTERISTIC FFTTZYL1 "Freeze Frame Tabelle: DFPM_TZYL1" VAL_BLK 0x4F0128 KwbUb 255.0 dez 0.00 255.0 FORMAT "%5.1" NUMBER 4 /end CHARACTERISTIC
/begin CHARACTERISTIC FFTTZYL2 "Freeze Frame Tabelle: DFPM_TZYL2" VAL_BLK 0x4F012C KwbUb 255.0 dez 0.00 255.0 FORMAT "%5.1" NUMBER 4 /end CHARACTERISTIC
/begin CHARACTERISTIC FFTU5VG1 "Freeze Frame Tabelle: Fehler Geberversorgung 1" VAL_BLK 0x4F0130 KwbWU8 255.0 dez 0.00 255.0 FORMAT "%5.1" NUMBER 4 /end CHARACTERISTIC
/begin CHARACTERISTIC FFTU5VG2 "Freeze Frame Tabelle: Fehler Geberversorgung 2" VAL_BLK 0x4F0134 KwbWU8 255.0 dez 0.00 255.0 FORMAT "%5.1" NUMBER 4 /end CHARACTERISTIC
/begin CHARACTERISTIC FFTU5VG3 "Freeze Frame Tabelle: Fehler Geberversorgung 3" VAL_BLK 0x4F0138 KwbWU8 255.0 dez 0.00 255.0 FORMAT "%5.1" NUMBER 4 /end CHARACTERISTIC
/begin CHARACTERISTIC FFTUB "Freeze Frame Tabelle: Batteriespannung UB (Bordnetz)" VAL_BLK 0x4F013C KwbWU8 255.0 dez 0.00 255.0 FORMAT "%5.1" NUMBER 4 /end CHARACTERISTIC
/begin CHARACTERISTIC FFTURRAM "Freeze Frame Tabelle: Rechner¸berwachung: RAM" VAL_BLK 0x4F0140 KwbUb 255.0 dez 0.00 255.0 FORMAT "%5.1" NUMBER 4 /end CHARACTERISTIC
/begin CHARACTERISTIC FFTURROM "Freeze Frame Tabelle: Rechner¸berwachung: ROM" VAL_BLK 0x4F0144 KwbUb 255.0 dez 0.00 255.0 FORMAT "%5.1" NUMBER 4 /end CHARACTERISTIC
/begin CHARACTERISTIC FFTURRST "Freeze Frame Tabelle: Rechner¸berwachung: Reset" VAL_BLK 0x4F0148 KwbUb 255.0 dez 0.00 255.0 FORMAT "%5.1" NUMBER 4 /end CHARACTERISTIC
/begin CHARACTERISTIC FFTVFZ "Freeze Frame Tabelle: Geschwindigkeitssignal" VAL_BLK 0x4F014C KwbUb 255.0 dez 0.00 255.0 FORMAT "%5.1" NUMBER 4 /end CHARACTERISTIC
/begin CHARACTERISTIC TSFBREMS "Fehlersummenzeit: BREMS (Bremsschalter)" VALUE 0x4F0159 KwUb 255.0 dez 0.00 255.0 FORMAT "%5.1" /end CHARACTERISTIC
/begin CHARACTERISTIC TSFDMLS "" VALUE 0x4F0161 KwWU8 255.0 dez 0.00 255.0 FORMAT "%5.1" /end CHARACTERISTIC
/begin CHARACTERISTIC TSFDSU "Fehlersummenzeit: Drucksensor Umgebung" VALUE 0x4F0164 KwUb 255.0 dez 0.00 255.0 FORMAT "%5.1" /end CHARACTERISTIC
/begin CHARACTERISTIC TSFEGFE "Fehlersummenzeit: Eingangsgrˆﬂe F¸llunserfassung" VALUE 0x4F0165 KwUb 255.0 dez 0.00 255.0 FORMAT "%5.1" /end CHARACTERISTIC
/begin CHARACTERISTIC TSFFRAO "Fehlersummenzeit: LR-Adaption oberer Bereich" VALUE 0x4F016D KwUb 255.0 dez 0.00 255.0 FORMAT "%5.1" /end CHARACTERISTIC
/begin CHARACTERISTIC TSFFRAO2 "Fehlersummenzeit: LR-Adaption oberer Bereich Bank 2" VALUE 0x4F016E KwUb 255.0 dez 0.00 255.0 FORMAT "%5.1" /end CHARACTERISTIC
/begin CHARACTERISTIC TSFFRAU "Fehlersummenzeit: LR-Adaption unterer Bereich" VALUE 0x4F016F KwUb 255.0 dez 0.00 255.0 FORMAT "%5.1" /end CHARACTERISTIC
/begin CHARACTERISTIC TSFFRAU2 "Fehlersummenzeit: LR-Adaption unterer Bereich Bank 2" VALUE 0x4F0170 KwUb 255.0 dez 0.00 255.0 FORMAT "%5.1" /end CHARACTERISTIC
/begin CHARACTERISTIC TSFFRPS "" VALUE 0x4F0171 KwWU8 255.0 dez 0.00 255.0 FORMAT "%5.1" /end CHARACTERISTIC
/begin CHARACTERISTIC TSFFRST "Fehlersummenzeit: LR-Abweichung" VALUE 0x4F0172 KwUb 255.0 dez 0.00 255.0 FORMAT "%5.1" /end CHARACTERISTIC
/begin CHARACTERISTIC TSFFRST2 "Fehlersummenzeit: LR-Abweichung Bank 2" VALUE 0x4F0173 KwUb 255.0 dez 0.00 255.0 FORMAT "%5.1" /end CHARACTERISTIC
/begin CHARACTERISTIC TSFGANG "Fehlersummenzeit: Getriebeschaltwalzenpoti" VALUE 0x4F0174 KwWU8 255.0 dez 0.00 255.0 FORMAT "%5.1" /end CHARACTERISTIC
/begin CHARACTERISTIC TSFHSSEKP "" VALUE 0x4F0175 KwUb 255.0 dez 0.00 255.0 FORMAT "%5.1" /end CHARACTERISTIC
/begin CHARACTERISTIC TSFHSSSYS "" VALUE 0x4F0176 KwUb 255.0 dez 0.00 255.0 FORMAT "%5.1" /end CHARACTERISTIC
/begin CHARACTERISTIC TSFHSSZDG "" VALUE 0x4F0177 KwUb 255.0 dez 0.00 255.0 FORMAT "%5.1" /end CHARACTERISTIC
/begin CHARACTERISTIC TSFKUPPL "Fehlersummenzeit: Pedalwertgeber Kupplung" VALUE 0x4F0184 KwUb 255.0 dez 0.00 255.0 FORMAT "%5.1" /end CHARACTERISTIC
/begin CHARACTERISTIC TSFLATP "" VALUE 0x4F0185 KwWU8 255.0 dez 0.00 255.0 FORMAT "%5.1" /end CHARACTERISTIC
/begin CHARACTERISTIC TSFLATP2 "" VALUE 0x4F0186 KwWU8 255.0 dez 0.00 255.0 FORMAT "%5.1" /end CHARACTERISTIC
/begin CHARACTERISTIC TSFLATV "" VALUE 0x4F0187 KwWU8 255.0 dez 0.00 255.0 FORMAT "%5.1" /end CHARACTERISTIC
/begin CHARACTERISTIC TSFLATV2 "" VALUE 0x4F0188 KwWU8 255.0 dez 0.00 255.0 FORMAT "%5.1" /end CHARACTERISTIC
/begin CHARACTERISTIC TSFLLR "Fehlersummenzeit: Leerlaufregelung am Anschlag" VALUE 0x4F0189 KwUb 255.0 dez 0.00 255.0 FORMAT "%5.1" /end CHARACTERISTIC
/begin CHARACTERISTIC TSFLSHVK1E "Schwelle f¸r Fehlerschwere: LSHVK1E" VALUE 0x4F018A KwWU8 255.0 dez 0.00 255.0 FORMAT "%5.1" /end CHARACTERISTIC
/begin CHARACTERISTIC TSFLSHVK2E "Schwelle f¸r Fehlerschwere: LSHVK2E" VALUE 0x4F018B KwWU8 255.0 dez 0.00 255.0 FORMAT "%5.1" /end CHARACTERISTIC
/begin CHARACTERISTIC TSFLSV "Fehlersummenzeit: Lambda-Sonde vor Kat" VALUE 0x4F018C KwWU8 255.0 dez 0.00 255.0 FORMAT "%5.1" /end CHARACTERISTIC
/begin CHARACTERISTIC TSFLSV2 "Fehlersummenzeit: Lambda-Sonde 2 vor Kat" VALUE 0x4F018D KwWU8 255.0 dez 0.00 255.0 FORMAT "%5.1" /end CHARACTERISTIC
/begin CHARACTERISTIC TSFOS "" VALUE 0x4F0190 KwWU8 255.0 dez 0.00 255.0 FORMAT "%5.1" /end CHARACTERISTIC
/begin CHARACTERISTIC TSFPH "Fehlersummenzeit: Phasensensor" VALUE 0x4F0191 KwUb 255.0 dez 0.00 255.0 FORMAT "%5.1" /end CHARACTERISTIC
/begin CHARACTERISTIC TSFPHW "" VALUE 0x4F0192 KwUb 255.0 dez 0.00 255.0 FORMAT "%5.1" /end CHARACTERISTIC
/begin CHARACTERISTIC TSFRADV "" VALUE 0x4F0193 KwWU8 255.0 dez 0.00 255.0 FORMAT "%5.1" /end CHARACTERISTIC
/begin CHARACTERISTIC TSFRKAT "Fehlersummenzeit: LR-Adaption additiver Bereich pro Zeit" VALUE 0x4F0194 KwUb 255.0 dez 0.00 255.0 FORMAT "%5.1" /end CHARACTERISTIC
/begin CHARACTERISTIC TSFRKAT2 "Fehlersummenzeit: LR-Adaption additiver Bereich pro Zeit Bank 2" VALUE 0x4F0195 KwUb 255.0 dez 0.00 255.0 FORMAT "%5.1" /end CHARACTERISTIC
/begin CHARACTERISTIC TSFRKAZ "Fehlersummenzeit: LR-Adaption additiver Bereich pro Z¸ndung" VALUE 0x4F0196 KwUb 255.0 dez 0.00 255.0 FORMAT "%5.1" /end CHARACTERISTIC
/begin CHARACTERISTIC TSFRKAZ2 "Fehlersummenzeit: LR-Adaption additiver Bereich pro Z¸ndung Bank 2" VALUE 0x4F0197 KwUb 255.0 dez 0.00 255.0 FORMAT "%5.1" /end CHARACTERISTIC
/begin CHARACTERISTIC TSFSIKODA "Fehlersummenzeit: SIKO-Doppelablage" VALUE 0x4F0198 KwWU8 255.0 dez 0.00 255.0 FORMAT "%5.1" /end CHARACTERISTIC
/begin CHARACTERISTIC TSFSLD "" VALUE 0x4F0199 KwWU8 255.0 dez 0.00 255.0 FORMAT "%5.1" /end CHARACTERISTIC
/begin CHARACTERISTIC TSFSLS "Fehlersummenzeit: Sekund‰rluft-System" VALUE 0x4F019A KwWU8 255.0 dez 0.00 255.0 FORMAT "%5.1" /end CHARACTERISTIC
/begin CHARACTERISTIC TSFSLS2 "Fehlersummenzeit: Sekund‰rluft-System Bank 2" VALUE 0x4F019B KwWU8 255.0 dez 0.00 255.0 FORMAT "%5.1" /end CHARACTERISTIC
/begin CHARACTERISTIC TSFSLV "Fehlersummenzeit: Sekund‰rluftventil" VALUE 0x4F019C KwWU8 255.0 dez 0.00 255.0 FORMAT "%5.1" /end CHARACTERISTIC
/begin CHARACTERISTIC TSFSLV1E "Schwelle f¸r Fehlerschwere: SLV1E" VALUE 0x4F019D KwWU8 255.0 dez 0.00 255.0 FORMAT "%5.1" /end CHARACTERISTIC
/begin CHARACTERISTIC TSFSLV2 "Fehlersummenzeit: Sekund‰rluftventil, Bank 2" VALUE 0x4F019E KwWU8 255.0 dez 0.00 255.0 FORMAT "%5.1" /end CHARACTERISTIC
/begin CHARACTERISTIC TSFSLV2E "Schwelle f¸r Fehlerschwere: SLV2E" VALUE 0x4F019F KwWU8 255.0 dez 0.00 255.0 FORMAT "%5.1" /end CHARACTERISTIC
/begin CHARACTERISTIC TSFSST "Fehlersummenzeit: Diagnose Seitenstuetzenschalter" VALUE 0x4F01A0 KwWU8 255.0 dez 0.00 255.0 FORMAT "%5.1" /end CHARACTERISTIC
/begin CHARACTERISTIC TSFSST2E "" VALUE 0x4F01A1 KwWU8 255.0 dez 0.00 255.0 FORMAT "%5.1" /end CHARACTERISTIC
/begin CHARACTERISTIC TSFSTARTE "Schwelle f¸r Fehlerschwere: STARTE" VALUE 0x4F01A2 KwWU8 255.0 dez 0.00 255.0 FORMAT "%5.1" /end CHARACTERISTIC
/begin CHARACTERISTIC TSFSTP1 "" VALUE 0x4F01A3 KwWU8 255.0 dez 0.00 255.0 FORMAT "%5.1" /end CHARACTERISTIC
/begin CHARACTERISTIC TSFSTP2 "" VALUE 0x4F01A4 KwWU8 255.0 dez 0.00 255.0 FORMAT "%5.1" /end CHARACTERISTIC
/begin CHARACTERISTIC TSFTA "Fehlersummenzeit: Ansauglufttemperatur TANS" VALUE 0x4F01A5 KwUb 255.0 dez 0.00 255.0 FORMAT "%5.1" /end CHARACTERISTIC
/begin CHARACTERISTIC TSFTCJ945 "Fehlersummenzeit: ‹bertemperatur CJ945" VALUE 0x4F01A6 KwWU8 255.0 dez 0.00 255.0 FORMAT "%5.1" /end CHARACTERISTIC
/begin CHARACTERISTIC TSFTCY315 "Fehlersummenzeit: ‹bertemperatur CY315" VALUE 0x4F01A7 KwWU8 255.0 dez 0.00 255.0 FORMAT "%5.1" /end CHARACTERISTIC
/begin CHARACTERISTIC TSFTDE "" VALUE 0x4F01A8 KwWU8 255.0 dez 0.00 255.0 FORMAT "%5.1" /end CHARACTERISTIC
/begin CHARACTERISTIC TSFTES "Fehlersummenzeit: Tankentl¸ftungssystem" VALUE 0x4F01A9 KwWU8 255.0 dez 0.00 255.0 FORMAT "%5.1" /end CHARACTERISTIC
/begin CHARACTERISTIC TSFTEVE "Schwelle f¸r Fehlerschwere: TEVE" VALUE 0x4F01AB KwWU8 255.0 dez 0.00 255.0 FORMAT "%5.1" /end CHARACTERISTIC
/begin CHARACTERISTIC TSFTHS "Schwelle f¸r Fehlerschwere DTHS" VALUE 0x4F01AC KwWU8 255.0 DEZ 0.00 255.0 FORMAT "%5.1" /end CHARACTERISTIC
/begin CHARACTERISTIC TSFTM "Fehlersummenzeit: Motortemperatur TMOT" VALUE 0x4F01AD KwUb 255.0 dez 0.00 255.0 FORMAT "%5.1" /end CHARACTERISTIC
/begin CHARACTERISTIC TSFTZYL1 "Fehlersummenzeit Kopftemperatur" VALUE 0x4F01AE KwUb 255.0 dez 0.00 255.0 FORMAT "%5.1" /end CHARACTERISTIC
/begin CHARACTERISTIC TSFTZYL2 "Fehlersummenzeit Kopftemperatur" VALUE 0x4F01AF KwUb 255.0 dez 0.00 255.0 FORMAT "%5.1" /end CHARACTERISTIC
/begin CHARACTERISTIC TSFU5VG1 "Fehlersummenzeit: Fehler Geberversorgung 1" VALUE 0x4F01B0 KwWU8 255.0 dez 0.00 255.0 FORMAT "%5.1" /end CHARACTERISTIC
/begin CHARACTERISTIC TSFU5VG2 "Fehlersummenzeit: Fehler Geberversorgung 2" VALUE 0x4F01B1 KwWU8 255.0 dez 0.00 255.0 FORMAT "%5.1" /end CHARACTERISTIC
/begin CHARACTERISTIC TSFU5VG3 "Fehlersummenzeit: Fehler Geberversorgung 3" VALUE 0x4F01B2 KwWU8 255.0 dez 0.00 255.0 FORMAT "%5.1" /end CHARACTERISTIC
/begin CHARACTERISTIC TSFUB "Fehlersummenzeit: Batteriespannung UB (Bordnetz)" VALUE 0x4F01B3 KwWU8 255.0 dez 0.00 255.0 FORMAT "%5.1" /end CHARACTERISTIC
/begin CHARACTERISTIC TSFURRAM "Fehlersummenzeit: Rechner¸berwachung: RAM" VALUE 0x4F01B4 KwUb 255.0 dez 0.00 255.0 FORMAT "%5.1" /end CHARACTERISTIC
/begin CHARACTERISTIC TSFURROM "Fehlersummenzeit: Rechner¸berwachung: ROM" VALUE 0x4F01B5 KwUb 255.0 dez 0.00 255.0 FORMAT "%5.1" /end CHARACTERISTIC
/begin CHARACTERISTIC TSFURRST "Fehlersummenzeit: Rechner¸berwachung: Reset" VALUE 0x4F01B6 KwUb 255.0 dez 0.00 255.0 FORMAT "%5.1" /end CHARACTERISTIC
/begin CHARACTERISTIC TSFVFZ "Fehlersummenzeit: Fahrzeug-Geschwindigkeit" VALUE 0x4F01B7 KwUb 255.0 dez 0.00 255.0 FORMAT "%5.1" /end CHARACTERISTIC
/begin MEASUREMENT B_bebrems "Bedingung Bandende-Funktionsanforderung Bremsschalter" UWORD B_TRUE 1 100 0 1 BIT_MASK 0x20 FORMAT "%13.11" ECU_ADDRESS 0x7F957C /end MEASUREMENT
/begin MEASUREMENT B_bedmls "" UWORD B_TRUE 1 100 0 1 BIT_MASK 0x20 FORMAT "%13.11" ECU_ADDRESS 0x7F959C /end MEASUREMENT
/begin MEASUREMENT B_bedsu "Bedingung: Bandende-Funktionsanforderung DSU" UWORD B_TRUE 1 100 0 1 BIT_MASK 0x20 FORMAT "%13.11" ECU_ADDRESS 0x7F95A8 /end MEASUREMENT
/begin MEASUREMENT B_beegfe "Bedingung: Bandende-Anforderung bei Eingangsgrˆﬂen der F¸llungserfassung" UWORD B_TRUE 1 100 0 1 BIT_MASK 0x20 FORMAT "%13.11" ECU_ADDRESS 0x7F95AC /end MEASUREMENT
/begin MEASUREMENT B_befrao "Bedingung: Bandendefunktionanford. f¸r FRAO" UWORD B_TRUE 1 100 0 1 BIT_MASK 0x20 FORMAT "%13.11" ECU_ADDRESS 0x7F95CC /end MEASUREMENT
/begin MEASUREMENT B_befrao2 "Bedingung: Bandendefunktionanford. f¸r FRAO2" UWORD B_TRUE 1 100 0 1 BIT_MASK 0x20 FORMAT "%13.11" ECU_ADDRESS 0x7F95D0 /end MEASUREMENT
/begin MEASUREMENT B_befrau "Bedingung: Bandendefunktionanford. f¸r FRAU" UWORD B_TRUE 1 100 0 1 BIT_MASK 0x20 FORMAT "%13.11" ECU_ADDRESS 0x7F95D4 /end MEASUREMENT
/begin MEASUREMENT B_befrau2 "Bedingung: Bandendefunktionanford. f¸r FRAU2" UWORD B_TRUE 1 100 0 1 BIT_MASK 0x20 FORMAT "%13.11" ECU_ADDRESS 0x7F95D8 /end MEASUREMENT
/begin MEASUREMENT B_befrps "" UWORD B_TRUE 1 100 0 1 BIT_MASK 0x20 FORMAT "%13.11" ECU_ADDRESS 0x7F95DC /end MEASUREMENT
/begin MEASUREMENT B_befrst "Bedingung: Bandendefunktionanford. f¸r LR- Kurztest" UWORD B_TRUE 1 100 0 1 BIT_MASK 0x20 FORMAT "%13.11" ECU_ADDRESS 0x7F95E0 /end MEASUREMENT
/begin MEASUREMENT B_befrst2 "Bedingung: Bandendefunktionanford. f¸r LR- Kurztest (Bank 2)" UWORD B_TRUE 1 100 0 1 BIT_MASK 0x20 FORMAT "%13.11" ECU_ADDRESS 0x7F95E4 /end MEASUREMENT
/begin MEASUREMENT B_begang "Pruefung am Bandende" UWORD B_TRUE 1 100 0 1 BIT_MASK 0x20 FORMAT "%13.11" ECU_ADDRESS 0x7F95E8 /end MEASUREMENT
/begin MEASUREMENT B_behssekp "" UWORD B_TRUE 1 100 0 1 BIT_MASK 0x20 FORMAT "%13.11" ECU_ADDRESS 0x7F95EC /end MEASUREMENT
/begin MEASUREMENT B_behsssys "" UWORD B_TRUE 1 100 0 1 BIT_MASK 0x20 FORMAT "%13.11" ECU_ADDRESS 0x7F95F0 /end MEASUREMENT
/begin MEASUREMENT B_behsszdg "" UWORD B_TRUE 1 100 0 1 BIT_MASK 0x20 FORMAT "%13.11" ECU_ADDRESS 0x7F95F4 /end MEASUREMENT
/begin MEASUREMENT B_bekuppl "Pruefung am Bandende" UWORD B_TRUE 1 100 0 1 BIT_MASK 0x20 FORMAT "%13.11" ECU_ADDRESS 0x7F9628 /end MEASUREMENT
/begin MEASUREMENT B_belatp "" UWORD B_TRUE 1 100 0 1 BIT_MASK 0x20 FORMAT "%13.11" ECU_ADDRESS 0x7F962C /end MEASUREMENT
/begin MEASUREMENT B_belatp2 "" UWORD B_TRUE 1 100 0 1 BIT_MASK 0x20 FORMAT "%13.11" ECU_ADDRESS 0x7F9630 /end MEASUREMENT
/begin MEASUREMENT B_belatv "" UWORD B_TRUE 1 100 0 1 BIT_MASK 0x20 FORMAT "%13.11" ECU_ADDRESS 0x7F9634 /end MEASUREMENT
/begin MEASUREMENT B_belatv2 "" UWORD B_TRUE 1 100 0 1 BIT_MASK 0x20 FORMAT "%13.11" ECU_ADDRESS 0x7F9638 /end MEASUREMENT
/begin MEASUREMENT B_bellr "Bedingung Bandende-Funktionsanforderung Leerlaufregelung" UWORD B_TRUE 1 100 0 1 BIT_MASK 0x20 FORMAT "%13.11" ECU_ADDRESS 0x7F963C /end MEASUREMENT
/begin MEASUREMENT B_belshv1e "Pr¸fung am Bandende: LSHVK1E" UWORD B_TRUE 1 100 0 1 BIT_MASK 0x20 FORMAT "%13.11" ECU_ADDRESS 0x7F9640 /end MEASUREMENT
/begin MEASUREMENT B_belshv2e "Pr¸fung am Bandende: LSHVK2E" UWORD B_TRUE 1 100 0 1 BIT_MASK 0x20 FORMAT "%13.11" ECU_ADDRESS 0x7F9644 /end MEASUREMENT
/begin MEASUREMENT B_belsv "Bedingung Bandende-Funktionsanforderung elktr. Diag. Lambda-Sonde vor KAT" UWORD B_TRUE 1 100 0 1 BIT_MASK 0x20 FORMAT "%13.11" ECU_ADDRESS 0x7F9648 /end MEASUREMENT
/begin MEASUREMENT B_belsv2 "Bedingung Bandende-Funktionsanforderung elktr. Diag. Lambda-Sonde vor KAT Bank2" UWORD B_TRUE 1 100 0 1 BIT_MASK 0x20 FORMAT "%13.11" ECU_ADDRESS 0x7F964C /end MEASUREMENT
/begin MEASUREMENT B_beos "" UWORD B_TRUE 1 100 0 1 BIT_MASK 0x20 FORMAT "%13.11" ECU_ADDRESS 0x7F9658 /end MEASUREMENT
/begin MEASUREMENT B_beph "Bedingung: Bandendefunktionanford. f¸r Phasengeber" UWORD B_TRUE 1 100 0 1 BIT_MASK 0x20 FORMAT "%13.11" ECU_ADDRESS 0x7F965C /end MEASUREMENT
/begin MEASUREMENT B_bephw "" UWORD B_TRUE 1 100 0 1 BIT_MASK 0x20 FORMAT "%13.11" ECU_ADDRESS 0x7F9660 /end MEASUREMENT
/begin MEASUREMENT B_beradv "" UWORD B_TRUE 1 100 0 1 BIT_MASK 0x20 FORMAT "%13.11" ECU_ADDRESS 0x7F9664 /end MEASUREMENT
/begin MEASUREMENT B_berkat "Bedingung: Bandendefunktionanford. f¸r RKAT" UWORD B_TRUE 1 100 0 1 BIT_MASK 0x20 FORMAT "%13.11" ECU_ADDRESS 0x7F9668 /end MEASUREMENT
/begin MEASUREMENT B_berkat2 "Bedingung: Bandendefunktionanford. f¸r RKAT2" UWORD B_TRUE 1 100 0 1 BIT_MASK 0x20 FORMAT "%13.11" ECU_ADDRESS 0x7F966C /end MEASUREMENT
/begin MEASUREMENT B_berkaz "Bedingung: Bandendefunktionanford. f¸r RKAZ" UWORD B_TRUE 1 100 0 1 BIT_MASK 0x20 FORMAT "%13.11" ECU_ADDRESS 0x7F9670 /end MEASUREMENT
/begin MEASUREMENT B_berkaz2 "Bedingung: Bandendefunktionanford. f¸r RKAZ2" UWORD B_TRUE 1 100 0 1 BIT_MASK 0x20 FORMAT "%13.11" ECU_ADDRESS 0x7F9674 /end MEASUREMENT
/begin MEASUREMENT B_besikoda "" UWORD B_TRUE 1 100 0 1 BIT_MASK 0x20 FORMAT "%13.11" ECU_ADDRESS 0x7F9678 /end MEASUREMENT
/begin MEASUREMENT B_besld "" UWORD B_TRUE 1 100 0 1 BIT_MASK 0x20 FORMAT "%13.11" ECU_ADDRESS 0x7F967C /end MEASUREMENT
/begin MEASUREMENT B_besls "Bedingung Bandende-Funktionsanforderung Sekund‰rluftsystem" UWORD B_TRUE 1 100 0 1 BIT_MASK 0x20 FORMAT "%13.11" ECU_ADDRESS 0x7F9680 /end MEASUREMENT
/begin MEASUREMENT B_besls2 "Bedingung Bandende-Funktionsanforderung Sekund‰rluftsystem, Bank2" UWORD B_TRUE 1 100 0 1 BIT_MASK 0x20 FORMAT "%13.11" ECU_ADDRESS 0x7F9684 /end MEASUREMENT
/begin MEASUREMENT B_beslv "Bedingung Bandende-Funktionsanforderung SLS" UWORD B_TRUE 1 100 0 1 BIT_MASK 0x20 FORMAT "%13.11" ECU_ADDRESS 0x7F9688 /end MEASUREMENT
/begin MEASUREMENT B_beslv1e "Pr¸fung am Bandende: SLV1E" UWORD B_TRUE 1 100 0 1 BIT_MASK 0x20 FORMAT "%13.11" ECU_ADDRESS 0x7F968C /end MEASUREMENT
/begin MEASUREMENT B_beslv2 "Bedingung Bandende-Funktionsanforderung SLS, Bank2" UWORD B_TRUE 1 100 0 1 BIT_MASK 0x20 FORMAT "%13.11" ECU_ADDRESS 0x7F9690 /end MEASUREMENT
/begin MEASUREMENT B_beslv2e "Pr¸fung am Bandende: SLV2E" UWORD B_TRUE 1 100 0 1 BIT_MASK 0x20 FORMAT "%13.11" ECU_ADDRESS 0x7F9694 /end MEASUREMENT
/begin MEASUREMENT B_besst "" UWORD B_TRUE 1 100 0 1 BIT_MASK 0x20 FORMAT "%13.11" ECU_ADDRESS 0x7F9698 /end MEASUREMENT
/begin MEASUREMENT B_besst2e "" UWORD B_TRUE 1 100 0 1 BIT_MASK 0x20 FORMAT "%13.11" ECU_ADDRESS 0x7F969C /end MEASUREMENT
/begin MEASUREMENT B_bestarte "Pr¸fung am Bandende: STARTE" UWORD B_TRUE 1 100 0 1 BIT_MASK 0x20 FORMAT "%13.11" ECU_ADDRESS 0x7F96A0 /end MEASUREMENT
/begin MEASUREMENT B_bestp1 "" UWORD B_TRUE 1 100 0 1 BIT_MASK 0x20 FORMAT "%13.11" ECU_ADDRESS 0x7F96A4 /end MEASUREMENT
/begin MEASUREMENT B_bestp2 "" UWORD B_TRUE 1 100 0 1 BIT_MASK 0x20 FORMAT "%13.11" ECU_ADDRESS 0x7F96A8 /end MEASUREMENT
/begin MEASUREMENT B_beta "Bedingung Bandende-Funktionsanforderung Ansauglufttemperaturf¸hler" UWORD B_TRUE 1 100 0 1 BIT_MASK 0x20 FORMAT "%13.11" ECU_ADDRESS 0x7F96AC /end MEASUREMENT
/begin MEASUREMENT B_betcj945 "Bedingung Bandendeanford. f¸r Fehler ‹bertemperatur CJ945" UWORD B_TRUE 1 100 0 1 BIT_MASK 0x20 FORMAT "%13.11" ECU_ADDRESS 0x7F96B0 /end MEASUREMENT
/begin MEASUREMENT B_betcy315 "Bedingung Bandendeanford. f¸r Fehler ‹bertemperatur CY315" UWORD B_TRUE 1 100 0 1 BIT_MASK 0x20 FORMAT "%13.11" ECU_ADDRESS 0x7F96B4 /end MEASUREMENT
/begin MEASUREMENT B_betde "" UWORD B_TRUE 1 100 0 1 BIT_MASK 0x20 FORMAT "%13.11" ECU_ADDRESS 0x7F96B8 /end MEASUREMENT
/begin MEASUREMENT B_beteve "Pr¸fung am Bandende: TEVE" UWORD B_TRUE 1 100 0 1 BIT_MASK 0x20 FORMAT "%13.11" ECU_ADDRESS 0x7F96C4 /end MEASUREMENT
/begin MEASUREMENT B_beths "Bandendepr¸fung" UWORD B_TRUE 1 100 0 1 BIT_MASK 0x20 FORMAT "%13.11" ECU_ADDRESS 0x7F96C8 /end MEASUREMENT
/begin MEASUREMENT B_betm "Bedingung Bandende-Funktionsanforderung Motortemperaturf¸hler" UWORD B_TRUE 1 100 0 1 BIT_MASK 0x20 FORMAT "%13.11" ECU_ADDRESS 0x7F96CC /end MEASUREMENT
/begin MEASUREMENT B_betzyl1 "Bandende Funktionsanforderung" UWORD B_TRUE 1 100 0 1 BIT_MASK 0x20 FORMAT "%13.11" ECU_ADDRESS 0x7F96D0 /end MEASUREMENT
/begin MEASUREMENT B_betzyl2 "Bandende Funktionsanforderung" UWORD B_TRUE 1 100 0 1 BIT_MASK 0x20 FORMAT "%13.11" ECU_ADDRESS 0x7F96D4 /end MEASUREMENT
/begin MEASUREMENT B_beu5vg1 "Bedingung Bandendeanford. f¸r Fehler Fehler Geberversorgung 1" UWORD B_TRUE 1 100 0 1 BIT_MASK 0x20 FORMAT "%13.11" ECU_ADDRESS 0x7F96D8 /end MEASUREMENT
/begin MEASUREMENT B_beu5vg2 "Bedingung Bandendeanford. f¸r Fehler Fehler Geberversorgung 2" UWORD B_TRUE 1 100 0 1 BIT_MASK 0x20 FORMAT "%13.11" ECU_ADDRESS 0x7F96DC /end MEASUREMENT
/begin MEASUREMENT B_beu5vg3 "Bedingung Bandendeanford. f¸r Fehler Fehler Geberversorgung 3" UWORD B_TRUE 1 100 0 1 BIT_MASK 0x20 FORMAT "%13.11" ECU_ADDRESS 0x7F96E0 /end MEASUREMENT
/begin MEASUREMENT B_beub "Bedingung: Bandendefunktionanford. f¸r Batteriespannung (Bordnetz)" UWORD B_TRUE 1 100 0 1 BIT_MASK 0x20 FORMAT "%13.11" ECU_ADDRESS 0x7F96E4 /end MEASUREMENT
/begin MEASUREMENT B_beurram "" UWORD B_TRUE 1 100 0 1 BIT_MASK 0x20 FORMAT "%13.11" ECU_ADDRESS 0x7F96E8 /end MEASUREMENT
/begin MEASUREMENT B_beurrom "" UWORD B_TRUE 1 100 0 1 BIT_MASK 0x20 FORMAT "%13.11" ECU_ADDRESS 0x7F96EC /end MEASUREMENT
/begin MEASUREMENT B_beurrst "" UWORD B_TRUE 1 100 0 1 BIT_MASK 0x20 FORMAT "%13.11" ECU_ADDRESS 0x7F96F0 /end MEASUREMENT
/begin MEASUREMENT B_bevfz "Bedingung Bandende-Funktionsanforderung f¸r Fehlerpfad Fahrzeuggeschwindigkeit" UWORD B_TRUE 1 100 0 1 BIT_MASK 0x20 FORMAT "%13.11" ECU_ADDRESS 0x7F96F4 /end MEASUREMENT
/begin MEASUREMENT B_bkbrems "Bedingung Ersatzwert aktiv: BREMS (Bremsschalter)" UWORD B_TRUE 1 100 0 1 BIT_MASK 0x40 FORMAT "%13.11" ECU_ADDRESS 0x7F957C /end MEASUREMENT
/begin MEASUREMENT B_bkdmls "" UWORD B_TRUE 1 100 0 1 BIT_MASK 0x40 FORMAT "%13.11" ECU_ADDRESS 0x7F959C /end MEASUREMENT
/begin MEASUREMENT B_bkdsu "Bedingung: Umgebungsdrucksensor" UWORD B_TRUE 1 100 0 1 BIT_MASK 0x40 FORMAT "%13.11" ECU_ADDRESS 0x7F95A8 /end MEASUREMENT
/begin MEASUREMENT B_bkegfe "Bedingung: Ersatzwert aktiv bei Eingangsgrˆﬂen der F¸llungserfassung" UWORD B_TRUE 1 100 0 1 BIT_MASK 0x40 FORMAT "%13.11" ECU_ADDRESS 0x7F95AC /end MEASUREMENT
/begin MEASUREMENT B_bkfrao "Ersatzwert f¸r FRAO aktiv" UWORD B_TRUE 1 100 0 1 BIT_MASK 0x40 FORMAT "%13.11" ECU_ADDRESS 0x7F95CC /end MEASUREMENT
/begin MEASUREMENT B_bkfrao2 "Ersatzwert f¸r FRAO aktiv Bank 2" UWORD B_TRUE 1 100 0 1 BIT_MASK 0x40 FORMAT "%13.11" ECU_ADDRESS 0x7F95D0 /end MEASUREMENT
/begin MEASUREMENT B_bkfrau "Ersatzwert f¸r FRAU aktiv" UWORD B_TRUE 1 100 0 1 BIT_MASK 0x40 FORMAT "%13.11" ECU_ADDRESS 0x7F95D4 /end MEASUREMENT
/begin MEASUREMENT B_bkfrau2 "Ersatzwert f¸r FRAU aktiv Bank 2" UWORD B_TRUE 1 100 0 1 BIT_MASK 0x40 FORMAT "%13.11" ECU_ADDRESS 0x7F95D8 /end MEASUREMENT
/begin MEASUREMENT B_bkfrps "" UWORD B_TRUE 1 100 0 1 BIT_MASK 0x40 FORMAT "%13.11" ECU_ADDRESS 0x7F95DC /end MEASUREMENT
/begin MEASUREMENT B_bkfrst "Bedingung: LR-Abweichung" UWORD B_TRUE 1 100 0 1 BIT_MASK 0x40 FORMAT "%13.11" ECU_ADDRESS 0x7F95E0 /end MEASUREMENT
/begin MEASUREMENT B_bkfrst2 "Bedingung: LR-Abweichung Bank 2" UWORD B_TRUE 1 100 0 1 BIT_MASK 0x40 FORMAT "%13.11" ECU_ADDRESS 0x7F95E4 /end MEASUREMENT
/begin MEASUREMENT B_bkgang "Ersatzwert aktiv" UWORD B_TRUE 1 100 0 1 BIT_MASK 0x40 FORMAT "%13.11" ECU_ADDRESS 0x7F95E8 /end MEASUREMENT
/begin MEASUREMENT B_bkhssekp "" UWORD B_TRUE 1 100 0 1 BIT_MASK 0x40 FORMAT "%13.11" ECU_ADDRESS 0x7F95EC /end MEASUREMENT
/begin MEASUREMENT B_bkhsssys "" UWORD B_TRUE 1 100 0 1 BIT_MASK 0x40 FORMAT "%13.11" ECU_ADDRESS 0x7F95F0 /end MEASUREMENT
/begin MEASUREMENT B_bkhsszdg "" UWORD B_TRUE 1 100 0 1 BIT_MASK 0x40 FORMAT "%13.11" ECU_ADDRESS 0x7F95F4 /end MEASUREMENT
/begin MEASUREMENT B_bkkuppl "Ersatzwert aktiv" UWORD B_TRUE 1 100 0 1 BIT_MASK 0x40 FORMAT "%13.11" ECU_ADDRESS 0x7F9628 /end MEASUREMENT
/begin MEASUREMENT B_bklatp "" UWORD B_TRUE 1 100 0 1 BIT_MASK 0x40 FORMAT "%13.11" ECU_ADDRESS 0x7F962C /end MEASUREMENT
/begin MEASUREMENT B_bklatp2 "" UWORD B_TRUE 1 100 0 1 BIT_MASK 0x40 FORMAT "%13.11" ECU_ADDRESS 0x7F9630 /end MEASUREMENT
/begin MEASUREMENT B_bklatv "" UWORD B_TRUE 1 100 0 1 BIT_MASK 0x40 FORMAT "%13.11" ECU_ADDRESS 0x7F9634 /end MEASUREMENT
/begin MEASUREMENT B_bklatv2 "" UWORD B_TRUE 1 100 0 1 BIT_MASK 0x40 FORMAT "%13.11" ECU_ADDRESS 0x7F9638 /end MEASUREMENT
/begin MEASUREMENT B_bkllr "Bedingung: Leerlaufregelung aktiv" UWORD B_TRUE 1 100 0 1 BIT_MASK 0x40 FORMAT "%13.11" ECU_ADDRESS 0x7F963C /end MEASUREMENT
/begin MEASUREMENT B_bklshv1e "Diagnose verwendet Ersatzwert: LSHVK1E" UWORD B_TRUE 1 100 0 1 BIT_MASK 0x40 FORMAT "%13.11" ECU_ADDRESS 0x7F9640 /end MEASUREMENT
/begin MEASUREMENT B_bklshv2e "Diagnose verwendet Ersatzwert: LSHVK2E" UWORD B_TRUE 1 100 0 1 BIT_MASK 0x40 FORMAT "%13.11" ECU_ADDRESS 0x7F9644 /end MEASUREMENT
/begin MEASUREMENT B_bklsv "Bedingung: Lambdasonde vor Kat. aktiv" UWORD B_TRUE 1 100 0 1 BIT_MASK 0x40 FORMAT "%13.11" ECU_ADDRESS 0x7F9648 /end MEASUREMENT
/begin MEASUREMENT B_bklsv2 "Bedingung: Lambdasonde vor Kat. aktiv Bank2" UWORD B_TRUE 1 100 0 1 BIT_MASK 0x40 FORMAT "%13.11" ECU_ADDRESS 0x7F964C /end MEASUREMENT
/begin MEASUREMENT B_bkos "" UWORD B_TRUE 1 100 0 1 BIT_MASK 0x40 FORMAT "%13.11" ECU_ADDRESS 0x7F9658 /end MEASUREMENT
/begin MEASUREMENT B_bkph "Bedingung: Phasengeber aktiv" UWORD B_TRUE 1 100 0 1 BIT_MASK 0x40 FORMAT "%13.11" ECU_ADDRESS 0x7F965C /end MEASUREMENT
/begin MEASUREMENT B_bkphw "" UWORD B_TRUE 1 100 0 1 BIT_MASK 0x40 FORMAT "%13.11" ECU_ADDRESS 0x7F9660 /end MEASUREMENT
/begin MEASUREMENT B_bkradv "" UWORD B_TRUE 1 100 0 1 BIT_MASK 0x40 FORMAT "%13.11" ECU_ADDRESS 0x7F9664 /end MEASUREMENT
/begin MEASUREMENT B_bkrkat "Ersatzwert f¸r RKAT aktiv" UWORD B_TRUE 1 100 0 1 BIT_MASK 0x40 FORMAT "%13.11" ECU_ADDRESS 0x7F9668 /end MEASUREMENT
/begin MEASUREMENT B_bkrkat2 "Ersatzwert f¸r RKAT aktiv Bank 2" UWORD B_TRUE 1 100 0 1 BIT_MASK 0x40 FORMAT "%13.11" ECU_ADDRESS 0x7F966C /end MEASUREMENT
/begin MEASUREMENT B_bkrkaz "Ersatzwert f¸r RKAZ aktiv" UWORD B_TRUE 1 100 0 1 BIT_MASK 0x40 FORMAT "%13.11" ECU_ADDRESS 0x7F9670 /end MEASUREMENT
/begin MEASUREMENT B_bkrkaz2 "Ersatzwert f¸r RKAZ aktiv Bank 2" UWORD B_TRUE 1 100 0 1 BIT_MASK 0x40 FORMAT "%13.11" ECU_ADDRESS 0x7F9674 /end MEASUREMENT
/begin MEASUREMENT B_bksikoda "" UWORD B_TRUE 1 100 0 1 BIT_MASK 0x40 FORMAT "%13.11" ECU_ADDRESS 0x7F9678 /end MEASUREMENT
/begin MEASUREMENT B_bksld "" UWORD B_TRUE 1 100 0 1 BIT_MASK 0x40 FORMAT "%13.11" ECU_ADDRESS 0x7F967C /end MEASUREMENT
/begin MEASUREMENT B_bksls "Bedingung: Sekund‰rluftsystem aktiv" UWORD B_TRUE 1 100 0 1 BIT_MASK 0x40 FORMAT "%13.11" ECU_ADDRESS 0x7F9680 /end MEASUREMENT
/begin MEASUREMENT B_bksls2 "Bedingung: Sekund‰rluftsystem Bank 2 aktiv" UWORD B_TRUE 1 100 0 1 BIT_MASK 0x40 FORMAT "%13.11" ECU_ADDRESS 0x7F9684 /end MEASUREMENT
/begin MEASUREMENT B_bkslv "Bedingung: Sekund‰rluftventil aktiv" UWORD B_TRUE 1 100 0 1 BIT_MASK 0x40 FORMAT "%13.11" ECU_ADDRESS 0x7F9688 /end MEASUREMENT
/begin MEASUREMENT B_bkslv1e "Diagnose verwendet Ersatzwert: SLV1E" UWORD B_TRUE 1 100 0 1 BIT_MASK 0x40 FORMAT "%13.11" ECU_ADDRESS 0x7F968C /end MEASUREMENT
/begin MEASUREMENT B_bkslv2 "Bedingung: Sekund‰rluftventil Bank 2 aktiv" UWORD B_TRUE 1 100 0 1 BIT_MASK 0x40 FORMAT "%13.11" ECU_ADDRESS 0x7F9690 /end MEASUREMENT
/begin MEASUREMENT B_bkslv2e "Diagnose verwendet Ersatzwert: SLV2E" UWORD B_TRUE 1 100 0 1 BIT_MASK 0x40 FORMAT "%13.11" ECU_ADDRESS 0x7F9694 /end MEASUREMENT
/begin MEASUREMENT B_bksst "Bedingung: Diagnose Seitenstuetzenschalter" UWORD B_TRUE 1 100 0 1 BIT_MASK 0x40 FORMAT "%13.11" ECU_ADDRESS 0x7F9698 /end MEASUREMENT
/begin MEASUREMENT B_bksst2e "" UWORD B_TRUE 1 100 0 1 BIT_MASK 0x40 FORMAT "%13.11" ECU_ADDRESS 0x7F969C /end MEASUREMENT
/begin MEASUREMENT B_bkstarte "Diagnose verwendet Ersatzwert: STARTE" UWORD B_TRUE 1 100 0 1 BIT_MASK 0x40 FORMAT "%13.11" ECU_ADDRESS 0x7F96A0 /end MEASUREMENT
/begin MEASUREMENT B_bkstp1 "" UWORD B_TRUE 1 100 0 1 BIT_MASK 0x40 FORMAT "%13.11" ECU_ADDRESS 0x7F96A4 /end MEASUREMENT
/begin MEASUREMENT B_bkstp2 "" UWORD B_TRUE 1 100 0 1 BIT_MASK 0x40 FORMAT "%13.11" ECU_ADDRESS 0x7F96A8 /end MEASUREMENT
/begin MEASUREMENT B_bkta "Bedingung Ersatzwert f¸r Ansauglufttemperatur (/Ladelufttemp.)" UWORD B_TRUE 1 100 0 1 BIT_MASK 0x40 FORMAT "%13.11" ECU_ADDRESS 0x7F96AC /end MEASUREMENT
/begin MEASUREMENT B_bktcj945 "Bedingung ‹bertemperatur CJ945 aktiv" UWORD B_TRUE 1 100 0 1 BIT_MASK 0x40 FORMAT "%13.11" ECU_ADDRESS 0x7F96B0 /end MEASUREMENT
/begin MEASUREMENT B_bktcy315 "Bedingung ‹bertemperatur CY315 aktiv" UWORD B_TRUE 1 100 0 1 BIT_MASK 0x40 FORMAT "%13.11" ECU_ADDRESS 0x7F96B4 /end MEASUREMENT
/begin MEASUREMENT B_bktde "" UWORD B_TRUE 1 100 0 1 BIT_MASK 0x40 FORMAT "%13.11" ECU_ADDRESS 0x7F96B8 /end MEASUREMENT
/begin MEASUREMENT B_bkteve "Diagnose verwendet Ersatzwert: TEVE" UWORD B_TRUE 1 100 0 1 BIT_MASK 0x40 FORMAT "%13.11" ECU_ADDRESS 0x7F96C4 /end MEASUREMENT
/begin MEASUREMENT B_bkths "Diagnose verwendet Ersatzwert" UWORD B_TRUE 1 100 0 1 BIT_MASK 0x40 FORMAT "%13.11" ECU_ADDRESS 0x7F96C8 /end MEASUREMENT
/begin MEASUREMENT B_bktm "Bedingung Ersatzwert f¸r Motortemperatur" UWORD B_TRUE 1 100 0 1 BIT_MASK 0x40 FORMAT "%13.11" ECU_ADDRESS 0x7F96CC /end MEASUREMENT
/begin MEASUREMENT B_bktzyl1 "Bedingung Ersatzwert fuer Kopftemperatur aktiv" UWORD B_TRUE 1 100 0 1 BIT_MASK 0x40 FORMAT "%13.11" ECU_ADDRESS 0x7F96D0 /end MEASUREMENT
/begin MEASUREMENT B_bktzyl2 "Bedingung Ersatzwert fuer Kopftemperatur aktiv" UWORD B_TRUE 1 100 0 1 BIT_MASK 0x40 FORMAT "%13.11" ECU_ADDRESS 0x7F96D4 /end MEASUREMENT
/begin MEASUREMENT B_bku5vg1 "Bedingung Fehler Geberversorgung 1 aktiv" UWORD B_TRUE 1 100 0 1 BIT_MASK 0x40 FORMAT "%13.11" ECU_ADDRESS 0x7F96D8 /end MEASUREMENT
/begin MEASUREMENT B_bku5vg2 "Bedingung Fehler Geberversorgung 2 aktiv" UWORD B_TRUE 1 100 0 1 BIT_MASK 0x40 FORMAT "%13.11" ECU_ADDRESS 0x7F96DC /end MEASUREMENT
/begin MEASUREMENT B_bku5vg3 "Bedingung Fehler Geberversorgung 3 aktiv" UWORD B_TRUE 1 100 0 1 BIT_MASK 0x40 FORMAT "%13.11" ECU_ADDRESS 0x7F96E0 /end MEASUREMENT
/begin MEASUREMENT B_bkub "Bedingung Ersatzwert f¸r Batteriespannung (Bordnetz)" UWORD B_TRUE 1 100 0 1 BIT_MASK 0x40 FORMAT "%13.11" ECU_ADDRESS 0x7F96E4 /end MEASUREMENT
/begin MEASUREMENT B_bkurram "Bedingung: Rechner¸berwachung: RAM" UWORD B_TRUE 1 100 0 1 BIT_MASK 0x40 FORMAT "%13.11" ECU_ADDRESS 0x7F96E8 /end MEASUREMENT
/begin MEASUREMENT B_bkurrom "Bedingung: Rechner¸berwachung: ROM" UWORD B_TRUE 1 100 0 1 BIT_MASK 0x40 FORMAT "%13.11" ECU_ADDRESS 0x7F96EC /end MEASUREMENT
/begin MEASUREMENT B_bkurrst "Bedingung: Rechner¸berwachung: RESET" UWORD B_TRUE 1 100 0 1 BIT_MASK 0x40 FORMAT "%13.11" ECU_ADDRESS 0x7F96F0 /end MEASUREMENT
/begin MEASUREMENT B_bkvfz "Bedingung Ersatzwert aktiv: Fahrzeuggeschwindigkeitssignal" UWORD B_TRUE 1 100 0 1 BIT_MASK 0x40 FORMAT "%13.11" ECU_ADDRESS 0x7F96F4 /end MEASUREMENT
/begin MEASUREMENT B_clbrems "Bedingung Fehlerpfad BREMS (Bremsschalter) lˆschen" UWORD B_TRUE 1 100 0 1 BIT_MASK 0x80 FORMAT "%13.11" ECU_ADDRESS 0x7F957C /end MEASUREMENT
/begin MEASUREMENT B_cldmls "" UWORD B_TRUE 1 100 0 1 BIT_MASK 0x80 FORMAT "%13.11" ECU_ADDRESS 0x7F959C /end MEASUREMENT
/begin MEASUREMENT B_cldsu "Bedingung: Fehlerpfad Umgebungsdrucksensor lˆschen" UWORD B_TRUE 1 100 0 1 BIT_MASK 0x80 FORMAT "%13.11" ECU_ADDRESS 0x7F95A8 /end MEASUREMENT
/begin MEASUREMENT B_clegfe "Bedingung Fehlerpfad EGFE lˆschen" UWORD B_TRUE 1 100 0 1 BIT_MASK 0x80 FORMAT "%13.11" ECU_ADDRESS 0x7F95AC /end MEASUREMENT
/begin MEASUREMENT B_clfrao "Bedingung Fehlerpfad FRAO lˆschen (obere Multipl. Bereich)" UWORD B_TRUE 1 100 0 1 BIT_MASK 0x80 FORMAT "%13.11" ECU_ADDRESS 0x7F95CC /end MEASUREMENT
/begin MEASUREMENT B_clfrao2 "Bedingung Fehlerpfad FRAO2 lˆschen (Stereo)" UWORD B_TRUE 1 100 0 1 BIT_MASK 0x80 FORMAT "%13.11" ECU_ADDRESS 0x7F95D0 /end MEASUREMENT
/begin MEASUREMENT B_clfrau "Bedingung Fehlerpfad FRAU lˆschen (untere Multipl. Bereich)" UWORD B_TRUE 1 100 0 1 BIT_MASK 0x80 FORMAT "%13.11" ECU_ADDRESS 0x7F95D4 /end MEASUREMENT
/begin MEASUREMENT B_clfrau2 "Bedingung Fehlerpfad FRAU2 lˆschen (Stereo)" UWORD B_TRUE 1 100 0 1 BIT_MASK 0x80 FORMAT "%13.11" ECU_ADDRESS 0x7F95D8 /end MEASUREMENT
/begin MEASUREMENT B_clfrps "" UWORD B_TRUE 1 100 0 1 BIT_MASK 0x80 FORMAT "%13.11" ECU_ADDRESS 0x7F95DC /end MEASUREMENT
/begin MEASUREMENT B_clfrst "Bedingung Fehlerpfad FRST lˆschen (Kurztest)" UWORD B_TRUE 1 100 0 1 BIT_MASK 0x80 FORMAT "%13.11" ECU_ADDRESS 0x7F95E0 /end MEASUREMENT
/begin MEASUREMENT B_clfrst2 "Bedingung Fehlerpfad FRST lˆschen (Kurztest Bank 2)" UWORD B_TRUE 1 100 0 1 BIT_MASK 0x80 FORMAT "%13.11" ECU_ADDRESS 0x7F95E4 /end MEASUREMENT
/begin MEASUREMENT B_clgang "" UWORD B_TRUE 1 100 0 1 BIT_MASK 0x80 FORMAT "%13.11" ECU_ADDRESS 0x7F95E8 /end MEASUREMENT
/begin MEASUREMENT B_clhssekp "" UWORD B_TRUE 1 100 0 1 BIT_MASK 0x80 FORMAT "%13.11" ECU_ADDRESS 0x7F95EC /end MEASUREMENT
/begin MEASUREMENT B_clhsssys "" UWORD B_TRUE 1 100 0 1 BIT_MASK 0x80 FORMAT "%13.11" ECU_ADDRESS 0x7F95F0 /end MEASUREMENT
/begin MEASUREMENT B_clhsszdg "" UWORD B_TRUE 1 100 0 1 BIT_MASK 0x80 FORMAT "%13.11" ECU_ADDRESS 0x7F95F4 /end MEASUREMENT
/begin MEASUREMENT B_clkuppl "Bedingung: Fehlerpfad KUPPL (Gebergrˆﬂe Kupplung) lˆschen" UWORD B_TRUE 1 100 0 1 BIT_MASK 0x80 FORMAT "%13.11" ECU_ADDRESS 0x7F9628 /end MEASUREMENT
/begin MEASUREMENT B_cllatp "Fehlerpfad in DLSA lˆschen." UWORD B_TRUE 1 100 0 1 BIT_MASK 0x80 FORMAT "%13.11" ECU_ADDRESS 0x7F962C /end MEASUREMENT
/begin MEASUREMENT B_cllatp2 "Fehlerpfad in DLSA lˆschen. Bank2" UWORD B_TRUE 1 100 0 1 BIT_MASK 0x80 FORMAT "%13.11" ECU_ADDRESS 0x7F9630 /end MEASUREMENT
/begin MEASUREMENT B_cllatv "Fehlerpfad in DLSA lˆschen." UWORD B_TRUE 1 100 0 1 BIT_MASK 0x80 FORMAT "%13.11" ECU_ADDRESS 0x7F9634 /end MEASUREMENT
/begin MEASUREMENT B_cllatv2 "Fehlerpfad in DLSA lˆschen. Bank2" UWORD B_TRUE 1 100 0 1 BIT_MASK 0x80 FORMAT "%13.11" ECU_ADDRESS 0x7F9638 /end MEASUREMENT
/begin MEASUREMENT B_clllr "Bedingung Fehlerpfad DLLR lˆschen" UWORD B_TRUE 1 100 0 1 BIT_MASK 0x80 FORMAT "%13.11" ECU_ADDRESS 0x7F963C /end MEASUREMENT
/begin MEASUREMENT B_cllshv1e "Fehlerpfad wird gelˆscht: LSHVK1E" UWORD B_TRUE 1 100 0 1 BIT_MASK 0x80 FORMAT "%13.11" ECU_ADDRESS 0x7F9640 /end MEASUREMENT
/begin MEASUREMENT B_cllshv2e "Fehlerpfad wird gelˆscht: LSHVK2E" UWORD B_TRUE 1 100 0 1 BIT_MASK 0x80 FORMAT "%13.11" ECU_ADDRESS 0x7F9644 /end MEASUREMENT
/begin MEASUREMENT B_cllsv "Fehlerpfad in DLSV lˆschen." UWORD B_TRUE 1 100 0 1 BIT_MASK 0x80 FORMAT "%13.11" ECU_ADDRESS 0x7F9648 /end MEASUREMENT
/begin MEASUREMENT B_cllsv2 "Fehlerpfad in DLSV lˆschen.  Bank2" UWORD B_TRUE 1 100 0 1 BIT_MASK 0x80 FORMAT "%13.11" ECU_ADDRESS 0x7F964C /end MEASUREMENT
/begin MEASUREMENT B_clos "" UWORD B_TRUE 1 100 0 1 BIT_MASK 0x80 FORMAT "%13.11" ECU_ADDRESS 0x7F9658 /end MEASUREMENT
/begin MEASUREMENT B_clph "Bedingung Fehlerpfad PH lˆschen" UWORD B_TRUE 1 100 0 1 BIT_MASK 0x80 FORMAT "%13.11" ECU_ADDRESS 0x7F965C /end MEASUREMENT
/begin MEASUREMENT B_clphw "" UWORD B_TRUE 1 100 0 1 BIT_MASK 0x80 FORMAT "%13.11" ECU_ADDRESS 0x7F9660 /end MEASUREMENT
/begin MEASUREMENT B_clradv "" UWORD B_TRUE 1 100 0 1 BIT_MASK 0x80 FORMAT "%13.11" ECU_ADDRESS 0x7F9664 /end MEASUREMENT
/begin MEASUREMENT B_clrkat "Bedingung Fehlerpfad RKAT lˆschen (add. pro Zeit)" UWORD B_TRUE 1 100 0 1 BIT_MASK 0x80 FORMAT "%13.11" ECU_ADDRESS 0x7F9668 /end MEASUREMENT
/begin MEASUREMENT B_clrkat2 "Bedingung Fehlerpfad RKAT2 lˆschen (Stereo)" UWORD B_TRUE 1 100 0 1 BIT_MASK 0x80 FORMAT "%13.11" ECU_ADDRESS 0x7F966C /end MEASUREMENT
/begin MEASUREMENT B_clrkaz "Bedingung Fehlerpfad RKAZ lˆschen (add. pro Z¸ndung)" UWORD B_TRUE 1 100 0 1 BIT_MASK 0x80 FORMAT "%13.11" ECU_ADDRESS 0x7F9670 /end MEASUREMENT
/begin MEASUREMENT B_clrkaz2 "Bedingung Fehlerpfad RKAZ2 lˆschen (Stereo)" UWORD B_TRUE 1 100 0 1 BIT_MASK 0x80 FORMAT "%13.11" ECU_ADDRESS 0x7F9674 /end MEASUREMENT
/begin MEASUREMENT B_clsikoda "" UWORD B_TRUE 1 100 0 1 BIT_MASK 0x80 FORMAT "%13.11" ECU_ADDRESS 0x7F9678 /end MEASUREMENT
/begin MEASUREMENT B_clsld "" UWORD B_TRUE 1 100 0 1 BIT_MASK 0x80 FORMAT "%13.11" ECU_ADDRESS 0x7F967C /end MEASUREMENT
/begin MEASUREMENT B_clsls "Bedingung: Fehler Sekund‰rluftsystem lˆschen" UWORD B_TRUE 1 100 0 1 BIT_MASK 0x80 FORMAT "%13.11" ECU_ADDRESS 0x7F9680 /end MEASUREMENT
/begin MEASUREMENT B_clsls2 "Bedingung: Fehler Sekund‰rluftsystem lˆschen (Bank 2)" UWORD B_TRUE 1 100 0 1 BIT_MASK 0x80 FORMAT "%13.11" ECU_ADDRESS 0x7F9684 /end MEASUREMENT
/begin MEASUREMENT B_clslv "Bedingung: Fehler Sekund‰rluftventil lˆschen" UWORD B_TRUE 1 100 0 1 BIT_MASK 0x80 FORMAT "%13.11" ECU_ADDRESS 0x7F9688 /end MEASUREMENT
/begin MEASUREMENT B_clslv1e "Fehlerpfad wird gelˆscht: SLV1E" UWORD B_TRUE 1 100 0 1 BIT_MASK 0x80 FORMAT "%13.11" ECU_ADDRESS 0x7F968C /end MEASUREMENT
/begin MEASUREMENT B_clslv2 "Bedingung: Fehler Sekund‰rluftventil lˆschen (Bank 2)" UWORD B_TRUE 1 100 0 1 BIT_MASK 0x80 FORMAT "%13.11" ECU_ADDRESS 0x7F9690 /end MEASUREMENT
/begin MEASUREMENT B_clslv2e "Fehlerpfad wird gelˆscht: SLV2E" UWORD B_TRUE 1 100 0 1 BIT_MASK 0x80 FORMAT "%13.11" ECU_ADDRESS 0x7F9694 /end MEASUREMENT
/begin MEASUREMENT B_clsst "Bedingung Fehlerpfad SST lˆschen" UWORD B_TRUE 1 100 0 1 BIT_MASK 0x80 FORMAT "%13.11" ECU_ADDRESS 0x7F9698 /end MEASUREMENT
/begin MEASUREMENT B_clsst2e "" UWORD B_TRUE 1 100 0 1 BIT_MASK 0x80 FORMAT "%13.11" ECU_ADDRESS 0x7F969C /end MEASUREMENT
/begin MEASUREMENT B_clstarte "Fehlerpfad wird gelˆscht: STARTE" UWORD B_TRUE 1 100 0 1 BIT_MASK 0x80 FORMAT "%13.11" ECU_ADDRESS 0x7F96A0 /end MEASUREMENT
/begin MEASUREMENT B_clstp1 "" UWORD B_TRUE 1 100 0 1 BIT_MASK 0x80 FORMAT "%13.11" ECU_ADDRESS 0x7F96A4 /end MEASUREMENT
/begin MEASUREMENT B_clstp2 "" UWORD B_TRUE 1 100 0 1 BIT_MASK 0x80 FORMAT "%13.11" ECU_ADDRESS 0x7F96A8 /end MEASUREMENT
/begin MEASUREMENT B_clta "Bedingung Fehlerpfad Ansauglufttemperatur (/Ladeluft-) TANS lˆschen" UWORD B_TRUE 1 100 0 1 BIT_MASK 0x80 FORMAT "%13.11" ECU_ADDRESS 0x7F96AC /end MEASUREMENT
/begin MEASUREMENT B_cltcj945 "Bedingung Fehlerpfad DTCJ945 lˆschen" UWORD B_TRUE 1 100 0 1 BIT_MASK 0x80 FORMAT "%13.11" ECU_ADDRESS 0x7F96B0 /end MEASUREMENT
/begin MEASUREMENT B_cltcy315 "Bedingung Fehlerpfad DTCY315 lˆschen" UWORD B_TRUE 1 100 0 1 BIT_MASK 0x80 FORMAT "%13.11" ECU_ADDRESS 0x7F96B4 /end MEASUREMENT
/begin MEASUREMENT B_cltde "" UWORD B_TRUE 1 100 0 1 BIT_MASK 0x80 FORMAT "%13.11" ECU_ADDRESS 0x7F96B8 /end MEASUREMENT
/begin MEASUREMENT B_cltes "Bedingung Fehlerflag ""Tankentl¸ftungssystem offen"" lˆschen" UWORD B_TRUE 1 100 0 1 BIT_MASK 0x80 FORMAT "%13.11" ECU_ADDRESS 0x7F96BC /end MEASUREMENT
/begin MEASUREMENT B_clteve "Fehlerpfad wird gelˆscht: TEVE" UWORD B_TRUE 1 100 0 1 BIT_MASK 0x80 FORMAT "%13.11" ECU_ADDRESS 0x7F96C4 /end MEASUREMENT
/begin MEASUREMENT B_clths "Flag f¸r Lˆschen der Diagnosedaten" UWORD B_TRUE 1 100 0 1 BIT_MASK 0x80 FORMAT "%13.11" ECU_ADDRESS 0x7F96C8 /end MEASUREMENT
/begin MEASUREMENT B_cltm "Bedingung Fehlerpfad Motortemperatur TMOT lˆschen" UWORD B_TRUE 1 100 0 1 BIT_MASK 0x80 FORMAT "%13.11" ECU_ADDRESS 0x7F96CC /end MEASUREMENT
/begin MEASUREMENT B_cltzyl1 "Bedingung Fehlerpfad fuer Kopftemperatur lˆschen" UWORD B_TRUE 1 100 0 1 BIT_MASK 0x80 FORMAT "%13.11" ECU_ADDRESS 0x7F96D0 /end MEASUREMENT
/begin MEASUREMENT B_cltzyl2 "Bedingung Fehlerpfad fuer Kopftemperatur lˆschen" UWORD B_TRUE 1 100 0 1 BIT_MASK 0x80 FORMAT "%13.11" ECU_ADDRESS 0x7F96D4 /end MEASUREMENT
/begin MEASUREMENT B_clu5vg1 "Bedingung Fehlerpfad DU5VG1 lˆschen" UWORD B_TRUE 1 100 0 1 BIT_MASK 0x80 FORMAT "%13.11" ECU_ADDRESS 0x7F96D8 /end MEASUREMENT
/begin MEASUREMENT B_clu5vg2 "Bedingung Fehlerpfad DU5VG2 lˆschen" UWORD B_TRUE 1 100 0 1 BIT_MASK 0x80 FORMAT "%13.11" ECU_ADDRESS 0x7F96DC /end MEASUREMENT
/begin MEASUREMENT B_clu5vg3 "Bedingung Fehlerpfad DU5VG3 lˆschen" UWORD B_TRUE 1 100 0 1 BIT_MASK 0x80 FORMAT "%13.11" ECU_ADDRESS 0x7F96E0 /end MEASUREMENT
/begin MEASUREMENT B_club "Bedingung Fehlerpfad Batteriespannung (Bordnetz) lˆschen" UWORD B_TRUE 1 100 0 1 BIT_MASK 0x80 FORMAT "%13.11" ECU_ADDRESS 0x7F96E4 /end MEASUREMENT
/begin MEASUREMENT B_clurram "Flag f¸r Lˆschung: Rechner¸berwachung: RAM" UWORD B_TRUE 1 100 0 1 BIT_MASK 0x80 FORMAT "%13.11" ECU_ADDRESS 0x7F96E8 /end MEASUREMENT
/begin MEASUREMENT B_clurrom "Flag f¸r Lˆschung: Rechner¸berwachung: ROM" UWORD B_TRUE 1 100 0 1 BIT_MASK 0x80 FORMAT "%13.11" ECU_ADDRESS 0x7F96EC /end MEASUREMENT
/begin MEASUREMENT B_clurrst "Flag f¸r Lˆschung: Rechner¸berwachung: Reset" UWORD B_TRUE 1 100 0 1 BIT_MASK 0x80 FORMAT "%13.11" ECU_ADDRESS 0x7F96F0 /end MEASUREMENT
/begin MEASUREMENT B_clvfz "Bedingung Fehlerpfad VFZ (Fahrzeuggeschwindigkeit) lˆschen" UWORD B_TRUE 1 100 0 1 BIT_MASK 0x80 FORMAT "%13.11" ECU_ADDRESS 0x7F96F4 /end MEASUREMENT
/begin MEASUREMENT B_ftbrems "Bedingung: Fehlereintrag durch Tester f¸r Bremsschalter" UWORD B_TRUE 1 100 0 1 BIT_MASK 0x10 FORMAT "%13.11" ECU_ADDRESS 0x7F957C /end MEASUREMENT
/begin MEASUREMENT B_ftdmls "" UWORD B_TRUE 1 100 0 1 BIT_MASK 0x10 FORMAT "%13.11" ECU_ADDRESS 0x7F959C /end MEASUREMENT
/begin MEASUREMENT B_ftdsu "Bedingung: Fehlereintrag durch Tester f¸r DSU" UWORD B_TRUE 1 100 0 1 BIT_MASK 0x10 FORMAT "%13.11" ECU_ADDRESS 0x7F95A8 /end MEASUREMENT
/begin MEASUREMENT B_ftegfe "Bedingung: Fehlereintrag durch Tester f¸r DEGFE" UWORD B_TRUE 1 100 0 1 BIT_MASK 0x10 FORMAT "%13.11" ECU_ADDRESS 0x7F95AC /end MEASUREMENT
/begin MEASUREMENT B_ftfrao "Bedingung Fehlereintrag durch Tester f¸r FRAO" UWORD B_TRUE 1 100 0 1 BIT_MASK 0x10 FORMAT "%13.11" ECU_ADDRESS 0x7F95CC /end MEASUREMENT
/begin MEASUREMENT B_ftfrao2 "Bedingung Fehlereintrag durch Tester f¸r FRAO2" UWORD B_TRUE 1 100 0 1 BIT_MASK 0x10 FORMAT "%13.11" ECU_ADDRESS 0x7F95D0 /end MEASUREMENT
/begin MEASUREMENT B_ftfrau "Bedingung Fehlereintrag durch Tester f¸r FRAU" UWORD B_TRUE 1 100 0 1 BIT_MASK 0x10 FORMAT "%13.11" ECU_ADDRESS 0x7F95D4 /end MEASUREMENT
/begin MEASUREMENT B_ftfrau2 "Bedingung Fehlereintrag durch Tester f¸r FRAU2" UWORD B_TRUE 1 100 0 1 BIT_MASK 0x10 FORMAT "%13.11" ECU_ADDRESS 0x7F95D8 /end MEASUREMENT
/begin MEASUREMENT B_ftfrst "Bedingung Fehlereintrag durch Tester f¸r FRST (FR-Kurztest)" UWORD B_TRUE 1 100 0 1 BIT_MASK 0x10 FORMAT "%13.11" ECU_ADDRESS 0x7F95E0 /end MEASUREMENT
/begin MEASUREMENT B_ftfrst2 "Bedingung Fehlereintrag durch Tester f¸r FRST (FR-Kurztest Bank 2)" UWORD B_TRUE 1 100 0 1 BIT_MASK 0x10 FORMAT "%13.11" ECU_ADDRESS 0x7F95E4 /end MEASUREMENT
/begin MEASUREMENT B_ftgang "Pruefung durch Kundendiensttester" UWORD B_TRUE 1 100 0 1 BIT_MASK 0x10 FORMAT "%13.11" ECU_ADDRESS 0x7F95E8 /end MEASUREMENT
/begin MEASUREMENT B_fthssekp "" UWORD B_TRUE 1 100 0 1 BIT_MASK 0x10 FORMAT "%13.11" ECU_ADDRESS 0x7F95EC /end MEASUREMENT
/begin MEASUREMENT B_fthsssys "" UWORD B_TRUE 1 100 0 1 BIT_MASK 0x10 FORMAT "%13.11" ECU_ADDRESS 0x7F95F0 /end MEASUREMENT
/begin MEASUREMENT B_fthsszdg "" UWORD B_TRUE 1 100 0 1 BIT_MASK 0x10 FORMAT "%13.11" ECU_ADDRESS 0x7F95F4 /end MEASUREMENT
/begin MEASUREMENT B_ftkuppl "Pruefung durch Kundendiensttester" UWORD B_TRUE 1 100 0 1 BIT_MASK 0x10 FORMAT "%13.11" ECU_ADDRESS 0x7F9628 /end MEASUREMENT
/begin MEASUREMENT B_ftlatp "" UWORD B_TRUE 1 100 0 1 BIT_MASK 0x10 FORMAT "%13.11" ECU_ADDRESS 0x7F962C /end MEASUREMENT
/begin MEASUREMENT B_ftlatp2 "" UWORD B_TRUE 1 100 0 1 BIT_MASK 0x10 FORMAT "%13.11" ECU_ADDRESS 0x7F9630 /end MEASUREMENT
/begin MEASUREMENT B_ftlatv "" UWORD B_TRUE 1 100 0 1 BIT_MASK 0x10 FORMAT "%13.11" ECU_ADDRESS 0x7F9634 /end MEASUREMENT
/begin MEASUREMENT B_ftlatv2 "" UWORD B_TRUE 1 100 0 1 BIT_MASK 0x10 FORMAT "%13.11" ECU_ADDRESS 0x7F9638 /end MEASUREMENT
/begin MEASUREMENT B_ftllr "" UWORD B_TRUE 1 100 0 1 BIT_MASK 0x10 FORMAT "%13.11" ECU_ADDRESS 0x7F963C /end MEASUREMENT
/begin MEASUREMENT B_ftlshv1e "Pr¸fung durch Kundendiensttester: LSHVK1E" UWORD B_TRUE 1 100 0 1 BIT_MASK 0x10 FORMAT "%13.11" ECU_ADDRESS 0x7F9640 /end MEASUREMENT
/begin MEASUREMENT B_ftlshv2e "Pr¸fung durch Kundendiensttester: LSHVK2E" UWORD B_TRUE 1 100 0 1 BIT_MASK 0x10 FORMAT "%13.11" ECU_ADDRESS 0x7F9644 /end MEASUREMENT
/begin MEASUREMENT B_ftlsv "Bedingung Fehlereintrag durch Tester Lambda Sonde vor KAT" UWORD B_TRUE 1 100 0 1 BIT_MASK 0x10 FORMAT "%13.11" ECU_ADDRESS 0x7F9648 /end MEASUREMENT
/begin MEASUREMENT B_ftlsv2 "Bedingung Fehlereintrag durch Tester Lambda Sonde vor KAT Bank2" UWORD B_TRUE 1 100 0 1 BIT_MASK 0x10 FORMAT "%13.11" ECU_ADDRESS 0x7F964C /end MEASUREMENT
/begin MEASUREMENT B_ftos "" UWORD B_TRUE 1 100 0 1 BIT_MASK 0x10 FORMAT "%13.11" ECU_ADDRESS 0x7F9658 /end MEASUREMENT
/begin MEASUREMENT B_ftph "Bedingung Fehlereintrag durch Tester f¸r Phasensensor" UWORD B_TRUE 1 100 0 1 BIT_MASK 0x10 FORMAT "%13.11" ECU_ADDRESS 0x7F965C /end MEASUREMENT
/begin MEASUREMENT B_ftphw "" UWORD B_TRUE 1 100 0 1 BIT_MASK 0x10 FORMAT "%13.11" ECU_ADDRESS 0x7F9660 /end MEASUREMENT
/begin MEASUREMENT B_ftradv "" UWORD B_TRUE 1 100 0 1 BIT_MASK 0x10 FORMAT "%13.11" ECU_ADDRESS 0x7F9664 /end MEASUREMENT
/begin MEASUREMENT B_ftrkat "Bedingung Fehlereintrag durch Tester f¸r RKAT" UWORD B_TRUE 1 100 0 1 BIT_MASK 0x10 FORMAT "%13.11" ECU_ADDRESS 0x7F9668 /end MEASUREMENT
/begin MEASUREMENT B_ftrkat2 "Bedingung Fehlereintrag durch Tester f¸r RKAT2" UWORD B_TRUE 1 100 0 1 BIT_MASK 0x10 FORMAT "%13.11" ECU_ADDRESS 0x7F966C /end MEASUREMENT
/begin MEASUREMENT B_ftrkaz "Bedingung Fehlereintrag durch Tester f¸r RKAZ" UWORD B_TRUE 1 100 0 1 BIT_MASK 0x10 FORMAT "%13.11" ECU_ADDRESS 0x7F9670 /end MEASUREMENT
/begin MEASUREMENT B_ftrkaz2 "Bedingung Fehlereintrag durch Tester f¸r RKAZ2" UWORD B_TRUE 1 100 0 1 BIT_MASK 0x10 FORMAT "%13.11" ECU_ADDRESS 0x7F9674 /end MEASUREMENT
/begin MEASUREMENT B_ftsikoda "" UWORD B_TRUE 1 100 0 1 BIT_MASK 0x10 FORMAT "%13.11" ECU_ADDRESS 0x7F9678 /end MEASUREMENT
/begin MEASUREMENT B_ftsld "" UWORD B_TRUE 1 100 0 1 BIT_MASK 0x10 FORMAT "%13.11" ECU_ADDRESS 0x7F967C /end MEASUREMENT
/begin MEASUREMENT B_ftsls "Bedingung: Fehlereintrag durch Tester f¸r SLS" UWORD B_TRUE 1 100 0 1 BIT_MASK 0x10 FORMAT "%13.11" ECU_ADDRESS 0x7F9680 /end MEASUREMENT
/begin MEASUREMENT B_ftsls2 "Bedingung: Fehlereintrag durch Tester f¸r SLS, Bank2" UWORD B_TRUE 1 100 0 1 BIT_MASK 0x10 FORMAT "%13.11" ECU_ADDRESS 0x7F9684 /end MEASUREMENT
/begin MEASUREMENT B_ftslv "Bedingung: Fehlereintrag durch Tester f¸r SLV" UWORD B_TRUE 1 100 0 1 BIT_MASK 0x10 FORMAT "%13.11" ECU_ADDRESS 0x7F9688 /end MEASUREMENT
/begin MEASUREMENT B_ftslv1e "Pr¸fung durch Kundendiensttester: SLV1E" UWORD B_TRUE 1 100 0 1 BIT_MASK 0x10 FORMAT "%13.11" ECU_ADDRESS 0x7F968C /end MEASUREMENT
/begin MEASUREMENT B_ftslv2 "Bedingung: Fehlereintrag durch Tester f¸r SLV, Bank2" UWORD B_TRUE 1 100 0 1 BIT_MASK 0x10 FORMAT "%13.11" ECU_ADDRESS 0x7F9690 /end MEASUREMENT
/begin MEASUREMENT B_ftslv2e "Pr¸fung durch Kundendiensttester: SLV2E" UWORD B_TRUE 1 100 0 1 BIT_MASK 0x10 FORMAT "%13.11" ECU_ADDRESS 0x7F9694 /end MEASUREMENT
/begin MEASUREMENT B_ftsst "" UWORD B_TRUE 1 100 0 1 BIT_MASK 0x10 FORMAT "%13.11" ECU_ADDRESS 0x7F9698 /end MEASUREMENT
/begin MEASUREMENT B_ftsst2e "" UWORD B_TRUE 1 100 0 1 BIT_MASK 0x10 FORMAT "%13.11" ECU_ADDRESS 0x7F969C /end MEASUREMENT
/begin MEASUREMENT B_ftstarte "Pr¸fung durch Kundendiensttester: STARTE" UWORD B_TRUE 1 100 0 1 BIT_MASK 0x10 FORMAT "%13.11" ECU_ADDRESS 0x7F96A0 /end MEASUREMENT
/begin MEASUREMENT B_ftstp1 "" UWORD B_TRUE 1 100 0 1 BIT_MASK 0x10 FORMAT "%13.11" ECU_ADDRESS 0x7F96A4 /end MEASUREMENT
/begin MEASUREMENT B_ftstp2 "" UWORD B_TRUE 1 100 0 1 BIT_MASK 0x10 FORMAT "%13.11" ECU_ADDRESS 0x7F96A8 /end MEASUREMENT
/begin MEASUREMENT B_ftta "" UWORD B_TRUE 1 100 0 1 BIT_MASK 0x10 FORMAT "%13.11" ECU_ADDRESS 0x7F96AC /end MEASUREMENT
/begin MEASUREMENT B_fttcj945 "Bedingung Fehlereintrag durch Tester ‹bertemperatur CJ945" UWORD B_TRUE 1 100 0 1 BIT_MASK 0x10 FORMAT "%13.11" ECU_ADDRESS 0x7F96B0 /end MEASUREMENT
/begin MEASUREMENT B_fttcy315 "Bedingung Fehlereintrag durch Tester ‹bertemperatur CY315" UWORD B_TRUE 1 100 0 1 BIT_MASK 0x10 FORMAT "%13.11" ECU_ADDRESS 0x7F96B4 /end MEASUREMENT
/begin MEASUREMENT B_fttde "" UWORD B_TRUE 1 100 0 1 BIT_MASK 0x10 FORMAT "%13.11" ECU_ADDRESS 0x7F96B8 /end MEASUREMENT
/begin MEASUREMENT B_ftteve "Pr¸fung durch Kundendiensttester: TEVE" UWORD B_TRUE 1 100 0 1 BIT_MASK 0x10 FORMAT "%13.11" ECU_ADDRESS 0x7F96C4 /end MEASUREMENT
/begin MEASUREMENT B_ftths "Pr¸fung durch Kundendiensttester" UWORD B_TRUE 1 100 0 1 BIT_MASK 0x10 FORMAT "%13.11" ECU_ADDRESS 0x7F96C8 /end MEASUREMENT
/begin MEASUREMENT B_fttm "" UWORD B_TRUE 1 100 0 1 BIT_MASK 0x10 FORMAT "%13.11" ECU_ADDRESS 0x7F96CC /end MEASUREMENT
/begin MEASUREMENT B_fttzyl1 "Fehlereintrag durch Tester" UWORD B_TRUE 1 100 0 1 BIT_MASK 0x10 FORMAT "%13.11" ECU_ADDRESS 0x7F96D0 /end MEASUREMENT
/begin MEASUREMENT B_fttzyl2 "Fehlereintrag durch Tester" UWORD B_TRUE 1 100 0 1 BIT_MASK 0x10 FORMAT "%13.11" ECU_ADDRESS 0x7F96D4 /end MEASUREMENT
/begin MEASUREMENT B_ftu5vg1 "Bedingung Fehlereintrag durch Tester Fehler Geberversorgung 1" UWORD B_TRUE 1 100 0 1 BIT_MASK 0x10 FORMAT "%13.11" ECU_ADDRESS 0x7F96D8 /end MEASUREMENT
/begin MEASUREMENT B_ftu5vg2 "Bedingung Fehlereintrag durch Tester Fehler Geberversorgung 2" UWORD B_TRUE 1 100 0 1 BIT_MASK 0x10 FORMAT "%13.11" ECU_ADDRESS 0x7F96DC /end MEASUREMENT
/begin MEASUREMENT B_ftu5vg3 "Bedingung Fehlereintrag durch Tester Fehler Geberversorgung 3" UWORD B_TRUE 1 100 0 1 BIT_MASK 0x10 FORMAT "%13.11" ECU_ADDRESS 0x7F96E0 /end MEASUREMENT
/begin MEASUREMENT B_ftub "Bedingung Fehlereintrag durch Tester f¸r Batteriespannung (Bordnetz)" UWORD B_TRUE 1 100 0 1 BIT_MASK 0x10 FORMAT "%13.11" ECU_ADDRESS 0x7F96E4 /end MEASUREMENT
/begin MEASUREMENT B_fturram "" UWORD B_TRUE 1 100 0 1 BIT_MASK 0x10 FORMAT "%13.11" ECU_ADDRESS 0x7F96E8 /end MEASUREMENT
/begin MEASUREMENT B_fturrom "" UWORD B_TRUE 1 100 0 1 BIT_MASK 0x10 FORMAT "%13.11" ECU_ADDRESS 0x7F96EC /end MEASUREMENT
/begin MEASUREMENT B_fturrst "" UWORD B_TRUE 1 100 0 1 BIT_MASK 0x10 FORMAT "%13.11" ECU_ADDRESS 0x7F96F0 /end MEASUREMENT
/begin MEASUREMENT B_ftvfz "Bedingung Fehlereintrag durch Tester f¸r Fehlerpfad VFZ" UWORD B_TRUE 1 100 0 1 BIT_MASK 0x10 FORMAT "%13.11" ECU_ADDRESS 0x7F96F4 /end MEASUREMENT
/begin MEASUREMENT B_mnbrems "Fehlertyp BREMS (Bremssschalter): Minimalwert unterschritten" UWORD B_TRUE 1 100 0 1 BIT_MASK 0x200 FORMAT "%13.11" ECU_ADDRESS 0x7F957C /end MEASUREMENT
/begin MEASUREMENT B_mndmls "" UWORD B_TRUE 1 100 0 1 BIT_MASK 0x200 FORMAT "%13.11" ECU_ADDRESS 0x7F959C /end MEASUREMENT
/begin MEASUREMENT B_mndsu "Bedingung: min-Fehler Umgebungsdrucksensor" UWORD B_TRUE 1 100 0 1 BIT_MASK 0x200 FORMAT "%13.11" ECU_ADDRESS 0x7F95A8 /end MEASUREMENT
/begin MEASUREMENT B_mnegfe "Bedingung: MIN-Fehler Eingangsgrˆﬂen F¸llungserfassung" UWORD B_TRUE 1 100 0 1 BIT_MASK 0x200 FORMAT "%13.11" ECU_ADDRESS 0x7F95AC /end MEASUREMENT
/begin MEASUREMENT B_mnfrao "Bedingung untere Plausibilit‰tsschwelle unterschritten (obere Multipl.)" UWORD B_TRUE 1 100 0 1 BIT_MASK 0x200 FORMAT "%13.11" ECU_ADDRESS 0x7F95CC /end MEASUREMENT
/begin MEASUREMENT B_mnfrao2 "Bedingung untere Plausibilit‰tsschwelle unterschritten (Stereo)" UWORD B_TRUE 1 100 0 1 BIT_MASK 0x200 FORMAT "%13.11" ECU_ADDRESS 0x7F95D0 /end MEASUREMENT
/begin MEASUREMENT B_mnfrau "Bedingung untere Plausibilit‰tsschwelle unterschritten (untere Multipl.)" UWORD B_TRUE 1 100 0 1 BIT_MASK 0x200 FORMAT "%13.11" ECU_ADDRESS 0x7F95D4 /end MEASUREMENT
/begin MEASUREMENT B_mnfrau2 "Bedingung untere Plausibilit‰tsschwelle unterschritten (Stereo)" UWORD B_TRUE 1 100 0 1 BIT_MASK 0x200 FORMAT "%13.11" ECU_ADDRESS 0x7F95D8 /end MEASUREMENT
/begin MEASUREMENT B_mnfrps "" UWORD B_TRUE 1 100 0 1 BIT_MASK 0x200 FORMAT "%13.11" ECU_ADDRESS 0x7F95DC /end MEASUREMENT
/begin MEASUREMENT B_mnfrst "Bedingung untere Plausibilit‰tsschwelle unterschritten(short test)" UWORD B_TRUE 1 100 0 1 BIT_MASK 0x200 FORMAT "%13.11" ECU_ADDRESS 0x7F95E0 /end MEASUREMENT
/begin MEASUREMENT B_mnfrst2 "Bedingung untere Plausibilit‰tsschwelle unterschritten(short test Stereo" UWORD B_TRUE 1 100 0 1 BIT_MASK 0x200 FORMAT "%13.11" ECU_ADDRESS 0x7F95E4 /end MEASUREMENT
/begin MEASUREMENT B_mngang "Fehlertyp GANG: Minimalwert unterschritten" UWORD B_TRUE 1 100 0 1 BIT_MASK 0x200 FORMAT "%13.11" ECU_ADDRESS 0x7F95E8 /end MEASUREMENT
/begin MEASUREMENT B_mnhssekp "" UWORD B_TRUE 1 100 0 1 BIT_MASK 0x200 FORMAT "%13.11" ECU_ADDRESS 0x7F95EC /end MEASUREMENT
/begin MEASUREMENT B_mnhsssys "" UWORD B_TRUE 1 100 0 1 BIT_MASK 0x200 FORMAT "%13.11" ECU_ADDRESS 0x7F95F0 /end MEASUREMENT
/begin MEASUREMENT B_mnhsszdg "" UWORD B_TRUE 1 100 0 1 BIT_MASK 0x200 FORMAT "%13.11" ECU_ADDRESS 0x7F95F4 /end MEASUREMENT
/begin MEASUREMENT B_mnkuppl "Fehlertyp KUPPL: Minimalwert unterschritten" UWORD B_TRUE 1 100 0 1 BIT_MASK 0x200 FORMAT "%13.11" ECU_ADDRESS 0x7F9628 /end MEASUREMENT
/begin MEASUREMENT B_mnlatp "Fehlertyp 'Minimalwert' f¸r Perioden-Dauer vor KAT erkannt" UWORD B_TRUE 1 100 0 1 BIT_MASK 0x200 FORMAT "%13.11" ECU_ADDRESS 0x7F962C /end MEASUREMENT
/begin MEASUREMENT B_mnlatp2 "Fehlertyp 'Minimalwert' f¸r Perioden-Dauer vor KAT erkannt Bank2" UWORD B_TRUE 1 100 0 1 BIT_MASK 0x200 FORMAT "%13.11" ECU_ADDRESS 0x7F9630 /end MEASUREMENT
/begin MEASUREMENT B_mnlatv "Fehlertyp 'Minimalwert' f¸r ATV-Pr¸fung vor KAT erkannt" UWORD B_TRUE 1 100 0 1 BIT_MASK 0x200 FORMAT "%13.11" ECU_ADDRESS 0x7F9634 /end MEASUREMENT
/begin MEASUREMENT B_mnlatv2 "Fehlertyp 'Minimalwert' f¸r ATV-Pr¸fung vor KAT erkannt Bank2" UWORD B_TRUE 1 100 0 1 BIT_MASK 0x200 FORMAT "%13.11" ECU_ADDRESS 0x7F9638 /end MEASUREMENT
/begin MEASUREMENT B_mnllr "Fehler 'Leerlaufdrehzahl zu klein'" UWORD B_TRUE 1 100 0 1 BIT_MASK 0x200 FORMAT "%13.11" ECU_ADDRESS 0x7F963C /end MEASUREMENT
/begin MEASUREMENT B_mnlshv1e "Fehlerart: Kurzschluﬂ Masse an Endstufe LSHVK1E" UWORD B_TRUE 1 100 0 1 BIT_MASK 0x200 FORMAT "%13.11" ECU_ADDRESS 0x7F9640 /end MEASUREMENT
/begin MEASUREMENT B_mnlshv2e "Fehlerart: Kurzschluﬂ Masse an Endstufe LSHVK2E" UWORD B_TRUE 1 100 0 1 BIT_MASK 0x200 FORMAT "%13.11" ECU_ADDRESS 0x7F9644 /end MEASUREMENT
/begin MEASUREMENT B_mnlsv "Fehlertyp 'Minimalwert' vor KAT erkannt" UWORD B_TRUE 1 100 0 1 BIT_MASK 0x200 FORMAT "%13.11" ECU_ADDRESS 0x7F9648 /end MEASUREMENT
/begin MEASUREMENT B_mnlsv2 "Fehlertyp 'Minimalwert' vor KAT erkannt  Bank2" UWORD B_TRUE 1 100 0 1 BIT_MASK 0x200 FORMAT "%13.11" ECU_ADDRESS 0x7F964C /end MEASUREMENT
/begin MEASUREMENT B_mnos "" UWORD B_TRUE 1 100 0 1 BIT_MASK 0x200 FORMAT "%13.11" ECU_ADDRESS 0x7F9658 /end MEASUREMENT
/begin MEASUREMENT B_mnph "Fehlerart: Kurzschluﬂ Masse Phasengeber" UWORD B_TRUE 1 100 0 1 BIT_MASK 0x200 FORMAT "%13.11" ECU_ADDRESS 0x7F965C /end MEASUREMENT
/begin MEASUREMENT B_mnphw "" UWORD B_TRUE 1 100 0 1 BIT_MASK 0x200 FORMAT "%13.11" ECU_ADDRESS 0x7F9660 /end MEASUREMENT
/begin MEASUREMENT B_mnradv "" UWORD B_TRUE 1 100 0 1 BIT_MASK 0x200 FORMAT "%13.11" ECU_ADDRESS 0x7F9664 /end MEASUREMENT
/begin MEASUREMENT B_mnrkat "Bedingung untere Plausibilit‰tsschwelle unterschritten (add. pro Zeit)" UWORD B_TRUE 1 100 0 1 BIT_MASK 0x200 FORMAT "%13.11" ECU_ADDRESS 0x7F9668 /end MEASUREMENT
/begin MEASUREMENT B_mnrkat2 "Bedingung untere Plausibilit‰tsschwelle unterschritten (Stereo)" UWORD B_TRUE 1 100 0 1 BIT_MASK 0x200 FORMAT "%13.11" ECU_ADDRESS 0x7F966C /end MEASUREMENT
/begin MEASUREMENT B_mnrkaz "Bedingung untere Plausibilit‰tsschwelle unterschritten (add. pro Z¸ndung)" UWORD B_TRUE 1 100 0 1 BIT_MASK 0x200 FORMAT "%13.11" ECU_ADDRESS 0x7F9670 /end MEASUREMENT
/begin MEASUREMENT B_mnrkaz2 "Bedingung untere Plausibilit‰tsschwelle unterschritten (Stereo)" UWORD B_TRUE 1 100 0 1 BIT_MASK 0x200 FORMAT "%13.11" ECU_ADDRESS 0x7F9674 /end MEASUREMENT
/begin MEASUREMENT B_mnsikoda "" UWORD B_TRUE 1 100 0 1 BIT_MASK 0x200 FORMAT "%13.11" ECU_ADDRESS 0x7F9678 /end MEASUREMENT
/begin MEASUREMENT B_mnsld "" UWORD B_TRUE 1 100 0 1 BIT_MASK 0x200 FORMAT "%13.11" ECU_ADDRESS 0x7F967C /end MEASUREMENT
/begin MEASUREMENT B_mnsls "Fehlerart: Sekund‰rluftmasse zu gering" UWORD B_TRUE 1 100 0 1 BIT_MASK 0x200 FORMAT "%13.11" ECU_ADDRESS 0x7F9680 /end MEASUREMENT
/begin MEASUREMENT B_mnsls2 "Fehlerart: Sekund‰rluftmasse zu gering, Bank 2" UWORD B_TRUE 1 100 0 1 BIT_MASK 0x200 FORMAT "%13.11" ECU_ADDRESS 0x7F9684 /end MEASUREMENT
/begin MEASUREMENT B_mnslv "Fehlerart:" UWORD B_TRUE 1 100 0 1 BIT_MASK 0x200 FORMAT "%13.11" ECU_ADDRESS 0x7F9688 /end MEASUREMENT
/begin MEASUREMENT B_mnslv1e "Fehlerart: Kurzschluﬂ Masse an Endstufe SLV1E" UWORD B_TRUE 1 100 0 1 BIT_MASK 0x200 FORMAT "%13.11" ECU_ADDRESS 0x7F968C /end MEASUREMENT
/begin MEASUREMENT B_mnslv2 "Fehlerart:" UWORD B_TRUE 1 100 0 1 BIT_MASK 0x200 FORMAT "%13.11" ECU_ADDRESS 0x7F9690 /end MEASUREMENT
/begin MEASUREMENT B_mnslv2e "Fehlerart: Kurzschluﬂ Masse an Endstufe SLV2E" UWORD B_TRUE 1 100 0 1 BIT_MASK 0x200 FORMAT "%13.11" ECU_ADDRESS 0x7F9694 /end MEASUREMENT
/begin MEASUREMENT B_mnsst "Fehlertyp min.: Diagnose Seitenstuetzenschalter" UWORD B_TRUE 1 100 0 1 BIT_MASK 0x200 FORMAT "%13.11" ECU_ADDRESS 0x7F9698 /end MEASUREMENT
/begin MEASUREMENT B_mnsst2e "" UWORD B_TRUE 1 100 0 1 BIT_MASK 0x200 FORMAT "%13.11" ECU_ADDRESS 0x7F969C /end MEASUREMENT
/begin MEASUREMENT B_mnstarte "Fehlerart: Kurzschluﬂ Masse an Endstufe STARTE" UWORD B_TRUE 1 100 0 1 BIT_MASK 0x200 FORMAT "%13.11" ECU_ADDRESS 0x7F96A0 /end MEASUREMENT
/begin MEASUREMENT B_mnstp1 "" UWORD B_TRUE 1 100 0 1 BIT_MASK 0x200 FORMAT "%13.11" ECU_ADDRESS 0x7F96A4 /end MEASUREMENT
/begin MEASUREMENT B_mnstp2 "" UWORD B_TRUE 1 100 0 1 BIT_MASK 0x200 FORMAT "%13.11" ECU_ADDRESS 0x7F96A8 /end MEASUREMENT
/begin MEASUREMENT B_mnta "Fehlertyp: Minimalwertunterschreitung Ansauglufttemperatur TANS" UWORD B_TRUE 1 100 0 1 BIT_MASK 0x200 FORMAT "%13.11" ECU_ADDRESS 0x7F96AC /end MEASUREMENT
/begin MEASUREMENT B_mntcj945 "Fehlertyp:" UWORD B_TRUE 1 100 0 1 BIT_MASK 0x200 FORMAT "%13.11" ECU_ADDRESS 0x7F96B0 /end MEASUREMENT
/begin MEASUREMENT B_mntcy315 "Fehlertyp:" UWORD B_TRUE 1 100 0 1 BIT_MASK 0x200 FORMAT "%13.11" ECU_ADDRESS 0x7F96B4 /end MEASUREMENT
/begin MEASUREMENT B_mntde "" UWORD B_TRUE 1 100 0 1 BIT_MASK 0x200 FORMAT "%13.11" ECU_ADDRESS 0x7F96B8 /end MEASUREMENT
/begin MEASUREMENT B_mntes "Fehlertyp 'Minimalwert' erkannt" UWORD B_TRUE 1 100 0 1 BIT_MASK 0x200 FORMAT "%13.11" ECU_ADDRESS 0x7F96BC /end MEASUREMENT
/begin MEASUREMENT B_mnteve "Fehlerart: Kurzschluﬂ Masse an Endstufe TEVE" UWORD B_TRUE 1 100 0 1 BIT_MASK 0x200 FORMAT "%13.11" ECU_ADDRESS 0x7F96C4 /end MEASUREMENT
/begin MEASUREMENT B_mnths "Minimaler Wert unterschritten" UWORD B_TRUE 1 100 0 1 BIT_MASK 0x200 FORMAT "%13.11" ECU_ADDRESS 0x7F96C8 /end MEASUREMENT
/begin MEASUREMENT B_mntm "Fehlertyp: Minimalwertunterschreitung Motortemperatur" UWORD B_TRUE 1 100 0 1 BIT_MASK 0x200 FORMAT "%13.11" ECU_ADDRESS 0x7F96CC /end MEASUREMENT
/begin MEASUREMENT B_mntzyl1 "Minimalwert¸berschreitung Kopftemperatur" UWORD B_TRUE 1 100 0 1 BIT_MASK 0x200 FORMAT "%13.11" ECU_ADDRESS 0x7F96D0 /end MEASUREMENT
/begin MEASUREMENT B_mntzyl2 "Minimalwert¸berschreitung Kopftemperatur" UWORD B_TRUE 1 100 0 1 BIT_MASK 0x200 FORMAT "%13.11" ECU_ADDRESS 0x7F96D4 /end MEASUREMENT
/begin MEASUREMENT B_mnu5vg1 "Fehlertyp: Unterspannung Geberversorgung 1" UWORD B_TRUE 1 100 0 1 BIT_MASK 0x200 FORMAT "%13.11" ECU_ADDRESS 0x7F96D8 /end MEASUREMENT
/begin MEASUREMENT B_mnu5vg2 "Fehlertyp: Unterspannung Geberversorgung 2" UWORD B_TRUE 1 100 0 1 BIT_MASK 0x200 FORMAT "%13.11" ECU_ADDRESS 0x7F96DC /end MEASUREMENT
/begin MEASUREMENT B_mnu5vg3 "Fehlertyp: Unterspannung Geberversorgung 3" UWORD B_TRUE 1 100 0 1 BIT_MASK 0x200 FORMAT "%13.11" ECU_ADDRESS 0x7F96E0 /end MEASUREMENT
/begin MEASUREMENT B_mnub "Fehlertyp: Minimalwertunterschreitung Batteriespannung (Bordnetz)" UWORD B_TRUE 1 100 0 1 BIT_MASK 0x200 FORMAT "%13.11" ECU_ADDRESS 0x7F96E4 /end MEASUREMENT
/begin MEASUREMENT B_mnurram "Fehlertyp min.: Rechner¸berwachung: RAM" UWORD B_TRUE 1 100 0 1 BIT_MASK 0x200 FORMAT "%13.11" ECU_ADDRESS 0x7F96E8 /end MEASUREMENT
/begin MEASUREMENT B_mnurrom "Fehlertyp min.: Rechner¸berwachung: ROM" UWORD B_TRUE 1 100 0 1 BIT_MASK 0x200 FORMAT "%13.11" ECU_ADDRESS 0x7F96EC /end MEASUREMENT
/begin MEASUREMENT B_mnurrst "Fehlertyp min.: Rechner¸berwachung: Reset" UWORD B_TRUE 1 100 0 1 BIT_MASK 0x200 FORMAT "%13.11" ECU_ADDRESS 0x7F96F0 /end MEASUREMENT
/begin MEASUREMENT B_mnvfz "Fehlertyp min,: Fahrzeuggeschwindigkeit" UWORD B_TRUE 1 100 0 1 BIT_MASK 0x200 FORMAT "%13.11" ECU_ADDRESS 0x7F96F4 /end MEASUREMENT
/begin MEASUREMENT B_mxbrems "Fehlertyp BREMS (Bremsschalter): Maximalwert ¸berschritten" UWORD B_TRUE 1 100 0 1 BIT_MASK 0x100 FORMAT "%13.11" ECU_ADDRESS 0x7F957C /end MEASUREMENT
/begin MEASUREMENT B_mxdmls "" UWORD B_TRUE 1 100 0 1 BIT_MASK 0x100 FORMAT "%13.11" ECU_ADDRESS 0x7F959C /end MEASUREMENT
/begin MEASUREMENT B_mxdsu "Bedingung: max-Fehler Umgebungsdrucksensor" UWORD B_TRUE 1 100 0 1 BIT_MASK 0x100 FORMAT "%13.11" ECU_ADDRESS 0x7F95A8 /end MEASUREMENT
/begin MEASUREMENT B_mxegfe "Bedingung: MAX-Fehler Eingangsgrˆﬂen F¸llungserfassung" UWORD B_TRUE 1 100 0 1 BIT_MASK 0x100 FORMAT "%13.11" ECU_ADDRESS 0x7F95AC /end MEASUREMENT
/begin MEASUREMENT B_mxfrao "Bedingung obere Plausibilit‰tsschwelle ¸berschritten (obere Multipl.)" UWORD B_TRUE 1 100 0 1 BIT_MASK 0x100 FORMAT "%13.11" ECU_ADDRESS 0x7F95CC /end MEASUREMENT
/begin MEASUREMENT B_mxfrao2 "Bedingung obere Plausibilit‰tsschwelle ¸berschritten (Stereo)" UWORD B_TRUE 1 100 0 1 BIT_MASK 0x100 FORMAT "%13.11" ECU_ADDRESS 0x7F95D0 /end MEASUREMENT
/begin MEASUREMENT B_mxfrau "Bedingung obere Plausiblit‰tsschwelle ¸berschritten (untere Multipl.)" UWORD B_TRUE 1 100 0 1 BIT_MASK 0x100 FORMAT "%13.11" ECU_ADDRESS 0x7F95D4 /end MEASUREMENT
/begin MEASUREMENT B_mxfrau2 "Bedingung obere Plausibilit‰tsschwelle ¸berschritten (mult. 2. Bank)" UWORD B_TRUE 1 100 0 1 BIT_MASK 0x100 FORMAT "%13.11" ECU_ADDRESS 0x7F95D8 /end MEASUREMENT
/begin MEASUREMENT B_mxfrps "" UWORD B_TRUE 1 100 0 1 BIT_MASK 0x100 FORMAT "%13.11" ECU_ADDRESS 0x7F95DC /end MEASUREMENT
/begin MEASUREMENT B_mxfrst "Bedingung obere Plausiblit‰tsschwelle ¸berschritten (short test" UWORD B_TRUE 1 100 0 1 BIT_MASK 0x100 FORMAT "%13.11" ECU_ADDRESS 0x7F95E0 /end MEASUREMENT
/begin MEASUREMENT B_mxfrst2 "Bedingung obere Plausiblit‰tsschwelle ¸berschritten (short test Stereo" UWORD B_TRUE 1 100 0 1 BIT_MASK 0x100 FORMAT "%13.11" ECU_ADDRESS 0x7F95E4 /end MEASUREMENT
/begin MEASUREMENT B_mxgang "Fehlertyp GANG: Maximalwert ¸berschritten" UWORD B_TRUE 1 100 0 1 BIT_MASK 0x100 FORMAT "%13.11" ECU_ADDRESS 0x7F95E8 /end MEASUREMENT
/begin MEASUREMENT B_mxhssekp "" UWORD B_TRUE 1 100 0 1 BIT_MASK 0x100 FORMAT "%13.11" ECU_ADDRESS 0x7F95EC /end MEASUREMENT
/begin MEASUREMENT B_mxhsssys "" UWORD B_TRUE 1 100 0 1 BIT_MASK 0x100 FORMAT "%13.11" ECU_ADDRESS 0x7F95F0 /end MEASUREMENT
/begin MEASUREMENT B_mxhsszdg "" UWORD B_TRUE 1 100 0 1 BIT_MASK 0x100 FORMAT "%13.11" ECU_ADDRESS 0x7F95F4 /end MEASUREMENT
/begin MEASUREMENT B_mxkuppl "Fehlertyp KUPPL: Maximalwert ¸berschritten" UWORD B_TRUE 1 100 0 1 BIT_MASK 0x100 FORMAT "%13.11" ECU_ADDRESS 0x7F9628 /end MEASUREMENT
/begin MEASUREMENT B_mxlatp "Fehlertyp 'Maximalwert' f¸r Periodendauer-Pr¸fung vor KAT erkannt" UWORD B_TRUE 1 100 0 1 BIT_MASK 0x100 FORMAT "%13.11" ECU_ADDRESS 0x7F962C /end MEASUREMENT
/begin MEASUREMENT B_mxlatp2 "Fehlertyp 'Maximalwert' f¸r Periodendauer-Pr¸fung vor KAT erkannt Bank2" UWORD B_TRUE 1 100 0 1 BIT_MASK 0x100 FORMAT "%13.11" ECU_ADDRESS 0x7F9630 /end MEASUREMENT
/begin MEASUREMENT B_mxlatv "Fehlertyp 'Maximalwert' f¸r ATV-Pr¸fung vor KAT erkannt" UWORD B_TRUE 1 100 0 1 BIT_MASK 0x100 FORMAT "%13.11" ECU_ADDRESS 0x7F9634 /end MEASUREMENT
/begin MEASUREMENT B_mxlatv2 "Fehlertyp 'Maximalwert' f¸r ATV-Pr¸fung vor KAT erkannt Bank2" UWORD B_TRUE 1 100 0 1 BIT_MASK 0x100 FORMAT "%13.11" ECU_ADDRESS 0x7F9638 /end MEASUREMENT
/begin MEASUREMENT B_mxllr "Fehler 'Leerlaufdrehzahl zu groﬂ'" UWORD B_TRUE 1 100 0 1 BIT_MASK 0x100 FORMAT "%13.11" ECU_ADDRESS 0x7F963C /end MEASUREMENT
/begin MEASUREMENT B_mxlshv1e "Fehlerart: Kurzschluﬂ UBat an Endstufe LSHVK1E" UWORD B_TRUE 1 100 0 1 BIT_MASK 0x100 FORMAT "%13.11" ECU_ADDRESS 0x7F9640 /end MEASUREMENT
/begin MEASUREMENT B_mxlshv2e "Fehlerart: Kurzschluﬂ UBat an Endstufe LSHVK2E" UWORD B_TRUE 1 100 0 1 BIT_MASK 0x100 FORMAT "%13.11" ECU_ADDRESS 0x7F9644 /end MEASUREMENT
/begin MEASUREMENT B_mxlsv "Fehlertyp 'Maximalwert' vor KAT erkannt" UWORD B_TRUE 1 100 0 1 BIT_MASK 0x100 FORMAT "%13.11" ECU_ADDRESS 0x7F9648 /end MEASUREMENT
/begin MEASUREMENT B_mxlsv2 "Fehlertyp 'Maximalwert' vor KAT erkannt Bank2" UWORD B_TRUE 1 100 0 1 BIT_MASK 0x100 FORMAT "%13.11" ECU_ADDRESS 0x7F964C /end MEASUREMENT
/begin MEASUREMENT B_mxos "" UWORD B_TRUE 1 100 0 1 BIT_MASK 0x100 FORMAT "%13.11" ECU_ADDRESS 0x7F9658 /end MEASUREMENT
/begin MEASUREMENT B_mxph "Fehlerart: Kurzschluﬂ Ubat Phasengeber" UWORD B_TRUE 1 100 0 1 BIT_MASK 0x100 FORMAT "%13.11" ECU_ADDRESS 0x7F965C /end MEASUREMENT
/begin MEASUREMENT B_mxphw "" UWORD B_TRUE 1 100 0 1 BIT_MASK 0x100 FORMAT "%13.11" ECU_ADDRESS 0x7F9660 /end MEASUREMENT
/begin MEASUREMENT B_mxradv "" UWORD B_TRUE 1 100 0 1 BIT_MASK 0x100 FORMAT "%13.11" ECU_ADDRESS 0x7F9664 /end MEASUREMENT
/begin MEASUREMENT B_mxrkat "Bedingung obere Plausibilit‰tsschwelle ¸berschritten (add. pro Zeit)" UWORD B_TRUE 1 100 0 1 BIT_MASK 0x100 FORMAT "%13.11" ECU_ADDRESS 0x7F9668 /end MEASUREMENT
/begin MEASUREMENT B_mxrkat2 "Bedingung obere Plausibilit‰tsschwelle ¸berschritten (Stereo)" UWORD B_TRUE 1 100 0 1 BIT_MASK 0x100 FORMAT "%13.11" ECU_ADDRESS 0x7F966C /end MEASUREMENT
/begin MEASUREMENT B_mxrkaz "Bedingung obere Plausibilit‰tsschwelle ¸berschritten (add. pro Z¸ndung)" UWORD B_TRUE 1 100 0 1 BIT_MASK 0x100 FORMAT "%13.11" ECU_ADDRESS 0x7F9670 /end MEASUREMENT
/begin MEASUREMENT B_mxrkaz2 "Bedingung obere Plausibilit‰tsschwelle ¸berschritten (Stereo)" UWORD B_TRUE 1 100 0 1 BIT_MASK 0x100 FORMAT "%13.11" ECU_ADDRESS 0x7F9674 /end MEASUREMENT
/begin MEASUREMENT B_mxsikoda "" UWORD B_TRUE 1 100 0 1 BIT_MASK 0x100 FORMAT "%13.11" ECU_ADDRESS 0x7F9678 /end MEASUREMENT
/begin MEASUREMENT B_mxsld "" UWORD B_TRUE 1 100 0 1 BIT_MASK 0x100 FORMAT "%13.11" ECU_ADDRESS 0x7F967C /end MEASUREMENT
/begin MEASUREMENT B_mxsls "Fehlerart:Sekund‰rluftsystem" UWORD B_TRUE 1 100 0 1 BIT_MASK 0x100 FORMAT "%13.11" ECU_ADDRESS 0x7F9680 /end MEASUREMENT
/begin MEASUREMENT B_mxsls2 "Fehlerart:Sekund‰rluftsystem Bank 2" UWORD B_TRUE 1 100 0 1 BIT_MASK 0x100 FORMAT "%13.11" ECU_ADDRESS 0x7F9684 /end MEASUREMENT
/begin MEASUREMENT B_mxslv "Fehlerart: Sekund‰rluftmasse bei Ventildichtheitspr¸fung zu groﬂ" UWORD B_TRUE 1 100 0 1 BIT_MASK 0x100 FORMAT "%13.11" ECU_ADDRESS 0x7F9688 /end MEASUREMENT
/begin MEASUREMENT B_mxslv1e "Fehlerart: Kurzschluﬂ UBat an Endstufe SLV1E" UWORD B_TRUE 1 100 0 1 BIT_MASK 0x100 FORMAT "%13.11" ECU_ADDRESS 0x7F968C /end MEASUREMENT
/begin MEASUREMENT B_mxslv2 "Fehlerart: Sekund‰rluftmasse bei Ventildichtheitspr¸fung zu groﬂ, Bank 2" UWORD B_TRUE 1 100 0 1 BIT_MASK 0x100 FORMAT "%13.11" ECU_ADDRESS 0x7F9690 /end MEASUREMENT
/begin MEASUREMENT B_mxslv2e "Fehlerart: Kurzschluﬂ UBat an Endstufe SLV2E" UWORD B_TRUE 1 100 0 1 BIT_MASK 0x100 FORMAT "%13.11" ECU_ADDRESS 0x7F9694 /end MEASUREMENT
/begin MEASUREMENT B_mxsst "Fehlertyp max.: Diagnose Seitenstuetzenschalter" UWORD B_TRUE 1 100 0 1 BIT_MASK 0x100 FORMAT "%13.11" ECU_ADDRESS 0x7F9698 /end MEASUREMENT
/begin MEASUREMENT B_mxsst2e "" UWORD B_TRUE 1 100 0 1 BIT_MASK 0x100 FORMAT "%13.11" ECU_ADDRESS 0x7F969C /end MEASUREMENT
/begin MEASUREMENT B_mxstarte "Fehlerart: Kurzschluﬂ UBat an Endstufe STARTE" UWORD B_TRUE 1 100 0 1 BIT_MASK 0x100 FORMAT "%13.11" ECU_ADDRESS 0x7F96A0 /end MEASUREMENT
/begin MEASUREMENT B_mxstp1 "" UWORD B_TRUE 1 100 0 1 BIT_MASK 0x100 FORMAT "%13.11" ECU_ADDRESS 0x7F96A4 /end MEASUREMENT
/begin MEASUREMENT B_mxstp2 "" UWORD B_TRUE 1 100 0 1 BIT_MASK 0x100 FORMAT "%13.11" ECU_ADDRESS 0x7F96A8 /end MEASUREMENT
/begin MEASUREMENT B_mxta "Fehlertyp: Maximalwert¸berschreitung Ansauglufttemperatur TANS" UWORD B_TRUE 1 100 0 1 BIT_MASK 0x100 FORMAT "%13.11" ECU_ADDRESS 0x7F96AC /end MEASUREMENT
/begin MEASUREMENT B_mxtcj945 "Fehlertyp: ‹bertemperatur CJ945" UWORD B_TRUE 1 100 0 1 BIT_MASK 0x100 FORMAT "%13.11" ECU_ADDRESS 0x7F96B0 /end MEASUREMENT
/begin MEASUREMENT B_mxtcy315 "Fehlertyp: ‹bertemperatur CY315" UWORD B_TRUE 1 100 0 1 BIT_MASK 0x100 FORMAT "%13.11" ECU_ADDRESS 0x7F96B4 /end MEASUREMENT
/begin MEASUREMENT B_mxtde "" UWORD B_TRUE 1 100 0 1 BIT_MASK 0x100 FORMAT "%13.11" ECU_ADDRESS 0x7F96B8 /end MEASUREMENT
/begin MEASUREMENT B_mxteve "Fehlerart: Kurzschluﬂ UBat an Endstufe TEVE" UWORD B_TRUE 1 100 0 1 BIT_MASK 0x100 FORMAT "%13.11" ECU_ADDRESS 0x7F96C4 /end MEASUREMENT
/begin MEASUREMENT B_mxths "Maximaler Wert ‹berschritten" UWORD B_TRUE 1 100 0 1 BIT_MASK 0x100 FORMAT "%13.11" ECU_ADDRESS 0x7F96C8 /end MEASUREMENT
/begin MEASUREMENT B_mxtm "Fehlertyp: Maximalwert¸berschreitung Motortemperatur" UWORD B_TRUE 1 100 0 1 BIT_MASK 0x100 FORMAT "%13.11" ECU_ADDRESS 0x7F96CC /end MEASUREMENT
/begin MEASUREMENT B_mxtzyl1 "Maximalwert¸berschreitung Kopftemperatur" UWORD B_TRUE 1 100 0 1 BIT_MASK 0x100 FORMAT "%13.11" ECU_ADDRESS 0x7F96D0 /end MEASUREMENT
/begin MEASUREMENT B_mxtzyl2 "Maximalwert¸berschreitung Kopftemperatur" UWORD B_TRUE 1 100 0 1 BIT_MASK 0x100 FORMAT "%13.11" ECU_ADDRESS 0x7F96D4 /end MEASUREMENT
/begin MEASUREMENT B_mxu5vg1 "Fehlertyp: ‹berspannung Geberversorgung 1" UWORD B_TRUE 1 100 0 1 BIT_MASK 0x100 FORMAT "%13.11" ECU_ADDRESS 0x7F96D8 /end MEASUREMENT
/begin MEASUREMENT B_mxu5vg2 "Fehlertyp: ‹berspannung Geberversorgung 2" UWORD B_TRUE 1 100 0 1 BIT_MASK 0x100 FORMAT "%13.11" ECU_ADDRESS 0x7F96DC /end MEASUREMENT
/begin MEASUREMENT B_mxu5vg3 "Fehlertyp: ‹berspannung Geberversorgung 3" UWORD B_TRUE 1 100 0 1 BIT_MASK 0x100 FORMAT "%13.11" ECU_ADDRESS 0x7F96E0 /end MEASUREMENT
/begin MEASUREMENT B_mxub "Fehlertyp: Maximalwert¸berschreitung Batteriespannung (Bordnetz)" UWORD B_TRUE 1 100 0 1 BIT_MASK 0x100 FORMAT "%13.11" ECU_ADDRESS 0x7F96E4 /end MEASUREMENT
/begin MEASUREMENT B_mxurram "Fehlertyp max.: Rechner¸berwachung: RAM" UWORD B_TRUE 1 100 0 1 BIT_MASK 0x100 FORMAT "%13.11" ECU_ADDRESS 0x7F96E8 /end MEASUREMENT
/begin MEASUREMENT B_mxurrom "Fehlertyp max.: Rechner¸berwachung: ROM" UWORD B_TRUE 1 100 0 1 BIT_MASK 0x100 FORMAT "%13.11" ECU_ADDRESS 0x7F96EC /end MEASUREMENT
/begin MEASUREMENT B_mxurrst "Fehlertyp max.: Rechner¸berwachung: Reset" UWORD B_TRUE 1 100 0 1 BIT_MASK 0x100 FORMAT "%13.11" ECU_ADDRESS 0x7F96F0 /end MEASUREMENT
/begin MEASUREMENT B_mxvfz "Fehlertyp max.: Fahrzeuggeschwindigkeit" UWORD B_TRUE 1 100 0 1 BIT_MASK 0x100 FORMAT "%13.11" ECU_ADDRESS 0x7F96F4 /end MEASUREMENT
/begin MEASUREMENT B_npbrems "Fehlertyp BREMS (Bremsschalter): Pr¸fresultat nicht plausibel" UWORD B_TRUE 1 100 0 1 BIT_MASK 0x800 FORMAT "%13.11" ECU_ADDRESS 0x7F957C /end MEASUREMENT
/begin MEASUREMENT B_npdmls "" UWORD B_TRUE 1 100 0 1 BIT_MASK 0x800 FORMAT "%13.11" ECU_ADDRESS 0x7F959C /end MEASUREMENT
/begin MEASUREMENT B_npdsu "Bedingung: Umgebungsdrucksensor nicht plausibel" UWORD B_TRUE 1 100 0 1 BIT_MASK 0x800 FORMAT "%13.11" ECU_ADDRESS 0x7F95A8 /end MEASUREMENT
/begin MEASUREMENT B_npegfe "Bedingung: unplausibler Wert bei den Eingangsgrˆﬂen der F¸llungserfassung" UWORD B_TRUE 1 100 0 1 BIT_MASK 0x800 FORMAT "%13.11" ECU_ADDRESS 0x7F95AC /end MEASUREMENT
/begin MEASUREMENT B_npfrao "Bedingung FRAO ist unplausibel" UWORD B_TRUE 1 100 0 1 BIT_MASK 0x800 FORMAT "%13.11" ECU_ADDRESS 0x7F95CC /end MEASUREMENT
/begin MEASUREMENT B_npfrao2 "Bedingung FRAO ist unplausibel Bank 2" UWORD B_TRUE 1 100 0 1 BIT_MASK 0x800 FORMAT "%13.11" ECU_ADDRESS 0x7F95D0 /end MEASUREMENT
/begin MEASUREMENT B_npfrau "Bedingung FRAU ist unplausibel" UWORD B_TRUE 1 100 0 1 BIT_MASK 0x800 FORMAT "%13.11" ECU_ADDRESS 0x7F95D4 /end MEASUREMENT
/begin MEASUREMENT B_npfrau2 "Bedingung FRAU ist unplausibel Bank 2" UWORD B_TRUE 1 100 0 1 BIT_MASK 0x800 FORMAT "%13.11" ECU_ADDRESS 0x7F95D8 /end MEASUREMENT
/begin MEASUREMENT B_npfrps "" UWORD B_TRUE 1 100 0 1 BIT_MASK 0x800 FORMAT "%13.11" ECU_ADDRESS 0x7F95DC /end MEASUREMENT
/begin MEASUREMENT B_npfrst "Fehlertyp 'unplausibles Pr¸fresultat' erkannt (DKVS Kurztest)" UWORD B_TRUE 1 100 0 1 BIT_MASK 0x800 FORMAT "%13.11" ECU_ADDRESS 0x7F95E0 /end MEASUREMENT
/begin MEASUREMENT B_npfrst2 "Fehlertyp 'unplausibles Pr¸fresultat' erkannt (DKVS Kurztest Bank 2)" UWORD B_TRUE 1 100 0 1 BIT_MASK 0x800 FORMAT "%13.11" ECU_ADDRESS 0x7F95E4 /end MEASUREMENT
/begin MEASUREMENT B_npgang "Fehlertyp GANG: Pr¸fresultat nicht plausibel" UWORD B_TRUE 1 100 0 1 BIT_MASK 0x800 FORMAT "%13.11" ECU_ADDRESS 0x7F95E8 /end MEASUREMENT
/begin MEASUREMENT B_nphssekp "" UWORD B_TRUE 1 100 0 1 BIT_MASK 0x800 FORMAT "%13.11" ECU_ADDRESS 0x7F95EC /end MEASUREMENT
/begin MEASUREMENT B_nphsssys "" UWORD B_TRUE 1 100 0 1 BIT_MASK 0x800 FORMAT "%13.11" ECU_ADDRESS 0x7F95F0 /end MEASUREMENT
/begin MEASUREMENT B_nphsszdg "" UWORD B_TRUE 1 100 0 1 BIT_MASK 0x800 FORMAT "%13.11" ECU_ADDRESS 0x7F95F4 /end MEASUREMENT
/begin MEASUREMENT B_npkuppl "Fehlertyp KUPPL: Pr¸fresultat nicht plausibel" UWORD B_TRUE 1 100 0 1 BIT_MASK 0x800 FORMAT "%13.11" ECU_ADDRESS 0x7F9628 /end MEASUREMENT
/begin MEASUREMENT B_nplatp "" UWORD B_TRUE 1 100 0 1 BIT_MASK 0x800 FORMAT "%13.11" ECU_ADDRESS 0x7F962C /end MEASUREMENT
/begin MEASUREMENT B_nplatp2 "" UWORD B_TRUE 1 100 0 1 BIT_MASK 0x800 FORMAT "%13.11" ECU_ADDRESS 0x7F9630 /end MEASUREMENT
/begin MEASUREMENT B_nplatv "" UWORD B_TRUE 1 100 0 1 BIT_MASK 0x800 FORMAT "%13.11" ECU_ADDRESS 0x7F9634 /end MEASUREMENT
/begin MEASUREMENT B_nplatv2 "" UWORD B_TRUE 1 100 0 1 BIT_MASK 0x800 FORMAT "%13.11" ECU_ADDRESS 0x7F9638 /end MEASUREMENT
/begin MEASUREMENT B_npllr "Nicht plausibler Fehler: Leerlaufregelung" UWORD B_TRUE 1 100 0 1 BIT_MASK 0x800 FORMAT "%13.11" ECU_ADDRESS 0x7F963C /end MEASUREMENT
/begin MEASUREMENT B_nplshv1e "Fehlerart: Zustand nicht plausibel LSHVK1E" UWORD B_TRUE 1 100 0 1 BIT_MASK 0x800 FORMAT "%13.11" ECU_ADDRESS 0x7F9640 /end MEASUREMENT
/begin MEASUREMENT B_nplshv2e "Fehlerart: Zustand nicht plausibel LSHVK2E" UWORD B_TRUE 1 100 0 1 BIT_MASK 0x800 FORMAT "%13.11" ECU_ADDRESS 0x7F9644 /end MEASUREMENT
/begin MEASUREMENT B_nplsv "Fehlertyp 'Wert unplausibel' erkannt" UWORD B_TRUE 1 100 0 1 BIT_MASK 0x800 FORMAT "%13.11" ECU_ADDRESS 0x7F9648 /end MEASUREMENT
/begin MEASUREMENT B_nplsv2 "Fehlertyp 'Wert unplausibel' erkannt Bank2" UWORD B_TRUE 1 100 0 1 BIT_MASK 0x800 FORMAT "%13.11" ECU_ADDRESS 0x7F964C /end MEASUREMENT
/begin MEASUREMENT B_npos "" UWORD B_TRUE 1 100 0 1 BIT_MASK 0x800 FORMAT "%13.11" ECU_ADDRESS 0x7F9658 /end MEASUREMENT
/begin MEASUREMENT B_npph "Bedingung Phasengebersignal ist unplausibel (ph)" UWORD B_TRUE 1 100 0 1 BIT_MASK 0x800 FORMAT "%13.11" ECU_ADDRESS 0x7F965C /end MEASUREMENT
/begin MEASUREMENT B_npphw "" UWORD B_TRUE 1 100 0 1 BIT_MASK 0x800 FORMAT "%13.11" ECU_ADDRESS 0x7F9660 /end MEASUREMENT
/begin MEASUREMENT B_npradv "" UWORD B_TRUE 1 100 0 1 BIT_MASK 0x800 FORMAT "%13.11" ECU_ADDRESS 0x7F9664 /end MEASUREMENT
/begin MEASUREMENT B_nprkat "Bedingung RKAT ist unplausibel" UWORD B_TRUE 1 100 0 1 BIT_MASK 0x800 FORMAT "%13.11" ECU_ADDRESS 0x7F9668 /end MEASUREMENT
/begin MEASUREMENT B_nprkat2 "Bedingung RKAT ist unplausibel Bank 2" UWORD B_TRUE 1 100 0 1 BIT_MASK 0x800 FORMAT "%13.11" ECU_ADDRESS 0x7F966C /end MEASUREMENT
/begin MEASUREMENT B_nprkaz "Bedingung RKAZ ist unplausibel" UWORD B_TRUE 1 100 0 1 BIT_MASK 0x800 FORMAT "%13.11" ECU_ADDRESS 0x7F9670 /end MEASUREMENT
/begin MEASUREMENT B_nprkaz2 "Bedingung RKAZ ist unplausibel Bank 2" UWORD B_TRUE 1 100 0 1 BIT_MASK 0x800 FORMAT "%13.11" ECU_ADDRESS 0x7F9674 /end MEASUREMENT
/begin MEASUREMENT B_npsikoda "" UWORD B_TRUE 1 100 0 1 BIT_MASK 0x800 FORMAT "%13.11" ECU_ADDRESS 0x7F9678 /end MEASUREMENT
/begin MEASUREMENT B_npsld "" UWORD B_TRUE 1 100 0 1 BIT_MASK 0x800 FORMAT "%13.11" ECU_ADDRESS 0x7F967C /end MEASUREMENT
/begin MEASUREMENT B_npsls "Fehlerart: Offsetwert Sekund‰rluftmasse zu groﬂ" UWORD B_TRUE 1 100 0 1 BIT_MASK 0x800 FORMAT "%13.11" ECU_ADDRESS 0x7F9680 /end MEASUREMENT
/begin MEASUREMENT B_npsls2 "Fehlerart: Offsetwert Sekund‰rluftmasse zu groﬂ, Bank 2" UWORD B_TRUE 1 100 0 1 BIT_MASK 0x800 FORMAT "%13.11" ECU_ADDRESS 0x7F9684 /end MEASUREMENT
/begin MEASUREMENT B_npslv "Fehlerart: Offsetwert Sekund‰rluftmasse zu groﬂ" UWORD B_TRUE 1 100 0 1 BIT_MASK 0x800 FORMAT "%13.11" ECU_ADDRESS 0x7F9688 /end MEASUREMENT
/begin MEASUREMENT B_npslv1e "Fehlerart: Zustand nicht plausibel SLV1E" UWORD B_TRUE 1 100 0 1 BIT_MASK 0x800 FORMAT "%13.11" ECU_ADDRESS 0x7F968C /end MEASUREMENT
/begin MEASUREMENT B_npslv2 "Fehlerart: Offsetwert Sekund‰rluftmasse zu groﬂ, Bank 2" UWORD B_TRUE 1 100 0 1 BIT_MASK 0x800 FORMAT "%13.11" ECU_ADDRESS 0x7F9690 /end MEASUREMENT
/begin MEASUREMENT B_npslv2e "Fehlerart: Zustand nicht plausibel SLV2E" UWORD B_TRUE 1 100 0 1 BIT_MASK 0x800 FORMAT "%13.11" ECU_ADDRESS 0x7F9694 /end MEASUREMENT
/begin MEASUREMENT B_npsst "Fehlerart:Diagnose Seitenstuetzenschalter" UWORD B_TRUE 1 100 0 1 BIT_MASK 0x800 FORMAT "%13.11" ECU_ADDRESS 0x7F9698 /end MEASUREMENT
/begin MEASUREMENT B_npsst2e "" UWORD B_TRUE 1 100 0 1 BIT_MASK 0x800 FORMAT "%13.11" ECU_ADDRESS 0x7F969C /end MEASUREMENT
/begin MEASUREMENT B_npstarte "Fehlerart: Zustand nicht plausibel STARTE" UWORD B_TRUE 1 100 0 1 BIT_MASK 0x800 FORMAT "%13.11" ECU_ADDRESS 0x7F96A0 /end MEASUREMENT
/begin MEASUREMENT B_npstp1 "" UWORD B_TRUE 1 100 0 1 BIT_MASK 0x800 FORMAT "%13.11" ECU_ADDRESS 0x7F96A4 /end MEASUREMENT
/begin MEASUREMENT B_npstp2 "" UWORD B_TRUE 1 100 0 1 BIT_MASK 0x800 FORMAT "%13.11" ECU_ADDRESS 0x7F96A8 /end MEASUREMENT
/begin MEASUREMENT B_npta "Fehlertyp unplaus.: Ansauglufttemperatur TANS (-Ladeluft)" UWORD B_TRUE 1 100 0 1 BIT_MASK 0x800 FORMAT "%13.11" ECU_ADDRESS 0x7F96AC /end MEASUREMENT
/begin MEASUREMENT B_nptcj945 "Fehlertyp:" UWORD B_TRUE 1 100 0 1 BIT_MASK 0x800 FORMAT "%13.11" ECU_ADDRESS 0x7F96B0 /end MEASUREMENT
/begin MEASUREMENT B_nptcy315 "Fehlertyp:" UWORD B_TRUE 1 100 0 1 BIT_MASK 0x800 FORMAT "%13.11" ECU_ADDRESS 0x7F96B4 /end MEASUREMENT
/begin MEASUREMENT B_nptde "" UWORD B_TRUE 1 100 0 1 BIT_MASK 0x800 FORMAT "%13.11" ECU_ADDRESS 0x7F96B8 /end MEASUREMENT
/begin MEASUREMENT B_npteve "Fehlerart: Zustand nicht plausibel TEVE" UWORD B_TRUE 1 100 0 1 BIT_MASK 0x800 FORMAT "%13.11" ECU_ADDRESS 0x7F96C4 /end MEASUREMENT
/begin MEASUREMENT B_npths "Signal unplausibel" UWORD B_TRUE 1 100 0 1 BIT_MASK 0x800 FORMAT "%13.11" ECU_ADDRESS 0x7F96C8 /end MEASUREMENT
/begin MEASUREMENT B_nptm "Fehlerart: Motortemperatursignal nicht plausibel gg¸. Modell" UWORD B_TRUE 1 100 0 1 BIT_MASK 0x800 FORMAT "%13.11" ECU_ADDRESS 0x7F96CC /end MEASUREMENT
/begin MEASUREMENT B_nptzyl1 "Fehler Kopftemperatur nicht plausiebel" UWORD B_TRUE 1 100 0 1 BIT_MASK 0x800 FORMAT "%13.11" ECU_ADDRESS 0x7F96D0 /end MEASUREMENT
/begin MEASUREMENT B_nptzyl2 "Fehler Kopftemperatur nicht plausiebel" UWORD B_TRUE 1 100 0 1 BIT_MASK 0x800 FORMAT "%13.11" ECU_ADDRESS 0x7F96D4 /end MEASUREMENT
/begin MEASUREMENT B_npu5vg1 "Fehlertyp:" UWORD B_TRUE 1 100 0 1 BIT_MASK 0x800 FORMAT "%13.11" ECU_ADDRESS 0x7F96D8 /end MEASUREMENT
/begin MEASUREMENT B_npu5vg2 "Fehlertyp:" UWORD B_TRUE 1 100 0 1 BIT_MASK 0x800 FORMAT "%13.11" ECU_ADDRESS 0x7F96DC /end MEASUREMENT
/begin MEASUREMENT B_npu5vg3 "Fehlertyp:" UWORD B_TRUE 1 100 0 1 BIT_MASK 0x800 FORMAT "%13.11" ECU_ADDRESS 0x7F96E0 /end MEASUREMENT
/begin MEASUREMENT B_npub "Fehlerart: Batteriespannungssignal nicht plausibel" UWORD B_TRUE 1 100 0 1 BIT_MASK 0x800 FORMAT "%13.11" ECU_ADDRESS 0x7F96E4 /end MEASUREMENT
/begin MEASUREMENT B_npurram "Fehlertyp unplaus: Rechner¸berwachung: RAM" UWORD B_TRUE 1 100 0 1 BIT_MASK 0x800 FORMAT "%13.11" ECU_ADDRESS 0x7F96E8 /end MEASUREMENT
/begin MEASUREMENT B_npurrom "Fehlertyp unplaus.: Rechner¸berwachung: ROM" UWORD B_TRUE 1 100 0 1 BIT_MASK 0x800 FORMAT "%13.11" ECU_ADDRESS 0x7F96EC /end MEASUREMENT
/begin MEASUREMENT B_npurrst "Fehlertyp unplaus: Rechner¸berwachung: Reset" UWORD B_TRUE 1 100 0 1 BIT_MASK 0x800 FORMAT "%13.11" ECU_ADDRESS 0x7F96F0 /end MEASUREMENT
/begin MEASUREMENT B_npvfz "Fehlerart: Fahrzeuggeschwindigkeit nicht plausibel" UWORD B_TRUE 1 100 0 1 BIT_MASK 0x800 FORMAT "%13.11" ECU_ADDRESS 0x7F96F4 /end MEASUREMENT
/begin MEASUREMENT B_sibrems "Fehlertyp BREMS (Bremsschalter): Signal inaktiv" UWORD B_TRUE 1 100 0 1 BIT_MASK 0x400 FORMAT "%13.11" ECU_ADDRESS 0x7F957C /end MEASUREMENT
/begin MEASUREMENT B_sidmls "" UWORD B_TRUE 1 100 0 1 BIT_MASK 0x400 FORMAT "%13.11" ECU_ADDRESS 0x7F959C /end MEASUREMENT
/begin MEASUREMENT B_sidsu "Fehlerart: Umgebungsdrucksensor" UWORD B_TRUE 1 100 0 1 BIT_MASK 0x400 FORMAT "%13.11" ECU_ADDRESS 0x7F95A8 /end MEASUREMENT
/begin MEASUREMENT B_siegfe "Bedingung: Signal Fehler bei den Eingangsgrˆﬂen der F¸llungserfassung" UWORD B_TRUE 1 100 0 1 BIT_MASK 0x400 FORMAT "%13.11" ECU_ADDRESS 0x7F95AC /end MEASUREMENT
/begin MEASUREMENT B_sifrao "Fehlertyp 'Signal fehlt' for FRAO erkannt" UWORD B_TRUE 1 100 0 1 BIT_MASK 0x400 FORMAT "%13.11" ECU_ADDRESS 0x7F95CC /end MEASUREMENT
/begin MEASUREMENT B_sifrao2 "Fehlertyp 'Signal fehlt' for FRAO erkannt Bank 2" UWORD B_TRUE 1 100 0 1 BIT_MASK 0x400 FORMAT "%13.11" ECU_ADDRESS 0x7F95D0 /end MEASUREMENT
/begin MEASUREMENT B_sifrau "Fehlertyp 'Signal fehlt' f¸r FRAU erkannt" UWORD B_TRUE 1 100 0 1 BIT_MASK 0x400 FORMAT "%13.11" ECU_ADDRESS 0x7F95D4 /end MEASUREMENT
/begin MEASUREMENT B_sifrau2 "Fehlertyp 'Signal fehlt' f¸r FRAU erkannt Bank 2" UWORD B_TRUE 1 100 0 1 BIT_MASK 0x400 FORMAT "%13.11" ECU_ADDRESS 0x7F95D8 /end MEASUREMENT
/begin MEASUREMENT B_sifrps "" UWORD B_TRUE 1 100 0 1 BIT_MASK 0x400 FORMAT "%13.11" ECU_ADDRESS 0x7F95DC /end MEASUREMENT
/begin MEASUREMENT B_sifrst "Fehlerart: LR-Abweichung" UWORD B_TRUE 1 100 0 1 BIT_MASK 0x400 FORMAT "%13.11" ECU_ADDRESS 0x7F95E0 /end MEASUREMENT
/begin MEASUREMENT B_sifrst2 "Fehlerart: LR-Abweichung Bank 2" UWORD B_TRUE 1 100 0 1 BIT_MASK 0x400 FORMAT "%13.11" ECU_ADDRESS 0x7F95E4 /end MEASUREMENT
/begin MEASUREMENT B_sigang "Fehlertyp GANG: Signal inaktiv" UWORD B_TRUE 1 100 0 1 BIT_MASK 0x400 FORMAT "%13.11" ECU_ADDRESS 0x7F95E8 /end MEASUREMENT
/begin MEASUREMENT B_sihssekp "" UWORD B_TRUE 1 100 0 1 BIT_MASK 0x400 FORMAT "%13.11" ECU_ADDRESS 0x7F95EC /end MEASUREMENT
/begin MEASUREMENT B_sihsssys "" UWORD B_TRUE 1 100 0 1 BIT_MASK 0x400 FORMAT "%13.11" ECU_ADDRESS 0x7F95F0 /end MEASUREMENT
/begin MEASUREMENT B_sihsszdg "" UWORD B_TRUE 1 100 0 1 BIT_MASK 0x400 FORMAT "%13.11" ECU_ADDRESS 0x7F95F4 /end MEASUREMENT
/begin MEASUREMENT B_sikuppl "Fehlertyp KUPPL: Signal inaktiv" UWORD B_TRUE 1 100 0 1 BIT_MASK 0x400 FORMAT "%13.11" ECU_ADDRESS 0x7F9628 /end MEASUREMENT
/begin MEASUREMENT B_silatp "" UWORD B_TRUE 1 100 0 1 BIT_MASK 0x400 FORMAT "%13.11" ECU_ADDRESS 0x7F962C /end MEASUREMENT
/begin MEASUREMENT B_silatp2 "" UWORD B_TRUE 1 100 0 1 BIT_MASK 0x400 FORMAT "%13.11" ECU_ADDRESS 0x7F9630 /end MEASUREMENT
/begin MEASUREMENT B_silatv "" UWORD B_TRUE 1 100 0 1 BIT_MASK 0x400 FORMAT "%13.11" ECU_ADDRESS 0x7F9634 /end MEASUREMENT
/begin MEASUREMENT B_silatv2 "" UWORD B_TRUE 1 100 0 1 BIT_MASK 0x400 FORMAT "%13.11" ECU_ADDRESS 0x7F9638 /end MEASUREMENT
/begin MEASUREMENT B_sillr "Fehlertyp: Leerlaufregelung" UWORD B_TRUE 1 100 0 1 BIT_MASK 0x400 FORMAT "%13.11" ECU_ADDRESS 0x7F963C /end MEASUREMENT
/begin MEASUREMENT B_silshv1e "Fehlerart: Unterbrechung an Endstufe LSHVK1E" UWORD B_TRUE 1 100 0 1 BIT_MASK 0x400 FORMAT "%13.11" ECU_ADDRESS 0x7F9640 /end MEASUREMENT
/begin MEASUREMENT B_silshv2e "Fehlerart: Unterbrechung an Endstufe LSHVK2E" UWORD B_TRUE 1 100 0 1 BIT_MASK 0x400 FORMAT "%13.11" ECU_ADDRESS 0x7F9644 /end MEASUREMENT
/begin MEASUREMENT B_silsv "Fehlertyp 'Signal fehlt' vor KAT erkannt" UWORD B_TRUE 1 100 0 1 BIT_MASK 0x400 FORMAT "%13.11" ECU_ADDRESS 0x7F9648 /end MEASUREMENT
/begin MEASUREMENT B_silsv2 "Fehlertyp 'Signal fehlt' vor KAT erkannt Bank2" UWORD B_TRUE 1 100 0 1 BIT_MASK 0x400 FORMAT "%13.11" ECU_ADDRESS 0x7F964C /end MEASUREMENT
/begin MEASUREMENT B_sios "" UWORD B_TRUE 1 100 0 1 BIT_MASK 0x400 FORMAT "%13.11" ECU_ADDRESS 0x7F9658 /end MEASUREMENT
/begin MEASUREMENT B_siph "Bedingung keine alternierende Phasenpegel PG in den Bezugsmarken" UWORD B_TRUE 1 100 0 1 BIT_MASK 0x400 FORMAT "%13.11" ECU_ADDRESS 0x7F965C /end MEASUREMENT
/begin MEASUREMENT B_siphw "" UWORD B_TRUE 1 100 0 1 BIT_MASK 0x400 FORMAT "%13.11" ECU_ADDRESS 0x7F9660 /end MEASUREMENT
/begin MEASUREMENT B_siradv "" UWORD B_TRUE 1 100 0 1 BIT_MASK 0x400 FORMAT "%13.11" ECU_ADDRESS 0x7F9664 /end MEASUREMENT
/begin MEASUREMENT B_sirkat "Fehlertyp 'Signal fehlt' for RKAT erkannt" UWORD B_TRUE 1 100 0 1 BIT_MASK 0x400 FORMAT "%13.11" ECU_ADDRESS 0x7F9668 /end MEASUREMENT
/begin MEASUREMENT B_sirkat2 "Fehlertyp 'Signal fehlt' for RKAT erkannt Bank 2" UWORD B_TRUE 1 100 0 1 BIT_MASK 0x400 FORMAT "%13.11" ECU_ADDRESS 0x7F966C /end MEASUREMENT
/begin MEASUREMENT B_sirkaz "Fehlertyp 'Signal fehlt' for RKAZ erkannt" UWORD B_TRUE 1 100 0 1 BIT_MASK 0x400 FORMAT "%13.11" ECU_ADDRESS 0x7F9670 /end MEASUREMENT
/begin MEASUREMENT B_sirkaz2 "Fehlertyp 'Signal fehlt' for RKAZ erkannt Bank 2" UWORD B_TRUE 1 100 0 1 BIT_MASK 0x400 FORMAT "%13.11" ECU_ADDRESS 0x7F9674 /end MEASUREMENT
/begin MEASUREMENT B_sisikoda "" UWORD B_TRUE 1 100 0 1 BIT_MASK 0x400 FORMAT "%13.11" ECU_ADDRESS 0x7F9678 /end MEASUREMENT
/begin MEASUREMENT B_sisld "" UWORD B_TRUE 1 100 0 1 BIT_MASK 0x400 FORMAT "%13.11" ECU_ADDRESS 0x7F967C /end MEASUREMENT
/begin MEASUREMENT B_sisls "Fehlertype: Sekund‰rluftsystem" UWORD B_TRUE 1 100 0 1 BIT_MASK 0x400 FORMAT "%13.11" ECU_ADDRESS 0x7F9680 /end MEASUREMENT
/begin MEASUREMENT B_sisls2 "Fehlertyp:Sekund‰rluftsystem Bank 2" UWORD B_TRUE 1 100 0 1 BIT_MASK 0x400 FORMAT "%13.11" ECU_ADDRESS 0x7F9684 /end MEASUREMENT
/begin MEASUREMENT B_sislv "Fehlertyp: Sekund‰rluftventil" UWORD B_TRUE 1 100 0 1 BIT_MASK 0x400 FORMAT "%13.11" ECU_ADDRESS 0x7F9688 /end MEASUREMENT
/begin MEASUREMENT B_sislv1e "Fehlerart: Unterbrechung an Endstufe SLV1E" UWORD B_TRUE 1 100 0 1 BIT_MASK 0x400 FORMAT "%13.11" ECU_ADDRESS 0x7F968C /end MEASUREMENT
/begin MEASUREMENT B_sislv2 "Fehlertyp: Sekund‰rluftventil Bank 2" UWORD B_TRUE 1 100 0 1 BIT_MASK 0x400 FORMAT "%13.11" ECU_ADDRESS 0x7F9690 /end MEASUREMENT
/begin MEASUREMENT B_sislv2e "Fehlerart: Unterbrechung an Endstufe SLV2E" UWORD B_TRUE 1 100 0 1 BIT_MASK 0x400 FORMAT "%13.11" ECU_ADDRESS 0x7F9694 /end MEASUREMENT
/begin MEASUREMENT B_sisst "Signalfehler Diagnose Seitenstuetzenschalter" UWORD B_TRUE 1 100 0 1 BIT_MASK 0x400 FORMAT "%13.11" ECU_ADDRESS 0x7F9698 /end MEASUREMENT
/begin MEASUREMENT B_sisst2e "" UWORD B_TRUE 1 100 0 1 BIT_MASK 0x400 FORMAT "%13.11" ECU_ADDRESS 0x7F969C /end MEASUREMENT
/begin MEASUREMENT B_sistarte "Fehlerart: Unterbrechung an Endstufe STARTE" UWORD B_TRUE 1 100 0 1 BIT_MASK 0x400 FORMAT "%13.11" ECU_ADDRESS 0x7F96A0 /end MEASUREMENT
/begin MEASUREMENT B_sistp1 "" UWORD B_TRUE 1 100 0 1 BIT_MASK 0x400 FORMAT "%13.11" ECU_ADDRESS 0x7F96A4 /end MEASUREMENT
/begin MEASUREMENT B_sistp2 "" UWORD B_TRUE 1 100 0 1 BIT_MASK 0x400 FORMAT "%13.11" ECU_ADDRESS 0x7F96A8 /end MEASUREMENT
/begin MEASUREMENT B_sita "Fehlertyp: Ansauglufttemperatur TANS (-Ladeluft)" UWORD B_TRUE 1 100 0 1 BIT_MASK 0x400 FORMAT "%13.11" ECU_ADDRESS 0x7F96AC /end MEASUREMENT
/begin MEASUREMENT B_sitcj945 "Fehlertyp:" UWORD B_TRUE 1 100 0 1 BIT_MASK 0x400 FORMAT "%13.11" ECU_ADDRESS 0x7F96B0 /end MEASUREMENT
/begin MEASUREMENT B_sitcy315 "Fehlertyp:" UWORD B_TRUE 1 100 0 1 BIT_MASK 0x400 FORMAT "%13.11" ECU_ADDRESS 0x7F96B4 /end MEASUREMENT
/begin MEASUREMENT B_sitde "" UWORD B_TRUE 1 100 0 1 BIT_MASK 0x400 FORMAT "%13.11" ECU_ADDRESS 0x7F96B8 /end MEASUREMENT
/begin MEASUREMENT B_siteve "Fehlerart: Unterbrechung an Endstufe TEVE" UWORD B_TRUE 1 100 0 1 BIT_MASK 0x400 FORMAT "%13.11" ECU_ADDRESS 0x7F96C4 /end MEASUREMENT
/begin MEASUREMENT B_siths "Signal inaktiv" UWORD B_TRUE 1 100 0 1 BIT_MASK 0x400 FORMAT "%13.11" ECU_ADDRESS 0x7F96C8 /end MEASUREMENT
/begin MEASUREMENT B_sitm "Fehlerart: Motortemperaturschwelle f¸r Lambdaregelungsfreigabe nicht erreicht" UWORD B_TRUE 1 100 0 1 BIT_MASK 0x400 FORMAT "%13.11" ECU_ADDRESS 0x7F96CC /end MEASUREMENT
/begin MEASUREMENT B_sitzyl1 "Fehlertyp Kopftemperatur" UWORD B_TRUE 1 100 0 1 BIT_MASK 0x400 FORMAT "%13.11" ECU_ADDRESS 0x7F96D0 /end MEASUREMENT
/begin MEASUREMENT B_sitzyl2 "Fehlertyp Kopftemperatur" UWORD B_TRUE 1 100 0 1 BIT_MASK 0x400 FORMAT "%13.11" ECU_ADDRESS 0x7F96D4 /end MEASUREMENT
/begin MEASUREMENT B_siu5vg1 "Fehlertyp:" UWORD B_TRUE 1 100 0 1 BIT_MASK 0x400 FORMAT "%13.11" ECU_ADDRESS 0x7F96D8 /end MEASUREMENT
/begin MEASUREMENT B_siu5vg2 "Fehlertyp:" UWORD B_TRUE 1 100 0 1 BIT_MASK 0x400 FORMAT "%13.11" ECU_ADDRESS 0x7F96DC /end MEASUREMENT
/begin MEASUREMENT B_siu5vg3 "Fehlertyp:" UWORD B_TRUE 1 100 0 1 BIT_MASK 0x400 FORMAT "%13.11" ECU_ADDRESS 0x7F96E0 /end MEASUREMENT
/begin MEASUREMENT B_siub "Fehlertyp: Umweltbedingungen" UWORD B_TRUE 1 100 0 1 BIT_MASK 0x400 FORMAT "%13.11" ECU_ADDRESS 0x7F96E4 /end MEASUREMENT
/begin MEASUREMENT B_siurram "Fehlertyp sig.: Rechner¸berwachung: RAM" UWORD B_TRUE 1 100 0 1 BIT_MASK 0x400 FORMAT "%13.11" ECU_ADDRESS 0x7F96E8 /end MEASUREMENT
/begin MEASUREMENT B_siurrom "Fehlertyp sig.: Rechner¸berwachung: ROM" UWORD B_TRUE 1 100 0 1 BIT_MASK 0x400 FORMAT "%13.11" ECU_ADDRESS 0x7F96EC /end MEASUREMENT
/begin MEASUREMENT B_siurrst "Fehlertyp sig.: Rechner¸berwachung: Reset" UWORD B_TRUE 1 100 0 1 BIT_MASK 0x400 FORMAT "%13.11" ECU_ADDRESS 0x7F96F0 /end MEASUREMENT
/begin MEASUREMENT B_sivfz "Bedingung fehlendes Signal Fahrzeuggeschwindigkeit" UWORD B_TRUE 1 100 0 1 BIT_MASK 0x400 FORMAT "%13.11" ECU_ADDRESS 0x7F96F4 /end MEASUREMENT
/begin MEASUREMENT E_brems "Fehlerflag: BREMS (Bremsschalter)" UWORD B_TRUE 1 100 0 1 BIT_MASK 0x1 FORMAT "%13.11" ECU_ADDRESS 0x7F957C /end MEASUREMENT
/begin MEASUREMENT E_dmls "" UWORD B_TRUE 1 100 0 1 BIT_MASK 0x1 FORMAT "%13.11" ECU_ADDRESS 0x7F959C /end MEASUREMENT
/begin MEASUREMENT E_dsu "Errorflag: Umgebungsdrucksensor" UWORD B_TRUE 1 100 0 1 BIT_MASK 0x1 FORMAT "%13.11" ECU_ADDRESS 0x7F95A8 /end MEASUREMENT
/begin MEASUREMENT E_egfe "Errorflag: Eingangsgrˆﬂen F¸llungserfassung" UWORD B_TRUE 1 100 0 1 BIT_MASK 0x1 FORMAT "%13.11" ECU_ADDRESS 0x7F95AC /end MEASUREMENT
/begin MEASUREMENT E_frao "Errorflag: LR-Adaption oberer multiplikativer Bereich" UWORD B_TRUE 1 100 0 1 BIT_MASK 0x1 FORMAT "%13.11" ECU_ADDRESS 0x7F95CC /end MEASUREMENT
/begin MEASUREMENT E_frao2 "Errorflag: LR-Adaption oberer multiplikativer Bereich (Bank 2)" UWORD B_TRUE 1 100 0 1 BIT_MASK 0x1 FORMAT "%13.11" ECU_ADDRESS 0x7F95D0 /end MEASUREMENT
/begin MEASUREMENT E_frau "Errorflag: LR-Adaption unterer multiplikativer Bereich" UWORD B_TRUE 1 100 0 1 BIT_MASK 0x1 FORMAT "%13.11" ECU_ADDRESS 0x7F95D4 /end MEASUREMENT
/begin MEASUREMENT E_frau2 "Errorflag: LR-Adaption unterer multiplikativer Bereich (Bank 2)" UWORD B_TRUE 1 100 0 1 BIT_MASK 0x1 FORMAT "%13.11" ECU_ADDRESS 0x7F95D8 /end MEASUREMENT
/begin MEASUREMENT E_frps "" UWORD B_TRUE 1 100 0 1 BIT_MASK 0x1 FORMAT "%13.11" ECU_ADDRESS 0x7F95DC /end MEASUREMENT
/begin MEASUREMENT E_frst "Errorflag: Fehler aus Diagnose Kraftstoffversorgungssystem (Kurztest)" UWORD B_TRUE 1 100 0 1 BIT_MASK 0x1 FORMAT "%13.11" ECU_ADDRESS 0x7F95E0 /end MEASUREMENT
/begin MEASUREMENT E_frst2 "Errorflag: Fehler aus Diagnose Kraftstoffvers.-System (Kurztest Bank 2)" UWORD B_TRUE 1 100 0 1 BIT_MASK 0x1 FORMAT "%13.11" ECU_ADDRESS 0x7F95E4 /end MEASUREMENT
/begin MEASUREMENT E_GANG "Fehlerflag: Getriebeschaltwalzenpoti" UWORD B_TRUE 1 100 0 1 BIT_MASK 0x1 FORMAT "%13.11" ECU_ADDRESS 0x7F95E8 /end MEASUREMENT
/begin MEASUREMENT E_HSSEKP "" UWORD B_TRUE 1 100 0 1 BIT_MASK 0x1 FORMAT "%13.11" ECU_ADDRESS 0x7F95EC /end MEASUREMENT
/begin MEASUREMENT E_HSSSYS "" UWORD B_TRUE 1 100 0 1 BIT_MASK 0x1 FORMAT "%13.11" ECU_ADDRESS 0x7F95F0 /end MEASUREMENT
/begin MEASUREMENT E_HSSZDG "" UWORD B_TRUE 1 100 0 1 BIT_MASK 0x1 FORMAT "%13.11" ECU_ADDRESS 0x7F95F4 /end MEASUREMENT
/begin MEASUREMENT E_kuppl "Fehlerflag: Gebergrˆﬂe Kupplung" UWORD B_TRUE 1 100 0 1 BIT_MASK 0x1 FORMAT "%13.11" ECU_ADDRESS 0x7F9628 /end MEASUREMENT
/begin MEASUREMENT E_latp "" UWORD B_TRUE 1 100 0 1 BIT_MASK 0x1 FORMAT "%13.11" ECU_ADDRESS 0x7F962C /end MEASUREMENT
/begin MEASUREMENT E_latp2 "" UWORD B_TRUE 1 100 0 1 BIT_MASK 0x1 FORMAT "%13.11" ECU_ADDRESS 0x7F9630 /end MEASUREMENT
/begin MEASUREMENT E_latv "" UWORD B_TRUE 1 100 0 1 BIT_MASK 0x1 FORMAT "%13.11" ECU_ADDRESS 0x7F9634 /end MEASUREMENT
/begin MEASUREMENT E_latv2 "" UWORD B_TRUE 1 100 0 1 BIT_MASK 0x1 FORMAT "%13.11" ECU_ADDRESS 0x7F9638 /end MEASUREMENT
/begin MEASUREMENT E_llr "Errorflag: Leerlaufregelung" UWORD B_TRUE 1 100 0 1 BIT_MASK 0x1 FORMAT "%13.11" ECU_ADDRESS 0x7F963C /end MEASUREMENT
/begin MEASUREMENT E_lshvk1e "Errorflag: LSHVK1E" UWORD B_TRUE 1 100 0 1 BIT_MASK 0x1 FORMAT "%13.11" ECU_ADDRESS 0x7F9640 /end MEASUREMENT
/begin MEASUREMENT E_lshvk2e "Errorflag: LSHVK2E" UWORD B_TRUE 1 100 0 1 BIT_MASK 0x1 FORMAT "%13.11" ECU_ADDRESS 0x7F9644 /end MEASUREMENT
/begin MEASUREMENT E_lsv "Errorflag: Lambda-Sonde vor Kat" UWORD B_TRUE 1 100 0 1 BIT_MASK 0x1 FORMAT "%13.11" ECU_ADDRESS 0x7F9648 /end MEASUREMENT
/begin MEASUREMENT E_lsv2 "Errorflag: Lambda-Sonde 2 vor Kat" UWORD B_TRUE 1 100 0 1 BIT_MASK 0x1 FORMAT "%13.11" ECU_ADDRESS 0x7F964C /end MEASUREMENT
/begin MEASUREMENT E_os "" UWORD B_TRUE 1 100 0 1 BIT_MASK 0x1 FORMAT "%13.11" ECU_ADDRESS 0x7F9658 /end MEASUREMENT
/begin MEASUREMENT E_ph "Errorflag: Phasensensor" UWORD B_TRUE 1 100 0 1 BIT_MASK 0x1 FORMAT "%13.11" ECU_ADDRESS 0x7F965C /end MEASUREMENT
/begin MEASUREMENT E_phw "" UWORD B_TRUE 1 100 0 1 BIT_MASK 0x1 FORMAT "%13.11" ECU_ADDRESS 0x7F9660 /end MEASUREMENT
/begin MEASUREMENT E_radv "" UWORD B_TRUE 1 100 0 1 BIT_MASK 0x1 FORMAT "%13.11" ECU_ADDRESS 0x7F9664 /end MEASUREMENT
/begin MEASUREMENT E_rkat "Errorflag DKVS (additive Korrektur pro Zeit)" UWORD B_TRUE 1 100 0 1 BIT_MASK 0x1 FORMAT "%13.11" ECU_ADDRESS 0x7F9668 /end MEASUREMENT
/begin MEASUREMENT E_rkat2 "Errorflag DKVS (additive Korrektur pro Zeit Bank 2)" UWORD B_TRUE 1 100 0 1 BIT_MASK 0x1 FORMAT "%13.11" ECU_ADDRESS 0x7F966C /end MEASUREMENT
/begin MEASUREMENT E_rkaz "Errorflag DKVS (additive Korrektur pro Z¸ndung)" UWORD B_TRUE 1 100 0 1 BIT_MASK 0x1 FORMAT "%13.11" ECU_ADDRESS 0x7F9670 /end MEASUREMENT
/begin MEASUREMENT E_rkaz2 "Errorflag DKVS (additive Korrektur pro Z¸ndung Bank 2)" UWORD B_TRUE 1 100 0 1 BIT_MASK 0x1 FORMAT "%13.11" ECU_ADDRESS 0x7F9674 /end MEASUREMENT
/begin MEASUREMENT E_sikoda "" UWORD B_TRUE 1 100 0 1 BIT_MASK 0x1 FORMAT "%13.11" ECU_ADDRESS 0x7F9678 /end MEASUREMENT
/begin MEASUREMENT E_sld "" UWORD B_TRUE 1 100 0 1 BIT_MASK 0x1 FORMAT "%13.11" ECU_ADDRESS 0x7F967C /end MEASUREMENT
/begin MEASUREMENT E_sls "Errorflag: Sekund‰rluft-System" UWORD B_TRUE 1 100 0 1 BIT_MASK 0x1 FORMAT "%13.11" ECU_ADDRESS 0x7F9680 /end MEASUREMENT
/begin MEASUREMENT E_sls2 "Errorflag: Sekund‰rluft-System Bank 2" UWORD B_TRUE 1 100 0 1 BIT_MASK 0x1 FORMAT "%13.11" ECU_ADDRESS 0x7F9684 /end MEASUREMENT
/begin MEASUREMENT E_slv "Errorflag: Sekund‰rluftventil" UWORD B_TRUE 1 100 0 1 BIT_MASK 0x1 FORMAT "%13.11" ECU_ADDRESS 0x7F9688 /end MEASUREMENT
/begin MEASUREMENT E_slv1e "Errorflag: SLV1E" UWORD B_TRUE 1 100 0 1 BIT_MASK 0x1 FORMAT "%13.11" ECU_ADDRESS 0x7F968C /end MEASUREMENT
/begin MEASUREMENT E_slv2 "Errorflag: Sekund‰rluftventil Bank 2" UWORD B_TRUE 1 100 0 1 BIT_MASK 0x1 FORMAT "%13.11" ECU_ADDRESS 0x7F9690 /end MEASUREMENT
/begin MEASUREMENT E_slv2e "Errorflag: SLV2E" UWORD B_TRUE 1 100 0 1 BIT_MASK 0x1 FORMAT "%13.11" ECU_ADDRESS 0x7F9694 /end MEASUREMENT
/begin MEASUREMENT E_sst "" UWORD B_TRUE 1 100 0 1 BIT_MASK 0x1 FORMAT "%13.11" ECU_ADDRESS 0x7F9698 /end MEASUREMENT
/begin MEASUREMENT E_sst2e "" UWORD B_TRUE 1 100 0 1 BIT_MASK 0x1 FORMAT "%13.11" ECU_ADDRESS 0x7F969C /end MEASUREMENT
/begin MEASUREMENT E_starte "Errorflag: STARTE" UWORD B_TRUE 1 100 0 1 BIT_MASK 0x1 FORMAT "%13.11" ECU_ADDRESS 0x7F96A0 /end MEASUREMENT
/begin MEASUREMENT E_stp1 "" UWORD B_TRUE 1 100 0 1 BIT_MASK 0x1 FORMAT "%13.11" ECU_ADDRESS 0x7F96A4 /end MEASUREMENT
/begin MEASUREMENT E_stp2 "" UWORD B_TRUE 1 100 0 1 BIT_MASK 0x1 FORMAT "%13.11" ECU_ADDRESS 0x7F96A8 /end MEASUREMENT
/begin MEASUREMENT E_ta "Errorflag: TANS" UWORD B_TRUE 1 100 0 1 BIT_MASK 0x1 FORMAT "%13.11" ECU_ADDRESS 0x7F96AC /end MEASUREMENT
/begin MEASUREMENT E_tcj945 "Errorflag: ‹bertemperatur CJ945" UWORD B_TRUE 1 100 0 1 BIT_MASK 0x1 FORMAT "%13.11" ECU_ADDRESS 0x7F96B0 /end MEASUREMENT
/begin MEASUREMENT E_tcy315 "Errorflag: ‹bertemperatur CY315" UWORD B_TRUE 1 100 0 1 BIT_MASK 0x1 FORMAT "%13.11" ECU_ADDRESS 0x7F96B4 /end MEASUREMENT
/begin MEASUREMENT E_tde "" UWORD B_TRUE 1 100 0 1 BIT_MASK 0x1 FORMAT "%13.11" ECU_ADDRESS 0x7F96B8 /end MEASUREMENT
/begin MEASUREMENT E_tes "Errorflag: Tankentl¸ftungssystem" UWORD B_TRUE 1 100 0 1 BIT_MASK 0x1 FORMAT "%13.11" ECU_ADDRESS 0x7F96BC /end MEASUREMENT
/begin MEASUREMENT E_teve "Errorflag: TEVE" UWORD B_TRUE 1 100 0 1 BIT_MASK 0x1 FORMAT "%13.11" ECU_ADDRESS 0x7F96C4 /end MEASUREMENT
/begin MEASUREMENT E_ths "Fehlerflag DTHS" UWORD B_TRUE 1 100 0 1 BIT_MASK 0x1 FORMAT "%13.11" ECU_ADDRESS 0x7F96C8 /end MEASUREMENT
/begin MEASUREMENT E_tm "Errorflag: TMOT" UWORD B_TRUE 1 100 0 1 BIT_MASK 0x1 FORMAT "%13.11" ECU_ADDRESS 0x7F96CC /end MEASUREMENT
/begin MEASUREMENT E_TZYL1 "Fehlerflag Kopftemperatur" UWORD B_TRUE 1 100 0 1 BIT_MASK 0x1 FORMAT "%13.11" ECU_ADDRESS 0x7F96D0 /end MEASUREMENT
/begin MEASUREMENT E_TZYL2 "Fehlerflag Kopftemperatur" UWORD B_TRUE 1 100 0 1 BIT_MASK 0x1 FORMAT "%13.11" ECU_ADDRESS 0x7F96D4 /end MEASUREMENT
/begin MEASUREMENT E_u5vg1 "Errorflag: Fehler Geberversorgung 1" UWORD B_TRUE 1 100 0 1 BIT_MASK 0x1 FORMAT "%13.11" ECU_ADDRESS 0x7F96D8 /end MEASUREMENT
/begin MEASUREMENT E_u5vg2 "Errorflag: Fehler Geberversorgung 2" UWORD B_TRUE 1 100 0 1 BIT_MASK 0x1 FORMAT "%13.11" ECU_ADDRESS 0x7F96DC /end MEASUREMENT
/begin MEASUREMENT E_u5vg3 "Errorflag: Fehler Geberversorgung 3" UWORD B_TRUE 1 100 0 1 BIT_MASK 0x1 FORMAT "%13.11" ECU_ADDRESS 0x7F96E0 /end MEASUREMENT
/begin MEASUREMENT E_ub "Errorflag: UB" UWORD B_TRUE 1 100 0 1 BIT_MASK 0x1 FORMAT "%13.11" ECU_ADDRESS 0x7F96E4 /end MEASUREMENT
/begin MEASUREMENT E_urram "Errorflag: Rechner¸berwachung: RAM" UWORD B_TRUE 1 100 0 1 BIT_MASK 0x1 FORMAT "%13.11" ECU_ADDRESS 0x7F96E8 /end MEASUREMENT
/begin MEASUREMENT E_urrom "Errorflag: Rechner¸berwachung: ROM" UWORD B_TRUE 1 100 0 1 BIT_MASK 0x1 FORMAT "%13.11" ECU_ADDRESS 0x7F96EC /end MEASUREMENT
/begin MEASUREMENT E_urrst "Errorflag: Rechner¸berwachung: Reset" UWORD B_TRUE 1 100 0 1 BIT_MASK 0x1 FORMAT "%13.11" ECU_ADDRESS 0x7F96F0 /end MEASUREMENT
/begin MEASUREMENT E_vfz "Errorflag: Fahrzeug-Geschwindigkeit" UWORD B_TRUE 1 100 0 1 BIT_MASK 0x1 FORMAT "%13.11" ECU_ADDRESS 0x7F96F4 /end MEASUREMENT
/begin MEASUREMENT sfpbrems "Status Fehlerpfad BREMS: Bremsschalter" UWORD dez 1 100 0 65535 FORMAT "%8.2" ECU_ADDRESS 0x7F957C /end MEASUREMENT
/begin MEASUREMENT sfpdmls "" UWORD dez 1 100 0 65535 FORMAT "%8.2" ECU_ADDRESS 0x7F959C /end MEASUREMENT
/begin MEASUREMENT sfpdsu "Status Fehlerpfad: Umgebungsdrucksensor" UWORD dez 1 100 0 65535 FORMAT "%8.2" ECU_ADDRESS 0x7F95A8 /end MEASUREMENT
/begin MEASUREMENT sfpegfe "Status Fehlerpfad: Diagose der Eingangsgrˆﬂen der F¸llungserfassung" UWORD dez 1 100 0 65535 FORMAT "%8.2" ECU_ADDRESS 0x7F95AC /end MEASUREMENT
/begin MEASUREMENT sfpfrao "Status Fehlerpfad: LR-Adaption oberer multiplikativer Bereich" UWORD dez 1 100 0 65535 FORMAT "%8.2" ECU_ADDRESS 0x7F95CC /end MEASUREMENT
/begin MEASUREMENT sfpfrao2 "Status Fehlerpfad: LR Adaption oberer multiplikativer Bereich (Bank2)" UWORD dez 1 100 0 65535 FORMAT "%8.2" ECU_ADDRESS 0x7F95D0 /end MEASUREMENT
/begin MEASUREMENT sfpfrau "Status Fehlerpfad: LR Adaption unterer multiplikativer Bereich" UWORD dez 1 100 0 65535 FORMAT "%8.2" ECU_ADDRESS 0x7F95D4 /end MEASUREMENT
/begin MEASUREMENT sfpfrau2 "Status Fehlerpfad: LR Adaption unterer multiplikativer Bereich (Bank2)" UWORD dez 1 100 0 65535 FORMAT "%8.2" ECU_ADDRESS 0x7F95D8 /end MEASUREMENT
/begin MEASUREMENT sfpfrps "" UWORD dez 1 100 0 65535 FORMAT "%8.2" ECU_ADDRESS 0x7F95DC /end MEASUREMENT
/begin MEASUREMENT sfpfrst "Status Fehlerpfad: LR-Abweichung" UWORD dez 1 100 0 65535 FORMAT "%8.2" ECU_ADDRESS 0x7F95E0 /end MEASUREMENT
/begin MEASUREMENT sfpfrst2 "Status Fehlerpfad: LR-Abweichung Bank 2" UWORD dez 1 100 0 65535 FORMAT "%8.2" ECU_ADDRESS 0x7F95E4 /end MEASUREMENT
/begin MEASUREMENT sfpgang "Status Fehlerpfad GANG: Getriebeschaltwalzenpoti" UWORD dez 1 100 0 65535 FORMAT "%8.2" ECU_ADDRESS 0x7F95E8 /end MEASUREMENT
/begin MEASUREMENT sfphssekp "" UWORD dez 1 100 0 65535 FORMAT "%8.2" ECU_ADDRESS 0x7F95EC /end MEASUREMENT
/begin MEASUREMENT sfphsssys "" UWORD dez 1 100 0 65535 FORMAT "%8.2" ECU_ADDRESS 0x7F95F0 /end MEASUREMENT
/begin MEASUREMENT sfphsszdg "" UWORD dez 1 100 0 65535 FORMAT "%8.2" ECU_ADDRESS 0x7F95F4 /end MEASUREMENT
/begin MEASUREMENT sfpkuppl "Status Fehlerpfad KUPPL: Gebergrˆﬂe Kupplung" UWORD dez 1 100 0 65535 FORMAT "%8.2" ECU_ADDRESS 0x7F9628 /end MEASUREMENT
/begin MEASUREMENT sfplatp "" UWORD dez 1 100 0 65535 FORMAT "%8.2" ECU_ADDRESS 0x7F962C /end MEASUREMENT
/begin MEASUREMENT sfplatp2 "" UWORD dez 1 100 0 65535 FORMAT "%8.2" ECU_ADDRESS 0x7F9630 /end MEASUREMENT
/begin MEASUREMENT sfplatv "" UWORD dez 1 100 0 65535 FORMAT "%8.2" ECU_ADDRESS 0x7F9634 /end MEASUREMENT
/begin MEASUREMENT sfplatv2 "" UWORD dez 1 100 0 65535 FORMAT "%8.2" ECU_ADDRESS 0x7F9638 /end MEASUREMENT
/begin MEASUREMENT sfpllr "Status Fehlerpfad: Leerlaufregelung" UWORD dez 1 100 0 65535 FORMAT "%8.2" ECU_ADDRESS 0x7F963C /end MEASUREMENT
/begin MEASUREMENT sfplshvk1e "Status Fehlerpfad: LSHVK1E" UWORD dez 1 100 0 65535 FORMAT "%8.2" ECU_ADDRESS 0x7F9640 /end MEASUREMENT
/begin MEASUREMENT sfplshvk2e "Status Fehlerpfad: LSHVK2E" UWORD dez 1 100 0 65535 FORMAT "%8.2" ECU_ADDRESS 0x7F9644 /end MEASUREMENT
/begin MEASUREMENT sfplsv "Status Fehlerpfad: Diagnose Lambdasonde vor Kat" UWORD dez 1 100 0 65535 FORMAT "%8.2" ECU_ADDRESS 0x7F9648 /end MEASUREMENT
/begin MEASUREMENT sfplsv2 "Status Fehlerpfad: Diagnose Lambdasonde vor Kat Bank2" UWORD dez 1 100 0 65535 FORMAT "%8.2" ECU_ADDRESS 0x7F964C /end MEASUREMENT
/begin MEASUREMENT sfpos "" UWORD default 1 100 0 65535 FORMAT "%8.2" ECU_ADDRESS 0x7F9658 /end MEASUREMENT
/begin MEASUREMENT sfpph "Status Fehlerpfad: Phasengeber" UWORD dez 1 100 0 65535 FORMAT "%8.2" ECU_ADDRESS 0x7F965C /end MEASUREMENT
/begin MEASUREMENT sfpphw "" UWORD dez 1 100 0 65535 FORMAT "%8.2" ECU_ADDRESS 0x7F9660 /end MEASUREMENT
/begin MEASUREMENT sfpradv "" UWORD default 1 100 0 65535 FORMAT "%8.2" ECU_ADDRESS 0x7F9664 /end MEASUREMENT
/begin MEASUREMENT sfprkat "Status Fehlerpfad: LR Adaption additive Korrektur pro Zeit" UWORD dez 1 100 0 65535 FORMAT "%8.2" ECU_ADDRESS 0x7F9668 /end MEASUREMENT
/begin MEASUREMENT sfprkat2 "Status Fehlerpfad: LR Adaption additive Korrektur pro Zeit (Bank 2)" UWORD dez 1 100 0 65535 FORMAT "%8.2" ECU_ADDRESS 0x7F966C /end MEASUREMENT
/begin MEASUREMENT sfprkaz "Status Fehlerpfad: LR Adaption additive Korrektur pro Z¸ndung" UWORD dez 1 100 0 65535 FORMAT "%8.2" ECU_ADDRESS 0x7F9670 /end MEASUREMENT
/begin MEASUREMENT sfprkaz2 "Status Fehlerpfad: LR Adaption additive Korrektur pro Z¸ndung (Bank 2)" UWORD dez 1 100 0 65535 FORMAT "%8.2" ECU_ADDRESS 0x7F9674 /end MEASUREMENT
/begin MEASUREMENT sfpsikoda "" UWORD default 1 100 0 65535 FORMAT "%8.2" ECU_ADDRESS 0x7F9678 /end MEASUREMENT
/begin MEASUREMENT sfpsld "" UWORD default 1 100 0 65535 FORMAT "%8.2" ECU_ADDRESS 0x7F967C /end MEASUREMENT
/begin MEASUREMENT sfpsls "Status Fehlerpfad: Diagnose Sekund‰rluftsystem" UWORD dez 1 100 0 65535 FORMAT "%8.2" ECU_ADDRESS 0x7F9680 /end MEASUREMENT
/begin MEASUREMENT sfpsls2 "Status Fehlerpfad: Diagnose Sekund‰rluftsystem, Bank 2" UWORD dez 1 100 0 65535 FORMAT "%8.2" ECU_ADDRESS 0x7F9684 /end MEASUREMENT
/begin MEASUREMENT sfpslv "Status Fehlerpfad: Diagnose Sekund‰rluftventil" UWORD dez 1 100 0 65535 FORMAT "%8.2" ECU_ADDRESS 0x7F9688 /end MEASUREMENT
/begin MEASUREMENT sfpslv1e "Status Fehlerpfad: SLV1E" UWORD default 1 100 0 65535 FORMAT "%8.2" ECU_ADDRESS 0x7F968C /end MEASUREMENT
/begin MEASUREMENT sfpslv2 "Status Fehlerpfad: Diagnose Sekund‰rluftventil, Bank 2" UWORD dez 1 100 0 65535 FORMAT "%8.2" ECU_ADDRESS 0x7F9690 /end MEASUREMENT
/begin MEASUREMENT sfpslv2e "Status Fehlerpfad: SLV2E" UWORD default 1 100 0 65535 FORMAT "%8.2" ECU_ADDRESS 0x7F9694 /end MEASUREMENT
/begin MEASUREMENT sfpsst "Status Fehlerpfad: Diagnose Seitenstuetzenschalter" UWORD dez 1 100 0 65535 FORMAT "%8.2" ECU_ADDRESS 0x7F9698 /end MEASUREMENT
/begin MEASUREMENT sfpsst2e "" UWORD default 1 100 0 65535 FORMAT "%8.2" ECU_ADDRESS 0x7F969C /end MEASUREMENT
/begin MEASUREMENT sfpstarte "Status Fehlerpfad: STARTE" UWORD default 1 100 0 65535 FORMAT "%8.2" ECU_ADDRESS 0x7F96A0 /end MEASUREMENT
/begin MEASUREMENT sfpstp1 "" UWORD default 1 100 0 65535 FORMAT "%8.2" ECU_ADDRESS 0x7F96A4 /end MEASUREMENT
/begin MEASUREMENT sfpstp2 "" UWORD default 1 100 0 65535 FORMAT "%8.2" ECU_ADDRESS 0x7F96A8 /end MEASUREMENT
/begin MEASUREMENT sfpta "Status Fehlerpfad: Ansauglufttemperatur (Ladeluft-) TANS" UWORD dez 1 100 0 65535 FORMAT "%8.2" ECU_ADDRESS 0x7F96AC /end MEASUREMENT
/begin MEASUREMENT sfptcj945 "Status Fehlerpfad: ‹bertemperatur CJ945" UWORD default 1 100 0 65535 FORMAT "%8.2" ECU_ADDRESS 0x7F96B0 /end MEASUREMENT
/begin MEASUREMENT sfptcy315 "Status Fehlerpfad: ‹bertemperatur CY315" UWORD default 1 100 0 65535 FORMAT "%8.2" ECU_ADDRESS 0x7F96B4 /end MEASUREMENT
/begin MEASUREMENT sfptde "" UWORD default 1 100 0 65535 FORMAT "%8.2" ECU_ADDRESS 0x7F96B8 /end MEASUREMENT
/begin MEASUREMENT sfptes "Status Fehlerpfad: Tankdiagnose, TEV defekt offen" UWORD dez 1 100 0 65535 FORMAT "%8.2" ECU_ADDRESS 0x7F96BC /end MEASUREMENT
/begin MEASUREMENT sfpteve "Status Fehlerpfad: TEVE" UWORD default 1 100 0 65535 FORMAT "%8.2" ECU_ADDRESS 0x7F96C4 /end MEASUREMENT
/begin MEASUREMENT sfpths "Status Fehlerpfad DTHS" UWORD dez 1 100 0 65535 FORMAT "%8.2" ECU_ADDRESS 0x7F96C8 /end MEASUREMENT
/begin MEASUREMENT sfptm "Status Fehlerpfad: Motortemperatur TMOT" UWORD dez 1 100 0 65535 FORMAT "%8.2" ECU_ADDRESS 0x7F96CC /end MEASUREMENT
/begin MEASUREMENT sfptzyl1 "Status Fehlerpfad: DFPM_TZYL1" UWORD dez 1 100 0 65535 FORMAT "%8.2" ECU_ADDRESS 0x7F96D0 /end MEASUREMENT
/begin MEASUREMENT sfptzyl2 "Status Fehlerpfad: DFPM_TZYL2" UWORD dez 1 100 0 65535 FORMAT "%8.2" ECU_ADDRESS 0x7F96D4 /end MEASUREMENT
/begin MEASUREMENT sfpu5vg1 "Status Fehlerpfad: Fehler Geberversorgung 1" UWORD default 1 100 0 65535 FORMAT "%8.2" ECU_ADDRESS 0x7F96D8 /end MEASUREMENT
/begin MEASUREMENT sfpu5vg2 "Status Fehlerpfad: Fehler Geberversorgung 2" UWORD default 1 100 0 65535 FORMAT "%8.2" ECU_ADDRESS 0x7F96DC /end MEASUREMENT
/begin MEASUREMENT sfpu5vg3 "Status Fehlerpfad: Fehler Geberversorgung 3" UWORD default 1 100 0 65535 FORMAT "%8.2" ECU_ADDRESS 0x7F96E0 /end MEASUREMENT
/begin MEASUREMENT sfpub "Status Fehlerpfad: Batteriespannung UB (Bordnetz)" UWORD dez 1 100 0 65535 FORMAT "%8.2" ECU_ADDRESS 0x7F96E4 /end MEASUREMENT
/begin MEASUREMENT sfpurram "Statuswort: Rechner¸berwachung: RAM" UWORD dez 1 100 0 65535 FORMAT "%8.2" ECU_ADDRESS 0x7F96E8 /end MEASUREMENT
/begin MEASUREMENT sfpurrom "Statuswort: Rechner¸berwachung: ROM" UWORD dez 1 100 0 65535 FORMAT "%8.2" ECU_ADDRESS 0x7F96EC /end MEASUREMENT
/begin MEASUREMENT sfpurrst "Statuswort: Rechner¸berwachung: Reset" UWORD dez 1 100 0 65535 FORMAT "%8.2" ECU_ADDRESS 0x7F96F0 /end MEASUREMENT
/begin MEASUREMENT sfpvfz "Status Fehlerpfad: Fahrzeuggeschwindigkeit" UWORD dez 1 100 0 65535 FORMAT "%8.2" ECU_ADDRESS 0x7F96F4 /end MEASUREMENT
/begin MEASUREMENT TYP_brems "Fehlertyp: Gebergrˆﬂe Bremsschalter" UWORD B_TRUE 1 100 0 1 BIT_MASK 0xf00 FORMAT "%13.11" ECU_ADDRESS 0x7F957C /end MEASUREMENT
/begin MEASUREMENT TYP_dmls "" UWORD SFP_TYP 1 100 0 8 BIT_MASK 0xf00 FORMAT "%13.11" ECU_ADDRESS 0x7F959C /end MEASUREMENT
/begin MEASUREMENT TYP_dsu "" UWORD SFP_TYP 1 100 0 8 BIT_MASK 0xf00 FORMAT "%13.11" ECU_ADDRESS 0x7F95A8 /end MEASUREMENT
/begin MEASUREMENT TYP_egfe "" UWORD B_TRUE 1 100 0 1 BIT_MASK 0xf00 FORMAT "%13.11" ECU_ADDRESS 0x7F95AC /end MEASUREMENT
/begin MEASUREMENT TYP_frao "" UWORD SFP_TYP 1 100 0 8 BIT_MASK 0xf00 FORMAT "%13.11" ECU_ADDRESS 0x7F95CC /end MEASUREMENT
/begin MEASUREMENT TYP_frao2 "" UWORD SFP_TYP 1 100 0 8 BIT_MASK 0xf00 FORMAT "%13.11" ECU_ADDRESS 0x7F95D0 /end MEASUREMENT
/begin MEASUREMENT TYP_frau "" UWORD SFP_TYP 1 100 0 8 BIT_MASK 0xf00 FORMAT "%13.11" ECU_ADDRESS 0x7F95D4 /end MEASUREMENT
/begin MEASUREMENT TYP_frau2 "" UWORD SFP_TYP 1 100 0 8 BIT_MASK 0xf00 FORMAT "%13.11" ECU_ADDRESS 0x7F95D8 /end MEASUREMENT
/begin MEASUREMENT TYP_frst "" UWORD SFP_TYP 1 100 0 8 BIT_MASK 0xf00 FORMAT "%13.11" ECU_ADDRESS 0x7F95E0 /end MEASUREMENT
/begin MEASUREMENT TYP_frst2 "" UWORD SFP_TYP 1 100 0 8 BIT_MASK 0xf00 FORMAT "%13.11" ECU_ADDRESS 0x7F95E4 /end MEASUREMENT
/begin MEASUREMENT TYP_gang "" UWORD B_TRUE 1 100 0 1 BIT_MASK 0xf00 FORMAT "%13.11" ECU_ADDRESS 0x7F95E8 /end MEASUREMENT
/begin MEASUREMENT TYP_HSSEKP "" UWORD B_TRUE 1 100 0 1 BIT_MASK 0xf00 FORMAT "%13.11" ECU_ADDRESS 0x7F95EC /end MEASUREMENT
/begin MEASUREMENT TYP_HSSSYS "" UWORD B_TRUE 1 100 0 1 BIT_MASK 0xf00 FORMAT "%13.11" ECU_ADDRESS 0x7F95F0 /end MEASUREMENT
/begin MEASUREMENT TYP_HSSZDG "" UWORD B_TRUE 1 100 0 1 BIT_MASK 0xf00 FORMAT "%13.11" ECU_ADDRESS 0x7F95F4 /end MEASUREMENT
/begin MEASUREMENT TYP_kuppl "Fehlertyp: Gebergrˆﬂe Kupplungsschalter" UWORD B_TRUE 1 100 0 1 BIT_MASK 0xf00 FORMAT "%13.11" ECU_ADDRESS 0x7F9628 /end MEASUREMENT
/begin MEASUREMENT TYP_latp "" UWORD B_TRUE 1 100 0 1 BIT_MASK 0xf00 FORMAT "%13.11" ECU_ADDRESS 0x7F962C /end MEASUREMENT
/begin MEASUREMENT TYP_latp2 "" UWORD B_TRUE 1 100 0 1 BIT_MASK 0xf00 FORMAT "%13.11" ECU_ADDRESS 0x7F9630 /end MEASUREMENT
/begin MEASUREMENT TYP_latv "" UWORD B_TRUE 1 100 0 1 BIT_MASK 0xf00 FORMAT "%13.11" ECU_ADDRESS 0x7F9634 /end MEASUREMENT
/begin MEASUREMENT TYP_latv2 "" UWORD B_TRUE 1 100 0 1 BIT_MASK 0xf00 FORMAT "%13.11" ECU_ADDRESS 0x7F9638 /end MEASUREMENT
/begin MEASUREMENT TYP_LLR "" UWORD SFP_TYP 1 100 0 8 BIT_MASK 0xf00 FORMAT "%13.11" ECU_ADDRESS 0x7F963C /end MEASUREMENT
/begin MEASUREMENT TYP_lshv1e "Fehlertyp: LSHVK1E" UWORD SFP_TYP 1 100 0 8 BIT_MASK 0xf00 FORMAT "%13.11" ECU_ADDRESS 0x7F9640 /end MEASUREMENT
/begin MEASUREMENT TYP_lshv2e "Fehlertyp: LSHVK2E" UWORD B_TRUE 1 100 0 1 BIT_MASK 0xf00 FORMAT "%13.11" ECU_ADDRESS 0x7F9644 /end MEASUREMENT
/begin MEASUREMENT TYP_lsv "Fehlertyp: Lambdasonde 1 vor Kat" UWORD SFP_TYP 1 100 0 8 BIT_MASK 0xf00 FORMAT "%13.11" ECU_ADDRESS 0x7F9648 /end MEASUREMENT
/begin MEASUREMENT TYP_lsv2 "Fehlertyp: Lambdasonde 2 vor Kat" UWORD SFP_TYP 1 100 0 8 BIT_MASK 0xf00 FORMAT "%13.11" ECU_ADDRESS 0x7F964C /end MEASUREMENT
/begin MEASUREMENT TYP_os "" UWORD SFP_TYP 1 100 0 8 BIT_MASK 0xf00 FORMAT "%13.11" ECU_ADDRESS 0x7F9658 /end MEASUREMENT
/begin MEASUREMENT TYP_ph "" UWORD SFP_TYP 1 100 0 8 BIT_MASK 0xf00 FORMAT "%13.11" ECU_ADDRESS 0x7F965C /end MEASUREMENT
/begin MEASUREMENT TYP_phw "" UWORD SFP_TYP 1 100 0 8 BIT_MASK 0xf00 FORMAT "%13.11" ECU_ADDRESS 0x7F9660 /end MEASUREMENT
/begin MEASUREMENT TYP_radv "" UWORD SFP_TYP 1 100 0 8 BIT_MASK 0xf00 FORMAT "%13.11" ECU_ADDRESS 0x7F9664 /end MEASUREMENT
/begin MEASUREMENT TYP_rkat "" UWORD SFP_TYP 1 100 0 8 BIT_MASK 0xf00 FORMAT "%13.11" ECU_ADDRESS 0x7F9668 /end MEASUREMENT
/begin MEASUREMENT TYP_rkat2 "" UWORD SFP_TYP 1 100 0 8 BIT_MASK 0xf00 FORMAT "%13.11" ECU_ADDRESS 0x7F966C /end MEASUREMENT
/begin MEASUREMENT TYP_rkaz "" UWORD SFP_TYP 1 100 0 8 BIT_MASK 0xf00 FORMAT "%13.11" ECU_ADDRESS 0x7F9670 /end MEASUREMENT
/begin MEASUREMENT TYP_rkaz2 "" UWORD SFP_TYP 1 100 0 8 BIT_MASK 0xf00 FORMAT "%13.11" ECU_ADDRESS 0x7F9674 /end MEASUREMENT
/begin MEASUREMENT TYP_sikoda "" UWORD B_TRUE 1 100 0 1 BIT_MASK 0xf00 FORMAT "%13.11" ECU_ADDRESS 0x7F9678 /end MEASUREMENT
/begin MEASUREMENT TYP_sld "" UWORD SFP_TYP 1 100 0 8 BIT_MASK 0xf00 FORMAT "%13.11" ECU_ADDRESS 0x7F967C /end MEASUREMENT
/begin MEASUREMENT TYP_sls "Fehlertyp: Sekund‰rluftsystem" UWORD SFP_TYP 1 100 0 8 BIT_MASK 0xf00 FORMAT "%13.11" ECU_ADDRESS 0x7F9680 /end MEASUREMENT
/begin MEASUREMENT TYP_sls2 "Fehlertyp: Sekund‰rluftsystem, Bank 2" UWORD SFP_TYP 1 100 0 8 BIT_MASK 0xf00 FORMAT "%13.11" ECU_ADDRESS 0x7F9684 /end MEASUREMENT
/begin MEASUREMENT TYP_slv "Fehlertyp: Dichtheit Sekund‰rluftventil" UWORD SFP_TYP 1 100 0 8 BIT_MASK 0xf00 FORMAT "%13.11" ECU_ADDRESS 0x7F9688 /end MEASUREMENT
/begin MEASUREMENT TYP_slv1e "Fehlertyp: SLV1E" UWORD SFP_TYP 1 100 0 8 BIT_MASK 0xf00 FORMAT "%13.11" ECU_ADDRESS 0x7F968C /end MEASUREMENT
/begin MEASUREMENT TYP_slv2 "Fehlertyp: Dichtheit Sekund‰rluftventil, Bank 2" UWORD SFP_TYP 1 100 0 8 BIT_MASK 0xf00 FORMAT "%13.11" ECU_ADDRESS 0x7F9690 /end MEASUREMENT
/begin MEASUREMENT TYP_slv2e "Fehlertyp: SLV2E" UWORD SFP_TYP 1 100 0 8 BIT_MASK 0xf00 FORMAT "%13.11" ECU_ADDRESS 0x7F9694 /end MEASUREMENT
/begin MEASUREMENT TYP_sst "" UWORD SFP_TYP 1 100 0 8 BIT_MASK 0xf00 FORMAT "%13.11" ECU_ADDRESS 0x7F9698 /end MEASUREMENT
/begin MEASUREMENT TYP_sst2e "" UWORD SFP_TYP 1 100 0 8 BIT_MASK 0xf00 FORMAT "%13.11" ECU_ADDRESS 0x7F969C /end MEASUREMENT
/begin MEASUREMENT TYP_starte "Fehlertyp: STARTE" UWORD SFP_TYP 1 100 0 8 BIT_MASK 0xf00 FORMAT "%13.11" ECU_ADDRESS 0x7F96A0 /end MEASUREMENT
/begin MEASUREMENT TYP_stp1 "" UWORD B_TRUE 1 100 0 1 BIT_MASK 0xf00 FORMAT "%13.11" ECU_ADDRESS 0x7F96A4 /end MEASUREMENT
/begin MEASUREMENT TYP_stp2 "" UWORD B_TRUE 1 100 0 1 BIT_MASK 0xf00 FORMAT "%13.11" ECU_ADDRESS 0x7F96A8 /end MEASUREMENT
/begin MEASUREMENT TYP_ta "" UWORD SFP_TYP 1 100 0 8 BIT_MASK 0xf00 FORMAT "%13.11" ECU_ADDRESS 0x7F96AC /end MEASUREMENT
/begin MEASUREMENT TYP_tcj945 "Fehlertyp: DTCJ945" UWORD SFP_TYP 1 100 0 8 BIT_MASK 0xf00 FORMAT "%13.11" ECU_ADDRESS 0x7F96B0 /end MEASUREMENT
/begin MEASUREMENT TYP_tcy315 "Fehlertyp: DTCY315" UWORD SFP_TYP 1 100 0 8 BIT_MASK 0xf00 FORMAT "%13.11" ECU_ADDRESS 0x7F96B4 /end MEASUREMENT
/begin MEASUREMENT TYP_tde "" UWORD SFP_TYP 1 100 0 8 BIT_MASK 0xf00 FORMAT "%13.11" ECU_ADDRESS 0x7F96B8 /end MEASUREMENT
/begin MEASUREMENT TYP_teve "Fehlertyp: TEVE" UWORD SFP_TYP 1 100 0 8 BIT_MASK 0xf00 FORMAT "%13.11" ECU_ADDRESS 0x7F96C4 /end MEASUREMENT
/begin MEASUREMENT TYP_ths "" UWORD B_TRUE 1 100 0 1 BIT_MASK 0xf00 FORMAT "%13.11" ECU_ADDRESS 0x7F96C8 /end MEASUREMENT
/begin MEASUREMENT TYP_tm "" UWORD SFP_TYP 1 100 0 8 BIT_MASK 0xf00 FORMAT "%13.11" ECU_ADDRESS 0x7F96CC /end MEASUREMENT
/begin MEASUREMENT TYP_tzyl1 "" UWORD SFP_TYP 1 100 0 8 BIT_MASK 0xf00 FORMAT "%13.11" ECU_ADDRESS 0x7F96D0 /end MEASUREMENT
/begin MEASUREMENT TYP_tzyl2 "" UWORD SFP_TYP 1 100 0 8 BIT_MASK 0xf00 FORMAT "%13.11" ECU_ADDRESS 0x7F96D4 /end MEASUREMENT
/begin MEASUREMENT TYP_u5vg1 "Fehlertyp: DU5VG1" UWORD SFP_TYP 1 100 0 8 BIT_MASK 0xf00 FORMAT "%13.11" ECU_ADDRESS 0x7F96D8 /end MEASUREMENT
/begin MEASUREMENT TYP_u5vg2 "Fehlertyp: DU5VG2" UWORD SFP_TYP 1 100 0 8 BIT_MASK 0xf00 FORMAT "%13.11" ECU_ADDRESS 0x7F96DC /end MEASUREMENT
/begin MEASUREMENT TYP_u5vg3 "Fehlertyp: DU5VG3" UWORD SFP_TYP 1 100 0 8 BIT_MASK 0xf00 FORMAT "%13.11" ECU_ADDRESS 0x7F96E0 /end MEASUREMENT
/begin MEASUREMENT TYP_ub "" UWORD B_TRUE 1 100 0 1 BIT_MASK 0xf00 FORMAT "%13.11" ECU_ADDRESS 0x7F96E4 /end MEASUREMENT
/begin MEASUREMENT TYP_urram "Fehlertyp: Rechner¸berwachung: RAM" UWORD B_TRUE 1 100 0 1 BIT_MASK 0xf00 FORMAT "%13.11" ECU_ADDRESS 0x7F96E8 /end MEASUREMENT
/begin MEASUREMENT TYP_urrom "Fehlertyp: Rechner¸berwachung: ROM" UWORD B_TRUE 1 100 0 1 BIT_MASK 0xf00 FORMAT "%13.11" ECU_ADDRESS 0x7F96EC /end MEASUREMENT
/begin MEASUREMENT TYP_urrst "Fehlertyp: Rechner¸berwachung: Reset" UWORD B_TRUE 1 100 0 1 BIT_MASK 0xf00 FORMAT "%13.11" ECU_ADDRESS 0x7F96F0 /end MEASUREMENT
/begin MEASUREMENT TYP_vfz "" UWORD B_TRUE 1 100 0 1 BIT_MASK 0xf00 FORMAT "%13.11" ECU_ADDRESS 0x7F96F4 /end MEASUREMENT
/begin MEASUREMENT Z_brems "Zyklusflag: BREMS (Bremsschalter)" UWORD B_TRUE 1 100 0 1 BIT_MASK 0x2 FORMAT "%13.11" ECU_ADDRESS 0x7F957C /end MEASUREMENT
/begin MEASUREMENT Z_dmls "" UWORD B_TRUE 1 100 0 1 BIT_MASK 0x2 FORMAT "%13.11" ECU_ADDRESS 0x7F959C /end MEASUREMENT
/begin MEASUREMENT Z_dsu "Zyklusflag: Umgebungsdrucksensor" UWORD B_TRUE 1 100 0 1 BIT_MASK 0x2 FORMAT "%13.11" ECU_ADDRESS 0x7F95A8 /end MEASUREMENT
/begin MEASUREMENT Z_egfe "Zyklusflag: Eingangsgrˆﬂen F¸llungserfassung" UWORD B_TRUE 1 100 0 1 BIT_MASK 0x2 FORMAT "%13.11" ECU_ADDRESS 0x7F95AC /end MEASUREMENT
/begin MEASUREMENT Z_frao "Zyklusflag:LR-Adaption oberer multiplikativer Bereich" UWORD B_TRUE 1 100 0 1 BIT_MASK 0x2 FORMAT "%13.11" ECU_ADDRESS 0x7F95CC /end MEASUREMENT
/begin MEASUREMENT Z_frao2 "Zyklusflag:LR-Adaption oberer multiplikativer Bereich Bank2" UWORD B_TRUE 1 100 0 1 BIT_MASK 0x2 FORMAT "%13.11" ECU_ADDRESS 0x7F95D0 /end MEASUREMENT
/begin MEASUREMENT Z_frau "Zyklusflag:LR-Adaption unterer multiplikativer Bereich" UWORD B_TRUE 1 100 0 1 BIT_MASK 0x2 FORMAT "%13.11" ECU_ADDRESS 0x7F95D4 /end MEASUREMENT
/begin MEASUREMENT Z_frau2 "Zyklusflag:LR-Adaption unterer multiplikativer Bereich Bank 2" UWORD B_TRUE 1 100 0 1 BIT_MASK 0x2 FORMAT "%13.11" ECU_ADDRESS 0x7F95D8 /end MEASUREMENT
/begin MEASUREMENT Z_frps "" UWORD B_TRUE 1 100 0 1 BIT_MASK 0x2 FORMAT "%13.11" ECU_ADDRESS 0x7F95DC /end MEASUREMENT
/begin MEASUREMENT Z_frst "Zyklusmeldung Diagnose Kraftstoffversorgungssystem (Kurztest)" UWORD B_TRUE 1 100 0 1 BIT_MASK 0x2 FORMAT "%13.11" ECU_ADDRESS 0x7F95E0 /end MEASUREMENT
/begin MEASUREMENT Z_frst2 "Zyklusmeldung Diagnose Kraftstoffversorgungssystem (Kurztest Bank 2)" UWORD B_TRUE 1 100 0 1 BIT_MASK 0x2 FORMAT "%13.11" ECU_ADDRESS 0x7F95E4 /end MEASUREMENT
/begin MEASUREMENT Z_gang "Zyklusflag: Getriebeschaltwalzenpoti betaetigt" UWORD B_TRUE 1 100 0 1 BIT_MASK 0x2 FORMAT "%13.11" ECU_ADDRESS 0x7F95E8 /end MEASUREMENT
/begin MEASUREMENT Z_HSSEKP "" UWORD B_TRUE 1 100 0 1 BIT_MASK 0x2 FORMAT "%13.11" ECU_ADDRESS 0x7F95EC /end MEASUREMENT
/begin MEASUREMENT Z_HSSSYS "" UWORD B_TRUE 1 100 0 1 BIT_MASK 0x2 FORMAT "%13.11" ECU_ADDRESS 0x7F95F0 /end MEASUREMENT
/begin MEASUREMENT Z_HSSZDG "" UWORD B_TRUE 1 100 0 1 BIT_MASK 0x2 FORMAT "%13.11" ECU_ADDRESS 0x7F95F4 /end MEASUREMENT
/begin MEASUREMENT Z_kuppl "Zyklusflag: Kupplung betaetigt" UWORD B_TRUE 1 100 0 1 BIT_MASK 0x2 FORMAT "%13.11" ECU_ADDRESS 0x7F9628 /end MEASUREMENT
/begin MEASUREMENT Z_latp "" UWORD B_TRUE 1 100 0 1 BIT_MASK 0x2 FORMAT "%13.11" ECU_ADDRESS 0x7F962C /end MEASUREMENT
/begin MEASUREMENT Z_latp2 "" UWORD B_TRUE 1 100 0 1 BIT_MASK 0x2 FORMAT "%13.11" ECU_ADDRESS 0x7F9630 /end MEASUREMENT
/begin MEASUREMENT Z_latv "" UWORD B_TRUE 1 100 0 1 BIT_MASK 0x2 FORMAT "%13.11" ECU_ADDRESS 0x7F9634 /end MEASUREMENT
/begin MEASUREMENT Z_latv2 "" UWORD B_TRUE 1 100 0 1 BIT_MASK 0x2 FORMAT "%13.11" ECU_ADDRESS 0x7F9638 /end MEASUREMENT
/begin MEASUREMENT Z_llr "Zyklusflag: Diagnose Leerlaufregelung, Steller" UWORD B_TRUE 1 100 0 1 BIT_MASK 0x2 FORMAT "%13.11" ECU_ADDRESS 0x7F963C /end MEASUREMENT
/begin MEASUREMENT Z_lshvk1e "Zyklusflag: LSHVK1E" UWORD B_TRUE 1 100 0 1 BIT_MASK 0x2 FORMAT "%13.11" ECU_ADDRESS 0x7F9640 /end MEASUREMENT
/begin MEASUREMENT Z_lshvk2e "Zyklusflag: LSHVK2E" UWORD B_TRUE 1 100 0 1 BIT_MASK 0x2 FORMAT "%13.11" ECU_ADDRESS 0x7F9644 /end MEASUREMENT
/begin MEASUREMENT Z_lsv "Zyklusflag: Lambda-Sonde vor Kat" UWORD B_TRUE 1 100 0 1 BIT_MASK 0x2 FORMAT "%13.11" ECU_ADDRESS 0x7F9648 /end MEASUREMENT
/begin MEASUREMENT Z_lsv2 "Zyklusflag: Lambda-Sonde 2 vor Kat" UWORD B_TRUE 1 100 0 1 BIT_MASK 0x2 FORMAT "%13.11" ECU_ADDRESS 0x7F964C /end MEASUREMENT
/begin MEASUREMENT Z_os "" UWORD B_TRUE 1 100 0 1 BIT_MASK 0x2 FORMAT "%13.11" ECU_ADDRESS 0x7F9658 /end MEASUREMENT
/begin MEASUREMENT Z_ph "Zyklusflag: Phasensensor" UWORD B_TRUE 1 100 0 1 BIT_MASK 0x2 FORMAT "%13.11" ECU_ADDRESS 0x7F965C /end MEASUREMENT
/begin MEASUREMENT Z_phw "" UWORD B_TRUE 1 100 0 1 BIT_MASK 0x2 FORMAT "%13.11" ECU_ADDRESS 0x7F9660 /end MEASUREMENT
/begin MEASUREMENT Z_radv "" UWORD B_TRUE 1 100 0 1 BIT_MASK 0x2 FORMAT "%13.11" ECU_ADDRESS 0x7F9664 /end MEASUREMENT
/begin MEASUREMENT Z_rkat "Zyklusflag:LR-Adaption additiv pro Zeit" UWORD B_TRUE 1 100 0 1 BIT_MASK 0x2 FORMAT "%13.11" ECU_ADDRESS 0x7F9668 /end MEASUREMENT
/begin MEASUREMENT Z_rkat2 "Zyklusflag:LR-Adaption additiv pro Zeit Bank 2" UWORD B_TRUE 1 100 0 1 BIT_MASK 0x2 FORMAT "%13.11" ECU_ADDRESS 0x7F966C /end MEASUREMENT
/begin MEASUREMENT Z_rkaz "Zyklusflag:LR-Adaption additiv pro Einspritzung" UWORD B_TRUE 1 100 0 1 BIT_MASK 0x2 FORMAT "%13.11" ECU_ADDRESS 0x7F9670 /end MEASUREMENT
/begin MEASUREMENT Z_rkaz2 "Zyklusflag:LR-Adaption additiv pro Einspritzung Bank 2" UWORD B_TRUE 1 100 0 1 BIT_MASK 0x2 FORMAT "%13.11" ECU_ADDRESS 0x7F9674 /end MEASUREMENT
/begin MEASUREMENT Z_sikoda "" UWORD B_TRUE 1 100 0 1 BIT_MASK 0x2 FORMAT "%13.11" ECU_ADDRESS 0x7F9678 /end MEASUREMENT
/begin MEASUREMENT Z_sld "" UWORD B_TRUE 1 100 0 1 BIT_MASK 0x2 FORMAT "%13.11" ECU_ADDRESS 0x7F967C /end MEASUREMENT
/begin MEASUREMENT Z_sls "Zyklusflag: Sekund‰rluft-System" UWORD B_TRUE 1 100 0 1 BIT_MASK 0x2 FORMAT "%13.11" ECU_ADDRESS 0x7F9680 /end MEASUREMENT
/begin MEASUREMENT Z_sls2 "Zyklusflag: Sekund‰rluft-System Bank 2" UWORD B_TRUE 1 100 0 1 BIT_MASK 0x2 FORMAT "%13.11" ECU_ADDRESS 0x7F9684 /end MEASUREMENT
/begin MEASUREMENT Z_slv "Zyklusflag: Sekund‰rluftventil" UWORD B_TRUE 1 100 0 1 BIT_MASK 0x2 FORMAT "%13.11" ECU_ADDRESS 0x7F9688 /end MEASUREMENT
/begin MEASUREMENT Z_slv1e "Zyklusflag: SLV1E" UWORD B_TRUE 1 100 0 1 BIT_MASK 0x2 FORMAT "%13.11" ECU_ADDRESS 0x7F968C /end MEASUREMENT
/begin MEASUREMENT Z_slv2 "Zyklusflag: Sekund‰rluftventil, Bank 2" UWORD B_TRUE 1 100 0 1 BIT_MASK 0x2 FORMAT "%13.11" ECU_ADDRESS 0x7F9690 /end MEASUREMENT
/begin MEASUREMENT Z_slv2e "Zyklusflag: SLV2E" UWORD B_TRUE 1 100 0 1 BIT_MASK 0x2 FORMAT "%13.11" ECU_ADDRESS 0x7F9694 /end MEASUREMENT
/begin MEASUREMENT Z_sst "" UWORD B_TRUE 1 100 0 1 BIT_MASK 0x2 FORMAT "%13.11" ECU_ADDRESS 0x7F9698 /end MEASUREMENT
/begin MEASUREMENT Z_sst2e "" UWORD B_TRUE 1 100 0 1 BIT_MASK 0x2 FORMAT "%13.11" ECU_ADDRESS 0x7F969C /end MEASUREMENT
/begin MEASUREMENT Z_starte "Zyklusflag: STARTE" UWORD B_TRUE 1 100 0 1 BIT_MASK 0x2 FORMAT "%13.11" ECU_ADDRESS 0x7F96A0 /end MEASUREMENT
/begin MEASUREMENT Z_stp1 "" UWORD B_TRUE 1 100 0 1 BIT_MASK 0x2 FORMAT "%13.11" ECU_ADDRESS 0x7F96A4 /end MEASUREMENT
/begin MEASUREMENT Z_stp2 "" UWORD B_TRUE 1 100 0 1 BIT_MASK 0x2 FORMAT "%13.11" ECU_ADDRESS 0x7F96A8 /end MEASUREMENT
/begin MEASUREMENT Z_ta "Zyklusflag: TANS" UWORD B_TRUE 1 100 0 1 BIT_MASK 0x2 FORMAT "%13.11" ECU_ADDRESS 0x7F96AC /end MEASUREMENT
/begin MEASUREMENT Z_tcj945 "Zyklusflag: ‹bertemperatur CJ945" UWORD B_TRUE 1 100 0 1 BIT_MASK 0x2 FORMAT "%13.11" ECU_ADDRESS 0x7F96B0 /end MEASUREMENT
/begin MEASUREMENT Z_tcy315 "Zyklusflag: ‹bertemperatur CY315" UWORD B_TRUE 1 100 0 1 BIT_MASK 0x2 FORMAT "%13.11" ECU_ADDRESS 0x7F96B4 /end MEASUREMENT
/begin MEASUREMENT Z_tde "" UWORD B_TRUE 1 100 0 1 BIT_MASK 0x2 FORMAT "%13.11" ECU_ADDRESS 0x7F96B8 /end MEASUREMENT
/begin MEASUREMENT Z_tes "Zyklusflag: Tankentl¸ftungssystem" UWORD B_TRUE 1 100 0 1 BIT_MASK 0x2 FORMAT "%13.11" ECU_ADDRESS 0x7F96BC /end MEASUREMENT
/begin MEASUREMENT Z_teve "Zyklusflag: TEVE" UWORD B_TRUE 1 100 0 1 BIT_MASK 0x2 FORMAT "%13.11" ECU_ADDRESS 0x7F96C4 /end MEASUREMENT
/begin MEASUREMENT Z_ths "Zyklusflag DTHS" UWORD B_TRUE 1 100 0 1 BIT_MASK 0x2 FORMAT "%13.11" ECU_ADDRESS 0x7F96C8 /end MEASUREMENT
/begin MEASUREMENT Z_tm "Zyklusflag:	TMOT" UWORD B_TRUE 1 100 0 1 BIT_MASK 0x2 FORMAT "%13.11" ECU_ADDRESS 0x7F96CC /end MEASUREMENT
/begin MEASUREMENT Z_TZYL1 "Zyklusflag Kopftemperatur" UWORD B_TRUE 1 100 0 1 BIT_MASK 0x2 FORMAT "%13.11" ECU_ADDRESS 0x7F96D0 /end MEASUREMENT
/begin MEASUREMENT Z_TZYL2 "Zyklusflag Kopftemperatur" UWORD B_TRUE 1 100 0 1 BIT_MASK 0x2 FORMAT "%13.11" ECU_ADDRESS 0x7F96D4 /end MEASUREMENT
/begin MEASUREMENT Z_u5vg1 "Zyklusflag: Fehler Geberversorgung 1" UWORD B_TRUE 1 100 0 1 BIT_MASK 0x2 FORMAT "%13.11" ECU_ADDRESS 0x7F96D8 /end MEASUREMENT
/begin MEASUREMENT Z_u5vg2 "Zyklusflag: Fehler Geberversorgung 2" UWORD B_TRUE 1 100 0 1 BIT_MASK 0x2 FORMAT "%13.11" ECU_ADDRESS 0x7F96DC /end MEASUREMENT
/begin MEASUREMENT Z_u5vg3 "Zyklusflag: Fehler Geberversorgung 3" UWORD B_TRUE 1 100 0 1 BIT_MASK 0x2 FORMAT "%13.11" ECU_ADDRESS 0x7F96E0 /end MEASUREMENT
/begin MEASUREMENT Z_ub "Zyklusflag:	UB" UWORD B_TRUE 1 100 0 1 BIT_MASK 0x2 FORMAT "%13.11" ECU_ADDRESS 0x7F96E4 /end MEASUREMENT
/begin MEASUREMENT Z_urram "Zyklusflag: Rechner¸berwachung: RAM" UWORD B_TRUE 1 100 0 1 BIT_MASK 0x2 FORMAT "%13.11" ECU_ADDRESS 0x7F96E8 /end MEASUREMENT
/begin MEASUREMENT Z_urrom "Zyklusflag: Rechner¸berwachung: ROM" UWORD B_TRUE 1 100 0 1 BIT_MASK 0x2 FORMAT "%13.11" ECU_ADDRESS 0x7F96EC /end MEASUREMENT
/begin MEASUREMENT Z_urrst "Zyklusflag: Rechner¸berwachung: Reset" UWORD B_TRUE 1 100 0 1 BIT_MASK 0x2 FORMAT "%13.11" ECU_ADDRESS 0x7F96F0 /end MEASUREMENT
/begin MEASUREMENT Z_vfz "Zyklusflag: Fahrzeug-Geschwindigkeit" UWORD B_TRUE 1 100 0 1 BIT_MASK 0x2 FORMAT "%13.11" ECU_ADDRESS 0x7F96F4 /end MEASUREMENT
/begin FUNCTION DFPM_DKUPPL "" /begin DEF_CHARACTERISTIC CDCKUPPL CDKKUPPL CDTKUPPL CLAKUPPL FFTKUPPL TSFKUPPL /end DEF_CHARACTERISTIC /begin REF_CHARACTERISTIC /end REF_CHARACTERISTIC /begin IN_MEASUREMENT /end IN_MEASUREMENT
 /begin OUT_MEASUREMENT B_bekuppl B_bkkuppl B_clkuppl B_ftkuppl B_mnkuppl B_mxkuppl B_npkuppl B_sikuppl E_kuppl sfpkuppl TYP_kuppl Z_kuppl /end OUT_MEASUREMENT
 /begin LOC_MEASUREMENT /end LOC_MEASUREMENT
 /begin SUB_FUNCTION /end SUB_FUNCTION
/end FUNCTION
/begin FUNCTION DFPM_DKVS ""
 /begin DEF_CHARACTERISTIC CDCFRAO CDCFRAO2 CDCFRAU CDCFRAU2 CDCFRST CDCFRST2 CDCRKAT CDCRKAT2 CDCRKAZ CDCRKAZ2 CDKFRAO CDKFRAO2 CDKFRAU CDKFRAU2 CDKFRST CDKFRST2 CDKRKAT CDKRKAT2 CDKRKAZ CDKRKAZ2 CDTFRAO CDTFRAO2 CDTFRAU CDTFRAU2 CDTFRST CDTFRST2 CDTRKAT CDTRKAT2 CDTRKAZ CDTRKAZ2 CLAFRAO CLAFRAO2 CLAFRAU CLAFRAU2 CLAFRST CLAFRST2 CLARKAT CLARKAT2 CLARKAZ CLARKAZ2 FFTFRAO FFTFRAO2 FFTFRAU FFTFRAU2 FFTFRST FFTFRST2 FFTRKAT FFTRKAT2 FFTRKAZ FFTRKAZ2 TSFFRAO TSFFRAO2 TSFFRAU TSFFRAU2 TSFFRST TSFFRST2 TSFRKAT TSFRKAT2 TSFRKAZ TSFRKAZ2 /end DEF_CHARACTERISTIC
 /begin REF_CHARACTERISTIC /end REF_CHARACTERISTIC
 /begin IN_MEASUREMENT /end IN_MEASUREMENT
 /begin OUT_MEASUREMENT B_befrao B_befrao2 B_befrau B_befrau2 B_befrst B_befrst2 B_berkat B_berkat2 B_berkaz B_berkaz2 B_bkfrao B_bkfrao2 B_bkfrau B_bkfrau2 B_bkfrst B_bkfrst2 B_bkrkat B_bkrkat2 B_bkrkaz B_bkrkaz2 B_clfrao B_clfrao2 B_clfrau B_clfrau2 B_clfrst B_clfrst2 B_clrkat B_clrkat2 B_clrkaz B_clrkaz2 B_ftfrao B_ftfrao2 B_ftfrau B_ftfrau2 B_ftfrst B_ftfrst2 B_ftrkat B_ftrkat2 B_ftrkaz B_ftrkaz2 B_mnfrao B_mnfrao2 B_mnfrau B_mnfrau2 B_mnfrst B_mnfrst2 B_mnrkat B_mnrkat2 B_mnrkaz B_mnrkaz2 B_mxfrao B_mxfrao2 B_mxfrau B_mxfrau2 B_mxfrst B_mxfrst2 B_mxrkat B_mxrkat2 B_mxrkaz B_mxrkaz2 B_npfrao B_npfrao2 B_npfrau B_npfrau2 B_npfrst B_npfrst2 B_nprkat B_nprkat2 B_nprkaz B_nprkaz2 B_sifrao B_sifrao2 B_sifrau B_sifrau2 B_sifrst B_sifrst2 B_sirkat B_sirkat2 B_sirkaz B_sirkaz2 E_frao E_frao2 E_frau E_frau2 E_frst E_frst2 E_rkat E_rkat2 E_rkaz E_rkaz2 sfpfrao sfpfrao2 sfpfrau sfpfrau2 sfpfrst sfpfrst2 sfprkat sfprkat2 sfprkaz sfprkaz2 TYP_frao TYP_frao2 TYP_frau TYP_frau2 TYP_frst TYP_frst2 TYP_rkat TYP_rkat2 TYP_rkaz TYP_rkaz2 Z_frao Z_frao2 Z_frau Z_frau2 Z_frst Z_frst2 Z_rkat Z_rkat2 Z_rkaz Z_rkaz2 /end OUT_MEASUREMENT
 /begin LOC_MEASUREMENT /end LOC_MEASUREMENT
 /begin SUB_FUNCTION /end SUB_FUNCTION
/end FUNCTION
/begin FUNCTION DFPM_DLLR "" /begin DEF_CHARACTERISTIC CDCLLR CDKLLR CDTLLR CLALLR FFTLLR TSFLLR /end DEF_CHARACTERISTIC /begin REF_CHARACTERISTIC /end REF_CHARACTERISTIC /begin IN_MEASUREMENT /end IN_MEASUREMENT
 /begin OUT_MEASUREMENT B_bellr B_bkllr B_clllr B_ftllr B_mnllr B_mxllr B_npllr B_sillr E_llr sfpllr TYP_LLR Z_llr /end OUT_MEASUREMENT
 /begin LOC_MEASUREMENT /end LOC_MEASUREMENT
 /begin SUB_FUNCTION /end SUB_FUNCTION
/end FUNCTION
/begin FUNCTION DFPM_DLSA ""
 /begin DEF_CHARACTERISTIC CDCLATP CDCLATP2 CDCLATV CDCLATV2 CDKLATP CDKLATP2 CDKLATV CDKLATV2 CDTLATP CDTLATP2 CDTLATV CDTLATV2 CLALATP CLALATP2 CLALATV CLALATV2 FFTLATP FFTLATP2 FFTLATV FFTLATV2 TSFLATP TSFLATP2 TSFLATV TSFLATV2 /end DEF_CHARACTERISTIC
 /begin REF_CHARACTERISTIC /end REF_CHARACTERISTIC
 /begin IN_MEASUREMENT /end IN_MEASUREMENT
 /begin OUT_MEASUREMENT B_belatp B_belatp2 B_belatv B_belatv2 B_bklatp B_bklatp2 B_bklatv B_bklatv2 B_cllatp B_cllatp2 B_cllatv B_cllatv2 B_ftlatp B_ftlatp2 B_ftlatv B_ftlatv2 B_mnlatp B_mnlatp2 B_mnlatv B_mnlatv2 B_mxlatp B_mxlatp2 B_mxlatv B_mxlatv2 B_nplatp B_nplatp2 B_nplatv B_nplatv2 B_silatp B_silatp2 B_silatv B_silatv2 E_latp E_latp2 E_latv E_latv2 sfplatp sfplatp2 sfplatv sfplatv2 TYP_latp TYP_latp2 TYP_latv TYP_latv2 Z_latp Z_latp2 Z_latv Z_latv2 /end OUT_MEASUREMENT
 /begin LOC_MEASUREMENT /end LOC_MEASUREMENT
 /begin SUB_FUNCTION /end SUB_FUNCTION
/end FUNCTION
/begin FUNCTION DFPM_DLSHVKE ""
 /begin DEF_CHARACTERISTIC CDCLSHVK1E CDCLSHVK2E CDKLSHVK1E CDKLSHVK2E CDTLSHVK1E CDTLSHVK2E CLALSHVK1E CLALSHVK2E FFTLSHVK1E FFTLSHVK2E TSFLSHVK1E TSFLSHVK2E /end DEF_CHARACTERISTIC
 /begin REF_CHARACTERISTIC /end REF_CHARACTERISTIC
 /begin IN_MEASUREMENT /end IN_MEASUREMENT
 /begin OUT_MEASUREMENT B_belshv1e B_belshv2e B_bklshv1e B_bklshv2e B_cllshv1e B_cllshv2e B_ftlshv1e B_ftlshv2e B_mnlshv1e B_mnlshv2e B_mxlshv1e B_mxlshv2e B_nplshv1e B_nplshv2e B_silshv1e B_silshv2e E_lshvk1e E_lshvk2e sfplshvk1e sfplshvk2e TYP_lshv1e TYP_lshv2e Z_lshvk1e Z_lshvk2e /end OUT_MEASUREMENT
 /begin LOC_MEASUREMENT /end LOC_MEASUREMENT
 /begin SUB_FUNCTION /end SUB_FUNCTION
/end FUNCTION
/begin FUNCTION DFPM_DLSV ""
 /begin DEF_CHARACTERISTIC CDCLSV CDCLSV2 CDKLSV CDKLSV2 CDTLSV CDTLSV2 CLALSV CLALSV2 FFTLSV FFTLSV2 TSFLSV TSFLSV2 /end DEF_CHARACTERISTIC
 /begin REF_CHARACTERISTIC /end REF_CHARACTERISTIC
 /begin IN_MEASUREMENT /end IN_MEASUREMENT
 /begin OUT_MEASUREMENT B_belsv B_belsv2 B_bklsv B_bklsv2 B_cllsv B_cllsv2 B_ftlsv B_ftlsv2 B_mnlsv B_mnlsv2 B_mxlsv B_mxlsv2 B_nplsv B_nplsv2 B_silsv B_silsv2 E_lsv E_lsv2 sfplsv sfplsv2 TYP_lsv TYP_lsv2 Z_lsv Z_lsv2 /end OUT_MEASUREMENT
 /begin LOC_MEASUREMENT /end LOC_MEASUREMENT
 /begin SUB_FUNCTION /end SUB_FUNCTION
/end FUNCTION
/begin FUNCTION DFPM_DMLS "" /begin DEF_CHARACTERISTIC CDCDMLS CDKDMLS CDTDMLS CLADMLS FFTDMLS TSFDMLS /end DEF_CHARACTERISTIC /begin REF_CHARACTERISTIC /end REF_CHARACTERISTIC /begin IN_MEASUREMENT /end IN_MEASUREMENT
 /begin OUT_MEASUREMENT B_bedmls B_bkdmls B_cldmls B_ftdmls B_mndmls B_mxdmls B_npdmls B_sidmls E_dmls sfpdmls TYP_dmls Z_dmls /end OUT_MEASUREMENT
 /begin LOC_MEASUREMENT /end LOC_MEASUREMENT
 /begin SUB_FUNCTION /end SUB_FUNCTION
/end FUNCTION
/begin FUNCTION DFPM_DOS "" /begin DEF_CHARACTERISTIC CDCOS CDKOS CDTOS CLAOS FFTOS TSFOS /end DEF_CHARACTERISTIC /begin REF_CHARACTERISTIC /end REF_CHARACTERISTIC /begin IN_MEASUREMENT /end IN_MEASUREMENT
 /begin OUT_MEASUREMENT B_beos B_bkos B_clos B_ftos B_mnos B_mxos B_npos B_sios E_os sfpos TYP_os Z_os /end OUT_MEASUREMENT
 /begin LOC_MEASUREMENT /end LOC_MEASUREMENT
 /begin SUB_FUNCTION /end SUB_FUNCTION
/end FUNCTION
/begin FUNCTION DFPM_DPH "" /begin DEF_CHARACTERISTIC CDCPH CDKPH CDTPH CLAPH FFTPH TSFPH /end DEF_CHARACTERISTIC /begin REF_CHARACTERISTIC /end REF_CHARACTERISTIC /begin IN_MEASUREMENT /end IN_MEASUREMENT
 /begin OUT_MEASUREMENT B_beph B_bkph B_clph B_ftph B_mnph B_mxph B_npph B_siph E_ph sfpph TYP_ph Z_ph /end OUT_MEASUREMENT
 /begin LOC_MEASUREMENT /end LOC_MEASUREMENT
 /begin SUB_FUNCTION /end SUB_FUNCTION
/end FUNCTION
/begin FUNCTION DFPM_DPHW "" /begin DEF_CHARACTERISTIC CDCPHW CDKPHW CDTPHW CLAPHW FFTPHW TSFPHW /end DEF_CHARACTERISTIC /begin REF_CHARACTERISTIC /end REF_CHARACTERISTIC /begin IN_MEASUREMENT /end IN_MEASUREMENT
 /begin OUT_MEASUREMENT B_bephw B_bkphw B_clphw B_ftphw B_mnphw B_mxphw B_npphw B_siphw E_phw sfpphw TYP_phw Z_phw /end OUT_MEASUREMENT
 /begin LOC_MEASUREMENT /end LOC_MEASUREMENT
 /begin SUB_FUNCTION /end SUB_FUNCTION
/end FUNCTION
/begin FUNCTION DFPM_DRADV "" /begin DEF_CHARACTERISTIC CDCRADV CDKRADV CDTRADV CLARADV FFTRADV TSFRADV /end DEF_CHARACTERISTIC /begin REF_CHARACTERISTIC /end REF_CHARACTERISTIC /begin IN_MEASUREMENT /end IN_MEASUREMENT
 /begin OUT_MEASUREMENT B_beradv B_bkradv B_clradv B_ftradv B_mnradv B_mxradv B_npradv B_siradv E_radv sfpradv TYP_radv Z_radv /end OUT_MEASUREMENT
 /begin LOC_MEASUREMENT /end LOC_MEASUREMENT
 /begin SUB_FUNCTION /end SUB_FUNCTION
/end FUNCTION
/begin FUNCTION DFPM_DSIKODA ""
 /begin DEF_CHARACTERISTIC CDCSIKODA CDKSIKODA CDTSIKODA CLASIKODA FFTSIKODA TSFSIKODA /end DEF_CHARACTERISTIC
 /begin REF_CHARACTERISTIC /end REF_CHARACTERISTIC
 /begin IN_MEASUREMENT /end IN_MEASUREMENT
 /begin OUT_MEASUREMENT B_besikoda B_bksikoda B_clsikoda B_ftsikoda B_mnsikoda B_mxsikoda B_npsikoda B_sisikoda E_sikoda sfpsikoda TYP_sikoda Z_sikoda /end OUT_MEASUREMENT
 /begin LOC_MEASUREMENT /end LOC_MEASUREMENT
 /begin SUB_FUNCTION /end SUB_FUNCTION
/end FUNCTION
/begin FUNCTION DFPM_DSLD "" /begin DEF_CHARACTERISTIC CDCSLD CDKSLD CDTSLD CLASLD FFTSLD TSFSLD /end DEF_CHARACTERISTIC /begin REF_CHARACTERISTIC /end REF_CHARACTERISTIC /begin IN_MEASUREMENT /end IN_MEASUREMENT
 /begin OUT_MEASUREMENT B_besld B_bksld B_clsld B_ftsld B_mnsld B_mxsld B_npsld B_sisld E_sld sfpsld TYP_sld Z_sld /end OUT_MEASUREMENT
 /begin LOC_MEASUREMENT /end LOC_MEASUREMENT
 /begin SUB_FUNCTION /end SUB_FUNCTION
/end FUNCTION
/begin FUNCTION DFPM_DSLSLR ""
 /begin DEF_CHARACTERISTIC CDCSLS CDCSLS2 CDCSLV CDCSLV2 CDKSLS CDKSLS2 CDKSLV CDKSLV2 CDTSLS CDTSLS2 CDTSLV CDTSLV2 CLASLS CLASLS2 CLASLV CLASLV2 FFTSLS FFTSLS2 FFTSLV FFTSLV2 TSFSLS TSFSLS2 TSFSLV TSFSLV2 /end DEF_CHARACTERISTIC
 /begin REF_CHARACTERISTIC /end REF_CHARACTERISTIC
 /begin IN_MEASUREMENT /end IN_MEASUREMENT
 /begin OUT_MEASUREMENT B_besls B_besls2 B_beslv B_beslv2 B_bksls B_bksls2 B_bkslv B_bkslv2 B_clsls B_clsls2 B_clslv B_clslv2 B_ftsls B_ftsls2 B_ftslv B_ftslv2 B_mnsls B_mnsls2 B_mnslv B_mnslv2 B_mxsls B_mxsls2 B_mxslv B_mxslv2 B_npsls B_npsls2 B_npslv B_npslv2 B_sisls B_sisls2 B_sislv B_sislv2 E_sls E_sls2 E_slv E_slv2 sfpsls sfpsls2 sfpslv sfpslv2 TYP_sls TYP_sls2 TYP_slv TYP_slv2 Z_sls Z_sls2 Z_slv Z_slv2 /end OUT_MEASUREMENT
 /begin LOC_MEASUREMENT /end LOC_MEASUREMENT
 /begin SUB_FUNCTION /end SUB_FUNCTION
/end FUNCTION
/begin FUNCTION DFPM_DSLVE ""
 /begin DEF_CHARACTERISTIC CDCSLV1E CDCSLV2E CDKSLV1E CDKSLV2E CDTSLV1E CDTSLV2E CLASLV1E CLASLV2E FFTSLV1E FFTSLV2E TSFSLV1E TSFSLV2E /end DEF_CHARACTERISTIC
 /begin REF_CHARACTERISTIC /end REF_CHARACTERISTIC
 /begin IN_MEASUREMENT /end IN_MEASUREMENT
 /begin OUT_MEASUREMENT B_beslv1e B_beslv2e B_bkslv1e B_bkslv2e B_clslv1e B_clslv2e B_ftslv1e B_ftslv2e B_mnslv1e B_mnslv2e B_mxslv1e B_mxslv2e B_npslv1e B_npslv2e B_sislv1e B_sislv2e E_slv1e E_slv2e sfpslv1e sfpslv2e TYP_slv1e TYP_slv2e Z_slv1e Z_slv2e /end OUT_MEASUREMENT
 /begin LOC_MEASUREMENT /end LOC_MEASUREMENT
 /begin SUB_FUNCTION /end SUB_FUNCTION
/end FUNCTION
/begin FUNCTION DFPM_DSST "" /begin DEF_CHARACTERISTIC CDCSST CDKSST CDTSST CLASST FFTSST TSFSST /end DEF_CHARACTERISTIC /begin REF_CHARACTERISTIC /end REF_CHARACTERISTIC /begin IN_MEASUREMENT /end IN_MEASUREMENT
 /begin OUT_MEASUREMENT B_besst B_bksst B_clsst B_ftsst B_mnsst B_mxsst B_npsst B_sisst E_sst sfpsst TYP_sst Z_sst /end OUT_MEASUREMENT
 /begin LOC_MEASUREMENT /end LOC_MEASUREMENT
 /begin SUB_FUNCTION /end SUB_FUNCTION
/end FUNCTION
/begin FUNCTION DFPM_DSSTE "" /begin DEF_CHARACTERISTIC CDCSST2E CDKSST2E CDTSST2E CLASST2E FFTSST2E TSFSST2E /end DEF_CHARACTERISTIC /begin REF_CHARACTERISTIC /end REF_CHARACTERISTIC /begin IN_MEASUREMENT /end IN_MEASUREMENT
 /begin OUT_MEASUREMENT B_besst2e B_bksst2e B_clsst2e B_ftsst2e B_mnsst2e B_mxsst2e B_npsst2e B_sisst2e E_sst2e sfpsst2e TYP_sst2e Z_sst2e /end OUT_MEASUREMENT
 /begin LOC_MEASUREMENT /end LOC_MEASUREMENT
 /begin SUB_FUNCTION /end SUB_FUNCTION
/end FUNCTION
/begin FUNCTION DFPM_DSTARTE ""
 /begin DEF_CHARACTERISTIC CDCSTARTE CDKSTARTE CDTSTARTE CLASTARTE FFTSTARTE TSFSTARTE /end DEF_CHARACTERISTIC
 /begin REF_CHARACTERISTIC /end REF_CHARACTERISTIC
 /begin IN_MEASUREMENT /end IN_MEASUREMENT
 /begin OUT_MEASUREMENT B_bestarte B_bkstarte B_clstarte B_ftstarte B_mnstarte B_mxstarte B_npstarte B_sistarte E_starte sfpstarte TYP_starte Z_starte /end OUT_MEASUREMENT
 /begin LOC_MEASUREMENT /end LOC_MEASUREMENT
 /begin SUB_FUNCTION /end SUB_FUNCTION
/end FUNCTION
/begin FUNCTION DFPM_DSTP1 "" /begin DEF_CHARACTERISTIC CDCSTP1 CDKSTP1 CDTSTP1 CLASTP1 FFTSTP1 TSFSTP1 /end DEF_CHARACTERISTIC /begin REF_CHARACTERISTIC /end REF_CHARACTERISTIC /begin IN_MEASUREMENT /end IN_MEASUREMENT
 /begin OUT_MEASUREMENT B_bestp1 B_bkstp1 B_clstp1 B_ftstp1 B_mnstp1 B_mxstp1 B_npstp1 B_sistp1 E_stp1 sfpstp1 TYP_stp1 Z_stp1 /end OUT_MEASUREMENT
 /begin LOC_MEASUREMENT /end LOC_MEASUREMENT
 /begin SUB_FUNCTION /end SUB_FUNCTION
/end FUNCTION
/begin FUNCTION DFPM_DSTP2 "" /begin DEF_CHARACTERISTIC CDCSTP2 CDKSTP2 CDTSTP2 CLASTP2 FFTSTP2 TSFSTP2 /end DEF_CHARACTERISTIC /begin REF_CHARACTERISTIC /end REF_CHARACTERISTIC /begin IN_MEASUREMENT /end IN_MEASUREMENT
 /begin OUT_MEASUREMENT B_bestp2 B_bkstp2 B_clstp2 B_ftstp2 B_mnstp2 B_mxstp2 B_npstp2 B_sistp2 E_stp2 sfpstp2 TYP_stp2 Z_stp2 /end OUT_MEASUREMENT
 /begin LOC_MEASUREMENT /end LOC_MEASUREMENT
 /begin SUB_FUNCTION /end SUB_FUNCTION
/end FUNCTION
/begin FUNCTION DFPM_DTCJ945 ""
 /begin DEF_CHARACTERISTIC CDCTCJ945 CDKTCJ945 CDTTCJ945 CLATCJ945 FFTTCJ945 TSFTCJ945 /end DEF_CHARACTERISTIC
 /begin REF_CHARACTERISTIC /end REF_CHARACTERISTIC
 /begin IN_MEASUREMENT /end IN_MEASUREMENT
 /begin OUT_MEASUREMENT B_betcj945 B_bktcj945 B_cltcj945 B_fttcj945 B_mntcj945 B_mxtcj945 B_nptcj945 B_sitcj945 E_tcj945 sfptcj945 TYP_tcj945 Z_tcj945 /end OUT_MEASUREMENT
 /begin LOC_MEASUREMENT /end LOC_MEASUREMENT
 /begin SUB_FUNCTION /end SUB_FUNCTION
/end FUNCTION
/begin FUNCTION DFPM_DTCY315 ""
 /begin DEF_CHARACTERISTIC CDCTCY315 CDKTCY315 CDTTCY315 CLATCY315 FFTTCY315 TSFTCY315 /end DEF_CHARACTERISTIC
 /begin REF_CHARACTERISTIC /end REF_CHARACTERISTIC
 /begin IN_MEASUREMENT /end IN_MEASUREMENT
 /begin OUT_MEASUREMENT B_betcy315 B_bktcy315 B_cltcy315 B_fttcy315 B_mntcy315 B_mxtcy315 B_nptcy315 B_sitcy315 E_tcy315 sfptcy315 TYP_tcy315 Z_tcy315 /end OUT_MEASUREMENT
 /begin LOC_MEASUREMENT /end LOC_MEASUREMENT
 /begin SUB_FUNCTION /end SUB_FUNCTION
/end FUNCTION
/begin FUNCTION DFPM_DTDE "" /begin DEF_CHARACTERISTIC CDCTDE CDKTDE CDTTDE CLATDE FFTTDE TSFTDE /end DEF_CHARACTERISTIC /begin REF_CHARACTERISTIC /end REF_CHARACTERISTIC /begin IN_MEASUREMENT /end IN_MEASUREMENT
 /begin OUT_MEASUREMENT B_betde B_bktde B_cltde B_fttde B_mntde B_mxtde B_nptde B_sitde E_tde sfptde TYP_tde Z_tde /end OUT_MEASUREMENT
 /begin LOC_MEASUREMENT /end LOC_MEASUREMENT
 /begin SUB_FUNCTION /end SUB_FUNCTION
/end FUNCTION
/begin FUNCTION DFPM_DTEVE "" /begin DEF_CHARACTERISTIC CDCTEVE CDKTEVE CDTTEVE CLATEVE FFTTEVE TSFTEVE /end DEF_CHARACTERISTIC /begin REF_CHARACTERISTIC /end REF_CHARACTERISTIC /begin IN_MEASUREMENT /end IN_MEASUREMENT
 /begin OUT_MEASUREMENT B_beteve B_bkteve B_clteve B_ftteve B_mnteve B_mxteve B_npteve B_siteve E_teve sfpteve TYP_teve Z_teve /end OUT_MEASUREMENT
 /begin LOC_MEASUREMENT /end LOC_MEASUREMENT
 /begin SUB_FUNCTION /end SUB_FUNCTION
/end FUNCTION
/begin FUNCTION DFPM_DTEVN "" /begin DEF_CHARACTERISTIC CDCTES CDKTES CDTTES CLATES FFTTES TSFTES /end DEF_CHARACTERISTIC /begin REF_CHARACTERISTIC /end REF_CHARACTERISTIC /begin IN_MEASUREMENT /end IN_MEASUREMENT /begin OUT_MEASUREMENT B_cltes B_mntes E_tes sfptes Z_tes /end OUT_MEASUREMENT /begin LOC_MEASUREMENT /end LOC_MEASUREMENT /begin SUB_FUNCTION /end SUB_FUNCTION /end FUNCTION
/begin FUNCTION DFPM_DTHS "DTHS." /begin DEF_CHARACTERISTIC CDCTHS CDKTHS CDTTHS CLATHS FFTTHS TSFTHS /end DEF_CHARACTERISTIC /begin REF_CHARACTERISTIC /end REF_CHARACTERISTIC /begin IN_MEASUREMENT /end IN_MEASUREMENT
 /begin OUT_MEASUREMENT B_beths B_bkths B_clths B_ftths B_mnths B_mxths B_npths B_siths E_ths sfpths TYP_ths Z_ths /end OUT_MEASUREMENT
 /begin LOC_MEASUREMENT /end LOC_MEASUREMENT
 /begin SUB_FUNCTION /end SUB_FUNCTION
/end FUNCTION
/begin FUNCTION DFPM_DU5VG ""
 /begin DEF_CHARACTERISTIC CDCU5VG1 CDCU5VG2 CDCU5VG3 CDKU5VG1 CDKU5VG2 CDKU5VG3 CDTU5VG1 CDTU5VG2 CDTU5VG3 CLAU5VG1 CLAU5VG2 CLAU5VG3 FFTU5VG1 FFTU5VG2 FFTU5VG3 TSFU5VG1 TSFU5VG2 TSFU5VG3 /end DEF_CHARACTERISTIC
 /begin REF_CHARACTERISTIC /end REF_CHARACTERISTIC
 /begin IN_MEASUREMENT /end IN_MEASUREMENT
 /begin OUT_MEASUREMENT B_beu5vg1 B_beu5vg2 B_beu5vg3 B_bku5vg1 B_bku5vg2 B_bku5vg3 B_clu5vg1 B_clu5vg2 B_clu5vg3 B_ftu5vg1 B_ftu5vg2 B_ftu5vg3 B_mnu5vg1 B_mnu5vg2 B_mnu5vg3 B_mxu5vg1 B_mxu5vg2 B_mxu5vg3 B_npu5vg1 B_npu5vg2 B_npu5vg3 B_siu5vg1 B_siu5vg2 B_siu5vg3 E_u5vg1 E_u5vg2 E_u5vg3 sfpu5vg1 sfpu5vg2 sfpu5vg3 TYP_u5vg1 TYP_u5vg2 TYP_u5vg3 Z_u5vg1 Z_u5vg2 Z_u5vg3 /end OUT_MEASUREMENT
 /begin LOC_MEASUREMENT /end LOC_MEASUREMENT
 /begin SUB_FUNCTION /end SUB_FUNCTION
/end FUNCTION
/begin FUNCTION DFPM_DUR ""
 /begin DEF_CHARACTERISTIC CDCURRAM CDCURROM CDCURRST CDKURRAM CDKURROM CDKURRST CDTURRAM CDTURROM CDTURRST CLAURRAM CLAURROM CLAURRST FFTURRAM FFTURROM FFTURRST TSFURRAM TSFURROM TSFURRST /end DEF_CHARACTERISTIC
 /begin REF_CHARACTERISTIC /end REF_CHARACTERISTIC
 /begin IN_MEASUREMENT /end IN_MEASUREMENT
 /begin OUT_MEASUREMENT B_beurram B_beurrom B_beurrst B_bkurram B_bkurrom B_bkurrst B_clurram B_clurrom B_clurrst B_fturram B_fturrom B_fturrst B_mnurram B_mnurrom B_mnurrst B_mxurram B_mxurrom B_mxurrst B_npurram B_npurrom B_npurrst B_siurram B_siurrom B_siurrst E_urram E_urrom E_urrst sfpurram sfpurrom sfpurrst TYP_urram TYP_urrom TYP_urrst Z_urram Z_urrom Z_urrst /end OUT_MEASUREMENT
 /begin LOC_MEASUREMENT /end LOC_MEASUREMENT
 /begin SUB_FUNCTION /end SUB_FUNCTION
/end FUNCTION
/begin FUNCTION DFPM_DVFZ "" /begin DEF_CHARACTERISTIC CDCVFZ CDKVFZ CDTVFZ CLAVFZ FFTVFZ TSFVFZ /end DEF_CHARACTERISTIC /begin REF_CHARACTERISTIC /end REF_CHARACTERISTIC /begin IN_MEASUREMENT /end IN_MEASUREMENT
 /begin OUT_MEASUREMENT B_bevfz B_bkvfz B_clvfz B_ftvfz B_mnvfz B_mxvfz B_npvfz B_sivfz E_vfz sfpvfz TYP_vfz Z_vfz /end OUT_MEASUREMENT
 /begin LOC_MEASUREMENT /end LOC_MEASUREMENT
 /begin SUB_FUNCTION /end SUB_FUNCTION
/end FUNCTION
/begin FUNCTION DFPM_DVMAXMAN "" /begin DEF_CHARACTERISTIC /end DEF_CHARACTERISTIC /begin REF_CHARACTERISTIC /end REF_CHARACTERISTIC /begin IN_MEASUREMENT /end IN_MEASUREMENT /begin OUT_MEASUREMENT /end OUT_MEASUREMENT /begin LOC_MEASUREMENT /end LOC_MEASUREMENT /begin SUB_FUNCTION /end SUB_FUNCTION /end FUNCTION
/begin FUNCTION DFPM_EGFE "" /begin DEF_CHARACTERISTIC CDCEGFE CDKEGFE CDTEGFE CLAEGFE FFTEGFE TSFEGFE /end DEF_CHARACTERISTIC /begin REF_CHARACTERISTIC /end REF_CHARACTERISTIC /begin IN_MEASUREMENT /end IN_MEASUREMENT
 /begin OUT_MEASUREMENT B_beegfe B_bkegfe B_clegfe B_ftegfe B_mnegfe B_mxegfe B_npegfe B_siegfe E_egfe sfpegfe TYP_egfe Z_egfe /end OUT_MEASUREMENT
 /begin LOC_MEASUREMENT /end LOC_MEASUREMENT
 /begin SUB_FUNCTION /end SUB_FUNCTION
/end FUNCTION
/begin FUNCTION DFPM_FRPS "" /begin DEF_CHARACTERISTIC CDCFRPS CDKFRPS CDTFRPS CLAFRPS FFTFRPS TSFFRPS /end DEF_CHARACTERISTIC /begin REF_CHARACTERISTIC /end REF_CHARACTERISTIC /begin IN_MEASUREMENT /end IN_MEASUREMENT
 /begin OUT_MEASUREMENT B_befrps B_bkfrps B_clfrps B_mnfrps B_mxfrps B_npfrps B_sifrps E_frps sfpfrps Z_frps /end OUT_MEASUREMENT
 /begin LOC_MEASUREMENT /end LOC_MEASUREMENT
 /begin SUB_FUNCTION /end SUB_FUNCTION
/end FUNCTION
/begin FUNCTION DFPM_GGDSAS "" /begin DEF_CHARACTERISTIC CDCDSU CDKDSU CDTDSU CLADSU FFTDSU TSFDSU /end DEF_CHARACTERISTIC /begin REF_CHARACTERISTIC /end REF_CHARACTERISTIC /begin IN_MEASUREMENT /end IN_MEASUREMENT
 /begin OUT_MEASUREMENT B_bedsu B_bkdsu B_cldsu B_ftdsu B_mndsu B_mxdsu B_npdsu B_sidsu E_dsu sfpdsu TYP_dsu Z_dsu /end OUT_MEASUREMENT
 /begin LOC_MEASUREMENT /end LOC_MEASUREMENT
 /begin SUB_FUNCTION /end SUB_FUNCTION
/end FUNCTION
/begin FUNCTION DFPM_GGEGAS "" /begin DEF_CHARACTERISTIC CDCBREMS CDKBREMS CDTBREMS CLABREMS FFTBREMS TSFBREMS /end DEF_CHARACTERISTIC /begin REF_CHARACTERISTIC /end REF_CHARACTERISTIC /begin IN_MEASUREMENT /end IN_MEASUREMENT
 /begin OUT_MEASUREMENT B_bebrems B_bkbrems B_clbrems B_ftbrems B_mnbrems B_mxbrems B_npbrems B_sibrems E_brems sfpbrems TYP_brems Z_brems /end OUT_MEASUREMENT
 /begin LOC_MEASUREMENT /end LOC_MEASUREMENT
 /begin SUB_FUNCTION /end SUB_FUNCTION
/end FUNCTION
/begin FUNCTION DFPM_GGGANG "" /begin DEF_CHARACTERISTIC CDCGANG CDKGANG CDTGANG CLAGANG FFTGANG TSFGANG /end DEF_CHARACTERISTIC /begin REF_CHARACTERISTIC /end REF_CHARACTERISTIC /begin IN_MEASUREMENT /end IN_MEASUREMENT
 /begin OUT_MEASUREMENT B_begang B_bkgang B_clgang B_ftgang B_mngang B_mxgang B_npgang B_sigang E_GANG sfpgang TYP_gang Z_gang /end OUT_MEASUREMENT
 /begin LOC_MEASUREMENT /end LOC_MEASUREMENT
 /begin SUB_FUNCTION /end SUB_FUNCTION
/end FUNCTION
/begin FUNCTION DFPM_GGTFA "" /begin DEF_CHARACTERISTIC CDCTA CDKTA CDTTA CLATA FFTTA TSFTA /end DEF_CHARACTERISTIC /begin REF_CHARACTERISTIC /end REF_CHARACTERISTIC /begin IN_MEASUREMENT /end IN_MEASUREMENT
 /begin OUT_MEASUREMENT B_beta B_bkta B_clta B_ftta B_mnta B_mxta B_npta B_sita E_ta sfpta TYP_ta Z_ta /end OUT_MEASUREMENT
 /begin LOC_MEASUREMENT /end LOC_MEASUREMENT
 /begin SUB_FUNCTION /end SUB_FUNCTION
/end FUNCTION
/begin FUNCTION DFPM_GGTFM "" /begin DEF_CHARACTERISTIC CDCTM CDKTM CDTTM CLATM FFTTM TSFTM /end DEF_CHARACTERISTIC /begin REF_CHARACTERISTIC /end REF_CHARACTERISTIC /begin IN_MEASUREMENT /end IN_MEASUREMENT
 /begin OUT_MEASUREMENT B_betm B_bktm B_cltm B_fttm B_mntm B_mxtm B_nptm B_sitm E_tm sfptm TYP_tm Z_tm /end OUT_MEASUREMENT
 /begin LOC_MEASUREMENT /end LOC_MEASUREMENT
 /begin SUB_FUNCTION /end SUB_FUNCTION
/end FUNCTION
/begin FUNCTION DFPM_GGTZYL1 "" /begin DEF_CHARACTERISTIC CDCTZYL1 CDKTZYL1 CDTTZYL1 CLATZYL1 FFTTZYL1 TSFTZYL1 /end DEF_CHARACTERISTIC /begin REF_CHARACTERISTIC /end REF_CHARACTERISTIC /begin IN_MEASUREMENT /end IN_MEASUREMENT
 /begin OUT_MEASUREMENT B_betzyl1 B_bktzyl1 B_cltzyl1 B_fttzyl1 B_mntzyl1 B_mxtzyl1 B_nptzyl1 B_sitzyl1 E_TZYL1 sfptzyl1 TYP_tzyl1 Z_TZYL1 /end OUT_MEASUREMENT
 /begin LOC_MEASUREMENT /end LOC_MEASUREMENT
 /begin SUB_FUNCTION /end SUB_FUNCTION
/end FUNCTION
/begin FUNCTION DFPM_GGTZYL2 "" /begin DEF_CHARACTERISTIC CDCTZYL2 CDKTZYL2 CDTTZYL2 CLATZYL2 FFTTZYL2 TSFTZYL2 /end DEF_CHARACTERISTIC /begin REF_CHARACTERISTIC /end REF_CHARACTERISTIC /begin IN_MEASUREMENT /end IN_MEASUREMENT
 /begin OUT_MEASUREMENT B_betzyl2 B_bktzyl2 B_cltzyl2 B_fttzyl2 B_mntzyl2 B_mxtzyl2 B_nptzyl2 B_sitzyl2 E_TZYL2 sfptzyl2 TYP_tzyl2 Z_TZYL2 /end OUT_MEASUREMENT
 /begin LOC_MEASUREMENT /end LOC_MEASUREMENT
 /begin SUB_FUNCTION /end SUB_FUNCTION
/end FUNCTION
/begin FUNCTION DFPM_GGUB "" /begin DEF_CHARACTERISTIC CDCUB CDKUB CDTUB CLAUB FFTUB TSFUB /end DEF_CHARACTERISTIC /begin REF_CHARACTERISTIC /end REF_CHARACTERISTIC /begin IN_MEASUREMENT /end IN_MEASUREMENT
 /begin OUT_MEASUREMENT B_beub B_bkub B_club B_ftub B_mnub B_mxub B_npub B_siub E_ub sfpub TYP_ub Z_ub /end OUT_MEASUREMENT
 /begin LOC_MEASUREMENT /end LOC_MEASUREMENT
 /begin SUB_FUNCTION /end SUB_FUNCTION
/end FUNCTION
/begin FUNCTION DFPM_HSSEKP ""
 /begin DEF_CHARACTERISTIC CDCHSSEKP CDKHSSEKP CDTHSSEKP CLAHSSEKP FFTHSSEKP TSFHSSEKP /end DEF_CHARACTERISTIC
 /begin REF_CHARACTERISTIC /end REF_CHARACTERISTIC
 /begin IN_MEASUREMENT /end IN_MEASUREMENT
 /begin OUT_MEASUREMENT B_behssekp B_bkhssekp B_clhssekp B_fthssekp B_mnhssekp B_mxhssekp B_nphssekp B_sihssekp E_HSSEKP sfphssekp TYP_HSSEKP Z_HSSEKP /end OUT_MEASUREMENT
 /begin LOC_MEASUREMENT /end LOC_MEASUREMENT
 /begin SUB_FUNCTION /end SUB_FUNCTION
/end FUNCTION
/begin FUNCTION DFPM_HSSSYS ""
 /begin DEF_CHARACTERISTIC CDCHSSSYS CDKHSSSYS CDTHSSSYS CLAHSSSYS FFTHSSSYS TSFHSSSYS /end DEF_CHARACTERISTIC
 /begin REF_CHARACTERISTIC /end REF_CHARACTERISTIC
 /begin IN_MEASUREMENT /end IN_MEASUREMENT
 /begin OUT_MEASUREMENT B_behsssys B_bkhsssys B_clhsssys B_fthsssys B_mnhsssys B_mxhsssys B_nphsssys B_sihsssys E_HSSSYS sfphsssys TYP_HSSSYS Z_HSSSYS /end OUT_MEASUREMENT
 /begin LOC_MEASUREMENT /end LOC_MEASUREMENT
 /begin SUB_FUNCTION /end SUB_FUNCTION
/end FUNCTION
/begin FUNCTION DFPM_HSSZDG ""
 /begin DEF_CHARACTERISTIC CDCHSSZDG CDKHSSZDG CDTHSSZDG CLAHSSZDG FFTHSSZDG TSFHSSZDG /end DEF_CHARACTERISTIC
 /begin REF_CHARACTERISTIC /end REF_CHARACTERISTIC
 /begin IN_MEASUREMENT /end IN_MEASUREMENT
 /begin OUT_MEASUREMENT B_behsszdg B_bkhsszdg B_clhsszdg B_fthsszdg B_mnhsszdg B_mxhsszdg B_nphsszdg B_sihsszdg E_HSSZDG sfphsszdg TYP_HSSZDG Z_HSSZDG /end OUT_MEASUREMENT
 /begin LOC_MEASUREMENT /end LOC_MEASUREMENT
 /begin SUB_FUNCTION /end SUB_FUNCTION
/end FUNCTION
/begin COMPU_METHOD B_TRUE "" TAB_VERB "%6.3" "" COMPU_TAB_REF B_TRUE /end COMPU_METHOD
/begin COMPU_VTAB B_TRUE "" TAB_VERB 2 0 "false" 1 "TRUE" /end COMPU_VTAB
/begin COMPU_METHOD DEZ "" RAT_FUNC "%6.2" "" COEFFS 0 1 0 0 0 1 /end COMPU_METHOD
/begin COMPU_METHOD dez "" RAT_FUNC "%6.2" "" COEFFS 0 1 0 0 0 1 /end COMPU_METHOD
/begin COMPU_METHOD SFP_TYP "" TAB_VERB "%6.3" "" COMPU_TAB_REF SFP_TYP /end COMPU_METHOD
/begin COMPU_VTAB SFP_TYP "" TAB_VERB 5 0 "clear" 1 "MAX" 2 "MIN" 4 "SIG" 8 "NPL" /end COMPU_VTAB
/begin COMPU_METHOD default "" RAT_FUNC "%6.2" "" COEFFS 0 1 0 0 0 1 /end COMPU_METHOD
/begin RECORD_LAYOUT KwbUb FNC_VALUES 1 UBYTE COLUMN_DIR DIRECT /end RECORD_LAYOUT
/begin RECORD_LAYOUT KwbUw FNC_VALUES 1 UWORD COLUMN_DIR DIRECT /end RECORD_LAYOUT
/begin RECORD_LAYOUT KwbWU16 FNC_VALUES 1 UWORD COLUMN_DIR DIRECT /end RECORD_LAYOUT
/begin RECORD_LAYOUT KwbWU8 FNC_VALUES 1 UBYTE COLUMN_DIR DIRECT /end RECORD_LAYOUT
/begin RECORD_LAYOUT KwUb FNC_VALUES 1 UBYTE COLUMN_DIR DIRECT /end RECORD_LAYOUT
/begin RECORD_LAYOUT KwUw FNC_VALUES 1 UWORD COLUMN_DIR DIRECT /end RECORD_LAYOUT
/begin RECORD_LAYOUT KwWU16 FNC_VALUES 1 UWORD COLUMN_DIR DIRECT /end RECORD_LAYOUT
/begin RECORD_LAYOUT KwWU8 FNC_VALUES 1 UBYTE COLUMN_DIR DIRECT /end RECORD_LAYOUT
/end MODULE
/end PROJECT
