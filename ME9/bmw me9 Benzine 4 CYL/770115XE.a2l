ASAP2_VERSION 1 3
/begin PROJECT basisme9 ""
/begin HEADER "" VERSION "basisme9" PROJECT_NO basisme9 /end HEADER
/begin MODULE DIM ""
/begin MOD_COMMON "" BYTE_ORDER MSB_FIRST ALIGNMENT_BYTE 1 ALIGNMENT_WORD 2 ALIGNMENT_LONG 2 ALIGNMENT_FLOAT32_IEEE 4 /end MOD_COMMON
/begin CHARACTERISTIC ABAOVMX "Max. Anzahl Beschleunigungsvorg‰nge ohne Adaptionswertr¸ckstellung" VALUE 0x4E4780 KwUb 254.0 dez 1.000 255.0 FORMAT "%5.1" /end CHARACTERISTIC
/begin CHARACTERISTIC AMNUUKA "Minimalanzahl Sondenspr¸nge zwischen 2 Adaptionsvorg‰ngen (‹K-Adaption)" VALUE 0x4E4781 KwUb 253.0 dez 2.000 255.0 FORMAT "%5.1" /end CHARACTERISTIC
/begin CHARACTERISTIC ANZRIBEV "Anzahl der Ri-Berechnungen vor KAT" VALUE 0x4E51BE KwUb 255.0 dez 0.00 255.0 FORMAT "%5.1" /end CHARACTERISTIC
/begin CHARACTERISTIC ANZTIBMX "Begrenzung ti-Einspritzz‰hler ""anztib_w""" VALUE 0x4E40CC KwUw 50176.00 dez 0.00 50176.00 FORMAT "%8.2" /end CHARACTERISTIC
/begin CHARACTERISTIC ANZTIWS "Anzahl Einspritzungen f¸r Wiederholstarterkennung" VALUE 0x4E4294 KwUb 255.0 dez 0.00 255.0 FORMAT "%5.1" /end CHARACTERISTIC
/begin CHARACTERISTIC ASPUUKA "Anzahl Sondenspr¸nge f¸r Verbot der ‹K-Adaption" VALUE 0x4E4782 KwUb 253.0 dez 2.000 255.0 FORMAT "%5.1" /end CHARACTERISTIC
/begin CHARACTERISTIC ATISLATM "Anzti-Schwelle zur Umschaltung von lamns_w auf lamwl_w" CURVE 0x4EC048 GklWUw 50176.00 dez 0.00 50176.00 FORMAT "%8.2"
 /begin AXIS_DESCR COM_AXIS tmstzyl_w temp_ub_q0p75_o48 12 -48.00000 49103.25 AXIS_PTS_REF STSZYL12ESUB /end AXIS_DESCR
/end CHARACTERISTIC
/begin CHARACTERISTIC ATIWKSTM "Anzti-Schwelle zur Umschaltung von lamns_w auf lamwl_w bei Wiederholkaltstart" CURVE 0x4EC060 GklWUw 50176.00 dez 0.00 50176.00 FORMAT "%8.2"
 /begin AXIS_DESCR COM_AXIS tmstzyl_w temp_ub_q0p75_o48 12 -48.00000 49103.25 AXIS_PTS_REF STSZYL12ESUB /end AXIS_DESCR
/end CHARACTERISTIC
/begin CHARACTERISTIC AVAOVMX "Max. Anzahl Verzˆgerungsvorg‰nge ohne Adaptionswertr¸ckstellung" VALUE 0x4E4783 KwUb 254.0 dez 1.000 255.0 FORMAT "%5.1" /end CHARACTERISTIC
/begin CHARACTERISTIC BYP1TEV "" VALUE 0x4E384A KwUb 100.0 relDK_ub_b100 0.00 100.0 FORMAT "%5.1" /end CHARACTERISTIC
/begin CHARACTERISTIC BYPAMAX "" VALUE 0x4E3902 KwSw 99.99847 rel_uw_b100 -50.00000 49.99847 FORMAT "%8.5" /end CHARACTERISTIC
/begin CHARACTERISTIC BYPAMIN "" VALUE 0x4E3904 KwSw 99.99847 rel_uw_b100 -50.00000 49.99847 FORMAT "%8.5" /end CHARACTERISTIC
/begin CHARACTERISTIC BYPAPP "Desired bypass position from tester" VALUE 0x4E3906 KwUw 99.99847 rel_uw_b100 0.00 99.99847 FORMAT "%8.5" /end CHARACTERISTIC
/begin CHARACTERISTIC BYPCORIMN "Begrenzung I-Anteil fuer den Bankbgleich" VALUE 0x4E3908 KwSw 25.59961 m_uw_b25p6 -12.80000 12.79961 FORMAT "%8.5" /end CHARACTERISTIC
/begin CHARACTERISTIC BYPCORIMX "Begrenzung I-Anteil fuer den Bankbgleich" VALUE 0x4E390A KwSw 25.59961 m_uw_b25p6 -12.80000 12.79961 FORMAT "%8.5" /end CHARACTERISTIC
/begin CHARACTERISTIC BYPCORMN "Begrenzung fuer den Bankbgleich" VALUE 0x4E390C KwSw 25.59961 m_uw_b25p6 -12.80000 12.79961 FORMAT "%8.5" /end CHARACTERISTIC
/begin CHARACTERISTIC BYPCORMX "Begrenzung fuer den Bankbgleich" VALUE 0x4E390E KwSw 25.59961 m_uw_b25p6 -12.80000 12.79961 FORMAT "%8.5" /end CHARACTERISTIC
/begin CHARACTERISTIC BYPCORRAPP "Bankabgleich Applikation" VALUE 0x4E3910 KwSw 25.59961 m_uw_b25p6 -12.80000 12.79961 FORMAT "%8.5" /end CHARACTERISTIC
/begin CHARACTERISTIC BYPILD "Gain factor for I part of load balancing PI controller" CURVE 0x4E3912 KlASwSstSwWSw 0.09999841116 m_ul_6553p6 -0.04999996852 0.04999844264 FORMAT "%13.11"
 /begin AXIS_DESCR STD_AXIS fuebyperr fak_ub_b1 8 -128.0000 127.9961 FORMAT "%8.4" DEPOSIT ABSOLUTE /end AXIS_DESCR
/end CHARACTERISTIC
/begin CHARACTERISTIC BYPKLD "Gain factor for P part of load balancing PI controller" CURVE 0x4E3934 KlASwSstSwWSw 25.59961 m_uw_b25p6 -12.80000 12.79961 FORMAT "%8.5"
 /begin AXIS_DESCR STD_AXIS fuebyperr fak_ub_b1 8 -128.0000 127.9961 FORMAT "%8.4" DEPOSIT ABSOLUTE /end AXIS_DESCR
/end CHARACTERISTIC
/begin CHARACTERISTIC BYPMBDNWDK "" MAP 0x4EAA0A KfAxUwAyUwSstxUwSstyUwWUw 99.99847 rel_uw_b100 0.00 99.99847 FORMAT "%8.5"
 /begin AXIS_DESCR STD_AXIS nmot_w nmot_uw_q0p25 12 0.00 16383.75 FORMAT "%8.2" DEPOSIT ABSOLUTE /end AXIS_DESCR
 /begin AXIS_DESCR STD_AXIS wdkba_w relDK_q0p02441 12 0.00 1599.976 FORMAT "%8.3" DEPOSIT ABSOLUTE /end AXIS_DESCR
/end CHARACTERISTIC
/begin CHARACTERISTIC BYPMBDTMOT "" CURVE 0x4E3956 KlAUwSstSwWUw 99.99847 rel_uw_b100 0.00 99.99847 FORMAT "%8.5"
 /begin AXIS_DESCR STD_AXIS tmot temp_ub_q0p75_o48 6 -24624.00 24527.25 FORMAT "%8.2" DEPOSIT ABSOLUTE /end AXIS_DESCR
/end CHARACTERISTIC
/begin CHARACTERISTIC BYPMLMX "ML Schwelle fuer Bankabgleich" VALUE 0x4E3970 KwUw 3276.750 m_uw_b3276p7 0.00 3276.750 FORMAT "%8.3" /end CHARACTERISTIC
/begin CHARACTERISTIC BYPMNNM "Drehzahlschelle fuer Bankabgleich" VALUE 0x4E384B KwUb 10200. nmot_ub_q40 0.00 10200. FORMAT "%5.0" /end CHARACTERISTIC
/begin CHARACTERISTIC BYPMSN "Map of desired air flow to bypass position" CURVE 0x4E3972 KlAUwSstUwWUw 99.99847 rel_uw_b100 0.00 99.99847 FORMAT "%8.5"
 /begin AXIS_DESCR STD_AXIS mlbypns_w m_uw_b3276p7 10 0.00 3276.750 FORMAT "%8.3" DEPOSIT ABSOLUTE /end AXIS_DESCR
/end CHARACTERISTIC
/begin CHARACTERISTIC BYPMWREF "" VALUE 0x4E399C KwUw 99.99847 rel_uw_b100 0.00 99.99847 FORMAT "%8.5" /end CHARACTERISTIC
/begin CHARACTERISTIC BYPMXNM "Max engine speed for load balancing" VALUE 0x4E384C KwUb 10200. nmot_ub_q40 0.00 10200. FORMAT "%5.0" /end CHARACTERISTIC
/begin CHARACTERISTIC BYPMXTM "Temperaturschwelle fuer Bankabgleich" VALUE 0x4E384D KwUb 191.3 temp_ub_q0p75_o48 -48.00 143.3 FORMAT "%5.1" /end CHARACTERISTIC
/begin CHARACTERISTIC BYPMXWP "Max driver demand for load balancing" VALUE 0x4E384E KwUb 100.0 relDK_ub_b100 0.00 100.0 FORMAT "%5.1" /end CHARACTERISTIC
/begin CHARACTERISTIC BYPUGDNWDK "" MAP 0x4EAB5E KfAxUwAyUwSstxUwSstyUwWUw 99.99847 rel_uw_b100 0.00 99.99847 FORMAT "%8.5"
 /begin AXIS_DESCR STD_AXIS nmot_w nmot_uw_q0p25 12 0.00 16383.75 FORMAT "%8.2" DEPOSIT ABSOLUTE /end AXIS_DESCR
 /begin AXIS_DESCR STD_AXIS wdkba_w relDK_q0p02441 12 0.00 1599.976 FORMAT "%8.3" DEPOSIT ABSOLUTE /end AXIS_DESCR
/end CHARACTERISTIC
/begin CHARACTERISTIC BYPUGDTMOT "" CURVE 0x4E399E KlAUwSstSwWUw 99.99847 rel_uw_b100 0.00 99.99847 FORMAT "%8.5"
 /begin AXIS_DESCR STD_AXIS tmot temp_ub_q0p75_o48 6 -24624.00 24527.25 FORMAT "%8.2" DEPOSIT ABSOLUTE /end AXIS_DESCR
/end CHARACTERISTIC
/begin CHARACTERISTIC CUKA "Codewort ‹K-Adaption" VALUE 0x4E4784 KwUb 255.0 dez 0.00 255.0 FORMAT "%5.1" /end CHARACTERISTIC
/begin CHARACTERISTIC CWBYP "" VALUE 0x4E384F KwUb 255.0 dez 0.00 255.0 FORMAT "%5.1" /end CHARACTERISTIC
/begin CHARACTERISTIC CWDKPADP "Codewort DKP-Adaption nur ¸ber Tester" VALUE 0x4E5014 KwUb 255.0 dez 0.00 255.0 FORMAT "%5.1" /end CHARACTERISTIC
/begin CHARACTERISTIC CWDOELNIV "" VALUE 0x4EC786 KwUb 255.0 dez 0.00 255.0 FORMAT "%5.1" /end CHARACTERISTIC
/begin CHARACTERISTIC CWESSTT "Codewort zum setzen der Bits B_vbemg und B_wks" VALUE 0x4E4295 KwUb 255.0 dez 0.00 255.0 FORMAT "%5.1" /end CHARACTERISTIC
/begin CHARACTERISTIC CWESVW "Codewort: Einspritzung Vorlagerungswinkel" VALUE 0x4E4839 KwWU8 7.000 dez 0.00 7.000 FORMAT "%5.3" /end CHARACTERISTIC
/begin CHARACTERISTIC CWFRPC "Codeword Kraftstoffdruckregelung" VALUE 0x4EDEC2 KwSw 65535.00 dez -32768.00 32767.00 FORMAT "%8.2" /end CHARACTERISTIC
/begin CHARACTERISTIC CWGGEGAS "Codewort f¸r GGEGAS" VALUE 0x4EC58A KwUb 255.0 dez 0.00 255.0 FORMAT "%5.1" /end CHARACTERISTIC
/begin CHARACTERISTIC CWGGLSV "Codeword f¸r Ri-Auswertung f¸r Sonde vor KAT (Heizung nicht voll ein)" VALUE 0x4EC89C KwUb 255.0 dez 0.00 255.0 FORMAT "%5.1" /end CHARACTERISTIC
/begin CHARACTERISTIC CWRLSOL "Rover" VALUE 0x4E3BC2 KwWU8 255.0 dez 0.00 255.0 FORMAT "%5.1" /end CHARACTERISTIC
/begin CHARACTERISTIC CWVAROELN "" VALUE 0x4EC787 KwUb 255.0 dez 0.00 255.0 FORMAT "%5.1" /end CHARACTERISTIC
/begin CHARACTERISTIC CWWL "Codewort f¸r Warmlaufsteuerung" VALUE 0x4EBE6C KwUb 255.0 dez 0.00 255.0 FORMAT "%5.1" /end CHARACTERISTIC
/begin CHARACTERISTIC CW_asg "Codewort ASG: ASG verbaut => TRUE" VALUE 0x4E974E KwUb 1.000 dez 0.00 1.000 FORMAT "%5.3" /end CHARACTERISTIC
/begin CHARACTERISTIC CW_BYPA "" VALUE 0x4E3848 KwWU8 255.0 default 0.00 255.0 FORMAT "%5.1" /end CHARACTERISTIC
/begin CHARACTERISTIC CW_BYPUG10 "" VALUE 0x4E3849 KwWU8 255.0 default 0.00 255.0 FORMAT "%5.1" /end CHARACTERISTIC
/begin CHARACTERISTIC CW_ESUKDK "" VALUE 0x4EBCD8 KwWU8 1.000 DEZ 0.00 1.000 FORMAT "%5.3" /end CHARACTERISTIC
/begin CHARACTERISTIC CW_FFZ "Codewort Folgefunken (aktiv: >0)" VALUE 0x4E8934 KwUb 255.0 DEZ 0.00 255.0 FORMAT "%5.1" /end CHARACTERISTIC
/begin CHARACTERISTIC CW_TOEL "" VALUE 0x4EC788 KwUb 255.0 dez 0.00 255.0 FORMAT "%5.1" /end CHARACTERISTIC
/begin CHARACTERISTIC DEFAULT_PAGE3 "" VALUE 0x4E5468 KwWU32 4294967295.00 default 0.00 4294967295.00 FORMAT "%13.2" /end CHARACTERISTIC
/begin CHARACTERISTIC DEFAULT_SK_H "" VALUE 0x4E5464 KwWU16 65535.00 default 0.00 65535.00 FORMAT "%8.2" /end CHARACTERISTIC
/begin CHARACTERISTIC DEFAULT_SK_L "" VALUE 0x4E546C KwWU32 4294967295.00 default 0.00 4294967295.00 FORMAT "%13.2" /end CHARACTERISTIC
/begin CHARACTERISTIC DFRBAF "" VALUE 0x4E478E KwSw 1.999969 fak_sw_b1 -1.000000 0.9999695 FORMAT "%8.6" /end CHARACTERISTIC
/begin CHARACTERISTIC DFRBAM "" VALUE 0x4E4790 KwSw 1.999969 fak_sw_b1 -1.000000 0.9999695 FORMAT "%8.6" /end CHARACTERISTIC
/begin CHARACTERISTIC DFRVAF "" VALUE 0x4E4792 KwSw 1.999969 fak_sw_b1 -1.000000 0.9999695 FORMAT "%8.6" /end CHARACTERISTIC
/begin CHARACTERISTIC DFRVAM "" VALUE 0x4E4794 KwSw 1.999969 fak_sw_b1 -1.000000 0.9999695 FORMAT "%8.6" /end CHARACTERISTIC
/begin CHARACTERISTIC DKADPCNTMX "Anzahl Schnelladaptionen" VALUE 0x4E502C KwUw 65535.00 dez 0.00 65535.00 FORMAT "%8.2" /end CHARACTERISTIC
/begin CHARACTERISTIC DKROKD "Obere Drehzahlschwelle f¸r Nulltest-Diagnose Klopfregelung" VALUE 0x4E51BB KwUb 10200. nmot_ub_q40 0.00 10200. FORMAT "%5.0" /end CHARACTERISTIC
/begin CHARACTERISTIC DKROKMX "Maximaler Offsetkompensationswert" VALUE 0x4E51BC KwUb 4.980 spg_ub_b5 0.00 4.980 FORMAT "%5.3" /end CHARACTERISTIC
/begin CHARACTERISTIC DKROKO "Obere Drehzahlschwelle f¸r Ermittlung Offsetkompensationswert" VALUE 0x4E51BD KwUb 10200. nmot_ub_q40 0.00 10200. FORMAT "%5.0" /end CHARACTERISTIC
/begin CHARACTERISTIC DLAMNSWL "max. Abweichung f¸r lamnswl_w=1.0" VALUE 0x4E48E4 KwUb 0.9961 fak_ub_b1 0.00 0.9961 /end CHARACTERISTIC
/begin CHARACTERISTIC DNSBYPOF "" VALUE 0x4E3850 KwUb 2550. nmot_ub_q10 0.00 2550. FORMAT "%5.0" /end CHARACTERISTIC
/begin CHARACTERISTIC DPDSVLU "Delta Druckwert f¸r Signalvergleich Ladedruck mit Umgebungsdruck" VALUE 0x4EC74E KwUw 2559.961 p_uw_q0p039 0.00 2559.961 FORMAT "%8.3" /end CHARACTERISTIC
/begin CHARACTERISTIC DPSUKAO "" VALUE 0x4EBE66 KwUw 2559.961 p_uw_q0p039 0.00 2559.961 FORMAT "%8.3" /end CHARACTERISTIC
/begin CHARACTERISTIC DPUPS "Druckdifferenz f¸r Umschaltung Referenzdruck vor Drosselklappe" VALUE 0x4E3BC3 KwUb 2550. p_ub_q10 0.00 2550. FORMAT "%5.0" /end CHARACTERISTIC
/begin CHARACTERISTIC DPUPVDK "Differenzdruck pu-pvdk" CURVE 0x4EC750 KlAUwSstUwWUw 2559.961 p_uw_q0p039 0.00 2559.961 FORMAT "%8.3"
 /begin AXIS_DESCR STD_AXIS ml_w m_uw_b6553p5 8 0.00 6553.500 FORMAT "%8.3" DEPOSIT ABSOLUTE /end AXIS_DESCR
/end CHARACTERISTIC
/begin CHARACTERISTIC DRKUKTHR "" VALUE 0x4E44F8 KwUb 11.95 rel_sw_b1536 0.00 11.95 FORMAT "%5.2" /end CHARACTERISTIC
/begin CHARACTERISTIC DRLSPMN "" VALUE 0x4E4785 KwSb 95.25 rel_sb_q0p75 0.00 95.25 FORMAT "%5.2" /end CHARACTERISTIC
/begin CHARACTERISTIC DRLTOTDK "" VALUE 0x4E463C KwUw 1535.977 rel_uw_q0p0234 0.00 1535.977 FORMAT "%8.3" /end CHARACTERISTIC
/begin CHARACTERISTIC DRLTOTDKLL "" VALUE 0x4E463E KwUw 1535.977 rel_uw_q0p0234 0.00 1535.977 FORMAT "%8.3" /end CHARACTERISTIC
/begin CHARACTERISTIC DSDKPA_MN "MN DK-Spannungsschwelle Diagnose" VALUE 0x4E502E KwUw 5.004090 spg_uw_q0p001222 0.00 5.004090 FORMAT "%8.6" /end CHARACTERISTIC
/begin CHARACTERISTIC DSDKPA_MX "MX DK-Spannungsschwelle Diagnose" VALUE 0x4E5030 KwUw 5.004090 spg_uw_q0p001222 0.00 5.004090 FORMAT "%8.6" /end CHARACTERISTIC
/begin CHARACTERISTIC DSUGRAD "Gradient f¸r Drucksensor Umgebung" VALUE 0x4EC772 KwUw 1023.984 dgrad_uw_q0p015 0.00 1023.984 FORMAT "%8.3" /end CHARACTERISTIC
/begin CHARACTERISTIC DSUOFS "Offset Drucksensor Umgebung" VALUE 0x4EC774 KwSw 2559.961 p_sw_q0p039 -1280.000 1279.961 FORMAT "%8.3" /end CHARACTERISTIC
/begin CHARACTERISTIC DTANSETR "Hysterese Ansauglufttemperatur f¸r elektr. Thermostatregelung" VALUE 0x4EF014 KwUb 191.3 temp_ub_b191p25 0.00 191.3 FORMAT "%5.1" /end CHARACTERISTIC
/begin CHARACTERISTIC DTMETR "Temperaturhysterese f¸r elektrische Thermostatregelung" VALUE 0x4EF015 KwUb 191.3 temp_ub_b191p25 0.00 191.3 FORMAT "%5.1" /end CHARACTERISTIC
/begin CHARACTERISTIC DUKK "Schwelle f¸r Kurzzeitanteil" VALUE 0x4E4640 KwSw 12287.81 rel_sw_q0p1875 -6144.000 6143.813 FORMAT "%8.3" /end CHARACTERISTIC
/begin CHARACTERISTIC DUSRIV "" VALUE 0x4E51C2 KwSw 319.9951 spg_sw_q0p00488 -160.0000 159.9951 FORMAT "%8.4" /end CHARACTERISTIC
/begin CHARACTERISTIC DUSSPV "" VALUE 0x4E51C4 KwSw 319.9951 spg_sw_q0p00488 -160.0000 159.9951 FORMAT "%8.4" /end CHARACTERISTIC
/begin CHARACTERISTIC DVFZETR "Hysterese Fahrzeuggeschwindigkeit f¸r el. Thermostatregelung" VALUE 0x4EF016 KwUb 318.8 vfzg_ub_q1p25 0.00 318.8 FORMAT "%5.1" /end CHARACTERISTIC
/begin CHARACTERISTIC DWEEMX "maximal zul‰ssige Zunahme Winkel Einspritzende pro Syncro" VALUE 0x4E483A KwWU8 765.0 kw_q3 0.00 765.0 FORMAT "%5.1" /end CHARACTERISTIC
/begin CHARACTERISTIC DWFK_THR "" VALUE 0x4E4642 KwSw 6143.813 rel_sw_q0p1875 0.00 6143.813 FORMAT "%8.3" /end CHARACTERISTIC
/begin CHARACTERISTIC DWPNEGWF "" VALUE 0x4E4644 KwSw 100.0000 GrelPED_sw_b100 -50.00076 49.99924 FORMAT "%8.5" /end CHARACTERISTIC
/begin CHARACTERISTIC DWPPOSWF "" VALUE 0x4E4646 KwSw 100.0000 GrelPED_sw_b100 -50.00076 49.99924 FORMAT "%8.5" /end CHARACTERISTIC
/begin CHARACTERISTIC FANGGANG_A "Array fuer Toleranzbereiche zum lokalisieren einzelner Gaenge" VAL_BLK 0x4E9730 KwbUb 4.980 spg_ub_b5 0.00 4.980 FORMAT "%5.3" NUMBER 7 /end CHARACTERISTIC
/begin CHARACTERISTIC FFLDZ "Folgefunkenladezeit" CURVE 0x4E8938 KlAUbSstUbWUb 25.50 txms_ub_q0p1 0.00 25.50 FORMAT "%5.2"
 /begin AXIS_DESCR STD_AXIS ub spg_ubatt 8 0.00 24.02 FORMAT "%5.2" DEPOSIT ABSOLUTE /end AXIS_DESCR
/end CHARACTERISTIC
/begin CHARACTERISTIC FFZOF "Folgefunkenoffenzeit" VALUE 0x4E8949 KwUb 12.75 txms_ub_q0p05 0.00 12.75 FORMAT "%5.2" /end CHARACTERISTIC
/begin CHARACTERISTIC FHOE "Ersatzwert f¸r Hˆhe" VALUE 0x4EC734 KwUb 3.984 fak_ub_b4 0.00 3.984 FORMAT "%5.3" /end CHARACTERISTIC
/begin CHARACTERISTIC FHSTT "Faktor Heiﬂstart" CURVE 0x4E4298 KlAUbSstUbWUb 63.75 fak_ub_b64 0.00 63.75 FORMAT "%5.2"
 /begin AXIS_DESCR STD_AXIS tans temp_ub_q0p75_o48 6 -48.00 143.3 FORMAT "%5.1" DEPOSIT ABSOLUTE /end AXIS_DESCR
/end CHARACTERISTIC
/begin CHARACTERISTIC FIMFMU "" CURVE 0x4E48B4 FklWUb 1.992 fak_ub_b2 0.00 1.992 FORMAT "%5.3"
 /begin AXIS_DESCR FIX_AXIS anzwefim dez 16 0.00 15.00 FORMAT "%5.2" FIX_AXIS_PAR 0 0 16 /end AXIS_DESCR
/end CHARACTERISTIC
/begin CHARACTERISTIC FIMHU "Faktor Impuls hart" CURVE 0x4E48C4 FklWUb 1.992 fak_ub_b2 0.00 1.992 FORMAT "%5.3"
 /begin AXIS_DESCR FIX_AXIS anzwefim dez 16 0.00 15.00 FORMAT "%5.2" FIX_AXIS_PAR 0 0 16 /end AXIS_DESCR
/end CHARACTERISTIC
/begin CHARACTERISTIC FIMWU "Faktor Impuls weich" CURVE 0x4E48D4 FklWUb 1.992 fak_ub_b2 0.00 1.992 FORMAT "%5.3"
 /begin AXIS_DESCR FIX_AXIS anzwefim dez 16 0.00 15.00 FORMAT "%5.2" FIX_AXIS_PAR 0 0 16 /end AXIS_DESCR
/end CHARACTERISTIC
/begin CHARACTERISTIC FKSTT "Faktor Kaltstart" CURVE 0x4E42FA KlAUwSstUwWUw 63.75000 fak_ub_b64 0.00 63.75000 FORMAT "%8.5"
 /begin AXIS_DESCR STD_AXIS tmstzyl_w temp_ub_q0p75_o48 12 -48.00000 49103.25 FORMAT "%8.2" DEPOSIT ABSOLUTE /end AXIS_DESCR
/end CHARACTERISTIC
/begin CHARACTERISTIC FMFKRN1 "Filtermittenfrequenz f¸r Bandpaﬂfilter Klopfregelung Zyl. 1" CURVE 0x4E515C KlAxU8SstxU8WU8 255.0 fmfkr_dez 0.00 255.0 FORMAT "%5.1"
 /begin AXIS_DESCR STD_AXIS nmot nmot_ub_q40 5 0.00 10200. FORMAT "%5.0" DEPOSIT ABSOLUTE /end AXIS_DESCR
/end CHARACTERISTIC
/begin CHARACTERISTIC FMFKRN2 "Filtermittenfrequenz f¸r Bandpaﬂfilter Klopfregelung Zyl. 2" CURVE 0x4E5168 KlAxU8SstxU8WU8 255.0 fmfkr_dez 0.00 255.0 FORMAT "%5.1"
 /begin AXIS_DESCR STD_AXIS nmot nmot_ub_q40 5 0.00 10200. FORMAT "%5.0" DEPOSIT ABSOLUTE /end AXIS_DESCR
/end CHARACTERISTIC
/begin CHARACTERISTIC FMFKRN3 "Filtermittenfrequenz f¸r Bandpaﬂfilter Klopfregelung Zyl. 3" CURVE 0x4E5174 KlAxU8SstxU8WU8 255.0 fmfkr_dez 0.00 255.0 FORMAT "%5.1"
 /begin AXIS_DESCR STD_AXIS nmot nmot_ub_q40 5 0.00 10200. FORMAT "%5.0" DEPOSIT ABSOLUTE /end AXIS_DESCR
/end CHARACTERISTIC
/begin CHARACTERISTIC FMFKRN4 "Filtermittenfrequenz f¸r Bandpaﬂfilter Klopfregelung Zyl. 4" CURVE 0x4E5180 KlAxU8SstxU8WU8 255.0 fmfkr_dez 0.00 255.0 FORMAT "%5.1"
 /begin AXIS_DESCR STD_AXIS nmot nmot_ub_q40 5 0.00 10200. FORMAT "%5.0" DEPOSIT ABSOLUTE /end AXIS_DESCR
/end CHARACTERISTIC
/begin CHARACTERISTIC FMFKRN5 "Filtermittenfrequenz f¸r Bandpaﬂfilter Klopfregelung Zyl. 5" CURVE 0x4E518C KlAxU8SstxU8WU8 255.0 fmfkr_dez 0.00 255.0 FORMAT "%5.1"
 /begin AXIS_DESCR STD_AXIS nmot nmot_ub_q40 5 0.00 10200. FORMAT "%5.0" DEPOSIT ABSOLUTE /end AXIS_DESCR
/end CHARACTERISTIC
/begin CHARACTERISTIC FMFKRN6 "Filtermittenfrequenz f¸r Bandpaﬂfilter Klopfregelung Zyl. 6" CURVE 0x4E5198 KlAxU8SstxU8WU8 255.0 fmfkr_dez 0.00 255.0 FORMAT "%5.1"
 /begin AXIS_DESCR STD_AXIS nmot nmot_ub_q40 5 0.00 10200. FORMAT "%5.0" DEPOSIT ABSOLUTE /end AXIS_DESCR
/end CHARACTERISTIC
/begin CHARACTERISTIC FMFKRN7 "Filtermittenfrequenz f¸r Bandpaﬂfilter Klopfregelung Zyl. 7" CURVE 0x4E51A4 KlAxU8SstxU8WU8 255.0 fmfkr_dez 0.00 255.0 FORMAT "%5.1"
 /begin AXIS_DESCR STD_AXIS nmot nmot_ub_q40 5 0.00 10200. FORMAT "%5.0" DEPOSIT ABSOLUTE /end AXIS_DESCR
/end CHARACTERISTIC
/begin CHARACTERISTIC FMFKRN8 "Filtermittenfrequenz f¸r Bandpaﬂfilter Klopfregelung Zyl. 8" CURVE 0x4E51B0 KlAxU8SstxU8WU8 255.0 fmfkr_dez 0.00 255.0 FORMAT "%5.1"
 /begin AXIS_DESCR STD_AXIS nmot nmot_ub_q40 5 0.00 10200. FORMAT "%5.0" DEPOSIT ABSOLUTE /end AXIS_DESCR
/end CHARACTERISTIC
/begin CHARACTERISTIC FNSA "Nachstartanhebung" CURVE 0x4EBC84 GklWUb 1.992 fak_ub_b2 0.00 1.992 FORMAT "%5.3"
 /begin AXIS_DESCR COM_AXIS tans temp_ub_q0p75_o48 6 -48.00 143.3 AXIS_PTS_REF STA06ESUB /end AXIS_DESCR
/end CHARACTERISTIC
/begin CHARACTERISTIC FNSHO "Wichtung Nachstartanhebung" CURVE 0x4EBC8C KlAUbSstUbWUb 1.992 fak_ub_b2 0.00 1.992 FORMAT "%5.3"
 /begin AXIS_DESCR STD_AXIS fho fak_ub_b4 4 0.00 3.984 FORMAT "%5.3" DEPOSIT ABSOLUTE /end AXIS_DESCR
/end CHARACTERISTIC
/begin CHARACTERISTIC FNSSM "Nachstartanhebung" CURVE 0x4EBC98 GklWUb 1.992 fak_ub_b2 0.00 1.992 FORMAT "%5.3"
 /begin AXIS_DESCR COM_AXIS tmstzyl_w temp_ub_q0p75_o48 12 -48.00000 49103.25 AXIS_PTS_REF STSZYL12ESUB /end AXIS_DESCR
/end CHARACTERISTIC
/begin CHARACTERISTIC FPBYPAPP "Map of driver throttle to air bypass position" CURVE 0x4E39B8 KlAUwSstUwWUw 99.99847 rel_uw_b100 0.00 99.99847 FORMAT "%8.5"
 /begin AXIS_DESCR STD_AXIS wped_w relPED_uw_b100 16 0.00 100.0000 FORMAT "%8.4" DEPOSIT ABSOLUTE /end AXIS_DESCR
/end CHARACTERISTIC
/begin CHARACTERISTIC FPWDKAPP "Drosselklappenkennlinie abh. von Fahrpedal nur f. Applik." CURVE 0x4E3BC6 KlAUwSstUwWUw 99.99847 rel_uw_b100 0.00 99.99847 FORMAT "%8.5"
 /begin AXIS_DESCR STD_AXIS wped_w relPED_uw_b100 16 0.00 100.0000 FORMAT "%8.4" DEPOSIT ABSOLUTE /end AXIS_DESCR
/end CHARACTERISTIC
/begin CHARACTERISTIC FRHOKRST "" CURVE 0x4E4018 KlAxU8SstxU8WU8 0.4980 fak_ub_b1p25_o0p75 0.7500 1.248 FORMAT "%5.3"
 /begin AXIS_DESCR STD_AXIS tkrst temp_ub_q0p75_o48 9 -48.00 143.3 FORMAT "%5.1" DEPOSIT ABSOLUTE /end AXIS_DESCR
/end CHARACTERISTIC
/begin CHARACTERISTIC FRINOF "Faktor f¸r Bewertung alter Ri-Wert ohne Filter" VALUE 0x4E51BF KwUb 15.94 fak_ub_b16 0.00 15.94 FORMAT "%5.2" /end CHARACTERISTIC
/begin CHARACTERISTIC FRKAP "Faktor relative Kraftstoffmasse f¸r Applikation" VALUE 0x4EB8E8 KwUb 1.992 fak_ub_b2 0.00 1.992 FORMAT "%5.3" /end CHARACTERISTIC
/begin CHARACTERISTIC FRPC_ACTIVE "" VALUE 0x4EDEC4 KwSw 65535.00 dez -32768.00 32767.00 FORMAT "%8.2" /end CHARACTERISTIC
/begin CHARACTERISTIC FRPC_CLP_FCTR "" VALUE 0x4EDEC6 KwSw 655.3500 PER0100 -327.6800 327.6700 FORMAT "%8.4" /end CHARACTERISTIC
/begin CHARACTERISTIC FRPC_CLP_MN "" VALUE 0x4EDEC8 KwSw 51.20078 strom_q0p00078 -25.60078 25.60000 FORMAT "%8.5" /end CHARACTERISTIC
/begin CHARACTERISTIC FRPC_CLP_MX "" VALUE 0x4EDECA KwSw 51.20078 strom_q0p00078 -25.60078 25.60000 FORMAT "%8.5" /end CHARACTERISTIC
/begin CHARACTERISTIC FRPC_DUTY_LIM "" VALUE 0x4EDECC KwSw 655.3500 PER0100 -327.6800 327.6700 FORMAT "%8.4" /end CHARACTERISTIC
/begin CHARACTERISTIC FRPC_I_MN "" VALUE 0x4EDECE KwSw 51.20078 strom_q0p00078 -25.60078 25.60000 FORMAT "%8.5" /end CHARACTERISTIC
/begin CHARACTERISTIC FRPC_I_MX "" VALUE 0x4EDED0 KwSw 51.20078 strom_q0p00078 -25.60078 25.60000 FORMAT "%8.5" /end CHARACTERISTIC
/begin CHARACTERISTIC FRPC_I_TERM_INIT "" VALUE 0x4EDED2 KwSw 51.20078 strom_q0p00078 -25.60078 25.60000 FORMAT "%8.5" /end CHARACTERISTIC
/begin CHARACTERISTIC FRPC_KI "" CURVE 0x4E8642 KlAxU8SstxS16WS16 51.20078 apsec_q0p00078 -25.60078 25.60000 FORMAT "%8.5"
 /begin AXIS_DESCR STD_AXIS frpc_err_w p_uw_q0p2 15 -6553.600 6553.400 FORMAT "%8.3" DEPOSIT ABSOLUTE /end AXIS_DESCR
/end CHARACTERISTIC
/begin CHARACTERISTIC FRPC_KP "" CURVE 0x4E8680 KlAxU8SstxS16WS16 51.20078 strom_q0p00078 -25.60078 25.60000 FORMAT "%8.5"
 /begin AXIS_DESCR STD_AXIS frpc_err_w p_uw_q0p2 15 -6553.600 6553.400 FORMAT "%8.3" DEPOSIT ABSOLUTE /end AXIS_DESCR
/end CHARACTERISTIC
/begin CHARACTERISTIC FRPC_OLP_FCTR "" VALUE 0x4EDED4 KwSw 655.3500 PER0100 -327.6800 327.6700 FORMAT "%8.4" /end CHARACTERISTIC
/begin CHARACTERISTIC FRPC_PERIOD "" VALUE 0x4EDED6 KwSw 6553.500 txms_uw_q0p1 -3276.800 3276.700 FORMAT "%8.3" /end CHARACTERISTIC
/begin CHARACTERISTIC FRPC_PMP_PFI_CHAR "" MAP 0x4EDED8 KfAxSwAySwSstxSwSstySwWSw 51.20078 strom_q0p00078 -25.60078 25.60000 FORMAT "%8.5"
 /begin AXIS_DESCR STD_AXIS actl_inj_fmf mgrad_sw_b28p44 10 -28.44444 28.44358 FORMAT "%8.5" DEPOSIT ABSOLUTE /end AXIS_DESCR
 /begin AXIS_DESCR STD_AXIS frp_setpoint p_uw_q0p2 8 -6553.600 6553.400 FORMAT "%8.3" DEPOSIT ABSOLUTE /end AXIS_DESCR
/end CHARACTERISTIC
/begin CHARACTERISTIC FRPC_PMP_V_CHAR "" CURVE 0x4E86BE KlAxU8SstxS16WS16 655.3500 PER0100 -327.6800 327.6700 FORMAT "%8.4"
 /begin AXIS_DESCR STD_AXIS ub_w spg_ubatt 5 -3086.746 3086.651 FORMAT "%8.3" DEPOSIT ABSOLUTE /end AXIS_DESCR
/end CHARACTERISTIC
/begin CHARACTERISTIC FRPC_RSRVFCTR "" VALUE 0x4EDFA0 KwSw 655.3500 PER0100 -327.6800 327.6700 FORMAT "%8.4" /end CHARACTERISTIC
/begin CHARACTERISTIC FRPC_WARNFCTR "" VALUE 0x4EDEB8 KwSw 655.3500 PER0100 -327.6800 327.6700 FORMAT "%8.4" /end CHARACTERISTIC
/begin CHARACTERISTIC FRPSFILT "" VALUE 0x4E86DC KwUw 655.350000 zk10msxs_uw_b655 0.0100001526 655.360000 FORMAT "%10.6" /end CHARACTERISTIC
/begin CHARACTERISTIC FRPSFILT2 "" CURVE 0x4EDFA6 KlAUbSstUwWUw 655.350000 zk10msxs_uw_b655 0.0100001526 655.360000 FORMAT "%10.6"
 /begin AXIS_DESCR STD_AXIS nmot_w nmot_uw_q0p25 9 0.00 16383.75 FORMAT "%8.2" DEPOSIT ABSOLUTE /end AXIS_DESCR
/end CHARACTERISTIC
/begin CHARACTERISTIC FRPSP_MN "" VALUE 0x4E863A KwWS16 13107.00 p_uw_q0p2 -6553.600 6553.400 FORMAT "%8.3" /end CHARACTERISTIC
/begin CHARACTERISTIC FRPSP_MX "" VALUE 0x4E863C KwWS16 13107.00 p_uw_q0p2 -6553.600 6553.400 FORMAT "%8.3" /end CHARACTERISTIC
/begin CHARACTERISTIC FRPS_GRAD "" VALUE 0x4E86D4 KwWU16 2047.969 dgrad_uw_q0p031 0.00 2047.969 FORMAT "%8.3" /end CHARACTERISTIC
/begin CHARACTERISTIC FRPS_MN "" VALUE 0x4E86D6 KwWS16 13107.00 p_uw_q0p2 -6553.600 6553.400 FORMAT "%8.3" /end CHARACTERISTIC
/begin CHARACTERISTIC FRPS_MX "" VALUE 0x4E86D8 KwWS16 13107.00 p_uw_q0p2 -6553.600 6553.400 FORMAT "%8.3" /end CHARACTERISTIC
/begin CHARACTERISTIC FRPS_OFST "" VALUE 0x4E86DA KwWU16 2559.961 p_sw_q0p039 0.00 2559.961 FORMAT "%8.3" /end CHARACTERISTIC
/begin CHARACTERISTIC FRPS_STA "" VALUE 0x4EDFA4 KwUb 255.0 t1sxs_ub_b255 0.00 255.0 FORMAT "%5.1" /end CHARACTERISTIC
/begin CHARACTERISTIC FRPS_TD "" VALUE 0x4EDFA5 KwUb 25.50 t100msxs_ub_b25p5 0.00 25.50 FORMAT "%5.2" /end CHARACTERISTIC
/begin CHARACTERISTIC FRP_SETPOINT_FORCE "" VALUE 0x4E863E KwWS16 13107.00 p_uw_q0p2 -6553.600 6553.400 FORMAT "%8.3" /end CHARACTERISTIC
/begin CHARACTERISTIC FRP_SETPOINT_RAMP "" VALUE 0x4E8640 KwWS16 13107.00 p_uw_q0p2 -6553.600 6553.400 FORMAT "%8.3" /end CHARACTERISTIC
/begin CHARACTERISTIC FRP_SETPOINT_RATE "" VALUE 0x4EDFA2 KwUw 2559.961 p_grad_uw_q0p039 0.00 2559.961 FORMAT "%8.3" /end CHARACTERISTIC
/begin CHARACTERISTIC FSTHO "" CURVE 0x4E42A8 KlAUbSstUbWUb 1.992 fak_ub_b2 0.00 1.992 FORMAT "%5.3"
 /begin AXIS_DESCR STD_AXIS fho fak_ub_b4 4 0.00 3.984 FORMAT "%5.3" DEPOSIT ABSOLUTE /end AXIS_DESCR
/end CHARACTERISTIC
/begin CHARACTERISTIC FUEL_CORR "" VALUE 0x4EDEBA KwUw 65.00000 fak_uw_q0p001 0.00 65.00000 FORMAT "%8.5" /end CHARACTERISTIC
/begin CHARACTERISTIC FUEPMLD "Faktor f¸r gleitender ‹bergang Druckmittelwert(Referenzdruck) beim Turbo" CURVE 0x4E3C08 KlAUwSstSwWUw 0.003890991 fak_uw_b1 0.00 0.003890991 FORMAT "%11.9"
 /begin AXIS_DESCR STD_AXIS lditv rel_sw_b1536 4 -1536.000 1535.953 FORMAT "%8.3" DEPOSIT ABSOLUTE /end AXIS_DESCR
/end CHARACTERISTIC
/begin CHARACTERISTIC FUKABAKI "Init.-Wert adaptiver ‹K-Korrekturfaktor BA f¸r kalten Motor" VALUE 0x4E4786 KwUb 3.984 fak_ub_b4 0.00 3.984 FORMAT "%5.3" /end CHARACTERISTIC
/begin CHARACTERISTIC FUKABAKO "Obergrenze adaptiver ‹K-Korrekturfaktor BA bei kaltem Motor" VALUE 0x4EBE5E KwUb 3.984 fak_ub_b4 0.00 3.984 FORMAT "%5.3" /end CHARACTERISTIC
/begin CHARACTERISTIC FUKABAKU "Untergrenze adaptiver ‹K-Korrekturfaktor BA bei kaltem Motor" VALUE 0x4EBE5F KwUb 3.891 fak_ub_b4 0.09375 3.984 FORMAT "%5.3" /end CHARACTERISTIC
/begin CHARACTERISTIC FUKABAWI "Init.-Wert adaptiver ‹K-Korrekturfaktor BA f¸r warmen Motor" VALUE 0x4E4787 KwUb 3.984 fak_ub_b4 0.00 3.984 FORMAT "%5.3" /end CHARACTERISTIC
/begin CHARACTERISTIC FUKABAWO "Obergrenze adaptiver ‹K-Korrekturfaktor BA bei warmem Motor" VALUE 0x4EBE60 KwUb 3.984 fak_ub_b4 0.00 3.984 FORMAT "%5.3" /end CHARACTERISTIC
/begin CHARACTERISTIC FUKABAWU "Untergrenze adaptiver ‹K-Korrekturfaktor BA bei warmem Motor" VALUE 0x4EBE61 KwUb 3.891 fak_ub_b4 0.09375 3.984 FORMAT "%5.3" /end CHARACTERISTIC
/begin CHARACTERISTIC FUKAVAKI "Init.-Wert adaptiver ‹K-Korrekturfaktor VA f¸r kalten Motor" VALUE 0x4E4788 KwUb 3.984 fak_ub_b4 0.00 3.984 FORMAT "%5.3" /end CHARACTERISTIC
/begin CHARACTERISTIC FUKAVAKO "Obergrenze adaptiver ‹K-Korrekturfaktor VA bei kaltem Motor" VALUE 0x4EBE62 KwUb 3.984 fak_ub_b4 0.00 3.984 FORMAT "%5.3" /end CHARACTERISTIC
/begin CHARACTERISTIC FUKAVAKU "Untergrenze adaptiver ‹K-Korrekturfaktor VA bei kaltem Motor" VALUE 0x4EBE63 KwUb 3.891 fak_ub_b4 0.09375 3.984 FORMAT "%5.3" /end CHARACTERISTIC
/begin CHARACTERISTIC FUKAVAWI "Init.-Wert adaptiver ‹K-Korrekturfaktor VA f¸r warmen Motor" VALUE 0x4E4789 KwUb 3.984 fak_ub_b4 0.00 3.984 FORMAT "%5.3" /end CHARACTERISTIC
/begin CHARACTERISTIC FUKAVAWO "Obergrenze adaptiver ‹K-Korrekturfaktor VA bei warmem Motor" VALUE 0x4EBE64 KwUb 3.984 fak_ub_b4 0.00 3.984 FORMAT "%5.3" /end CHARACTERISTIC
/begin CHARACTERISTIC FUKAVAWU "Untergrenze adaptiver ‹K-Korrekturfaktor VA bei warmem Motor" VALUE 0x4EBE65 KwUb 3.891 fak_ub_b4 0.09375 3.984 FORMAT "%5.3" /end CHARACTERISTIC
/begin CHARACTERISTIC FUKE "Faktor ‹K-Ersatzwert" VALUE 0x4E4648 KwUw 7.999878 fak_uw_b8 0.00 7.999878 FORMAT "%8.6" /end CHARACTERISTIC
/begin CHARACTERISTIC FUKNSTM "Startwert Faktor ‹K im Nachstart" CURVE 0x4EBDF2 KlAUbSstUwWUw 3.984375 fak_ub_b4 0.00 3.984375 FORMAT "%8.6"
 /begin AXIS_DESCR STD_AXIS tmstzyl_w temp_ub_q0p75_o48 9 -48.00000 49103.25 FORMAT "%8.2" DEPOSIT ABSOLUTE /end AXIS_DESCR
/end CHARACTERISTIC
/begin CHARACTERISTIC FVANST "Gewichtungsfaktor VA im Nachstart" VALUE 0x4E44F9 KwUb 1.992 fak_ub_b2 0.00 1.992 FORMAT "%5.3" /end CHARACTERISTIC
/begin CHARACTERISTIC FWFN "Faktor Wandfilm Drehzahleinfluss" VALUE 0x4E44FA KwUb 1.494 rel_ub_b1p4941 0.00 1.494 FORMAT "%5.3" /end CHARACTERISTIC
/begin CHARACTERISTIC FWSTAA1 "Wichtung Nachstart" CURVE 0x4E402C GklWUb 1.992 fak_ub_b2 0.00 1.992 FORMAT "%5.3"
 /begin AXIS_DESCR COM_AXIS kstaa fak_ub_b2 6 0.00 1.992 AXIS_PTS_REF SKS06ESUB /end AXIS_DESCR
/end CHARACTERISTIC
/begin CHARACTERISTIC FWSTAA2 "Wichtung Nachstart Umschaltschwelle" CURVE 0x4E4034 GklWUb 1.992 fak_ub_b2 0.00 1.992 FORMAT "%5.3"
 /begin AXIS_DESCR COM_AXIS kstaa fak_ub_b2 6 0.00 1.992 AXIS_PTS_REF SKS06ESUB /end AXIS_DESCR
/end CHARACTERISTIC
/begin CHARACTERISTIC FWSTAA3 "Wichtung Nachstart Abregelung Bereich 1" CURVE 0x4E403C GklWUb 1.992 fak_ub_b2 0.00 1.992 FORMAT "%5.3"
 /begin AXIS_DESCR COM_AXIS kstaa fak_ub_b2 6 0.00 1.992 AXIS_PTS_REF SKS06ESUB /end AXIS_DESCR
/end CHARACTERISTIC
/begin CHARACTERISTIC FWSTAA4 "Wichtung Nachstart Abregelung Bereich 2" CURVE 0x4E4044 GklWUb 1.992 fak_ub_b2 0.00 1.992 FORMAT "%5.3"
 /begin AXIS_DESCR COM_AXIS kstaa fak_ub_b2 6 0.00 1.992 AXIS_PTS_REF SKS06ESUB /end AXIS_DESCR
/end CHARACTERISTIC
/begin CHARACTERISTIC FZANSSA1 "Faktor f¸r z¸ndsynchrone Abregelung des Nachstartfaktors bei Heiﬂstart Bereich 1" CURVE 0x4EBCA4 GklWUb 0.249023438 fak_ub_b0p25 0.00 0.249023438 FORMAT "%11.9"
 /begin AXIS_DESCR COM_AXIS tans temp_ub_q0p75_o48 6 -48.00 143.3 AXIS_PTS_REF STA06ESUB /end AXIS_DESCR
/end CHARACTERISTIC
/begin CHARACTERISTIC FZANSSA2 "Faktor f¸r z¸ndsynchrone Abregelung des Nachstartfaktors bei Heiﬂstart Bereich 2" CURVE 0x4EBCAC GklWUb 0.249023438 fak_ub_b0p25 0.00 0.249023438 FORMAT "%11.9"
 /begin AXIS_DESCR COM_AXIS tans temp_ub_q0p75_o48 6 -48.00 143.3 AXIS_PTS_REF STA06ESUB /end AXIS_DESCR
/end CHARACTERISTIC
/begin CHARACTERISTIC FZANSSM1 "Faktor f¸r z¸ndsynchrone Abregelung des Nachstartfaktors oberhalb Schwelle" CURVE 0x4EBCB4 GklWUb 0.249023438 fak_ub_b0p25 0.00 0.249023438 FORMAT "%11.9"
 /begin AXIS_DESCR COM_AXIS tmstzyl_w temp_ub_q0p75_o48 12 -48.00000 49103.25 AXIS_PTS_REF STSZYL12ESUB /end AXIS_DESCR
/end CHARACTERISTIC
/begin CHARACTERISTIC FZANSSM2 "Faktor f¸r z¸ndsynchrone Abregelung des Nachstartfaktors unterhalb Schwelle" CURVE 0x4EBCC0 GklWUb 0.249023438 fak_ub_b0p25 0.00 0.249023438 FORMAT "%11.9"
 /begin AXIS_DESCR COM_AXIS tmstzyl_w temp_ub_q0p75_o48 12 -48.00000 49103.25 AXIS_PTS_REF STSZYL12ESUB /end AXIS_DESCR
/end CHARACTERISTIC
/begin CHARACTERISTIC GANGNP "Wert fuer eine nicht plausible Ganginfo" VALUE 0x4EF38A KwUb 255.0 dez 0.00 255.0 FORMAT "%5.1" /end CHARACTERISTIC
/begin CHARACTERISTIC GANGRG "Toleranzbereich fuer adaptierte Gaenge 1 -6" VALUE 0x4EF38B KwUb 4.980 spg_ub_b5 0.00 4.980 FORMAT "%5.3" /end CHARACTERISTIC
/begin CHARACTERISTIC GANGRGN "Toleranzbereich fuer adaptierter Neutral Gang" VALUE 0x4EF38C KwUb 4.980 spg_ub_b5 0.00 4.980 FORMAT "%5.3" /end CHARACTERISTIC
/begin CHARACTERISTIC IGANG "Zuornungstabelle von Gangangaben zu Spannungswerte" VAL_BLK 0x4E9738 KwbUb 255.0 dez 0.00 255.0 FORMAT "%5.1" NUMBER 10 /end CHARACTERISTIC
/begin CHARACTERISTIC ILMRMN "Minimalwert des Luftmassenreglers" VALUE 0x4E3D2C KwSw 1535.977 rel_sw_q0p0234 -768.0000 767.9766 FORMAT "%8.4" /end CHARACTERISTIC
/begin CHARACTERISTIC ILMRMX "Maximalwert des Luftmassenreglers" VALUE 0x4E3D2E KwSw 1535.977 rel_sw_q0p0234 -768.0000 767.9766 FORMAT "%8.4" /end CHARACTERISTIC
/begin CHARACTERISTIC ILMRN "Integratorverst‰rkung von Luftmassenregler" CURVE 0x4EB770 GklWUb 7.969 fak_ub_b8 0.00 7.969 FORMAT "%5.3"
 /begin AXIS_DESCR COM_AXIS nmot nmot_ub_q40 8 0.00 10200. AXIS_PTS_REF SNM08FEUB /end AXIS_DESCR
/end CHARACTERISTIC
/begin CHARACTERISTIC IMLHS "Luftmassenintegral Heiﬂstart" VALUE 0x4E42B1 KwUb 23.21 m_ub_b23p3 0.00 23.21 FORMAT "%5.2" /end CHARACTERISTIC
/begin CHARACTERISTIC INJ_QSTAT "" VALUE 0x4EDEBC KwSw 25.00000 mgrad_sw_b28p44 0.00 25.00000 FORMAT "%8.5" /end CHARACTERISTIC
/begin CHARACTERISTIC KEMLN "Messfensterl‰nge f¸r Klopfregelung" CURVE 0x4EC790 KlAUbSstUbWUb 191.3 zw_ub_q0p75 0.00 191.3 FORMAT "%5.1"
 /begin AXIS_DESCR STD_AXIS nmot nmot_ub_q40 16 0.00 10200. FORMAT "%5.0" DEPOSIT ABSOLUTE /end AXIS_DESCR
/end CHARACTERISTIC
/begin CHARACTERISTIC KFABAK "Aufteilungsfaktor Wandfilm bei BA" MAP 0x4EBCDC GkfWUb 0.9961 fak_ub_b1 0.00 0.9961
 /begin AXIS_DESCR COM_AXIS tmotzyl_w temp_ub_q0p75_o48 9 -48.00000 49103.25 AXIS_PTS_REF STMZYL09ESUW /end AXIS_DESCR
 /begin AXIS_DESCR COM_AXIS nmot nmot_ub_q40 7 0.00 10200. AXIS_PTS_REF SNM07ESUB /end AXIS_DESCR
/end CHARACTERISTIC
/begin CHARACTERISTIC KFAFBYP "map flow≠ characteristic of bypass" MAP 0x4E3854 KfAxUbAyUbSstxUbSstyUbWUb 1.984 fak_ub_b2 0.007813 1.992 FORMAT "%5.3"
 /begin AXIS_DESCR STD_AXIS nmot nmot_ub_q40 10 0.00 10200. FORMAT "%5.0" DEPOSIT ABSOLUTE /end AXIS_DESCR
 /begin AXIS_DESCR STD_AXIS wdkba relDK_ub_b100 10 0.00 100.0 FORMAT "%5.1" DEPOSIT ABSOLUTE /end AXIS_DESCR
/end CHARACTERISTIC
/begin CHARACTERISTIC KFAKBDK "" MAP 0x4E44FC KfAxUbAyUbSstxUbSstyUbWUb 2.550 fak_ub_q0p01 0.00 2.550 FORMAT "%5.3"
 /begin AXIS_DESCR STD_AXIS nmot nmot_ub_q40 8 0.00 10200. FORMAT "%5.0" DEPOSIT ABSOLUTE /end AXIS_DESCR
 /begin AXIS_DESCR STD_AXIS rl rel_ub_q0p75 6 0.00 191.3 FORMAT "%5.1" DEPOSIT ABSOLUTE /end AXIS_DESCR
/end CHARACTERISTIC
/begin CHARACTERISTIC KFAKTDK "" MAP 0x4E453C KfAxUwAyUwSstxUwSstyUwWUw 3199.951 fak_ub_b12p45 0.00 3199.951 FORMAT "%8.3"
 /begin AXIS_DESCR STD_AXIS tmotzyl_w temp_ub_q0p75_o48 9 -48.00000 49103.25 FORMAT "%8.2" DEPOSIT ABSOLUTE /end AXIS_DESCR
 /begin AXIS_DESCR STD_AXIS tans temp_ub_q0p75_o48 5 -48.00000 49103.25 FORMAT "%8.2" DEPOSIT ABSOLUTE /end AXIS_DESCR
/end CHARACTERISTIC
/begin CHARACTERISTIC KFAKVDK "" MAP 0x4E45B8 KfAxUbAyUbSstxUbSstyUbWUb 2.550 fak_ub_q0p01 0.00 2.550 FORMAT "%5.3"
 /begin AXIS_DESCR STD_AXIS nmot nmot_ub_q40 8 0.00 10200. FORMAT "%5.0" DEPOSIT ABSOLUTE /end AXIS_DESCR
 /begin AXIS_DESCR STD_AXIS rl rel_ub_q0p75 6 0.00 191.3 FORMAT "%5.1" DEPOSIT ABSOLUTE /end AXIS_DESCR
/end CHARACTERISTIC
/begin CHARACTERISTIC KFAVAK "Aufteilungsfaktor Wandfilm bei VA" MAP 0x4EBD1C GkfWUb 0.9961 fak_ub_b1 0.00 0.9961
 /begin AXIS_DESCR COM_AXIS tmotzyl_w temp_ub_q0p75_o48 9 -48.00000 49103.25 AXIS_PTS_REF STMZYL09ESUW /end AXIS_DESCR
 /begin AXIS_DESCR COM_AXIS nmot nmot_ub_q40 7 0.00 10200. AXIS_PTS_REF SNM07ESUB /end AXIS_DESCR
/end CHARACTERISTIC
/begin CHARACTERISTIC KFBAKL "Faktor Beschleunigungsanreicherung (K+L-Anteil)" MAP 0x4EBD5C GkfWUb 15.94 fak_ub_b16 0.00 15.94 FORMAT "%5.2"
 /begin AXIS_DESCR COM_AXIS tmotzyl_w temp_ub_q0p75_o48 9 -48.00000 49103.25 AXIS_PTS_REF STMZYL09ESUW /end AXIS_DESCR
 /begin AXIS_DESCR COM_AXIS nmot nmot_ub_q40 7 0.00 10200. AXIS_PTS_REF SNM07ESUB /end AXIS_DESCR
/end CHARACTERISTIC
/begin CHARACTERISTIC KFETRD "Sollwert f¸r elektr. Thermostatregelung aus dk" MAP 0x4EF018 KfAxUbAyUbSstxUbSstyUbWUb 191.3 temp_ub_q0p75_o48 -48.00 143.3 FORMAT "%5.1"
 /begin AXIS_DESCR STD_AXIS vfzg vfzg_ub_q1p25 6 0.00 318.8 FORMAT "%5.1" DEPOSIT ABSOLUTE /end AXIS_DESCR
 /begin AXIS_DESCR STD_AXIS wdkba relDK_ub_b100 6 0.00 100.0 FORMAT "%5.1" DEPOSIT ABSOLUTE /end AXIS_DESCR
/end CHARACTERISTIC
/begin CHARACTERISTIC KFETRT "Sollwert f¸r elektr. Thermostatregelung aus tans" MAP 0x4EF04C KfAxUbAyUbSstxUbSstyUbWUb 191.3 temp_ub_q0p75_o48 -48.00 143.3 FORMAT "%5.1"
 /begin AXIS_DESCR STD_AXIS vfzg vfzg_ub_q1p25 8 0.00 318.8 FORMAT "%5.1" DEPOSIT ABSOLUTE /end AXIS_DESCR
 /begin AXIS_DESCR STD_AXIS tans temp_ub_q0p75_o48 8 -48.00 143.3 FORMAT "%5.1" DEPOSIT ABSOLUTE /end AXIS_DESCR
/end CHARACTERISTIC
/begin CHARACTERISTIC KFFAKRLDK "" MAP 0x4E45F8 KfAxUbAyUbSstxUbSstyUbWUb 1.000 fak_ub_q0p00392 0.00 1.000 FORMAT "%5.3"
 /begin AXIS_DESCR STD_AXIS gangi dez 7 0.00 255.0 FORMAT "%5.1" DEPOSIT ABSOLUTE /end AXIS_DESCR
 /begin AXIS_DESCR STD_AXIS nmot nmot_ub_q40 7 0.00 10200. FORMAT "%5.0" DEPOSIT ABSOLUTE /end AXIS_DESCR
/end CHARACTERISTIC
/begin CHARACTERISTIC KFFFANZ "Anzahl Folgefunken" MAP 0x4E894A KfAxUbAyUbSstxUwSstyUbWUb 255.0 dez 0.00 255.0 FORMAT "%5.1"
 /begin AXIS_DESCR STD_AXIS tmotzyl_w temp_ub_q0p75_o48 6 -48.00000 49103.25 FORMAT "%8.2" DEPOSIT ABSOLUTE /end AXIS_DESCR
 /begin AXIS_DESCR STD_AXIS nmot nmot_ub_q40 8 0.00 10200. FORMAT "%5.0" DEPOSIT ABSOLUTE /end AXIS_DESCR
/end CHARACTERISTIC
/begin CHARACTERISTIC KFFWL "Kennfeld Warmlauffaktor" MAP 0x4EBE70 GkfWUb 1.992 fak_ub_b2 0.00 1.992 FORMAT "%5.3"
 /begin AXIS_DESCR COM_AXIS tmotzyl_w temp_ub_q0p75_o48 12 -48.00000 49103.25 AXIS_PTS_REF STMZYL12ESUB /end AXIS_DESCR
 /begin AXIS_DESCR COM_AXIS tmstzyl_w temp_ub_q0p75_o48 12 -48.00000 49103.25 AXIS_PTS_REF STSZYL12ESUB /end AXIS_DESCR
/end CHARACTERISTIC
/begin CHARACTERISTIC KFFWLW "Kennfeld Wichtung Warmlauffaktor" MAP 0x4EBF00 KfAxUbAyUbSstxUbSstyUbWUb 0.9961 fak_ub_b1 0.00 0.9961
 /begin AXIS_DESCR STD_AXIS nmotseg nmot_ub_q40 12 0.00 10200. FORMAT "%5.0" DEPOSIT ABSOLUTE /end AXIS_DESCR
 /begin AXIS_DESCR STD_AXIS rl rel_ub_q0p75 12 0.00 191.3 FORMAT "%5.1" DEPOSIT ABSOLUTE /end AXIS_DESCR
/end CHARACTERISTIC
/begin CHARACTERISTIC KFFWST "Faktor Wiederholstart" MAP 0x4E432C KfAxUwAyUwSstxUwSstyUwWUw 0.9960938 fak_ub_b1 0.00 0.9960938 FORMAT "%9.7"
 /begin AXIS_DESCR STD_AXIS tmlauf_w t100msxs_uw_b6553p6 8 0.00 6553.500 FORMAT "%8.3" DEPOSIT ABSOLUTE /end AXIS_DESCR
 /begin AXIS_DESCR STD_AXIS tabzyl_w temp_ub_q0p75_o48 8 -48.00000 49103.25 FORMAT "%8.2" DEPOSIT ABSOLUTE /end AXIS_DESCR
/end CHARACTERISTIC
/begin CHARACTERISTIC KFLANS "Kennfeld Lambda-Motor-Beschreibung im Nachstart" MAP 0x4E40CE GkfWUw 15.89990 fak_uw_b16 0.09985352 15.99976 FORMAT "%8.5"
 /begin AXIS_DESCR COM_AXIS tmstzyl_w temp_ub_q0p75_o48 12 -48.00000 49103.25 AXIS_PTS_REF STSZYL12ESUB /end AXIS_DESCR
 /begin AXIS_DESCR COM_AXIS anztib_w dez 12 0.00 65535.00 AXIS_PTS_REF SAN12ESUW /end AXIS_DESCR
/end CHARACTERISTIC
/begin CHARACTERISTIC KFLASWLR "Kennfeld Lambda-Motor-Soll im Warmlauf bei aktiver LR" MAP 0x4EBFAC GkfWUb 1.992 fak_ub_b2 0.00 1.992 FORMAT "%5.3"
 /begin AXIS_DESCR COM_AXIS tmotzyl_w temp_ub_q0p75_o48 12 -48.00000 49103.25 AXIS_PTS_REF STMZYL12ESUB /end AXIS_DESCR
 /begin AXIS_DESCR COM_AXIS tmstzyl_w temp_ub_q0p75_o48 12 -48.00000 49103.25 AXIS_PTS_REF STSZYL12ESUB /end AXIS_DESCR
/end CHARACTERISTIC
/begin CHARACTERISTIC KFLF "Lambdakennfeld bei Teillast" MAP 0x4EB8EC KfAxUbAyUbSstxUbSstyUbWUb 1.992 fak_ub_b2 0.00 1.992 FORMAT "%5.3"
 /begin AXIS_DESCR STD_AXIS nmotseg nmot_ub_q40 16 0.00 10200. FORMAT "%5.0" DEPOSIT ABSOLUTE /end AXIS_DESCR
 /begin AXIS_DESCR STD_AXIS rl rel_ub_q0p75 16 0.00 191.3 FORMAT "%5.1" DEPOSIT ABSOLUTE /end AXIS_DESCR
/end CHARACTERISTIC
/begin CHARACTERISTIC KFLFWDK "" MAP 0x4EBA10 KfAxUbAyUbSstxUbSstyUbWUb 1.992 fak_ub_b2 0.00 1.992 FORMAT "%5.3"
 /begin AXIS_DESCR STD_AXIS nmot nmot_ub_q40 24 0.00 10200. FORMAT "%5.0" DEPOSIT ABSOLUTE /end AXIS_DESCR
 /begin AXIS_DESCR STD_AXIS wdkba relDK_ub_b100 24 0.00 100.0 FORMAT "%5.1" DEPOSIT ABSOLUTE /end AXIS_DESCR
/end CHARACTERISTIC
/begin CHARACTERISTIC KFMAKR "Kennfeld Meﬂfensteranfang Klopfregelung" MAP 0x4EC7B4 KfAxUbAyUbSstxUbSstyUbWUb 191.3 zw_ub_q0p75 0.00 191.3 FORMAT "%5.1"
 /begin AXIS_DESCR STD_AXIS nmot nmot_ub_q40 16 0.00 10200. FORMAT "%5.0" DEPOSIT ABSOLUTE /end AXIS_DESCR
 /begin AXIS_DESCR STD_AXIS rl rel_ub_q0p75 12 0.00 191.3 FORMAT "%5.1" DEPOSIT ABSOLUTE /end AXIS_DESCR
/end CHARACTERISTIC
/begin CHARACTERISTIC KFNSWRL "Wichtung Nachstartanhebung" MAP 0x4E404A KfAxUwAyUwSstxUwSstyUwWUw 1.992188 fak_ub_b2 0.00 1.992188 FORMAT "%8.6"
 /begin AXIS_DESCR STD_AXIS tmstzyl_w temp_ub_q0p75_o48 8 -48.00000 49103.25 FORMAT "%8.2" DEPOSIT ABSOLUTE /end AXIS_DESCR
 /begin AXIS_DESCR STD_AXIS rl_w rel_uw_q0p0234 6 0.00 1535.977 FORMAT "%8.3" DEPOSIT ABSOLUTE /end AXIS_DESCR
/end CHARACTERISTIC
/begin CHARACTERISTIC KFVAKL "Faktor Verzˆgerungsabmagerung (K+L-Anteil)" MAP 0x4EBD9C GkfWUb 15.94 fak_ub_b16 0.00 15.94 FORMAT "%5.2"
 /begin AXIS_DESCR COM_AXIS tmotzyl_w temp_ub_q0p75_o48 9 -48.00000 49103.25 AXIS_PTS_REF STMZYL09ESUW /end AXIS_DESCR
 /begin AXIS_DESCR COM_AXIS nmot nmot_ub_q40 7 0.00 10200. AXIS_PTS_REF SNM07ESUB /end AXIS_DESCR
/end CHARACTERISTIC
/begin CHARACTERISTIC KFWDKMSN "Kennfeld f¸r Drosselklappen-Sollwinkel" MAP 0x4E3C1A KfAxUwAyUwSstxUwSstyUwWUw 99.99847 rel_uw_b100 0.00 99.99847 FORMAT "%8.5"
 /begin AXIS_DESCR STD_AXIS mlwdkns_w m_uw_b6553p5 16 0.00 6553.500 FORMAT "%8.3" DEPOSIT ABSOLUTE /end AXIS_DESCR
 /begin AXIS_DESCR STD_AXIS nmot_w nmot_uw_q0p25 6 0.00 16383.75 FORMAT "%8.2" DEPOSIT ABSOLUTE /end AXIS_DESCR
/end CHARACTERISTIC
/begin CHARACTERISTIC KFWDKNOT "" MAP 0x4E5032 KfAxUwAyUwSstxUwSstyUwWUw 1599.976 relDK_q0p02441 0.00 1599.976 FORMAT "%8.3"
 /begin AXIS_DESCR STD_AXIS vfzg_w vfzg_uw_b512 10 0.00 511.9922 FORMAT "%8.4" DEPOSIT ABSOLUTE /end AXIS_DESCR
 /begin AXIS_DESCR STD_AXIS nmot_w nmot_uw_q0p25 10 0.00 16383.75 FORMAT "%8.2" DEPOSIT ABSOLUTE /end AXIS_DESCR
/end CHARACTERISTIC
/begin CHARACTERISTIC KFWEE "Kennfeld Winkel Einspritzende" MAP 0x4E47A0 GkfWU8 765.0 kw_q3 0.00 765.0 FORMAT "%5.1"
 /begin AXIS_DESCR COM_AXIS nmot nmot_ub_q40 8 0.00 10200. AXIS_PTS_REF SNM08GKUB /end AXIS_DESCR
 /begin AXIS_DESCR COM_AXIS rl rel_ub_q0p75 8 0.00 191.3 AXIS_PTS_REF SRL08GKUB /end AXIS_DESCR
/end CHARACTERISTIC
/begin CHARACTERISTIC KFWEEGD "Kennfeld Winkel Einspritzende f¸r gedrosselten Betrieb" MAP 0x4E47E0 GkfWU8 765.0 kw_q3 0.00 765.0 FORMAT "%5.1"
 /begin AXIS_DESCR COM_AXIS nmot nmot_ub_q40 8 0.00 10200. AXIS_PTS_REF SNM08GKUB /end AXIS_DESCR
 /begin AXIS_DESCR COM_AXIS rl rel_ub_q0p75 8 0.00 191.3 AXIS_PTS_REF SRL08GKUB /end AXIS_DESCR
/end CHARACTERISTIC
/begin CHARACTERISTIC KFWFRLDWE "" MAP 0x4E464A KfAxUwAyUwSstxUwSstyUwWUw 100.0000 GrelPED_sw_b100 0.00 100.0000 FORMAT "%8.4"
 /begin AXIS_DESCR STD_AXIS nmot_w nmot_uw_q0p25 10 0.00 16383.75 FORMAT "%8.2" DEPOSIT ABSOLUTE /end AXIS_DESCR
 /begin AXIS_DESCR STD_AXIS rl_w rel_uw_q0p0234 10 0.00 1535.977 FORMAT "%8.3" DEPOSIT ABSOLUTE /end AXIS_DESCR
/end CHARACTERISTIC
/begin CHARACTERISTIC KFWHSTT "Wichtungskennfeld Heiﬂstart" MAP 0x4E42B4 KfAxUbAyUbSstxUbSstyUbWUb 1.992 fak_ub_b2 0.00 1.992 FORMAT "%5.3"
 /begin AXIS_DESCR STD_AXIS tans temp_ub_q0p75_o48 6 -48.00 143.3 FORMAT "%5.1" DEPOSIT ABSOLUTE /end AXIS_DESCR
 /begin AXIS_DESCR STD_AXIS anztist dez 6 0.00 255.0 FORMAT "%5.1" DEPOSIT ABSOLUTE /end AXIS_DESCR
/end CHARACTERISTIC
/begin CHARACTERISTIC KFWKSTN "Wichtungskennfeld Kaltstart" MAP 0x4E43D0 KfAxUwAyUwSstxUwSstyUwWUw 0.9960938 fak_ub_b1 0.00 0.9960938 FORMAT "%9.7"
 /begin AXIS_DESCR STD_AXIS tmstzyl_w temp_ub_q0p75_o48 4 -48.00000 49103.25 FORMAT "%8.2" DEPOSIT ABSOLUTE /end AXIS_DESCR
 /begin AXIS_DESCR STD_AXIS nmotseg nmot_ub_q40 4 0.00 2621400. FORMAT "%8.0" DEPOSIT ABSOLUTE /end AXIS_DESCR
/end CHARACTERISTIC
/begin CHARACTERISTIC KFWKSTT "Wichtungskennfeld Kaltstart" MAP 0x4E4404 KfAxUwAyUwSstxUwSstyUwWUw 1.992188 fak_ub_b2 0.00 1.992188 FORMAT "%8.6"
 /begin AXIS_DESCR STD_AXIS tmstzyl_w temp_ub_q0p75_o48 12 -48.00000 49103.25 FORMAT "%8.2" DEPOSIT ABSOLUTE /end AXIS_DESCR
 /begin AXIS_DESCR STD_AXIS anztist dez 6 0.00 65535.00 FORMAT "%8.2" DEPOSIT ABSOLUTE /end AXIS_DESCR
/end CHARACTERISTIC
/begin CHARACTERISTIC KFWWNS "Wiederholstartzeitfaktor" MAP 0x4E41EE KfAxUwAyUwSstxUwSstyUwWUw 1.992188 fak_ub_b2 0.00 1.992188 FORMAT "%8.6"
 /begin AXIS_DESCR STD_AXIS tabst_w t1sxs_uw_q1 8 0.00 65535.00 FORMAT "%8.2" DEPOSIT ABSOLUTE /end AXIS_DESCR
 /begin AXIS_DESCR STD_AXIS tmstzyl_w temp_ub_q0p75_o48 8 -48.00000 49103.25 FORMAT "%8.2" DEPOSIT ABSOLUTE /end AXIS_DESCR
/end CHARACTERISTIC
/begin CHARACTERISTIC KLAKWDK "" CURVE 0x4EBE18 KlASwSstSwWSw 3071.953 rel_sw_b1536 -1536.000 1535.953 FORMAT "%8.3"
 /begin AXIS_DESCR STD_AXIS ddrkakdk_w rel_sw_b1536 8 -1536.000 1535.953 FORMAT "%8.3" DEPOSIT ABSOLUTE /end AXIS_DESCR
/end CHARACTERISTIC
/begin CHARACTERISTIC KLBYPGANGI "" CURVE 0x4E39FA KlAUwSstSwWUw 99.99847 rel_uw_b100 0.00 99.99847 FORMAT "%8.5"
 /begin AXIS_DESCR STD_AXIS gangi dez 6 -32768.00 32767.00 FORMAT "%8.2" DEPOSIT ABSOLUTE /end AXIS_DESCR
/end CHARACTERISTIC
/begin CHARACTERISTIC KLFWST "Faktor Wiederholstart" CURVE 0x4E44BC KlAUwSstUwWUw 0.9999847 fak_uw_b1 0.00 0.9999847 FORMAT "%9.7"
 /begin AXIS_DESCR STD_AXIS tabst_w t1sxs_uw_q1 8 0.00 65535.00 FORMAT "%8.2" DEPOSIT ABSOLUTE /end AXIS_DESCR
/end CHARACTERISTIC
/begin CHARACTERISTIC KW_UbEwsMin "" VALUE 0x4ECAFA KwUb 24.02 spg_ubatt 0.00 24.02 FORMAT "%5.2" /end CHARACTERISTIC
/begin CHARACTERISTIC LASWLTM "Offset Lambda-Motor-Soll bei inaktiver Lambdaregelung" CURVE 0x4EC03C GklWSb 1.992 fak_sb_b1 -1.000 0.9922 FORMAT "%5.3"
 /begin AXIS_DESCR COM_AXIS tmotzyl_w temp_ub_q0p75_o48 12 -48.00000 49103.25 AXIS_PTS_REF STMZYL12ESUB /end AXIS_DESCR
/end CHARACTERISTIC
/begin CHARACTERISTIC MAXGANG "max. Anzahl von Gaengen" VALUE 0x4EF38D KwUb 255.0 dez 0.00 255.0 FORMAT "%5.1" /end CHARACTERISTIC
/begin CHARACTERISTIC MAXINJANGPRD "" VALUE 0x4EDEBE KwSw 720.0000 kw_q0p1 0.00 720.0000 FORMAT "%8.4" /end CHARACTERISTIC
/begin CHARACTERISTIC MAXWDKBA "" VALUE 0x4E5126 KwUw 1.000000 fak_ub_b1 0.00 1.000000 FORMAT "%8.6" /end CHARACTERISTIC
/begin CHARACTERISTIC MECH_SC_TRSP_INIT "" VALUE 0x4E5470 KwWU32 4294967295.00 default 0.00 4294967295.00 FORMAT "%13.2" /end CHARACTERISTIC
/begin CHARACTERISTIC NBYPMN "lowest engine speed for calculation of umsrln" VALUE 0x4E3A14 KwUw 16383.75 nmot_uw_q0p25 0.00 16383.75 FORMAT "%8.2" /end CHARACTERISTIC
/begin CHARACTERISTIC NDKPADO "" VALUE 0x4E5015 KwUb 2520. nmot_ub_q40 0.00 2520. FORMAT "%5.0" /end CHARACTERISTIC
/begin CHARACTERISTIC NDSVLO "obere Drehzahlschwelle f¸r Signalvergleich Ladedruck mit Umgebungsdruck" VALUE 0x4EC735 KwUb 10200. nmot_ub_q40 0.00 10200. FORMAT "%5.0" /end CHARACTERISTIC
/begin CHARACTERISTIC NDSVLU "Drehzahlschwelle f¸r Signalvergleich Ladedruck mit Umgebungsdruck" VALUE 0x4EC736 KwUb 10200. nmot_ub_q40 0.00 10200. FORMAT "%5.0" /end CHARACTERISTIC
/begin CHARACTERISTIC NGFM "" VALUE 0x4EBE68 KwSw 25599.94 nmotg_sw_q0p39 -12800.16 12799.77 FORMAT "%8.2" /end CHARACTERISTIC
/begin CHARACTERISTIC NMOTGANG "Drehzahlschwelle zum aktiviren der Gangplausibilisierung" VALUE 0x4EF38E KwUb 10200. nmot_ub_q40 0.00 10200. FORMAT "%5.0" /end CHARACTERISTIC
/begin CHARACTERISTIC NRLMN "Minimaldrehzahl zur Berechnung von umsrln" VALUE 0x4E3D0A KwUw 16383.75 nmot_uw_q0p25 0.00 16383.75 FORMAT "%8.2" /end CHARACTERISTIC
/begin CHARACTERISTIC NUKAO "obere Drehzahlgrenze f¸r ‹K-Adaption" VALUE 0x4E478A KwUb 10200. nmot_ub_q40 0.00 10200. FORMAT "%5.0" /end CHARACTERISTIC
/begin CHARACTERISTIC NUKAU "untere Drehzahlgrenze f¸r ‹K-Adaption" VALUE 0x4E478B KwUb 10200. nmot_ub_q40 0.00 10200. FORMAT "%5.0" /end CHARACTERISTIC
/begin CHARACTERISTIC NVGDSLL "Drehzahlschwelle  f¸r Drucksensorvergleich DSU/DSL im Leerlauf" VALUE 0x4EC737 KwUb 10200. nmot_ub_q40 0.00 10200. FORMAT "%5.0" /end CHARACTERISTIC
/begin CHARACTERISTIC OS_ENTP "" VALUE 0x4EC789 KwUb 25.50 t100msxs_uw_b6553p5 0.00 25.50 FORMAT "%5.2" /end CHARACTERISTIC
/begin CHARACTERISTIC OS_TABST "" VALUE 0x4EC78C KwUw 65535.00 t1sxs_uw_q1 0.00 65535.00 FORMAT "%8.2" /end CHARACTERISTIC
/begin CHARACTERISTIC PLMRN "P-Anteil von Luftmassenregler" CURVE 0x4EB778 GklWUb 7.969 fak_ub_b8 0.00 7.969 FORMAT "%5.3"
 /begin AXIS_DESCR COM_AXIS nmot nmot_ub_q40 8 0.00 10200. AXIS_PTS_REF SNM08FEUB /end AXIS_DESCR
/end CHARACTERISTIC
/begin CHARACTERISTIC PUE "Ersatzwert f¸r Umgebungsdruck" VALUE 0x4EC776 KwUw 2559.961 p_uw_q0p039 0.00 2559.961 FORMAT "%8.3" /end CHARACTERISTIC
/begin CHARACTERISTIC PUMN "Umgebungsdruckbegrenzung minimal" VALUE 0x4EC778 KwUw 2559.961 p_uw_q0p039 0.00 2559.961 FORMAT "%8.3" /end CHARACTERISTIC
/begin CHARACTERISTIC PUMX "Umgebungsdruckbegrenzung maximal" VALUE 0x4EC77A KwUw 2559.961 p_uw_q0p039 0.00 2559.961 FORMAT "%8.3" /end CHARACTERISTIC
/begin CHARACTERISTIC PUSPSMX "max. Abweichung von Umgebungsdruck und Saugrohrdruck" VALUE 0x4EC77C KwUw 2559.961 p_uw_q0p039 0.00 2559.961 FORMAT "%8.3" /end CHARACTERISTIC
/begin CHARACTERISTIC PVDKPUD "Schwelle unterhalb welcher die Diff. zw. pvdkds und pu als 0 ausgegeben wird" VALUE 0x4EC738 KwUb 2550. p_ub_q10 0.00 2550. FORMAT "%5.0" /end CHARACTERISTIC
/begin CHARACTERISTIC RBEL "Belastungswiderstand f¸r Pumpstrom-Erzeugung" VALUE 0x4E51C6 KwUw 131070.0 r_uw_q2 0.00 131070.0 FORMAT "%8.1" /end CHARACTERISTIC
/begin CHARACTERISTIC RINVMX "" VALUE 0x4E51C8 KwUw 131070.0 r_uw_q2 0.00 131070.0 FORMAT "%8.1" /end CHARACTERISTIC
/begin CHARACTERISTIC RKAKDKEMN "" VALUE 0x4E473E KwSw 3071.953 rel_sw_b1536 -1536.000 1535.953 FORMAT "%8.3" /end CHARACTERISTIC
/begin CHARACTERISTIC RKAKDKEMX "" VALUE 0x4E4740 KwSw 3071.953 rel_sw_b1536 -1536.000 1535.953 FORMAT "%8.3" /end CHARACTERISTIC
/begin CHARACTERISTIC RKAKDKGMN "" VALUE 0x4E4742 KwSw 3071.953 rel_sw_b1536 -1536.000 1535.953 FORMAT "%8.3" /end CHARACTERISTIC
/begin CHARACTERISTIC RKAKDKGMX "" VALUE 0x4E4744 KwSw 3071.953 rel_sw_b1536 -1536.000 1535.953 FORMAT "%8.3" /end CHARACTERISTIC
/begin CHARACTERISTIC RKBAUM "rk-Schwelle f¸r BA-Anzeige" CURVE 0x4EBE3A GklWSw 6143.813 rel_sw_q0p1875 0.00 6143.813 FORMAT "%8.3"
 /begin AXIS_DESCR COM_AXIS tmotzyl_w temp_ub_q0p75_o48 9 -48.00000 49103.25 AXIS_PTS_REF STMZYL09ESUW /end AXIS_DESCR
/end CHARACTERISTIC
/begin CHARACTERISTIC RKSP "Widerstand zwischen kongurierende Spannung und Sondensignal" VALUE 0x4E51CA KwUw 131070.0 r_uw_q2 0.00 131070.0 FORMAT "%8.1" /end CHARACTERISTIC
/begin CHARACTERISTIC RKUKKLU "Schwelle Summe Kurz-/Langzeitanteil" VALUE 0x4E4746 KwSw 12287.81 rel_sw_q0p1875 -6144.000 6143.813 FORMAT "%8.3" /end CHARACTERISTIC
/begin CHARACTERISTIC RKVAUM "rk-Schwelle f¸r VA-Anzeige" CURVE 0x4EBE4C GklWSw 6144.000 rel_sw_q0p1875 -6144.000 0.00 FORMAT "%8.3"
 /begin AXIS_DESCR COM_AXIS tmotzyl_w temp_ub_q0p75_o48 9 -48.00000 49103.25 AXIS_PTS_REF STMZYL09ESUW /end AXIS_DESCR
/end CHARACTERISTIC
/begin CHARACTERISTIC RLUKAU "untere Lastgrenze f¸r ‹K-Adaption" VALUE 0x4E478C KwUb 191.3 rel_ub_q0p75 0.00 191.3 FORMAT "%5.1" /end CHARACTERISTIC
/begin AXIS_PTS SAN12ESUW "SST-Verteilung f¸r den begrenzten Einspritzz‰hler anztib_w" 0x4E2BA2 anztib_w SstAUwSstUw 65535.00 dez 12 0.00 65535.00 FORMAT "%8.2" DEPOSIT ABSOLUTE /end AXIS_PTS
/begin CHARACTERISTIC SDUGETRG "max.Gradient der Potispannung" VALUE 0x4E975E KwUb 4.980 spg_ub_b5 0.00 4.980 FORMAT "%5.3" /end CHARACTERISTIC
/begin CHARACTERISTIC SENZZYL "Klopfsensoren f¸r SW-Zylinderz‰hler 0-7" VAL_BLK 0x4EC894 KwbUb 3.000 dezsub1 1.000 4.000 FORMAT "%5.3" NUMBER 8 /end CHARACTERISTIC
/begin CHARACTERISTIC SJITT "Jitter Schwelle" VALUE 0x4E5128 KwUw 5.004090 spg_uw_q0p001222 0.00 5.004090 FORMAT "%8.6" /end CHARACTERISTIC
/begin AXIS_PTS SKS06ESUB "SST-Verteilung f¸r den Startadaptionsfaktor kstaa" 0x4E2A70 kstaa SstAUbSstUb 1.992 fak_ub_b2 6 0.00 1.992 FORMAT "%5.3" DEPOSIT ABSOLUTE /end AXIS_PTS
/begin AXIS_PTS SNM07ESUB "St¸tzstellenverteilung Drehzahl, 7 Sst." 0x4EA120 nmot SstAUbSstUb 10200. nmot_ub_q40 7 0.00 10200. FORMAT "%5.0" DEPOSIT ABSOLUTE /end AXIS_PTS
/begin AXIS_PTS SNM08FEUB "" 0x4E2AB0 nmot SstAUbSstUb 10200. nmot_ub_q40 8 0.00 10200. FORMAT "%5.0" DEPOSIT ABSOLUTE /end AXIS_PTS
/begin AXIS_PTS SNM08GKUB "St¸tzstellenverteilung Gemischkontrolle 8 nmot St¸tzstellen" 0x4E2A44 nmot SstAU8SstU8 10200. nmot_ub_q40 8 0.00 10200. FORMAT "%5.0" DEPOSIT ABSOLUTE /end AXIS_PTS
/begin CHARACTERISTIC SQRT "" CURVE 0x4E85E0 KlAxU8SstxU16WU16 150.0000 p_uw_q0p039 0.00 150.0000 FORMAT "%8.4"
 /begin AXIS_DESCR STD_AXIS inj_pres_drop p_uw_q0p2 22 0.00 13107.00 FORMAT "%8.2" DEPOSIT ABSOLUTE /end AXIS_DESCR
/end CHARACTERISTIC
/begin CHARACTERISTIC SQRT_QSTAT_PRES_DROP "" VALUE 0x4EDEC0 KwUw 2559.961 p_uw_q0p039 0.00 2559.961 FORMAT "%8.3" /end CHARACTERISTIC
/begin AXIS_PTS SRL08GKUB "St¸tzstellenverteilung Gemischkontrolle 8 rl St¸tzstellen" 0x4E2A50 rl SstAU8SstU8 191.3 rel_ub_q0p75 8 0.00 191.3 FORMAT "%5.1" DEPOSIT ABSOLUTE /end AXIS_PTS
/begin AXIS_PTS STA06ESUB "SST-Verteilung f¸r die Ansauglufttemperatur" 0x4EA194 tans SstAUbSstUb 191.3 temp_ub_q0p75_o48 6 -48.00 143.3 FORMAT "%5.1" DEPOSIT ABSOLUTE /end AXIS_PTS
/begin AXIS_PTS STMZYL09ESUW "" 0x4EA27A tmotzyl_w SstAUwSstUw 49151.25 temp_ub_q0p75_o48 9 -48.00000 49103.25 FORMAT "%8.2" DEPOSIT ABSOLUTE /end AXIS_PTS
/begin AXIS_PTS STMZYL12ESUB "" 0x4EA28E tmotzyl_w SstAUwSstUw 49151.25 temp_ub_q0p75_o48 12 -48.00000 49103.25 FORMAT "%8.2" DEPOSIT ABSOLUTE /end AXIS_PTS
/begin AXIS_PTS STSZYL12ESUB "" 0x4EA2A8 tmstzyl_w SstAUwSstUw 49151.25 temp_ub_q0p75_o48 12 -48.00000 49103.25 FORMAT "%8.2" DEPOSIT ABSOLUTE /end AXIS_PTS
/begin CHARACTERISTIC SUGTRADP "max.Abweichung des Adaptionswert von der Potispannung" VALUE 0x4E975F KwUb 4.980 spg_ub_b5 0.00 4.980 FORMAT "%5.3" /end CHARACTERISTIC
/begin CHARACTERISTIC SW_WPEDRL "" VALUE 0x4EBCD9 KwWU8 1.000 DEZ 0.00 1.000 FORMAT "%5.3" /end CHARACTERISTIC
/begin CHARACTERISTIC SZANSSM "Absteuerungsfaktorumschaltschwelle f¸r Nachstartfaktor" CURVE 0x4EBCCC GklWUb 0.9961 fak_ub_b1 0.00 0.9961
 /begin AXIS_DESCR COM_AXIS tmstzyl_w temp_ub_q0p75_o48 12 -48.00000 49103.25 AXIS_PTS_REF STSZYL12ESUB /end AXIS_DESCR
/end CHARACTERISTIC
/begin CHARACTERISTIC TADE "Ersatzgrˆﬂe Lufttemperatur im Fehlerfall" VALUE 0x4EC590 KwUb 191.3 temp_ub_q0p75_o48 -48.00 143.3 FORMAT "%5.1" /end CHARACTERISTIC
/begin CHARACTERISTIC TADMN "Ansauglufttemperatur min." VALUE 0x4EC591 KwUb 191.3 temp_ub_q0p75_o48 -48.00 143.3 FORMAT "%5.1" /end CHARACTERISTIC
/begin CHARACTERISTIC TADMX "Ansauglufttemperatur max." VALUE 0x4EC592 KwUb 191.3 temp_ub_q0p75_o48 -48.00 143.3 FORMAT "%5.1" /end CHARACTERISTIC
/begin CHARACTERISTIC TAETRMN "Ansauglufttemperaturschwelle zur Abschaltung der el. Thermostatregelung" VALUE 0x4EF09E KwUb 191.3 temp_ub_q0p75_o48 -48.00 143.3 FORMAT "%5.1" /end CHARACTERISTIC
/begin CHARACTERISTIC TANDT "Schwelle Temperaturdifferenz Ansaugluft f¸r Heiﬂstart" CURVE 0x4E42E8 KlAUbSstUbWUb 191.3 temp_ub_b191p25 0.00 191.3 FORMAT "%5.1"
 /begin AXIS_DESCR STD_AXIS tansab temp_ub_q0p75_o48 8 -48.00 143.3 FORMAT "%5.1" DEPOSIT ABSOLUTE /end AXIS_DESCR
/end CHARACTERISTIC
/begin CHARACTERISTIC TANSELI "Temperatur Ansaugluft-Erfassung u. Linearisierung, Inverskennlinie" CURVE 0x4EC594 KlAUbSstUbWUb 191.3 temp_ub_q0p75_o48 -48.00 143.3 FORMAT "%5.1"
 /begin AXIS_DESCR STD_AXIS wtans spg_ub_b5 20 0.00 4.980 FORMAT "%5.3" DEPOSIT ABSOLUTE /end AXIS_DESCR
/end CHARACTERISTIC
/begin CHARACTERISTIC TBYPA "" VALUE 0x4E38CE KwUb 2.54996 zk10msxs_ub_b2p56 0.0100392 2.56000 FORMAT "%7.5" /end CHARACTERISTIC
/begin CHARACTERISTIC TBYPDML1 "" MAP 0x4E3A16 KfAxUwAyUwSstxSwSstyUwWUw 2.5499607843 zk10msxs_ub_b2p56 0.010039215686 2.5600000000 FORMAT "%12.10"
 /begin AXIS_DESCR STD_AXIS dns nmotd_sb_q10 8 -327680.0 327670.0 FORMAT "%8.1" DEPOSIT ABSOLUTE /end AXIS_DESCR
 /begin AXIS_DESCR STD_AXIS dmlbyps_w m_uw_b3276p7 8 0.00 3276.750 FORMAT "%8.3" DEPOSIT ABSOLUTE /end AXIS_DESCR
/end CHARACTERISTIC
/begin CHARACTERISTIC TBYPDML2 "" MAP 0x4E3ABA KfAxUwAyUwSstxSwSstyUwWUw 2.5499607843 zk10msxs_ub_b2p56 0.010039215686 2.5600000000 FORMAT "%12.10"
 /begin AXIS_DESCR STD_AXIS dns nmotd_sb_q10 8 -327680.0 327670.0 FORMAT "%8.1" DEPOSIT ABSOLUTE /end AXIS_DESCR
 /begin AXIS_DESCR STD_AXIS dmlbyps_w m_uw_b3276p7 8 0.00 3276.750 FORMAT "%8.3" DEPOSIT ABSOLUTE /end AXIS_DESCR
/end CHARACTERISTIC
/begin CHARACTERISTIC TBYWDKNMOT "" MAP 0x4E38D0 KfAxUbAyUbSstxUbSstyUbWUb 2.54996 zk10msxs_ub_b2p56 0.0100392 2.56000 FORMAT "%7.5"
 /begin AXIS_DESCR STD_AXIS nmot nmot_ub_q40 6 0.00 10200. FORMAT "%5.0" DEPOSIT ABSOLUTE /end AXIS_DESCR
 /begin AXIS_DESCR STD_AXIS wdkba relDK_ub_b100 6 0.00 100.0 FORMAT "%5.1" DEPOSIT ABSOLUTE /end AXIS_DESCR
/end CHARACTERISTIC
/begin CHARACTERISTIC TCEKP "‹berwachung CAN time out f¸r EKP-Abschaltung" VALUE 0x4E5008 KwUb 2.550 t10msxs_ub_b2p55 0.00 2.550 FORMAT "%5.3" /end CHARACTERISTIC
/begin CHARACTERISTIC TDCLOELNIV "" VALUE 0x4E5140 KwUw 10.00000 t100msxs_uw_q100 0.00 10.00000 FORMAT "%8.5" /end CHARACTERISTIC
/begin CHARACTERISTIC TDDFU "Entprellzeit f¸r Fehlereintrag Druckksensor Umgebung" VALUE 0x4EC739 KwUb 25.50 t100msxs_ub_b25p5 0.00 25.50 FORMAT "%5.2" /end CHARACTERISTIC
/begin CHARACTERISTIC TDDFUUGD "Entprellzeit f¸r Fehlereintrag Druckksensor Umgebung" VALUE 0x4EC73A KwUb 25.50 t100msxs_ub_b25p5 0.00 25.50 FORMAT "%5.2" /end CHARACTERISTIC
/begin CHARACTERISTIC TDDKADP "" VALUE 0x4E5016 KwUb 25.50 t100msxs_ub_b25p5 0.00 25.50 FORMAT "%5.2" /end CHARACTERISTIC
/begin CHARACTERISTIC TDDKPADU "" VALUE 0x4EC77E KwUb 10.00 t100msxs_ub_b25p5 0.00 10.00 FORMAT "%5.2" /end CHARACTERISTIC
/begin CHARACTERISTIC TDDKPADWN "" VALUE 0x4EC77F KwUb 10.00 t100msxs_ub_b25p5 0.00 10.00 FORMAT "%5.2" /end CHARACTERISTIC
/begin CHARACTERISTIC TDDKPMXAD "" VALUE 0x4EC780 KwUb 2.550 t10msxs_ub_b2p55 0.00 2.550 FORMAT "%5.3" /end CHARACTERISTIC
/begin CHARACTERISTIC TDGANG "" VALUE 0x4EF38F KwUb 51.00 t200msxs_ub_b51 0.00 51.00 FORMAT "%5.2" /end CHARACTERISTIC
/begin CHARACTERISTIC TDHGANG "" VALUE 0x4EF390 KwUb 51.00 t200msxs_ub_b51 0.00 51.00 FORMAT "%5.2" /end CHARACTERISTIC
/begin CHARACTERISTIC TDHPLAUS "Timer zur Heilung eines nicht Plausibel Fehlers" VALUE 0x4EF391 KwUb 25.50 t100msxs_ub_b25p5 0.00 25.50 FORMAT "%5.2" /end CHARACTERISTIC
/begin CHARACTERISTIC TDNSTA "Auspufferw‰rmzeit ab Start, f¸r TANS - Diagnose" VALUE 0x4EC5BD KwUb 255.0 t1sxs_ub_b255 0.00 255.0 FORMAT "%5.1" /end CHARACTERISTIC
/begin CHARACTERISTIC TDOELNIV "" VALUE 0x4E5142 KwUw 10.00000 t100msxs_uw_q100 0.00 10.00000 FORMAT "%8.5" /end CHARACTERISTIC
/begin CHARACTERISTIC TDPLAUS "Timer zum eintragen eines nicht Plausibel Fehlers" VALUE 0x4EF392 KwUb 25.50 t100msxs_ub_b25p5 0.00 25.50 FORMAT "%5.2" /end CHARACTERISTIC
/begin CHARACTERISTIC TDTA "Entprellzeit Fehlererkennung TANS" VALUE 0x4EC5BE KwUb 25.50 t100msxs_ub_b25p5 0.00 25.50 FORMAT "%5.2" /end CHARACTERISTIC
/begin CHARACTERISTIC TDTAL "TANS Fehlererkennung / Zeitsperre ab B_LL = 1" VALUE 0x4EC5BF KwUb 255.0 t1sxs_ub_b255 0.00 255.0 FORMAT "%5.1" /end CHARACTERISTIC
/begin CHARACTERISTIC TDUGANGRS "Zeit bis zum Ruecksetzen der einzelnen Adaptionen" VALUE 0x4E9760 KwUb 25.50 t100msxs_ub_b25p5 0.00 25.50 FORMAT "%5.2" /end CHARACTERISTIC
/begin CHARACTERISTIC TDUGETRADP "Zeit bis zum setzten der Bedingung B_dtugetrg" VALUE 0x4E9761 KwUb 25.50 t100msxs_ub_b25p5 0.00 25.50 FORMAT "%5.2" /end CHARACTERISTIC
/begin CHARACTERISTIC TDVGDSLL "Verzˆgerungszeit f¸r Drucksensorvergleich DSU/DSL im Leerlauf" VALUE 0x4EC73B KwUb 25.50 t100msxs_ub_b25p5 0.00 25.50 FORMAT "%5.2" /end CHARACTERISTIC
/begin CHARACTERISTIC TEDK "Entprellzeit bei DK-Pori Fehler" VALUE 0x4E512A KwUw 10.00000 t100msxs_uw_q100 0.00 10.00000 FORMAT "%8.5" /end CHARACTERISTIC
/begin CHARACTERISTIC TFUPI "Filterzeitkonstante bei Umschaltung auf Ist-Druck als Referenzdruck vor DK" VALUE 0x4E3D0C KwUw 655.350000 zk10msxs_uw_b655 0.0100001526 655.360000 FORMAT "%10.6" /end CHARACTERISTIC
/begin CHARACTERISTIC TFUPS "Filterzeitkonstante bei Umschaltung auf Soll-Ladedruck als Referenzdruck vor DK" VALUE 0x4E3D0E KwUw 655.350000 zk10msxs_uw_b655 0.0100001526 655.360000 FORMAT "%10.6" /end CHARACTERISTIC
/begin CHARACTERISTIC TGGLS "Zeitdauer f¸r ADC nach Interrupt im Funktionsrechner (Asic)" VALUE 0x4E51C0 KwUb 2.000 t1msxms_q1 3.000 5.000 FORMAT "%5.3" /end CHARACTERISTIC
/begin CHARACTERISTIC THSRIV "" VALUE 0x4E51CC KwUw 655.3500 t10msxs_uw_b655p35 0.00 655.3500 FORMAT "%8.4" /end CHARACTERISTIC
/begin CHARACTERISTIC TMH "Motortemperatur - Schwelle heiﬂ" VALUE 0x4E44DE KwUw 49151.25 temp_ub_q0p75_o48 -48.00000 49103.25 FORMAT "%8.2" /end CHARACTERISTIC
/begin CHARACTERISTIC TMHSG "Motortemperatur Heiﬂstartgrenze" VALUE 0x4E44E0 KwUw 49151.25 temp_ub_q0p75_o48 -48.00000 49103.25 FORMAT "%8.2" /end CHARACTERISTIC
/begin CHARACTERISTIC TMINOELNIV "" VALUE 0x4EC78A KwUb 191.3 temp_ub_q0p75_o48 -48.00 143.3 FORMAT "%5.1" /end CHARACTERISTIC
/begin CHARACTERISTIC TMOTAB_MIN "" VALUE 0x4EC78B KwUb 191.3 temp_ub_q0p75_o48 -48.00 143.3 FORMAT "%5.1" /end CHARACTERISTIC
/begin CHARACTERISTIC TMOTDKPFAD "" VALUE 0x4E5017 KwUb 191.3 temp_ub_q0p75_o48 -48.00 143.3 FORMAT "%5.1" /end CHARACTERISTIC
/begin CHARACTERISTIC TMUKAK "Temperaturbereich kalter Motor f¸r ‹K-Adaption" VALUE 0x4E4796 KwUw 49151.25 temp_ub_q0p75_o48 -48.00000 49103.25 FORMAT "%8.2" /end CHARACTERISTIC
/begin CHARACTERISTIC TMUKAU "untere Motortemperatur-Grenze f¸r ‹K-Adaption" VALUE 0x4E4798 KwUw 49151.25 temp_ub_q0p75_o48 -48.00000 49103.25 FORMAT "%8.2" /end CHARACTERISTIC
/begin CHARACTERISTIC TMUKAW "Temperaturbereich warmer Motor f¸r ‹K-Adaption" VALUE 0x4E479A KwUw 49151.25 temp_ub_q0p75_o48 -48.00000 49103.25 FORMAT "%8.2" /end CHARACTERISTIC
/begin CHARACTERISTIC TNSUUK "Zeit UK-Unterdr¸ckung im Nachstart" VALUE 0x4E4639 KwUb 25.50 t100msxs_ub_b25p5 0.00 25.50 FORMAT "%5.2" /end CHARACTERISTIC
/begin CHARACTERISTIC TNSUUKA "Verbotszeit ‹K-Adaption im Nachstart" VALUE 0x4E479C KwUw 655.3500 t10msxs_uw_b655p35 0.00 655.3500 FORMAT "%8.4" /end CHARACTERISTIC
/begin CHARACTERISTIC TRIAKTV "" VALUE 0x4E51CE KwUw 6553.500 t100msxs_uw_b6553p5 0.00 6553.500 FORMAT "%8.3" /end CHARACTERISTIC
/begin CHARACTERISTIC TRIIMPV "" VALUE 0x4E51D0 KwUw 655.3500 t10msxs_uw_b655p35 0.00 655.3500 FORMAT "%8.4" /end CHARACTERISTIC
/begin CHARACTERISTIC TSTAEBR "Zeit f¸r Steckerabfall-Erkennung Bremse" VALUE 0x4EC58E KwUw 6553.500 t100msxs_uw_b6553p5 0.00 6553.500 FORMAT "%8.3" /end CHARACTERISTIC
/begin CHARACTERISTIC TUGETRGNP "Timer zur Erkennung eines nicht plausiblen Spannungswert von Getriebepoti" VALUE 0x4EF393 KwUb 255.0 dez 0.00 255.0 FORMAT "%5.1" /end CHARACTERISTIC
/begin CHARACTERISTIC TUGETRGPL "" VALUE 0x4EF394 KwUb 255.0 dez 0.00 255.0 FORMAT "%5.1" /end CHARACTERISTIC
/begin CHARACTERISTIC TUSBELV "" VALUE 0x4E51C1 KwUb 2.550 t10msxs_ub_b2p55 0.00 2.550 FORMAT "%5.3" /end CHARACTERISTIC
/begin CHARACTERISTIC TVERBR "Verzˆgerungszeit f¸r Bremsschalter-Plausibilit‰tspr¸fung" VALUE 0x4EC58B KwUb 25.50 t100msxs_ub_b25p5 0.00 25.50 FORMAT "%5.2" /end CHARACTERISTIC
/begin CHARACTERISTIC TVETRA "Verzˆgerungzeit zum Lˆschen von B_etr" VALUE 0x4EF0A2 KwUw 6553.500 t100msxs_uw_b6553p6 0.00 6553.500 FORMAT "%8.3" /end CHARACTERISTIC
/begin CHARACTERISTIC TVETRE "Verzˆgerungzeit zum Setzen von B_etr" VALUE 0x4EF0A4 KwUw 6553.500 t100msxs_uw_b6553p6 0.00 6553.500 FORMAT "%8.3" /end CHARACTERISTIC
/begin CHARACTERISTIC TVKUP "Verzˆgerungszeit f¸r B_kupplv" VALUE 0x4E5009 KwUb 5.100 t20msxs_ub_b5p1 0.00 5.100 FORMAT "%5.3" /end CHARACTERISTIC
/begin CHARACTERISTIC TVWDKS "Verzˆgerungszeit f¸r Drosselklappen-Sollwinkel" VALUE 0x4E3BC4 KwUb 0.05000 t10msxs_ub_b2p55 0.00 0.05000 FORMAT "%7.5" /end CHARACTERISTIC
/begin CHARACTERISTIC TWDKSV "Zeitkonstante f¸r Drosselklappensollwinkelfilterung" CURVE 0x4E3D10 KlAUwSstUwWUw 655.350000 zk10msxs_uw_b655 0.0100001526 655.360000 FORMAT "%10.6"
 /begin AXIS_DESCR STD_AXIS pspvmin_w fak_uw_b2 6 0.00 1.999969 FORMAT "%8.6" DEPOSIT ABSOLUTE /end AXIS_DESCR
/end CHARACTERISTIC
/begin CHARACTERISTIC TWETRS "Solltemperatur bei Anforderung W‰rmetauscherschutz, ersetzt FWETRS" VALUE 0x4EF09F KwUb 191.3 temp_ub_q0p75_o48 -48.00 143.3 FORMAT "%5.1" /end CHARACTERISTIC
/begin CHARACTERISTIC UADPUMN "min. Spannungswert f¸r Diagnose Drucksensor" VALUE 0x4EC73C KwUb 4.845 spg_ub_q0p019 0.00 4.845 FORMAT "%5.3" /end CHARACTERISTIC
/begin CHARACTERISTIC UADPUMX "max. Spannungswert f¸r Diagnose Drucksensor" VALUE 0x4EC73D KwUb 4.845 spg_ub_q0p019 0.00 4.845 FORMAT "%5.3" /end CHARACTERISTIC
/begin CHARACTERISTIC UDKP1NHUB "Nennhub der Drosselklappe im DV-E, (Poti 1)" VALUE 0x4E512C KwUw 5.004090 spg_uw_q0p001222 0.00 5.004090 FORMAT "%8.6" /end CHARACTERISTIC
/begin CHARACTERISTIC UDKPADP_MN "MN DK-Spannungsschwelle Adaptionsfreigabe" VALUE 0x4E512E KwUw 5.004090 spg_uw_q0p001222 0.00 5.004090 FORMAT "%8.6" /end CHARACTERISTIC
/begin CHARACTERISTIC UDKPADP_MX "MX DK-Spannungsschwelle Adaptionsfreigabe" VALUE 0x4E5130 KwUw 5.004090 spg_uw_q0p001222 0.00 5.004090 FORMAT "%8.6" /end CHARACTERISTIC
/begin CHARACTERISTIC UDKPAOFFS "Schrittweite schnelle Adaption" VALUE 0x4E5132 KwUw 5.004090 spg_uw_q0p001222 0.00 5.004090 FORMAT "%8.6" /end CHARACTERISTIC
/begin CHARACTERISTIC UDKPMXO "" VALUE 0x4E5134 KwUw 5.004090 spg_uw_q0p001222 0.00 5.004090 FORMAT "%8.6" /end CHARACTERISTIC
/begin CHARACTERISTIC UDKPMXU "" VALUE 0x4E5136 KwUw 5.004090 spg_uw_q0p001222 0.00 5.004090 FORMAT "%8.6" /end CHARACTERISTIC
/begin CHARACTERISTIC UDKP_MN "Untere Diagnoseschwelle DK-Poti" VALUE 0x4E5138 KwUw 5.004090 spg_uw_q0p001222 0.00 5.004090 FORMAT "%8.6" /end CHARACTERISTIC
/begin CHARACTERISTIC UDKP_MX "Obere Diagnoseschwelle DK-Poti" VALUE 0x4E513A KwUw 5.004090 spg_uw_q0p001222 0.00 5.004090 FORMAT "%8.6" /end CHARACTERISTIC
/begin CHARACTERISTIC UGANG "zugeordnete Spannungswert von Getriebepoti" VAL_BLK 0x4E9744 KwbUb 4.980 spg_ub_b5 0.00 4.980 FORMAT "%5.3" NUMBER 10 /end CHARACTERISTIC
/begin CHARACTERISTIC UGETRGMN "min. Spannungswert von Getriebepoti" VALUE 0x4EF395 KwUb 4.980 spg_ub_b5 0.00 4.980 FORMAT "%5.3" /end CHARACTERISTIC
/begin CHARACTERISTIC UGETRGMX "max. Spannungswert von Getriebepoti" VALUE 0x4EF396 KwUb 4.980 spg_ub_b5 0.00 4.980 FORMAT "%5.3" /end CHARACTERISTIC
/begin CHARACTERISTIC USRIMINV "" VALUE 0x4E51D2 KwUw 319.9951 spg_uw_q0p00488_o1 -1.000000 318.9951 FORMAT "%8.4" /end CHARACTERISTIC
/begin CHARACTERISTIC USRIOV "" VALUE 0x4E51D4 KwUw 319.9951 spg_uw_q0p00488_o1 -1.000000 318.9951 FORMAT "%8.4" /end CHARACTERISTIC
/begin CHARACTERISTIC USRIUV "" VALUE 0x4E51D6 KwUw 319.9951 spg_uw_q0p00488_o1 -1.000000 318.9951 FORMAT "%8.4" /end CHARACTERISTIC
/begin CHARACTERISTIC VDKPADO "" VALUE 0x4E5018 KwUb 260.0 vfzg_ub_q1p25 0.00 260.0 FORMAT "%5.1" /end CHARACTERISTIC
/begin CHARACTERISTIC VFZETR "Geschwindigkeitsschwelle f¸r el. Thermostatregelung" VALUE 0x4EF0A0 KwUb 318.8 vfzg_ub_q1p25 0.00 318.8 FORMAT "%5.1" /end CHARACTERISTIC
/begin CHARACTERISTIC WDKBA_EW "" VALUE 0x4E513C KwSw 899.9756 relDK_q0p02441 -800.0000 99.97559 FORMAT "%8.4" /end CHARACTERISTIC
/begin CHARACTERISTIC WDKDSVLU "Drosselklappenschwelle f¸r Drucksensorplausibilisierung" CURVE 0x4EC740 KlAUbSstUbWUb 100.0 relDK_ub_b100 0.00 100.0 FORMAT "%5.1"
 /begin AXIS_DESCR STD_AXIS nmot nmot_ub_q40 6 0.00 10200. FORMAT "%5.0" DEPOSIT ABSOLUTE /end AXIS_DESCR
/end CHARACTERISTIC
/begin CHARACTERISTIC WDKFADPMX "" VALUE 0x4E513E KwSw 899.9756 relDK_q0p02441 -800.0000 99.97559 FORMAT "%8.4" /end CHARACTERISTIC
/begin CHARACTERISTIC WDKGANG_EW "" VALUE 0x4EC781 KwUb 7.969 rel_ub_b0p03125 0.00 7.969 FORMAT "%5.3" /end CHARACTERISTIC
/begin CHARACTERISTIC WDKNOTGANG "" CURVE 0x4E501C KlAUbSstUbWUb 7.969 rel_ub_b0p03125 0.00 7.969 FORMAT "%5.3"
 /begin AXIS_DESCR STD_AXIS gangi dez 7 0.00 255.0 FORMAT "%5.1" DEPOSIT ABSOLUTE /end AXIS_DESCR
/end CHARACTERISTIC
/begin CHARACTERISTIC WDKSAPP "Drosselklappensollwert f¸r Applikationszwecke" VALUE 0x4E3D2A KwUw 99.99847 rel_uw_b100 0.00 99.99847 FORMAT "%8.5" /end CHARACTERISTIC
/begin CHARACTERISTIC WDKUGDN "KL Drosselklappenwinkel, ab der keine Drosselung mehr erfolgt" CURVE 0x4E3B90 KlAxU16SstxU16WU16 99.99847 rel_uw_b100 0.00 99.99847 FORMAT "%8.5"
 /begin AXIS_DESCR STD_AXIS nmot nmot_ub_q40 12 0.00 2621400. FORMAT "%8.0" DEPOSIT ABSOLUTE /end AXIS_DESCR
/end CHARACTERISTIC
/begin CHARACTERISTIC WEAN "Winkel Einspritzabbruch" CURVE 0x4E4820 GklWU8 765.0 kw_q3 0.00 765.0 FORMAT "%5.1"
 /begin AXIS_DESCR COM_AXIS nmot nmot_ub_q40 8 0.00 10200. AXIS_PTS_REF SNM08GKUB /end AXIS_DESCR
/end CHARACTERISTIC
/begin CHARACTERISTIC WEANST "Winkel Einspritzabbruch im Start" CURVE 0x4E483C KlAUwSstUwWSw 765.0000 kw_q3 -384.0000 381.0000 FORMAT "%8.4"
 /begin AXIS_DESCR STD_AXIS tmotzyl_w temp_ub_q0p75_o48 4 -48.00000 49103.25 FORMAT "%8.2" DEPOSIT ABSOLUTE /end AXIS_DESCR
/end CHARACTERISTIC
/begin CHARACTERISTIC WEEM "Vorlagerungswinkel - Korrektur" CURVE 0x4E484E KlAUwSstUwWSw 765.0000 kw_q3 -384.0000 381.0000 FORMAT "%8.4"
 /begin AXIS_DESCR STD_AXIS tmotzyl_w temp_ub_q0p75_o48 8 -48.00000 49103.25 FORMAT "%8.2" DEPOSIT ABSOLUTE /end AXIS_DESCR
/end CHARACTERISTIC
/begin CHARACTERISTIC WEEMGD "Vorlagerungswinkel - Korrektur gedrosselt" CURVE 0x4E4870 KlAUwSstUwWSw 765.0000 kw_q3 -384.0000 381.0000 FORMAT "%8.4"
 /begin AXIS_DESCR STD_AXIS tmotzyl_w temp_ub_q0p75_o48 8 -48.00000 143.2500 FORMAT "%8.4" DEPOSIT ABSOLUTE /end AXIS_DESCR
/end CHARACTERISTIC
/begin CHARACTERISTIC WEEMRFAN "Winkel Einspritzende bei maximalem Fahrerwunsch" CURVE 0x4E4828 GklWU8 765.0 kw_q3 0.00 765.0 FORMAT "%5.1"
 /begin AXIS_DESCR COM_AXIS nmot nmot_ub_q40 8 0.00 10200. AXIS_PTS_REF SNM08GKUB /end AXIS_DESCR
/end CHARACTERISTIC
/begin CHARACTERISTIC WEESTM "Vorlagerunswinkel-Korrektur im Start" CURVE 0x4E4892 KlAUwSstUwWUw 765.0000 kw_q3 0.00 765.0000 FORMAT "%8.4"
 /begin AXIS_DESCR STD_AXIS tmotzyl_w temp_ub_q0p75_o48 8 -48.00000 143.2500 FORMAT "%8.4" DEPOSIT ABSOLUTE /end AXIS_DESCR
/end CHARACTERISTIC
/begin CHARACTERISTIC WEESTN "Winkel Einspritzende im Start" CURVE 0x4E4830 KlAxU8SstxU8WU8 765.0 kw_q3 0.00 765.0 FORMAT "%5.1"
 /begin AXIS_DESCR STD_AXIS nmot nmot_ub_q40 4 0.00 10200. FORMAT "%5.0" DEPOSIT ABSOLUTE /end AXIS_DESCR
/end CHARACTERISTIC
/begin CHARACTERISTIC WFRL "Kraftstoffwandfilmkennlinie" CURVE 0x4E4748 FklWUw 6143.906 rel_uw_b6144 0.00 6143.906 FORMAT "%8.3"
 /begin AXIS_DESCR FIX_AXIS rlp_w rel_uw_q0p0234 26 0.00 155.9766 FORMAT "%8.4" FIX_AXIS_PAR 0 8 26 /end AXIS_DESCR
/end CHARACTERISTIC
/begin CHARACTERISTIC ZBALM "Abregelfaktor L-Speicher (tmot) BA" CURVE 0x4EBDDC GklWUb 0.1245 fak_ub_b0p125 0.00 0.1245 FORMAT "%6.4"
 /begin AXIS_DESCR COM_AXIS tmotzyl_w temp_ub_q0p75_o48 9 -48.00000 49103.25 AXIS_PTS_REF STMZYL09ESUW /end AXIS_DESCR
/end CHARACTERISTIC
/begin CHARACTERISTIC ZDGZA1 "Z¸ndungszahl Abregelung Bereich 1" VALUE 0x4E40CA KwUb 255.0 dez 0.00 255.0 FORMAT "%5.1" /end CHARACTERISTIC
/begin CHARACTERISTIC ZDGZA2 "Z¸ndungszahl Abregelung Bereich 2" VALUE 0x4E40CB KwUb 255.0 dez 0.00 255.0 FORMAT "%5.1" /end CHARACTERISTIC
/begin CHARACTERISTIC ZDSU "Zeitkonstante f¸r Filterung von pu und fho in GGDSU" VALUE 0x4EC74D KwUb 25.4996 zk100msxs_ub_b25p5 0.100392 25.6000 FORMAT "%7.4" /end CHARACTERISTIC
/begin CHARACTERISTIC ZERBR "Fehlerz‰hler f¸r Bremsschalter-Unplausibilit‰ten" VALUE 0x4EC58C KwUb 255.0 dez 0.00 255.0 FORMAT "%5.1" /end CHARACTERISTIC
/begin CHARACTERISTIC ZFRIV "" VALUE 0x4E51D8 KwUw 0.9999847 fak_uw_b1 0.00 0.9999847 FORMAT "%9.7" /end CHARACTERISTIC
/begin CHARACTERISTIC ZFTANS "Zeitkonstante Tiefpaﬂfilter Ansauglufttemperatur" VALUE 0x4EC5C0 KwUw 6553.50000 zk100msxs_uw_b6553 0.100001526 6553.60000 FORMAT "%10.5" /end CHARACTERISTIC
/begin CHARACTERISTIC ZFUKA "" VALUE 0x4E478D KwUb 1.992 fak_ub_b2 0.00 1.992 FORMAT "%5.3" /end CHARACTERISTIC
/begin CHARACTERISTIC ZKDKA "Filterkonstante bei langsamer DK-Adaption" VALUE 0x4EC782 KwUb 25.4996 zk100msxs_ub_b25p5 0.100392 25.6000 FORMAT "%7.4" /end CHARACTERISTIC
/begin CHARACTERISTIC ZKDKAO "" VALUE 0x4EC783 KwUb 25.4996 zk100msxs_ub_b25p5 0.100392 25.6000 FORMAT "%7.4" /end CHARACTERISTIC
/begin CHARACTERISTIC ZKDKAT "Filterkonstante bei DK-Adaption ¸ber Tester" VALUE 0x4EC784 KwUb 25.4996 zk100msxs_ub_b25p5 0.100392 25.6000 FORMAT "%7.4" /end CHARACTERISTIC
/begin CHARACTERISTIC ZKLANSWL "Zeitkonstante Filterung lamnswl_w" VALUE 0x4E48E6 KwUw 655.350000 zk10msxs_uw_b655 0.0100001526 655.360000 FORMAT "%10.6" /end CHARACTERISTIC
/begin CHARACTERISTIC ZKRLSOLDK "" CURVE 0x4E44E4 KlAxU8SstxU8WU16 655.350000 zk10msxs_uw_b655 0.0100001526 655.360000 FORMAT "%10.6"
 /begin AXIS_DESCR STD_AXIS nmot nmot_ub_q40 6 0.00 10200. FORMAT "%5.0" DEPOSIT ABSOLUTE /end AXIS_DESCR
/end CHARACTERISTIC
/begin CHARACTERISTIC ZUKE "Zeitkonstante ‹K-Ersatzwert" VALUE 0x4E477C KwUw 655.350000 zk10msxs_uw_b655 0.0100001526 655.360000 FORMAT "%10.6" /end CHARACTERISTIC
/begin CHARACTERISTIC ZUKK "Abregelfaktor Kurzzeitanteil" VALUE 0x4E463A KwUb 0.9961 fak_ub_b1 0.00 0.9961 /end CHARACTERISTIC
/begin CHARACTERISTIC ZUKNST "Abregelzeitkonstante ‹K-Faktor im Nachstart" VALUE 0x4E477E KwUw 6553.50000 zk100msxs_uw_b6553 0.100001526 6553.60000 FORMAT "%10.5" /end CHARACTERISTIC
/begin CHARACTERISTIC ZVALM "Abregelfaktor L-Speicher (tmot) VA" CURVE 0x4EBDE8 GklWUb 0.1245 fak_ub_b0p125 0.00 0.1245 FORMAT "%6.4"
 /begin AXIS_DESCR COM_AXIS tmotzyl_w temp_ub_q0p75_o48 9 -48.00000 49103.25 AXIS_PTS_REF STMZYL09ESUW /end AXIS_DESCR
/end CHARACTERISTIC
/begin MEASUREMENT abak "Aufteilungsfaktor Wandfilm bei BA" UBYTE fak_ub_b1 1 100 0 0.996094 ECU_ADDRESS 0x7FD5B8 /end MEASUREMENT
/begin MEASUREMENT abaov "Anzahl Beschleunigungsvorg‰nge ohne Adaptionswertverstellung" UBYTE dez 1 100 0 255 FORMAT "%5.1" ECU_ADDRESS 0x7FD93A /end MEASUREMENT
/begin MEASUREMENT abaov2 "Anzahl Beschleunigungsvorg‰nge ohne Adaptionswertverstellung Bank2" UBYTE dez 1 100 0 255 FORMAT "%5.1" ECU_ADDRESS 0x7FD93B /end MEASUREMENT
/begin MEASUREMENT actl_inj_fmf "" SWORD mgrad_sw_b28p44 1 100 -28.4444 28.4436 FORMAT "%8.5" ECU_ADDRESS 0x7FDF8A /end MEASUREMENT
/begin MEASUREMENT actl_inj_ratio "" UWORD fak_uw_q0p001 1 100 0 65.535 FORMAT "%8.5" ECU_ADDRESS 0x7FDF8C /end MEASUREMENT
/begin MEASUREMENT ainkba "" SBYTE dez 1 100 -128 127 FORMAT "%5.1" ECU_ADDRESS 0x7FD93C /end MEASUREMENT
/begin MEASUREMENT ainkva "" SBYTE dez 1 100 -128 127 FORMAT "%5.1" ECU_ADDRESS 0x7FD93D /end MEASUREMENT
/begin MEASUREMENT anztib_w "ti-Einspritzz‰hler mit Begrenzung" UWORD dez 1 100 0 65535 FORMAT "%8.2" ECU_ADDRESS 0x7FDC92 /end MEASUREMENT
/begin MEASUREMENT anztis "Anzahl vom CIFI initialisierter ti's (Synchro-Abtastung)" UBYTE dez 1 100 0 255 FORMAT "%5.1" ECU_ADDRESS 0x7FD939 /end MEASUREMENT
/begin MEASUREMENT anztist "ti-Einspritzz‰hler im Start" UBYTE dez 1 100 0 255 FORMAT "%5.1" ECU_ADDRESS 0x7FD930 /end MEASUREMENT
/begin MEASUREMENT anzwefim "Anzahl der abgearbeiteten Wiedereinsetzfaktoren" UBYTE dez 1 100 0 255 FORMAT "%5.1" ECU_ADDRESS 0x7FD946 /end MEASUREMENT
/begin MEASUREMENT aspuka "" UBYTE dez 1 100 0 255 FORMAT "%5.1" ECU_ADDRESS 0x7FD93E /end MEASUREMENT
/begin MEASUREMENT aspuka2 "" UBYTE dez 1 100 0 255 FORMAT "%5.1" ECU_ADDRESS 0x7FD93F /end MEASUREMENT
/begin MEASUREMENT AS_bf0 "" UWORD B_TRUE 1 100 0 1 BIT_MASK 0x8 FORMAT "%13.11" ECU_ADDRESS 0x7FE140 /end MEASUREMENT
/begin MEASUREMENT AS_bf1 "" UWORD B_TRUE 1 100 0 1 BIT_MASK 0x10 FORMAT "%13.11" ECU_ADDRESS 0x7FE140 /end MEASUREMENT
/begin MEASUREMENT AS_bf2 "" UWORD B_TRUE 1 100 0 1 BIT_MASK 0x20 FORMAT "%13.11" ECU_ADDRESS 0x7FE140 /end MEASUREMENT
/begin MEASUREMENT AS_bf3 "" UWORD B_TRUE 1 100 0 1 BIT_MASK 0x40 FORMAT "%13.11" ECU_ADDRESS 0x7FE140 /end MEASUREMENT
/begin MEASUREMENT AS_g0 "" UWORD B_TRUE 1 100 0 1 BIT_MASK 0x1 FORMAT "%13.11" ECU_ADDRESS 0x7FE140 /end MEASUREMENT
/begin MEASUREMENT AS_g1 "" UWORD B_TRUE 1 100 0 1 BIT_MASK 0x2 FORMAT "%13.11" ECU_ADDRESS 0x7FE140 /end MEASUREMENT
/begin MEASUREMENT AS_g2 "" UWORD B_TRUE 1 100 0 1 BIT_MASK 0x4 FORMAT "%13.11" ECU_ADDRESS 0x7FE140 /end MEASUREMENT
/begin MEASUREMENT AS_ksa1 "" UWORD B_TRUE 1 100 0 1 BIT_MASK 0x80 FORMAT "%13.11" ECU_ADDRESS 0x7FE140 /end MEASUREMENT
/begin MEASUREMENT AS_ksa2 "" UWORD B_TRUE 1 100 0 1 BIT_MASK 0x100 FORMAT "%13.11" ECU_ADDRESS 0x7FE140 /end MEASUREMENT
/begin MEASUREMENT AS_ksa3 "" UWORD B_TRUE 1 100 0 1 BIT_MASK 0x200 FORMAT "%13.11" ECU_ADDRESS 0x7FE140 /end MEASUREMENT
/begin MEASUREMENT AS_kti "" UWORD B_TRUE 1 100 0 1 BIT_MASK 0x400 FORMAT "%13.11" ECU_ADDRESS 0x7FE140 /end MEASUREMENT
/begin MEASUREMENT atislatm_w "Rover" UWORD dez 1 100 0 65535 FORMAT "%8.2" ECU_ADDRESS 0x7FDCE4 /end MEASUREMENT
/begin MEASUREMENT atiwkstm_w "Rover" UWORD dez 1 100 0 65535 FORMAT "%8.2" ECU_ADDRESS 0x7FDCE6 /end MEASUREMENT
/begin MEASUREMENT avak "Aufteilungsfaktor Wandfilm bei VA" UBYTE fak_ub_b1 1 100 0 0.996094 ECU_ADDRESS 0x7FD5B9 /end MEASUREMENT
/begin MEASUREMENT avaov "Anzahl Verzˆgerungsvorg‰nge ohne Adaptionswertverstellung" UBYTE dez 1 100 0 255 FORMAT "%5.1" ECU_ADDRESS 0x7FD940 /end MEASUREMENT
/begin MEASUREMENT avaov2 "Anzahl Verzˆgerungsvorg‰nge ohne Adaptionswertverstellung Bank2" UBYTE dez 1 100 0 255 FORMAT "%5.1" ECU_ADDRESS 0x7FD941 /end MEASUREMENT
/begin MEASUREMENT azylwe "Anzahl wiedereingesetzter Zylinder" UBYTE dez 1 100 0 255 FORMAT "%5.1" ECU_ADDRESS 0x7FD947 /end MEASUREMENT
/begin MEASUREMENT betrag_w "" SWORD rel_sw_q0p1875 1 100 -6144 6143.81 FORMAT "%8.3" ECU_ADDRESS 0x7FDCA8 /end MEASUREMENT
/begin MEASUREMENT bypafilt_w "" SWORD rel_uw_b100 1 100 -50 49.9985 FORMAT "%8.5" ECU_ADDRESS 0x7FDBC4 /end MEASUREMENT
/begin MEASUREMENT bypaoff_w "" SWORD rel_uw_b100 1 100 -50 49.9985 FORMAT "%8.5" ECU_ADDRESS 0x7F9BA8 /end MEASUREMENT
/begin MEASUREMENT bypa_w "" SWORD rel_uw_b100 1 100 -50 49.9985 FORMAT "%8.5" ECU_ADDRESS 0x7FDBC6 /end MEASUREMENT
/begin MEASUREMENT bypcorr "Reglerausgang fuer Bankbgleich" SWORD m_uw_b25p6 1 100 -12.8 12.7996 FORMAT "%8.5" ECU_ADDRESS 0x7FDBC8 /end MEASUREMENT
/begin MEASUREMENT bypcorr_i "Reglerausgang I-Anteil fuer Bankbgleich" SLONG m_ul_6553p6 1 100 -3276.8 3276.8 FORMAT "%11.6" ECU_ADDRESS 0x7FE43C /end MEASUREMENT
/begin MEASUREMENT bypcorr_p "Reglerausgang P-Anteil fuer Bankbgleich" SWORD m_uw_b25p6 1 100 -12.8 12.7996 FORMAT "%8.5" ECU_ADDRESS 0x7FDBCA /end MEASUREMENT
/begin MEASUREMENT bypg1v2_w "" UWORD rel_uw_b100 1 100 0 99.9985 FORMAT "%8.5" ECU_ADDRESS 0x7FDBCC /end MEASUREMENT
/begin MEASUREMENT bypg1v_w "" UWORD rel_uw_b100 1 100 0 99.9985 FORMAT "%8.5" ECU_ADDRESS 0x7FDBCE /end MEASUREMENT
/begin MEASUREMENT bypgv2_w "Steppersollpsition in % nach Filter Bank2" UWORD rel_uw_b100 1 100 0 99.9985 FORMAT "%8.5" ECU_ADDRESS 0x7FDBD0 /end MEASUREMENT
/begin MEASUREMENT bypgv_w "Steppersollpsition in % nach Filter" UWORD rel_uw_b100 1 100 0 99.9985 FORMAT "%8.5" ECU_ADDRESS 0x7FDBD2 /end MEASUREMENT
/begin MEASUREMENT bypistmw "" UWORD rel_uw_b100 1 100 0 99.9985 FORMAT "%8.5" ECU_ADDRESS 0x7FDBD4 /end MEASUREMENT
/begin MEASUREMENT bypsolary "Steppersollpsition in % nach Manipulation" UWORD rel_uw_b100 1 100 0 99.9985 FORMAT "%8.5" ARRAY_SIZE 2 ECU_ADDRESS 0x7FDBD6 /end MEASUREMENT
/begin MEASUREMENT bypsol_w "" UWORD rel_uw_b100 1 100 0 99.9985 FORMAT "%8.5" ECU_ADDRESS 0x7FDBDA /end MEASUREMENT
/begin MEASUREMENT bypugdn_w "" UWORD rel_uw_b100 1 100 0 99.9985 FORMAT "%8.5" ECU_ADDRESS 0x7FDBDC /end MEASUREMENT
/begin MEASUREMENT bypugdx_w "" UWORD rel_uw_b100 1 100 0 99.9985 FORMAT "%8.5" ECU_ADDRESS 0x7FDBDE /end MEASUREMENT
/begin MEASUREMENT bypv2_w "Steppersollpsition in % vor Filter Bank2" UWORD rel_uw_b100 1 100 0 99.9985 FORMAT "%8.5" ECU_ADDRESS 0x7FDBE0 /end MEASUREMENT
/begin MEASUREMENT bypv_w "Steppersollpsition in % vor Filter" UWORD rel_uw_b100 1 100 0 99.9985 FORMAT "%8.5" ECU_ADDRESS 0x7FDBE2 /end MEASUREMENT
/begin MEASUREMENT B_afwe "Bedingung Anzahl der Wiedereinsetzfaktoren" UBYTE B_TRUE 1 100 0 1 BIT_MASK 0x1 FORMAT "%13.11" ECU_ADDRESS 0x7FBA41 /end MEASUREMENT
/begin MEASUREMENT B_airbag "Bedingung Airbag ausgelˆst" UBYTE B_TRUE 1 100 0 1 BIT_MASK 0x1 FORMAT "%13.11" ECU_ADDRESS 0x7FBA69 /end MEASUREMENT
/begin MEASUREMENT B_amnuka "Bedingung: Minimale Anzahl Sondenspr¸nge zwischen Adaptionsvorg‰nge abgelaufen" UBYTE B_TRUE 1 100 0 1 BIT_MASK 0x1 FORMAT "%13.11" ECU_ADDRESS 0x7FBA1D /end MEASUREMENT
/begin MEASUREMENT B_amnuka2 "Bedingung: Min. Anzahl Sondenspr¸nge zwischen Adapt.-vorg‰nge abgelaufen Bank 2" UBYTE B_TRUE 1 100 0 1 BIT_MASK 0x1 FORMAT "%13.11" ECU_ADDRESS 0x7FBA1E /end MEASUREMENT
/begin MEASUREMENT B_ba "Bedingung Beschleunigungsanreicherung (Anzeige)" UBYTE B_TRUE 1 100 0 1 BIT_MASK 0x1 FORMAT "%13.11" ECU_ADDRESS 0x7FBA0E /end MEASUREMENT
/begin MEASUREMENT B_bag "Bedingung starke Beschleunigungsanreicherung" UBYTE B_TRUE 1 100 0 1 BIT_MASK 0x1 FORMAT "%13.11" ECU_ADDRESS 0x7FBA0F /end MEASUREMENT
/begin MEASUREMENT B_bl "Bedingung Bremslichtschalter bet‰tigt" UBYTE B_TRUE 1 100 0 1 BIT_MASK 0x1 FORMAT "%13.11" ECU_ADDRESS 0x7FBA6A /end MEASUREMENT
/begin MEASUREMENT B_br "Bedingung Bremstestschalter bet‰tigt" UBYTE B_TRUE 1 100 0 1 BIT_MASK 0x1 FORMAT "%13.11" ECU_ADDRESS 0x7FBA6B /end MEASUREMENT
/begin MEASUREMENT B_br2k "Bedingung Bremse bet‰tigt 2-kanalig erkannt" UBYTE B_TRUE 1 100 0 1 BIT_MASK 0x1 FORMAT "%13.11" ECU_ADDRESS 0x7FBA6C /end MEASUREMENT
/begin MEASUREMENT B_brems "Bedingung Bremse bet‰tigt" UBYTE B_TRUE 1 100 0 1 BIT_MASK 0x1 FORMAT "%13.11" ECU_ADDRESS 0x7FBA6D /end MEASUREMENT
/begin MEASUREMENT B_bypapp "Condition - air bypass value from tester in operation" UBYTE B_TRUE 1 100 0 1 BIT_MASK 0x1 FORMAT "%13.11" ECU_ADDRESS 0x7FB9C7 /end MEASUREMENT
/begin MEASUREMENT B_bypldon "Condition - secondary load balancing switched on" UBYTE B_TRUE 1 100 0 1 BIT_MASK 0x1 FORMAT "%13.11" ECU_ADDRESS 0x7FB9C8 /end MEASUREMENT
/begin MEASUREMENT B_bypped "Condition - air bypass value from driver throttle requested" UBYTE B_TRUE 1 100 0 1 BIT_MASK 0x1 FORMAT "%13.11" ECU_ADDRESS 0x7FB9C9 /end MEASUREMENT
/begin MEASUREMENT B_c95bf0 "Ansteuersignal zum Einstellen der Filtermittenfrequenz des CC195 (Pin BF0)" UBYTE B_TRUE 1 100 0 1 BIT_MASK 0x1 FORMAT "%13.11" ECU_ADDRESS 0x7FBA7D /end MEASUREMENT
/begin MEASUREMENT B_c95bf1 "Ansteuersignal zum Einstellen der Filtermittenfrequenz des CC195 (Pin BF1)" UBYTE B_TRUE 1 100 0 1 BIT_MASK 0x1 FORMAT "%13.11" ECU_ADDRESS 0x7FBA7E /end MEASUREMENT
/begin MEASUREMENT B_c95bf2 "Ansteuersignal zum Einstellen der Filtermittenfrequenz des CC195 (Pin BF2)" UBYTE B_TRUE 1 100 0 1 BIT_MASK 0x1 FORMAT "%13.11" ECU_ADDRESS 0x7FBA7F /end MEASUREMENT
/begin MEASUREMENT B_c95bf3 "Ansteuersignal zum Eintstellen der Filtermittenfrequenz des CC195 (Pin BF3)" UBYTE B_TRUE 1 100 0 1 BIT_MASK 0x1 FORMAT "%13.11" ECU_ADDRESS 0x7FBA80 /end MEASUREMENT
/begin MEASUREMENT B_c95ks3 "Ansteuersignal f¸r den Nulltest des CC195" UBYTE B_TRUE 1 100 0 1 BIT_MASK 0x1 FORMAT "%13.11" ECU_ADDRESS 0x7FBA81 /end MEASUREMENT
/begin MEASUREMENT B_cfukaba "" UBYTE B_TRUE 1 100 0 1 BIT_MASK 0x1 FORMAT "%13.11" ECU_ADDRESS 0x7FBA1F /end MEASUREMENT
/begin MEASUREMENT B_cfukava "" UBYTE B_TRUE 1 100 0 1 BIT_MASK 0x1 FORMAT "%13.11" ECU_ADDRESS 0x7FBA20 /end MEASUREMENT
/begin MEASUREMENT B_clradhoe "Bedingung: Adaptionswerte Hoehenfaktor selektiv loeschen" UBYTE B_TRUE 1 100 0 1 BIT_MASK 0x1 FORMAT "%13.11" ECU_ADDRESS 0x7FBA78 /end MEASUREMENT
/begin MEASUREMENT B_decay2 "Rover" UBYTE B_TRUE 1 100 0 1 BIT_MASK 0x1 FORMAT "%13.11" ECU_ADDRESS 0x7FBA08 /end MEASUREMENT
/begin MEASUREMENT B_dfukaba "Bedingung: Adaptionsfaktor BA dekrementieren" UBYTE B_TRUE 1 100 0 1 BIT_MASK 0x1 FORMAT "%13.11" ECU_ADDRESS 0x7FBA21 /end MEASUREMENT
/begin MEASUREMENT B_dfukava "Bedingung: Adaptionsfaktor VA dekrementieren" UBYTE B_TRUE 1 100 0 1 BIT_MASK 0x1 FORMAT "%13.11" ECU_ADDRESS 0x7FBA22 /end MEASUREMENT
/begin MEASUREMENT B_dkpfado "" UBYTE B_TRUE 1 100 0 1 BIT_MASK 0x1 FORMAT "%13.11" ECU_ADDRESS 0x7FBA7B /end MEASUREMENT
/begin MEASUREMENT B_dnt "Aktive Diagnose: Klopfregelung Nulltest" UBYTE B_TRUE 1 100 0 1 BIT_MASK 0x1 FORMAT "%13.11" ECU_ADDRESS 0x7FBA82 /end MEASUREMENT
/begin MEASUREMENT B_dntb "Bedingung Diagnose: Bereitschaft zum Nulltest (Nulltest im n‰chsten MF)" UBYTE B_TRUE 1 100 0 1 BIT_MASK 0x1 FORMAT "%13.11" ECU_ADDRESS 0x7FBA83 /end MEASUREMENT
/begin MEASUREMENT B_dr_lowrlim "" UBYTE B_TRUE 1 100 0 1 FORMAT "%13.11" ECU_ADDRESS 0x7FD853 /end MEASUREMENT
/begin MEASUREMENT B_dr_upprlim "" UBYTE B_TRUE 1 100 0 1 FORMAT "%13.11" ECU_ADDRESS 0x7FD854 /end MEASUREMENT
/begin MEASUREMENT B_dtp "Aktive Diagnose: Klopfregelung Testimpuls" UBYTE B_TRUE 1 100 0 1 BIT_MASK 0x1 FORMAT "%13.11" ECU_ADDRESS 0x7FBA84 /end MEASUREMENT
/begin MEASUREMENT B_dtpb "Bedingung Diagnose: Bereitschaft zum Testpuls (Testpuls im n‰chsten MF)" UBYTE B_TRUE 1 100 0 1 BIT_MASK 0x1 FORMAT "%13.11" ECU_ADDRESS 0x7FBA85 /end MEASUREMENT
/begin MEASUREMENT B_dtugetrg "" UBYTE B_TRUE 1 100 0 1 BIT_MASK 0x1 FORMAT "%13.11" ECU_ADDRESS 0x7FBCA3 /end MEASUREMENT
/begin MEASUREMENT B_dummy "" UBYTE B_TRUE 1 100 0 1 BIT_MASK 0x1 FORMAT "%13.11" ECU_ADDRESS 0x7FBA86 /end MEASUREMENT
/begin MEASUREMENT B_dwfk "" UBYTE B_TRUE 1 100 0 1 BIT_MASK 0x1 FORMAT "%13.11" ECU_ADDRESS 0x7FBA10 /end MEASUREMENT
/begin MEASUREMENT B_edsl "Bedingung Error Ladedrucksensor" UBYTE B_TRUE 1 100 0 1 BIT_MASK 0x1 FORMAT "%13.11" ECU_ADDRESS 0x7FBA79 /end MEASUREMENT
/begin MEASUREMENT B_edsuu "Bedingung Error Umgebungsdrucksensor nicht zeitentprellt" UBYTE B_TRUE 1 100 0 1 BIT_MASK 0x1 FORMAT "%13.11" ECU_ADDRESS 0x7F9C0E /end MEASUREMENT
/begin MEASUREMENT B_enrinv "Bedingung enable f¸r Ri-Nernst mit Filter vor KAT" UBYTE B_TRUE 1 100 0 1 BIT_MASK 0x1 FORMAT "%13.11" ECU_ADDRESS 0x7FBA8E /end MEASUREMENT
/begin MEASUREMENT B_enrinv2 "Bedingung enable f¸r Ri-Nernst mit Filter vor KAT Bank2" UBYTE B_TRUE 1 100 0 1 BIT_MASK 0x1 FORMAT "%13.11" ECU_ADDRESS 0x7FBA8F /end MEASUREMENT
/begin MEASUREMENT B_erbr "Bedingung Bremsschaltersignale unplausibel" UBYTE B_TRUE 1 100 0 1 BIT_MASK 0x1 FORMAT "%13.11" ECU_ADDRESS 0x7FBA6E /end MEASUREMENT
/begin MEASUREMENT B_erinofv "Bedingung enable f¸r Ri-Nernst ohne Filter vor KAT" UBYTE B_TRUE 1 100 0 1 BIT_MASK 0x1 FORMAT "%13.11" ECU_ADDRESS 0x7FBA90 /end MEASUREMENT
/begin MEASUREMENT B_erinofv2 "Bedingung enable f¸r Ri-Nernst ohne Filter vor KAT Bank2" UBYTE B_TRUE 1 100 0 1 BIT_MASK 0x1 FORMAT "%13.11" ECU_ADDRESS 0x7FBA91 /end MEASUREMENT
/begin MEASUREMENT B_esbnb "Bedingung Einspritzbeginn im Normalbetrieb" UBYTE B_TRUE 1 100 0 1 BIT_MASK 0x2 FORMAT "%13.11" ECU_ADDRESS 0x7FD824 /end MEASUREMENT
/begin MEASUREMENT B_esbst "Bedingung Einspritzbeginn im Start" UBYTE B_TRUE 1 100 0 1 BIT_MASK 0x1 FORMAT "%13.11" ECU_ADDRESS 0x7FD824 /end MEASUREMENT
/begin MEASUREMENT B_esukdk10 "" UBYTE B_TRUE 1 100 0 1 BIT_MASK 0x1 FORMAT "%13.11" ECU_ADDRESS 0x7FBA11 /end MEASUREMENT
/begin MEASUREMENT B_etr "Bedingung elektrische Thermostatregelung" UBYTE B_TRUE 1 100 0 1 BIT_MASK 0x1 FORMAT "%13.11" ECU_ADDRESS 0x7FBC63 /end MEASUREMENT
/begin MEASUREMENT B_etrtam "Umschaltung elektr. Thermostatregelung auf Festwert bei niedrigem tans" UBYTE B_TRUE 1 100 0 1 BIT_MASK 0x1 FORMAT "%13.11" ECU_ADDRESS 0x7FBC64 /end MEASUREMENT
/begin MEASUREMENT B_etrvfzg "Bedingung elektr. Thermostatregelung bzgl. VFZG" UBYTE B_TRUE 1 100 0 1 BIT_MASK 0x1 FORMAT "%13.11" ECU_ADDRESS 0x7FBC65 /end MEASUREMENT
/begin MEASUREMENT B_ff "Bedingung Folgefunkenz¸ndung" UBYTE B_TRUE 1 100 0 1 BIT_MASK 0x1 FORMAT "%13.11" ECU_ADDRESS 0x7FBC4C /end MEASUREMENT
/begin MEASUREMENT B_fmf2frpsp "" UBYTE B_TRUE 1 100 0 1 FORMAT "%13.11" ECU_ADDRESS 0x7FD855 /end MEASUREMENT
/begin MEASUREMENT B_fmfkrc "Filtermittenfrequenz des CC195/CC650 umgeschaltet" UBYTE B_TRUE 1 100 0 1 BIT_MASK 0x1 FORMAT "%13.11" ECU_ADDRESS 0x7FBA87 /end MEASUREMENT
/begin MEASUREMENT B_fmfkrco "Filtermittenfrequenz umgeschaltet, neue Frequenz ist hˆher" UBYTE B_TRUE 1 100 0 1 BIT_MASK 0x1 FORMAT "%13.11" ECU_ADDRESS 0x7FBA88 /end MEASUREMENT
/begin MEASUREMENT B_fmfkrcu "Filtermittenfrequenz umgeschaltet, neue Frequenz ist kleiner" UBYTE B_TRUE 1 100 0 1 BIT_MASK 0x1 FORMAT "%13.11" ECU_ADDRESS 0x7FBA89 /end MEASUREMENT
/begin MEASUREMENT B_force_frpsp "" UBYTE B_TRUE 1 100 0 1 FORMAT "%13.11" ECU_ADDRESS 0x7FD856 /end MEASUREMENT
/begin MEASUREMENT B_frgadp "Bedingungen Freigabe Adaption" UBYTE B_TRUE 1 100 0 1 BIT_MASK 0x1 FORMAT "%13.11" ECU_ADDRESS 0x7FBCA4 /end MEASUREMENT
/begin MEASUREMENT B_frpc_cl_enbl "" UBYTE B_TRUE 1 100 0 1 BIT_MASK 0x1 FORMAT "%13.11" ECU_ADDRESS 0x7FD858 /end MEASUREMENT
/begin MEASUREMENT B_frpc_I_frzlowr "" UBYTE B_TRUE 1 100 0 1 BIT_MASK 0x10 FORMAT "%13.11" ECU_ADDRESS 0x7FD858 /end MEASUREMENT
/begin MEASUREMENT B_frpc_I_frzuppr "" UBYTE B_TRUE 1 100 0 1 BIT_MASK 0x8 FORMAT "%13.11" ECU_ADDRESS 0x7FD858 /end MEASUREMENT
/begin MEASUREMENT B_frpc_i_lowrlim "" UBYTE B_TRUE 1 100 0 1 BIT_MASK 0x80 FORMAT "%13.11" ECU_ADDRESS 0x7FD858 /end MEASUREMENT
/begin MEASUREMENT B_frpc_I_reset "" UBYTE B_TRUE 1 100 0 1 BIT_MASK 0x2 FORMAT "%13.11" ECU_ADDRESS 0x7FD858 /end MEASUREMENT
/begin MEASUREMENT B_frpc_I_run "" UBYTE B_TRUE 1 100 0 1 BIT_MASK 0x20 FORMAT "%13.11" ECU_ADDRESS 0x7FD858 /end MEASUREMENT
/begin MEASUREMENT B_frpc_I_set "" UBYTE B_TRUE 1 100 0 1 BIT_MASK 0x4 FORMAT "%13.11" ECU_ADDRESS 0x7FD858 /end MEASUREMENT
/begin MEASUREMENT B_frpc_i_upprlim "" UBYTE B_TRUE 1 100 0 1 BIT_MASK 0x40 FORMAT "%13.11" ECU_ADDRESS 0x7FD858 /end MEASUREMENT
/begin MEASUREMENT B_frps "" UBYTE B_TRUE 1 100 0 1 FORMAT "%13.11" ECU_ADDRESS 0x7FD859 /end MEASUREMENT
/begin MEASUREMENT B_furena "" UBYTE B_TRUE 1 100 0 1 BIT_MASK 0x1 FORMAT "%13.11" ECU_ADDRESS 0x7FB9D0 /end MEASUREMENT
/begin MEASUREMENT B_fwe "Bedingung Faktor Wiedereinsetzen" UBYTE B_TRUE 1 100 0 1 BIT_MASK 0x1 FORMAT "%13.11" ECU_ADDRESS 0x7FBA42 /end MEASUREMENT
/begin MEASUREMENT B_gangnp "Ganginfo nicht plausibel" UBYTE B_TRUE 1 100 0 1 BIT_MASK 0x8 FORMAT "%13.11" ECU_ADDRESS 0x7F9CB1 /end MEASUREMENT
/begin MEASUREMENT B_hag "Bedingung Hˆhenadaption g¸ltig" UBYTE B_TRUE 1 100 0 1 BIT_MASK 0x1 FORMAT "%13.11" ECU_ADDRESS 0x7FBA7A /end MEASUREMENT
/begin MEASUREMENT B_hst "Bedingung Heiﬂstart" UBYTE B_TRUE 1 100 0 1 BIT_MASK 0x1 FORMAT "%13.11" ECU_ADDRESS 0x7F9BC0 /end MEASUREMENT
/begin MEASUREMENT B_ifukaba "Bedingung: Adaptionsfaktor BA inkrementieren" UBYTE B_TRUE 1 100 0 1 BIT_MASK 0x1 FORMAT "%13.11" ECU_ADDRESS 0x7FBA23 /end MEASUREMENT
/begin MEASUREMENT B_ifukava "Bedingung: Adaptionsfaktor VA inkrementieren" UBYTE B_TRUE 1 100 0 1 BIT_MASK 0x1 FORMAT "%13.11" ECU_ADDRESS 0x7FBA24 /end MEASUREMENT
/begin MEASUREMENT B_krmfok "Semaphore" UBYTE B_TRUE 1 100 0 1 BIT_MASK 0x1 FORMAT "%13.11" ECU_ADDRESS 0x7FBA8A /end MEASUREMENT
/begin MEASUREMENT B_kuppl "Bedingung Kupplung bet‰tigt" UBYTE B_TRUE 1 100 0 1 BIT_MASK 0x1 FORMAT "%13.11" ECU_ADDRESS 0x7FBA6F /end MEASUREMENT
/begin MEASUREMENT B_kupplv "Bedingung Kupplung bet‰tigt verzˆgert" UBYTE B_TRUE 1 100 0 1 BIT_MASK 0x1 FORMAT "%13.11" ECU_ADDRESS 0x7FBA70 /end MEASUREMENT
/begin MEASUREMENT B_lamnse "Bedingung Ende lamns_w-Berechnung" UBYTE B_TRUE 1 100 0 1 BIT_MASK 0x1 FORMAT "%13.11" ECU_ADDRESS 0x7FBA09 /end MEASUREMENT
/begin MEASUREMENT B_lawlon "lamwl_w ist aktiv" UBYTE B_TRUE 1 100 0 1 BIT_MASK 0x1 FORMAT "%13.11" ECU_ADDRESS 0x7FBA43 /end MEASUREMENT
/begin MEASUREMENT B_ldon "Condition - load balance active" UBYTE B_TRUE 1 100 0 1 BIT_MASK 0x1 FORMAT "%13.11" ECU_ADDRESS 0x7FB9CA /end MEASUREMENT
/begin MEASUREMENT B_ldrugd "Bedingung ungedrosselt, Freigabe durch LDR" UBYTE B_TRUE 1 100 0 1 BIT_MASK 0x1 FORMAT "%13.11" ECU_ADDRESS 0x7FB9CB /end MEASUREMENT
/begin MEASUREMENT B_los "" UBYTE B_los 1 100 0 3 FORMAT "%13.11" ECU_ADDRESS 0x7F9C12 /end MEASUREMENT
/begin MEASUREMENT B_lowr_wrn "" UBYTE B_TRUE 1 100 0 1 FORMAT "%13.11" ECU_ADDRESS 0x7FD851 /end MEASUREMENT
/begin MEASUREMENT B_lowvoltage "" UBYTE B_TRUE 1 100 0 1 BIT_MASK 0x1 FORMAT "%13.11" ECU_ADDRESS 0x7FBAC6 /end MEASUREMENT
/begin MEASUREMENT B_ntini "KR: Bedingung f¸r Initialisierungs-Nulltest" UBYTE B_TRUE 1 100 0 1 BIT_MASK 0x1 FORMAT "%13.11" ECU_ADDRESS 0x7FBA8B /end MEASUREMENT
/begin MEASUREMENT B_oelnll "" UBYTE B_SET 1 100 0 1 BIT_MASK 0x1 FORMAT "%13.11" ECU_ADDRESS 0x7FBA7C /end MEASUREMENT
/begin MEASUREMENT B_pripv "Bedingung Port schalten f¸r Pumpimpuls vor KAT" UBYTE B_TRUE 1 100 0 1 BIT_MASK 0x1 FORMAT "%13.11" ECU_ADDRESS 0x7FBA92 /end MEASUREMENT
/begin MEASUREMENT B_pripv2 "Bedingung Port schalten f¸r Pumpimpuls vor KAT Bank2" UBYTE B_TRUE 1 100 0 1 BIT_MASK 0x1 FORMAT "%13.11" ECU_ADDRESS 0x7FBA93 /end MEASUREMENT
/begin MEASUREMENT B_redkl "Freigabe Reduzierung ‹K-K- und -L-Anteil" UBYTE B_TRUE 1 100 0 1 BIT_MASK 0x1 FORMAT "%13.11" ECU_ADDRESS 0x7FBA12 /end MEASUREMENT
/begin MEASUREMENT B_riakv "" UBYTE B_TRUE 1 100 0 1 BIT_MASK 0x1 FORMAT "%13.11" ECU_ADDRESS 0x7FBA94 /end MEASUREMENT
/begin MEASUREMENT B_riakv2 "" UBYTE B_TRUE 1 100 0 1 BIT_MASK 0x1 FORMAT "%13.11" ECU_ADDRESS 0x7FBA95 /end MEASUREMENT
/begin MEASUREMENT B_ribev "" UBYTE B_TRUE 1 100 0 1 BIT_MASK 0x1 FORMAT "%13.11" ECU_ADDRESS 0x7FBA96 /end MEASUREMENT
/begin MEASUREMENT B_ribev2 "" UBYTE B_TRUE 1 100 0 1 BIT_MASK 0x1 FORMAT "%13.11" ECU_ADDRESS 0x7FBA97 /end MEASUREMENT
/begin MEASUREMENT B_riibv "" UBYTE B_TRUE 1 100 0 1 BIT_MASK 0x1 FORMAT "%13.11" ECU_ADDRESS 0x7FBA98 /end MEASUREMENT
/begin MEASUREMENT B_riibv2 "" UBYTE B_TRUE 1 100 0 1 BIT_MASK 0x1 FORMAT "%13.11" ECU_ADDRESS 0x7FBA99 /end MEASUREMENT
/begin MEASUREMENT B_riimpv "" UBYTE B_TRUE 1 100 0 1 BIT_MASK 0x1 FORMAT "%13.11" ECU_ADDRESS 0x7FBA9A /end MEASUREMENT
/begin MEASUREMENT B_rimv "" UBYTE B_TRUE 1 100 0 1 BIT_MASK 0x1 FORMAT "%13.11" ECU_ADDRESS 0x7FBA9B /end MEASUREMENT
/begin MEASUREMENT B_rimv2 "" UBYTE B_TRUE 1 100 0 1 BIT_MASK 0x1 FORMAT "%13.11" ECU_ADDRESS 0x7FBA9C /end MEASUREMENT
/begin MEASUREMENT B_rinv "" UBYTE B_TRUE 1 100 0 1 BIT_MASK 0x1 FORMAT "%13.11" ECU_ADDRESS 0x7FBA9D /end MEASUREMENT
/begin MEASUREMENT B_rinv2 "" UBYTE B_TRUE 1 100 0 1 BIT_MASK 0x1 FORMAT "%13.11" ECU_ADDRESS 0x7FBA9E /end MEASUREMENT
/begin MEASUREMENT B_ripuv "Bedingung Strom-Pumpen f¸r Sonde vor KAT" UBYTE B_TRUE 1 100 0 1 BIT_MASK 0x1 FORMAT "%13.11" ECU_ADDRESS 0x7FBA9F /end MEASUREMENT
/begin MEASUREMENT B_ripuv2 "Bedingung Strom-Pumpen f¸r Sonde vor KAT Bank2" UBYTE B_TRUE 1 100 0 1 BIT_MASK 0x1 FORMAT "%13.11" ECU_ADDRESS 0x7FBAA0 /end MEASUREMENT
/begin MEASUREMENT B_rirev "" UBYTE B_TRUE 1 100 0 1 BIT_MASK 0x1 FORMAT "%13.11" ECU_ADDRESS 0x7FBAA1 /end MEASUREMENT
/begin MEASUREMENT B_rirev2 "" UBYTE B_TRUE 1 100 0 1 BIT_MASK 0x1 FORMAT "%13.11" ECU_ADDRESS 0x7FBAA2 /end MEASUREMENT
/begin MEASUREMENT B_rispv "" UBYTE B_TRUE 1 100 0 1 BIT_MASK 0x1 FORMAT "%13.11" ECU_ADDRESS 0x7FBAA3 /end MEASUREMENT
/begin MEASUREMENT B_rispv2 "" UBYTE B_TRUE 1 100 0 1 BIT_MASK 0x1 FORMAT "%13.11" ECU_ADDRESS 0x7FBAA4 /end MEASUREMENT
/begin MEASUREMENT B_rmp_frpsp "" UBYTE B_TRUE 1 100 0 1 FORMAT "%13.11" ECU_ADDRESS 0x7FD857 /end MEASUREMENT
/begin MEASUREMENT B_staebr "Bedingung Steckerabfall-Erkennung Bremse" UBYTE B_TRUE 1 100 0 1 BIT_MASK 0x1 FORMAT "%13.11" ECU_ADDRESS 0x7FBA71 /end MEASUREMENT
/begin MEASUREMENT B_svuerf "Bedingung Sondenspannung vor KAT erfassen" UBYTE B_TRUE 1 100 0 1 BIT_MASK 0x1 FORMAT "%13.11" ECU_ADDRESS 0x7FBAA5 /end MEASUREMENT
/begin MEASUREMENT B_svuerf2 "Bedingung Sondenspannung vor KAT erfassen Bank2" UBYTE B_TRUE 1 100 0 1 BIT_MASK 0x1 FORMAT "%13.11" ECU_ADDRESS 0x7FBAA6 /end MEASUREMENT
/begin MEASUREMENT B_timesync_out "" UBYTE dez 1 100 0 255 FORMAT "%5.1" ECU_ADDRESS 0x7FD7FA /end MEASUREMENT
/begin MEASUREMENT B_tpnt_aw "KR: Auswahl Nulltest oder Testimpuls" UBYTE B_TRUE 1 100 0 1 BIT_MASK 0x1 FORMAT "%13.11" ECU_ADDRESS 0x7FBA8C /end MEASUREMENT
/begin MEASUREMENT B_tpnt_e "KR: Nulltest/Testimpuls freigegeben" UBYTE B_TRUE 1 100 0 1 BIT_MASK 0x1 FORMAT "%13.11" ECU_ADDRESS 0x7FBA8D /end MEASUREMENT
/begin MEASUREMENT B_ugd "" UBYTE B_TRUE 1 100 0 1 BIT_MASK 0x1 FORMAT "%13.11" ECU_ADDRESS 0x7FB9CC /end MEASUREMENT
/begin MEASUREMENT B_ugdb "" UBYTE B_TRUE 1 100 0 1 BIT_MASK 0x1 FORMAT "%13.11" ECU_ADDRESS 0x7FB9CD /end MEASUREMENT
/begin MEASUREMENT B_ugds "" UBYTE B_TRUE 1 100 0 1 BIT_MASK 0x1 FORMAT "%13.11" ECU_ADDRESS 0x7FB9CE /end MEASUREMENT
/begin MEASUREMENT B_ugdset "" UBYTE B_TRUE 1 100 0 1 BIT_MASK 0x1 FORMAT "%13.11" ECU_ADDRESS 0x7FB9CF /end MEASUREMENT
/begin MEASUREMENT B_ugetrad "Bedingungen Adaption fuer alle Gaenge abgeschlossen" UBYTE dez 1 100 0 255 FORMAT "%5.1" ECU_ADDRESS 0x7F9CB4 /end MEASUREMENT
/begin MEASUREMENT B_ugetrad1 "Bedingungen Adaption fuer Gang 1 abgeschlossen" UBYTE B_TRUE 1 100 0 1 BIT_MASK 0x2 FORMAT "%13.11" ECU_ADDRESS 0x7F9CB4 /end MEASUREMENT
/begin MEASUREMENT B_ugetrad2 "Bedingungen Adaption fuer Gang 2 abgeschlossen" UBYTE B_TRUE 1 100 0 1 BIT_MASK 0x4 FORMAT "%13.11" ECU_ADDRESS 0x7F9CB4 /end MEASUREMENT
/begin MEASUREMENT B_ugetrad3 "Bedingungen Adaption fuer Gang 3 abgeschlossen" UBYTE B_TRUE 1 100 0 1 BIT_MASK 0x8 FORMAT "%13.11" ECU_ADDRESS 0x7F9CB4 /end MEASUREMENT
/begin MEASUREMENT B_ugetrad4 "Bedingungen Adaption fuer Gang 4 abgeschlossen" UBYTE B_TRUE 1 100 0 1 BIT_MASK 0x10 FORMAT "%13.11" ECU_ADDRESS 0x7F9CB4 /end MEASUREMENT
/begin MEASUREMENT B_ugetrad5 "Bedingungen Adaption fuer Gang 5 abgeschlossen" UBYTE B_TRUE 1 100 0 1 BIT_MASK 0x20 FORMAT "%13.11" ECU_ADDRESS 0x7F9CB4 /end MEASUREMENT
/begin MEASUREMENT B_ugetrad6 "Bedingungen Adaption fuer Gang 6 abgeschlossen" UBYTE B_TRUE 1 100 0 1 BIT_MASK 0x40 FORMAT "%13.11" ECU_ADDRESS 0x7F9CB4 /end MEASUREMENT
/begin MEASUREMENT B_ugetradN "Bedingungen Adaption fuer Neutral abgeschlossen" UBYTE B_TRUE 1 100 0 1 BIT_MASK 0x1 FORMAT "%13.11" ECU_ADDRESS 0x7F9CB4 /end MEASUREMENT
/begin MEASUREMENT B_ugetrgad "Zustand der Adaption fuer alle Gaenge" UBYTE B_TRUE 1 100 0 1 BIT_MASK 0x1 FORMAT "%13.11" ECU_ADDRESS 0x7FBCA5 /end MEASUREMENT
/begin MEASUREMENT B_ugetrger "Fehler am Getriebeschaltwalzenpoti" UBYTE B_TRUE 1 100 0 1 BIT_MASK 0x1 FORMAT "%13.11" ECU_ADDRESS 0x7F9CB1 /end MEASUREMENT
/begin MEASUREMENT B_ugetrgmn "min. Spannungswert von Getriebepoti unterschritten" UBYTE B_TRUE 1 100 0 1 BIT_MASK 0x2 FORMAT "%13.11" ECU_ADDRESS 0x7F9CB1 /end MEASUREMENT
/begin MEASUREMENT B_ugetrgmx "max. Spannungswert von Getriebepoti ueberschritten" UBYTE B_TRUE 1 100 0 1 BIT_MASK 0x4 FORMAT "%13.11" ECU_ADDRESS 0x7F9CB1 /end MEASUREMENT
/begin MEASUREMENT B_ugetrgnp "Spannungswert von Getriebepoti nicht plausibel" UBYTE B_TRUE 1 100 0 1 BIT_MASK 0x10 FORMAT "%13.11" ECU_ADDRESS 0x7F9CB1 /end MEASUREMENT
/begin MEASUREMENT B_uk1 "Einschaltbedingung ‹bergangskompensation" UBYTE B_TRUE 1 100 0 1 BIT_MASK 0x1 FORMAT "%13.11" ECU_ADDRESS 0x7FBA13 /end MEASUREMENT
/begin MEASUREMENT B_uka "Freigabebedingung ‹K-Adaption" UBYTE B_TRUE 1 100 0 1 BIT_MASK 0x1 FORMAT "%13.11" ECU_ADDRESS 0x7FBA25 /end MEASUREMENT
/begin MEASUREMENT B_uka2 "Freigabebedingung ‹K-Adaption Zylinderbank 2" UBYTE B_TRUE 1 100 0 1 BIT_MASK 0x1 FORMAT "%13.11" ECU_ADDRESS 0x7FBA26 /end MEASUREMENT
/begin MEASUREMENT B_ukab "Bedingung g¸ltiger Betriebsbereich f¸r adaptive ‹K" UBYTE B_TRUE 1 100 0 1 BIT_MASK 0x1 FORMAT "%13.11" ECU_ADDRESS 0x7FBA27 /end MEASUREMENT
/begin MEASUREMENT B_ukaba "" UBYTE B_TRUE 1 100 0 1 BIT_MASK 0x1 FORMAT "%13.11" ECU_ADDRESS 0x7FBA28 /end MEASUREMENT
/begin MEASUREMENT B_ukaba2 "" UBYTE B_TRUE 1 100 0 1 BIT_MASK 0x1 FORMAT "%13.11" ECU_ADDRESS 0x7FBA29 /end MEASUREMENT
/begin MEASUREMENT B_ukabaf "" UBYTE B_TRUE 1 100 0 1 BIT_MASK 0x1 FORMAT "%13.11" ECU_ADDRESS 0x7FBA2A /end MEASUREMENT
/begin MEASUREMENT B_ukabaf2 "" UBYTE B_TRUE 1 100 0 1 BIT_MASK 0x1 FORMAT "%13.11" ECU_ADDRESS 0x7FBA2B /end MEASUREMENT
/begin MEASUREMENT B_ukabah "" UBYTE B_TRUE 1 100 0 1 BIT_MASK 0x1 FORMAT "%13.11" ECU_ADDRESS 0x7FBA2C /end MEASUREMENT
/begin MEASUREMENT B_ukabal "" UBYTE B_TRUE 1 100 0 1 BIT_MASK 0x1 FORMAT "%13.11" ECU_ADDRESS 0x7FBA2D /end MEASUREMENT
/begin MEASUREMENT B_ukabam "" UBYTE B_TRUE 1 100 0 1 BIT_MASK 0x1 FORMAT "%13.11" ECU_ADDRESS 0x7FBA2E /end MEASUREMENT
/begin MEASUREMENT B_ukabam2 "" UBYTE B_TRUE 1 100 0 1 BIT_MASK 0x1 FORMAT "%13.11" ECU_ADDRESS 0x7FBA2F /end MEASUREMENT
/begin MEASUREMENT B_ukadba "" UBYTE B_TRUE 1 100 0 1 BIT_MASK 0x1 FORMAT "%13.11" ECU_ADDRESS 0x7FBA30 /end MEASUREMENT
/begin MEASUREMENT B_ukadba2 "" UBYTE B_TRUE 1 100 0 1 BIT_MASK 0x1 FORMAT "%13.11" ECU_ADDRESS 0x7FBA31 /end MEASUREMENT
/begin MEASUREMENT B_ukadva "" UBYTE B_TRUE 1 100 0 1 BIT_MASK 0x1 FORMAT "%13.11" ECU_ADDRESS 0x7FBA32 /end MEASUREMENT
/begin MEASUREMENT B_ukadva2 "" UBYTE B_TRUE 1 100 0 1 BIT_MASK 0x1 FORMAT "%13.11" ECU_ADDRESS 0x7FBA33 /end MEASUREMENT
/begin MEASUREMENT B_ukaiba "" UBYTE B_TRUE 1 100 0 1 BIT_MASK 0x1 FORMAT "%13.11" ECU_ADDRESS 0x7FBA34 /end MEASUREMENT
/begin MEASUREMENT B_ukaiba2 "" UBYTE B_TRUE 1 100 0 1 BIT_MASK 0x1 FORMAT "%13.11" ECU_ADDRESS 0x7FBA35 /end MEASUREMENT
/begin MEASUREMENT B_ukaiva "" UBYTE B_TRUE 1 100 0 1 BIT_MASK 0x1 FORMAT "%13.11" ECU_ADDRESS 0x7FBA36 /end MEASUREMENT
/begin MEASUREMENT B_ukaiva2 "" UBYTE B_TRUE 1 100 0 1 BIT_MASK 0x1 FORMAT "%13.11" ECU_ADDRESS 0x7FBA37 /end MEASUREMENT
/begin MEASUREMENT B_ukat "" UBYTE B_TRUE 1 100 0 1 BIT_MASK 0x1 FORMAT "%13.11" ECU_ADDRESS 0x7FBA38 /end MEASUREMENT
/begin MEASUREMENT B_ukava "Bedingung Verzˆgerung (‹K-Adaption)" UBYTE B_TRUE 1 100 0 1 BIT_MASK 0x1 FORMAT "%13.11" ECU_ADDRESS 0x7FBA39 /end MEASUREMENT
/begin MEASUREMENT B_ukava2 "" UBYTE B_TRUE 1 100 0 1 BIT_MASK 0x1 FORMAT "%13.11" ECU_ADDRESS 0x7FBA3A /end MEASUREMENT
/begin MEASUREMENT B_ukavaf "" UBYTE B_TRUE 1 100 0 1 BIT_MASK 0x1 FORMAT "%13.11" ECU_ADDRESS 0x7FBA3B /end MEASUREMENT
/begin MEASUREMENT B_ukavaf2 "" UBYTE B_TRUE 1 100 0 1 BIT_MASK 0x1 FORMAT "%13.11" ECU_ADDRESS 0x7FBA3C /end MEASUREMENT
/begin MEASUREMENT B_ukavah "" UBYTE B_TRUE 1 100 0 1 BIT_MASK 0x1 FORMAT "%13.11" ECU_ADDRESS 0x7FBA3D /end MEASUREMENT
/begin MEASUREMENT B_ukaval "" UBYTE B_TRUE 1 100 0 1 BIT_MASK 0x1 FORMAT "%13.11" ECU_ADDRESS 0x7FBA3E /end MEASUREMENT
/begin MEASUREMENT B_ukavam "" UBYTE B_TRUE 1 100 0 1 BIT_MASK 0x1 FORMAT "%13.11" ECU_ADDRESS 0x7FBA3F /end MEASUREMENT
/begin MEASUREMENT B_ukavam2 "" UBYTE B_TRUE 1 100 0 1 BIT_MASK 0x1 FORMAT "%13.11" ECU_ADDRESS 0x7FBA40 /end MEASUREMENT
/begin MEASUREMENT B_uke "Einschaltbedingung ‹K-Ersatzwert" UBYTE B_TRUE 1 100 0 1 BIT_MASK 0x1 FORMAT "%13.11" ECU_ADDRESS 0x7FBA14 /end MEASUREMENT
/begin MEASUREMENT B_ukg "Bedingung ‹k wirkt stark" UBYTE B_TRUE 1 100 0 1 BIT_MASK 0x1 FORMAT "%13.11" ECU_ADDRESS 0x7FBA15 /end MEASUREMENT
/begin MEASUREMENT B_ukns "Einschaltbedingung ‹K nach Start" UBYTE B_TRUE 1 100 0 1 BIT_MASK 0x1 FORMAT "%13.11" ECU_ADDRESS 0x7FBA16 /end MEASUREMENT
/begin MEASUREMENT B_uppr_wrn "" UBYTE B_TRUE 1 100 0 1 FORMAT "%13.11" ECU_ADDRESS 0x7FD852 /end MEASUREMENT
/begin MEASUREMENT B_usbev "" UBYTE B_TRUE 1 100 0 1 BIT_MASK 0x1 FORMAT "%13.11" ECU_ADDRESS 0x7FBAA7 /end MEASUREMENT
/begin MEASUREMENT B_usbev2 "" UBYTE B_TRUE 1 100 0 1 BIT_MASK 0x1 FORMAT "%13.11" ECU_ADDRESS 0x7FBAA8 /end MEASUREMENT
/begin MEASUREMENT B_va "Bedingung Verzˆgerungsabmagerung (Anzeige)" UBYTE B_TRUE 1 100 0 1 BIT_MASK 0x1 FORMAT "%13.11" ECU_ADDRESS 0x7FBA17 /end MEASUREMENT
/begin MEASUREMENT B_vaau "Bedingung Verzˆgerungsabmagerung Aufteilung" UBYTE B_TRUE 1 100 0 1 BIT_MASK 0x1 FORMAT "%13.11" ECU_ADDRESS 0x7FBA18 /end MEASUREMENT
/begin MEASUREMENT B_vag "Bedingung starke Verzˆgerungsabmagerung" UBYTE B_TRUE 1 100 0 1 BIT_MASK 0x1 FORMAT "%13.11" ECU_ADDRESS 0x7FBA19 /end MEASUREMENT
/begin MEASUREMENT B_vakl "Bedingung Verzˆgerungsabmagerung L- und K-Anteil" UBYTE B_TRUE 1 100 0 1 BIT_MASK 0x1 FORMAT "%13.11" ECU_ADDRESS 0x7FBA1A /end MEASUREMENT
/begin MEASUREMENT B_val "Bedingung Verzˆgerungsabmagerung L-Anteil" UBYTE B_TRUE 1 100 0 1 BIT_MASK 0x1 FORMAT "%13.11" ECU_ADDRESS 0x7FBA1B /end MEASUREMENT
/begin MEASUREMENT B_vbemg "Bedingung Verbrennungserkennung mˆglich" UBYTE B_TRUE 1 100 0 1 BIT_MASK 0x1 FORMAT "%13.11" ECU_ADDRESS 0x7FBA0A /end MEASUREMENT
/begin MEASUREMENT B_vbmg "Bedingung Verbrennung mˆglich" UBYTE B_TRUE 1 100 0 1 BIT_MASK 0x1 FORMAT "%13.11" ECU_ADDRESS 0x7FBA0B /end MEASUREMENT
/begin MEASUREMENT B_wf "Bedingung Wandfilmberechnung" UBYTE B_TRUE 1 100 0 1 BIT_MASK 0x1 FORMAT "%13.11" ECU_ADDRESS 0x7FBA1C /end MEASUREMENT
/begin MEASUREMENT B_wks "Bedingung Wiederholkaltstart" UBYTE B_TRUE 1 100 0 1 BIT_MASK 0x1 FORMAT "%13.11" ECU_ADDRESS 0x7FBA0C /end MEASUREMENT
/begin MEASUREMENT B_wst "Bedingung Wiederholstart" UBYTE B_TRUE 1 100 0 1 BIT_MASK 0x1 FORMAT "%13.11" ECU_ADDRESS 0x7FBA0D /end MEASUREMENT
/begin MEASUREMENT ctrerbr "Fehlerz‰hler f¸r Bremsschalter-Plausibilisierung" UBYTE dez 1 100 0 255 FORMAT "%5.1" ECU_ADDRESS 0x7FD604 /end MEASUREMENT
/begin MEASUREMENT dbyp_w "Gradient Steppersollposition in %" SWORD rel_sw_b100 1 100 -100 99.9969 FORMAT "%8.4" ECU_ADDRESS 0x7FDBE4 /end MEASUREMENT
/begin MEASUREMENT ddrkakdk_w "" SWORD rel_sw_b1536 1 100 -1536 1535.95 FORMAT "%8.3" ECU_ADDRESS 0x7FDCAA /end MEASUREMENT
/begin MEASUREMENT dkpadpcnt "Durchlaufcounter f¸r schnelle Adaption" UWORD dez 1 100 0 65535 FORMAT "%8.2" ECU_ADDRESS 0x7FDD5A /end MEASUREMENT
/begin MEASUREMENT dmlbyps2_w "" UWORD m_uw_b3276p7 1 100 0 3276.75 FORMAT "%8.3" ECU_ADDRESS 0x7FDBE6 /end MEASUREMENT
/begin MEASUREMENT dmlbyps_w "" UWORD m_uw_b3276p7 1 100 0 3276.75 FORMAT "%8.3" ECU_ADDRESS 0x7FDBE8 /end MEASUREMENT
/begin MEASUREMENT dpsfak "normierter Faktor delta Saugrohrdruck" UBYTE fak_ub_q0p00392 1 100 0 1 FORMAT "%5.3" ECU_ADDRESS 0x7FD816 /end MEASUREMENT
/begin MEASUREMENT dpvdkspu_w "delta zwischen Druck vor Drosselklappe und Umgebungsdruck" UWORD p_uw_q0p039 1 100 0 2559.96 FORMAT "%8.3" ECU_ADDRESS 0x7FD61A /end MEASUREMENT
/begin MEASUREMENT drkakdk_w "" SWORD rel_sw_b1536 1 100 -1536 1535.95 FORMAT "%8.3" ECU_ADDRESS 0x7FDCAC /end MEASUREMENT
/begin MEASUREMENT drkuke_w "Delta relative Kraftstoffmasse Ersatzwert" UWORD rel_uw_q0p1875 1 100 0 12287.8 FORMAT "%8.2" ECU_ADDRESS 0x7FDCAE /end MEASUREMENT
/begin MEASUREMENT drlfue_w "Lastkorrektur des F¸llungsreglers" SWORD rel_sw_q0p0234 1 100 -768 767.977 FORMAT "%8.4" ECU_ADDRESS 0x7FDC5C /end MEASUREMENT
/begin MEASUREMENT drlm_w "" SWORD rel_sw_q0p0234 1 100 -768 767.977 FORMAT "%8.4" ECU_ADDRESS 0x7FDC5E /end MEASUREMENT
/begin MEASUREMENT drlsoldk_seg "" SWORD rel_sw_b1536 1 100 -1536 1535.95 FORMAT "%8.3" ECU_ADDRESS 0x7FDCB0 /end MEASUREMENT
/begin MEASUREMENT drlsoldk_w "" SWORD rel_sw_b1536 1 100 -1536 1535.95 FORMAT "%8.3" ECU_ADDRESS 0x7FDCB2 /end MEASUREMENT
/begin MEASUREMENT drlsp "" SBYTE rel_sb_q0p75 1 100 -96 95.25 FORMAT "%5.2" ECU_ADDRESS 0x7FD942 /end MEASUREMENT
/begin MEASUREMENT drlsp2 "" SBYTE rel_sb_q0p75 1 100 -96 95.25 FORMAT "%5.2" ECU_ADDRESS 0x7FD943 /end MEASUREMENT
/begin MEASUREMENT dwdkba_w "Gradient DK-Winkel" SWORD relDK_q0p02441 1 100 -800 799.976 FORMAT "%8.4" ECU_ADDRESS 0x7FDD5C /end MEASUREMENT
/begin MEASUREMENT dwdks_w "ƒnderung des Drosselklappen-Sollwinkels" SWORD rel_sw_b50 1 100 -50 49.9985 FORMAT "%8.5" ECU_ADDRESS 0x7FDC38 /end MEASUREMENT
/begin MEASUREMENT dwfk_w "Wandfilmmengendifferenz Kurzzeitanteil" SWORD rel_sw_q0p1875 1 100 -6144 6143.81 FORMAT "%8.3" ECU_ADDRESS 0x7FDCB4 /end MEASUREMENT
/begin MEASUREMENT dwfl_w "Wandfilmmengendifferenz Langzeitanteil" SWORD rel_sw_q0p1875 1 100 -6144 6143.81 FORMAT "%8.3" ECU_ADDRESS 0x7FDCB6 /end MEASUREMENT
/begin MEASUREMENT dwfroh "" SWORD rel_sw_q0p1875 1 100 -6144 6143.81 FORMAT "%8.3" ECU_ADDRESS 0x7FDCB8 /end MEASUREMENT
/begin MEASUREMENT dwf_w "Wandfilmmengendifferenz" SWORD rel_sw_q0p1875 1 100 -6144 6143.81 FORMAT "%8.3" ECU_ADDRESS 0x7FDCBA /end MEASUREMENT
/begin MEASUREMENT dwped_tmp "" UWORD GrelPED_sw_b100 1 100 0 100 FORMAT "%8.4" ECU_ADDRESS 0x7FDCBC /end MEASUREMENT
/begin MEASUREMENT EE_bdm_init "" UBYTE dez 1 100 0 255 FORMAT "%5.1" ECU_ADDRESS 0x7FD9CB /end MEASUREMENT
/begin MEASUREMENT ESSTTbits "Bits zur Funktion Start" UBYTE dez 1 100 0 255 FORMAT "%5.1" ECU_ADDRESS 0x7F9BC0 /end MEASUREMENT
/begin MEASUREMENT esvw_bit "" UBYTE dez 1 100 0 255 FORMAT "%5.1" ECU_ADDRESS 0x7FD824 /end MEASUREMENT
/begin MEASUREMENT Ews_active "" UBYTE B_TRUE 1 100 0 1 BIT_MASK 0x1 FORMAT "%13.11" ECU_ADDRESS 0x7FBAC7 /end MEASUREMENT
/begin MEASUREMENT EWS_ActualTRSP_ID "" ULONG dez 1 100 0 4.29497e+009 FORMAT "%13.2" ECU_ADDRESS 0x7FE47C /end MEASUREMENT
/begin MEASUREMENT Ews_auth "" UBYTE B_TRUE 1 100 0 1 BIT_MASK 0x1 FORMAT "%13.11" ECU_ADDRESS 0x7FBAC8 /end MEASUREMENT
/begin MEASUREMENT EWS_Auth_P3 "" ULONG dez 1 100 0 4.29497e+009 FORMAT "%13.2" ECU_ADDRESS 0x7FE480 /end MEASUREMENT
/begin MEASUREMENT EWS_ComTrspPage_State "" UBYTE dez 1 100 0 255 FORMAT "%5.1" ECU_ADDRESS 0x7FD9D0 /end MEASUREMENT
/begin MEASUREMENT Ews_default_auth "" UBYTE B_TRUE 1 100 0 1 BIT_MASK 0x1 FORMAT "%13.11" ECU_ADDRESS 0x7FBABB /end MEASUREMENT
/begin MEASUREMENT Ews_Diag_Auth_done "" UBYTE B_TRUE 1 100 0 1 BIT_MASK 0x1 FORMAT "%13.11" ECU_ADDRESS 0x7FBABC /end MEASUREMENT
/begin MEASUREMENT Ews_Diag_check_activ "" UBYTE B_TRUE 1 100 0 1 BIT_MASK 0x1 FORMAT "%13.11" ECU_ADDRESS 0x7FBABD /end MEASUREMENT
/begin MEASUREMENT Ews_Diag_check_State "" UBYTE dez 1 100 0 255 FORMAT "%5.1" ECU_ADDRESS 0x7FD9CC /end MEASUREMENT
/begin MEASUREMENT Ews_Diag_FGNR_equal "" UBYTE B_TRUE 1 100 0 1 BIT_MASK 0x1 FORMAT "%13.11" ECU_ADDRESS 0x7FBABE /end MEASUREMENT
/begin MEASUREMENT Ews_Diag_mSC_equal "" UBYTE B_TRUE 1 100 0 1 BIT_MASK 0x1 FORMAT "%13.11" ECU_ADDRESS 0x7FBABF /end MEASUREMENT
/begin MEASUREMENT Ews_Diag_no_FGNR_ECU "" UBYTE B_TRUE 1 100 0 1 BIT_MASK 0x1 FORMAT "%13.11" ECU_ADDRESS 0x7FBAC0 /end MEASUREMENT
/begin MEASUREMENT Ews_Diag_no_mSC_ECU "" UBYTE B_TRUE 1 100 0 1 BIT_MASK 0x1 FORMAT "%13.11" ECU_ADDRESS 0x7FBAC1 /end MEASUREMENT
/begin MEASUREMENT Ews_D_Page4 "" ULONG dez 1 100 0 4.29497e+009 FORMAT "%13.2" ECU_ADDRESS 0x7FE46C /end MEASUREMENT
/begin MEASUREMENT Ews_D_Page5 "" ULONG dez 1 100 0 4.29497e+009 FORMAT "%13.2" ECU_ADDRESS 0x7FE470 /end MEASUREMENT
/begin MEASUREMENT Ews_D_Page6 "" ULONG dez 1 100 0 4.29497e+009 FORMAT "%13.2" ECU_ADDRESS 0x7FE474 /end MEASUREMENT
/begin MEASUREMENT Ews_D_Page7 "" ULONG dez 1 100 0 4.29497e+009 FORMAT "%13.2" ECU_ADDRESS 0x7FE478 /end MEASUREMENT
/begin MEASUREMENT EWS_GetID_activ "" UBYTE B_TRUE 1 100 0 1 BIT_MASK 0x1 FORMAT "%13.11" ECU_ADDRESS 0x7FBAC2 /end MEASUREMENT
/begin MEASUREMENT EWS_GetID_State "" UBYTE dez 1 100 0 255 FORMAT "%5.1" ECU_ADDRESS 0x7FD9CD /end MEASUREMENT
/begin MEASUREMENT EWS_GSS_State "" UBYTE dez 1 100 0 255 FORMAT "%5.1" ECU_ADDRESS 0x7FD9D1 /end MEASUREMENT
/begin MEASUREMENT Ews_ID_found "" UBYTE B_TRUE 1 100 0 1 BIT_MASK 0x1 FORMAT "%13.11" ECU_ADDRESS 0x7FBAC3 /end MEASUREMENT
/begin MEASUREMENT EWS_inhibit "" UBYTE B_TRUE 1 100 0 1 BIT_MASK 0x1 FORMAT "%13.11" ECU_ADDRESS 0x7FBAC9 /end MEASUREMENT
/begin MEASUREMENT EWS_Init_activ "" UBYTE B_TRUE 1 100 0 1 BIT_MASK 0x1 FORMAT "%13.11" ECU_ADDRESS 0x7FBAC4 /end MEASUREMENT
/begin MEASUREMENT EWS_Init_State "" UBYTE dez 1 100 0 255 FORMAT "%5.1" ECU_ADDRESS 0x7FD9CE /end MEASUREMENT
/begin MEASUREMENT EWS_KeyNo "" UBYTE dez 1 100 0 255 FORMAT "%5.1" ECU_ADDRESS 0x7FD9D2 /end MEASUREMENT
/begin MEASUREMENT EWS_mechSC_A "" UBYTE dez 1 100 0 255 FORMAT "%5.1" ARRAY_SIZE 5 ECU_ADDRESS 0x7F98B4 /end MEASUREMENT
/begin MEASUREMENT EWS_mechSC_B "" UBYTE dez 1 100 0 255 FORMAT "%5.1" ARRAY_SIZE 5 ECU_ADDRESS 0x7F98BC /end MEASUREMENT
/begin MEASUREMENT Ews_NS_auth "" UBYTE B_TRUE 1 100 0 1 BIT_MASK 0x1 FORMAT "%13.11" ECU_ADDRESS 0x7FBAC5 /end MEASUREMENT
/begin MEASUREMENT Ews_Prog_Day "" UBYTE dez 1 100 0 255 FORMAT "%5.1" ECU_ADDRESS 0x7F98C1 /end MEASUREMENT
/begin MEASUREMENT Ews_Prog_Mon "" UBYTE dez 1 100 0 255 FORMAT "%5.1" ECU_ADDRESS 0x7F98C2 /end MEASUREMENT
/begin MEASUREMENT Ews_Prog_Ort "" UBYTE dez 1 100 0 255 FORMAT "%5.1" ECU_ADDRESS 0x7F98C3 /end MEASUREMENT
/begin MEASUREMENT Ews_Prog_Year "" UBYTE dez 1 100 0 255 FORMAT "%5.1" ECU_ADDRESS 0x7F98C4 /end MEASUREMENT
/begin MEASUREMENT EWS_ReadPageInv_Data "" ULONG dez 1 100 0 4.29497e+009 FORMAT "%13.2" ECU_ADDRESS 0x7FE484 /end MEASUREMENT
/begin MEASUREMENT EWS_ReadPageNumber "" UBYTE dez 1 100 0 255 FORMAT "%5.1" ECU_ADDRESS 0x7FD9D3 /end MEASUREMENT
/begin MEASUREMENT EWS_ReadPage_Data "" ULONG dez 1 100 0 4.29497e+009 FORMAT "%13.2" ECU_ADDRESS 0x7FE488 /end MEASUREMENT
/begin MEASUREMENT EWS_Retry_Counter "" UBYTE dez 1 100 0 255 FORMAT "%5.1" ECU_ADDRESS 0x7FD9D4 /end MEASUREMENT
/begin MEASUREMENT EWS_Retry_Counter_max "" UBYTE dez 1 100 0 255 FORMAT "%5.1" ECU_ADDRESS 0x7F9C28 /end MEASUREMENT
/begin MEASUREMENT EWS_Retry_Counter_temp "" UBYTE dez 1 100 0 255 FORMAT "%5.1" ECU_ADDRESS 0x7FD9D5 /end MEASUREMENT
/begin MEASUREMENT EWS_SendToTRSP_Counter "" UBYTE dez 1 100 0 255 FORMAT "%5.1" ECU_ADDRESS 0x7FD9D6 /end MEASUREMENT
/begin MEASUREMENT EWS_Start_Init "" UBYTE dez 1 100 0 255 FORMAT "%5.1" ECU_ADDRESS 0x7FD9D7 /end MEASUREMENT
/begin MEASUREMENT EWS_State "" UBYTE dez 1 100 0 255 FORMAT "%5.1" ECU_ADDRESS 0x7FD9D8 /end MEASUREMENT
/begin MEASUREMENT EWS_State_off "" UBYTE dez 1 100 0 255 FORMAT "%5.1" ECU_ADDRESS 0x7FD9D9 /end MEASUREMENT
/begin MEASUREMENT EWS_status "" UBYTE dez 1 100 0 255 FORMAT "%5.1" ECU_ADDRESS 0x7FD9DA /end MEASUREMENT
/begin MEASUREMENT EWS_status_temp "" UBYTE dez 1 100 0 255 FORMAT "%5.1" ECU_ADDRESS 0x7FD9DB /end MEASUREMENT
/begin MEASUREMENT EWS_TimeOutFlags "" UWORD dez 1 100 0 65535 FORMAT "%8.2" ECU_ADDRESS 0x7FDE2A /end MEASUREMENT
/begin MEASUREMENT EWS_TimeOut_Cnt "" UBYTE dez 1 100 0 255 FORMAT "%5.1" ECU_ADDRESS 0x7FD9DC /end MEASUREMENT
/begin MEASUREMENT EWS_TRSP_Auth_State "" UBYTE dez 1 100 0 255 FORMAT "%5.1" ECU_ADDRESS 0x7FD9DD /end MEASUREMENT
/begin MEASUREMENT Ews_Trsp_fz_cnt "" UBYTE dez 1 100 0 255 FORMAT "%5.1" ARRAY_SIZE 4 ECU_ADDRESS 0x7F98C8 /end MEASUREMENT
/begin MEASUREMENT Ews_trsp_init "" UBYTE dez 1 100 0 255 FORMAT "%5.1" ARRAY_SIZE 3 ECU_ADDRESS 0x7F98CC /end MEASUREMENT
/begin MEASUREMENT Ews_TRSP_Mode "" UBYTE B_TRUE 1 100 0 1 BIT_MASK 0x1 FORMAT "%13.11" ECU_ADDRESS 0x7FBACA /end MEASUREMENT
/begin MEASUREMENT Ews_Wait_State "" UBYTE dez 1 100 0 255 FORMAT "%5.1" ECU_ADDRESS 0x7FD9DE /end MEASUREMENT
/begin MEASUREMENT EWS_WritePageNumber "" UBYTE dez 1 100 0 255 FORMAT "%5.1" ECU_ADDRESS 0x7FD9DF /end MEASUREMENT
/begin MEASUREMENT EWS_WritePage_Data "" ULONG dez 1 100 0 4.29497e+009 FORMAT "%13.2" ECU_ADDRESS 0x7FE48C /end MEASUREMENT
/begin MEASUREMENT EWS_WriteToTRSP_State "" UBYTE dez 1 100 0 255 FORMAT "%5.1" ECU_ADDRESS 0x7FD9E0 /end MEASUREMENT
/begin MEASUREMENT EWS_WriteTrspPage_State "" UBYTE dez 1 100 0 255 FORMAT "%5.1" ECU_ADDRESS 0x7FD9E1 /end MEASUREMENT
/begin MEASUREMENT exwinks_w "Sollwert Exzenterwinkel VVT" UWORD wink_uw_q0p1 1 100 0 230 FORMAT "%8.4" ECU_ADDRESS 0x7FE124 /end MEASUREMENT
/begin MEASUREMENT fafbyp "flow≠ characteristic of bypass" UBYTE fak_ub_b2 1 100 0 1.99219 FORMAT "%5.3" ECU_ADDRESS 0x7FD906 /end MEASUREMENT
/begin MEASUREMENT fbakl_w "Faktor K- und L-Anteil der ‹K bei BA" SWORD fak_sw_b256 1 100 -256 255.992 FORMAT "%8.4" ECU_ADDRESS 0x7FD5C0 /end MEASUREMENT
/begin MEASUREMENT fbans "Nachstartfaktor der ‹K bei BA" UBYTE fak_ub_b8 1 100 0 7.96875 FORMAT "%5.3" ECU_ADDRESS 0x7FD5BA /end MEASUREMENT
/begin MEASUREMENT fbans_w "Nachstartfaktor der ‹K bei BA" UWORD fak_uw_b8 1 100 0 7.99988 FORMAT "%8.6" ECU_ADDRESS 0x7FD5C2 /end MEASUREMENT
/begin MEASUREMENT fbavst_w "Faktor ‹K-Verstellung bei Beschleunigungsanreicherung" SWORD fak_sw_b256 1 100 -256 255.992 FORMAT "%8.4" ECU_ADDRESS 0x7FD5C4 /end MEASUREMENT
/begin MEASUREMENT ffzanz "Anzahl Folgefunken" UBYTE dez 1 100 0 255 FORMAT "%5.1" ECU_ADDRESS 0x7FDAE2 /end MEASUREMENT
/begin MEASUREMENT ffztld "Ladezeit Folgefunken" UBYTE txms_ub_q0p1 1 100 0 25.5 FORMAT "%5.2" ECU_ADDRESS 0x7FDAE3 /end MEASUREMENT
/begin MEASUREMENT ffztof "Offenzeit Folgefunken" UBYTE txms_ub_q0p05 1 100 0 12.75 FORMAT "%5.2" ECU_ADDRESS 0x7FDAE4 /end MEASUREMENT
/begin MEASUREMENT fgru "Faktor Grundvorsteuerung" UBYTE fak_ub_b2 1 100 0 1.99219 FORMAT "%5.3" ECU_ADDRESS 0x7FD5B6 /end MEASUREMENT
/begin MEASUREMENT Fgstnummer "" UBYTE dez 1 100 0 255 FORMAT "%5.1" ARRAY_SIZE 17 ECU_ADDRESS 0x7F98D0 /end MEASUREMENT
/begin MEASUREMENT fho "Korrekturfaktor Hˆhe" UBYTE fak_ub_b4 1 100 0 3.98438 FORMAT "%5.3" ECU_ADDRESS 0x7FD616 /end MEASUREMENT
/begin MEASUREMENT fho_w "Korrekturfaktor Hˆhe (word)" UWORD fak_uw_b4 1 100 0 3.99994 FORMAT "%8.6" ECU_ADDRESS 0x7FD61C /end MEASUREMENT
/begin MEASUREMENT fkstt0 "Rover" UBYTE fak_ub_b64 1 100 0 63.75 FORMAT "%5.2" ECU_ADDRESS 0x7FD931 /end MEASUREMENT
/begin MEASUREMENT fktns "Nachstartanhebung" UBYTE fak_ub_b4 1 100 0 3.98438 FORMAT "%5.3" ECU_ADDRESS 0x7FD921 /end MEASUREMENT
/begin MEASUREMENT fktns0_w "Rover" UWORD fak_uw_b512 1 100 0 511.992 FORMAT "%8.4" ECU_ADDRESS 0x7FDC94 /end MEASUREMENT
/begin MEASUREMENT fktns1_w "Rover" UWORD fak_uw_b1024 1 100 0 1023.98 FORMAT "%8.3" ECU_ADDRESS 0x7FDC96 /end MEASUREMENT
/begin MEASUREMENT fmfkrakt "Mittenfrequenz f¸r Bandpaﬂfilter Klopfregelung" UBYTE dez 1 100 0 255 FORMAT "%5.1" ECU_ADDRESS 0x7FD95C /end MEASUREMENT
/begin MEASUREMENT fmfkraktne "Mittenfrequenz f¸r Bandpaﬂfilter Klopfregelung, neuer Wert" UBYTE dez 1 100 0 255 FORMAT "%5.1" ARRAY_SIZE 8 ECU_ADDRESS 0x7FD62C /end MEASUREMENT
/begin MEASUREMENT fmf_lowr_thd "" SWORD mgrad_sw_b28p44 1 100 -28.4444 28.4436 FORMAT "%8.5" ECU_ADDRESS 0x7FDFA0 /end MEASUREMENT
/begin MEASUREMENT fmf_lowr_wrn_thd "" SWORD mgrad_sw_b28p44 1 100 -28.4444 28.4436 FORMAT "%8.5" ECU_ADDRESS 0x7FDF8E /end MEASUREMENT
/begin MEASUREMENT fmf_uppr_thd "" SWORD mgrad_sw_b28p44 1 100 -28.4444 28.4436 FORMAT "%8.5" ECU_ADDRESS 0x7FDFA2 /end MEASUREMENT
/begin MEASUREMENT fmf_uppr_wrn_thd "" SWORD mgrad_sw_b28p44 1 100 -28.4444 28.4436 FORMAT "%8.5" ECU_ADDRESS 0x7FDF90 /end MEASUREMENT
/begin MEASUREMENT fns "Faktor Nachstart" UBYTE fak_ub_b4 1 100 0 3.98438 FORMAT "%5.3" ECU_ADDRESS 0x7FD922 /end MEASUREMENT
/begin MEASUREMENT fnsa0 "Rover" UBYTE fak_ub_b2 1 100 0 1.99219 FORMAT "%5.3" ECU_ADDRESS 0x7FD923 /end MEASUREMENT
/begin MEASUREMENT fnsho0 "Rover" UBYTE fak_ub_b2 1 100 0 1.99219 FORMAT "%5.3" ECU_ADDRESS 0x7FD924 /end MEASUREMENT
/begin MEASUREMENT fnssm0 "Rover" UBYTE fak_ub_b2 1 100 0 1.99219 FORMAT "%5.3" ECU_ADDRESS 0x7FD925 /end MEASUREMENT
/begin MEASUREMENT fpvdkds "Faktor Druck vor Drosselklappe von Drucksensor" UBYTE fak_ub_b4 1 100 0 3.98438 FORMAT "%5.3" ECU_ADDRESS 0x7FD954 /end MEASUREMENT
/begin MEASUREMENT fpvdkdsl_w "Faktor Druck vor Drosselklappe von Ladedrucksensor (word)" UWORD fak_uw_b4 1 100 0 3.99994 FORMAT "%8.6" ECU_ADDRESS 0x7FDD48 /end MEASUREMENT
/begin MEASUREMENT fpvdkdsu_w "Faktor Druck vor Drosselklappe von Umgebungsdrucksensor (word)" UWORD fak_uw_b4 1 100 0 3.99994 FORMAT "%8.6" ECU_ADDRESS 0x7FD61E /end MEASUREMENT
/begin MEASUREMENT fpvdkds_w "Faktor Druck vor Drosselklappe von Drucksensor (word)" UWORD fak_uw_b4 1 100 0 3.99994 FORMAT "%8.6" ECU_ADDRESS 0x7FDD4A /end MEASUREMENT
/begin MEASUREMENT frg_ASG "Startfreigabe-Bit intern" UBYTE B_TRUE 1 100 0 1 BIT_MASK 0x1 FORMAT "%13.11" ECU_ADDRESS 0x7FBC9F /end MEASUREMENT
/begin MEASUREMENT frhodkr_w "Faktor Luftdichtekorrektur f¸r DK-Durchfluﬂ korrigiert (word)" UWORD fak_uw_b2 1 100 0 1.99997 FORMAT "%8.6" ECU_ADDRESS 0x7FDC3A /end MEASUREMENT
/begin MEASUREMENT frhol_w "Faktor Luftdichte f(Ansauglufttemp., Hˆhe) 16-Bit" UWORD fak_uw_b2 1 100 0 1.99997 FORMAT "%8.6" ECU_ADDRESS 0x7FD620 /end MEASUREMENT
/begin MEASUREMENT frpc_clp_w "" SWORD strom_q0p00078 1 100 -25.6008 25.6 FORMAT "%8.5" ECU_ADDRESS 0x7FD744 /end MEASUREMENT
/begin MEASUREMENT frpc_corr "Einspritzzeitkorrekturfaktor (Kraftstoffdruck, Saugrohrdruck)" SWORD fak_sw_b2 1 100 -2 1.99994 FORMAT "%8.6" ECU_ADDRESS 0x7FDF92 /end MEASUREMENT
/begin MEASUREMENT frpc_ctrllr_status "" UBYTE dez 1 100 0 255 FORMAT "%5.1" ECU_ADDRESS 0x7FD858 /end MEASUREMENT
/begin MEASUREMENT frpc_duty_w "" SWORD PER0100 1 100 -327.68 327.67 FORMAT "%8.4" ECU_ADDRESS 0x7FD746 /end MEASUREMENT
/begin MEASUREMENT frpc_err_w "" SWORD p_uw_q0p2 1 100 -6553.6 6553.4 FORMAT "%8.3" ECU_ADDRESS 0x7FD748 /end MEASUREMENT
/begin MEASUREMENT frpc_i_residual "" UWORD strom_b0p00078 1 100 0 0.000781 FORMAT "%12.10" ECU_ADDRESS 0x7FD74A /end MEASUREMENT
/begin MEASUREMENT frpc_i_term_w "" SWORD strom_q0p00078 1 100 -25.6008 25.6 FORMAT "%8.5" ECU_ADDRESS 0x7FD74C /end MEASUREMENT
/begin MEASUREMENT frpc_ol_pmp_currnt "" SWORD strom_q0p00078 1 100 -25.6008 25.6 FORMAT "%8.5" ECU_ADDRESS 0x7FD74E /end MEASUREMENT
/begin MEASUREMENT frpc_pmp_currnt "" SWORD strom_q0p00078 1 100 -25.6008 25.6 FORMAT "%8.5" ECU_ADDRESS 0x7FD750 /end MEASUREMENT
/begin MEASUREMENT frpc_prd_w "" SWORD txms_uw_q0p1 1 100 -3276.8 3276.7 FORMAT "%8.3" ECU_ADDRESS 0x7FD752 /end MEASUREMENT
/begin MEASUREMENT frpc_p_term_w "" SWORD strom_q0p00078 1 100 -25.6008 25.6 FORMAT "%8.5" ECU_ADDRESS 0x7FD754 /end MEASUREMENT
/begin MEASUREMENT frpc_volt_corr "" SWORD PER0100 1 100 -327.68 327.67 FORMAT "%8.4" ECU_ADDRESS 0x7FD756 /end MEASUREMENT
/begin MEASUREMENT frpsf_w "" SWORD p_uw_q0p2 1 100 -6553.6 6553.4 FORMAT "%8.3" ECU_ADDRESS 0x7FBCFE /end MEASUREMENT
/begin MEASUREMENT frps_filt "Kraftstoffdruck gefiltert" SWORD p_uw_q0p2 1 100 -6553.6 6553.4 FORMAT "%8.3" ECU_ADDRESS 0x7FBD00 /end MEASUREMENT
/begin MEASUREMENT frps_meas "" SWORD p_uw_q0p2 1 100 -6553.6 6553.4 FORMAT "%8.3" ECU_ADDRESS 0x7FBD02 /end MEASUREMENT
/begin MEASUREMENT frps_ss_prdict "" SWORD p_uw_q0p2 1 100 -6553.6 6553.4 FORMAT "%8.3" ECU_ADDRESS 0x7FBCFA /end MEASUREMENT
/begin MEASUREMENT frps_sta_tmr "" UWORD t10msxs_uw_b655p35 1 100 0 655.35 FORMAT "%8.4" ECU_ADDRESS 0x7FE1AC /end MEASUREMENT
/begin MEASUREMENT frps_td_tmr "" UWORD t10msxs_uw_b655p35 1 100 0 655.35 FORMAT "%8.4" ECU_ADDRESS 0x7FE1AE /end MEASUREMENT
/begin MEASUREMENT frps_w "" SWORD p_uw_q0p2 1 100 -6553.6 6553.4 FORMAT "%8.3" ECU_ADDRESS 0x7FBD04 /end MEASUREMENT
/begin MEASUREMENT frp_setpoint "" SWORD p_uw_q0p2 1 100 -6553.6 6553.4 FORMAT "%8.3" ECU_ADDRESS 0x7FBCFC /end MEASUREMENT
/begin MEASUREMENT fst0_w "Vorgesteuerter Startfaktor 16 Bit" UWORD fak_uw_b64 1 100 0 63.999 FORMAT "%8.5" ECU_ADDRESS 0x7FDC9E /end MEASUREMENT
/begin MEASUREMENT fst_w "Faktor Starteinspritzung" UWORD fak_uw_b64 1 100 0 63.999 FORMAT "%8.5" ECU_ADDRESS 0x7FDCA0 /end MEASUREMENT
/begin MEASUREMENT fthobyp "Hoehen und Temperaturkorrekturfaktor" UWORD fak_uw_b2 1 100 0 1.99997 FORMAT "%8.6" ECU_ADDRESS 0x7FDBEA /end MEASUREMENT
/begin MEASUREMENT fuebyperr "Regelabweichung Bankabgleich" SWORD fak_ub_b1 1 100 -128 127.996 FORMAT "%8.4" ECU_ADDRESS 0x7FDBEC /end MEASUREMENT
/begin MEASUREMENT fukabak_w "‹K-Adaptionsfaktor (kalter Motor) BA" UWORD fak_uw_b4 1 100 0 3.99994 FORMAT "%8.6" ECU_ADDRESS 0x7F9BC4 /end MEASUREMENT
/begin MEASUREMENT fukabaw_w "‹K-Adaptionsfaktor (warmer Motor) BA" UWORD fak_uw_b4 1 100 0 3.99994 FORMAT "%8.6" ECU_ADDRESS 0x7F9BC6 /end MEASUREMENT
/begin MEASUREMENT fukaba_w "‹K-Adaptions-Faktor BA" UWORD fak_uw_b4 1 100 0 3.99994 FORMAT "%8.6" ECU_ADDRESS 0x7FD5CC /end MEASUREMENT
/begin MEASUREMENT fukavak_w "‹K-Adaptionsfaktor (kalter Motor) VA" UWORD fak_uw_b4 1 100 0 3.99994 FORMAT "%8.6" ECU_ADDRESS 0x7F9BC8 /end MEASUREMENT
/begin MEASUREMENT fukavaw_w "‹K-Adaptionsfaktor (warmer Motor) VA" UWORD fak_uw_b4 1 100 0 3.99994 FORMAT "%8.6" ECU_ADDRESS 0x7F9BCA /end MEASUREMENT
/begin MEASUREMENT fukava_w "‹K-Adaptions-Faktor VA" UWORD fak_uw_b4 1 100 0 3.99994 FORMAT "%8.6" ECU_ADDRESS 0x7FD5CE /end MEASUREMENT
/begin MEASUREMENT fukkl_w "" SWORD fak_sw_b256 1 100 -256 255.992 FORMAT "%8.4" ECU_ADDRESS 0x7FD5C6 /end MEASUREMENT
/begin MEASUREMENT full_opn_inj_fmf "" SWORD mgrad_sw_b28p44 1 100 -28.4444 28.4436 FORMAT "%8.5" ECU_ADDRESS 0x7FDF94 /end MEASUREMENT
/begin MEASUREMENT fvakl_w "Faktor K- und L-Anteil der ‹K bei VA" SWORD fak_sw_b256 1 100 -256 255.992 FORMAT "%8.4" ECU_ADDRESS 0x7FD5C8 /end MEASUREMENT
/begin MEASUREMENT fvans "Nachstartfaktor der ‹K bei VA" UBYTE fak_ub_b8 1 100 0 7.96875 FORMAT "%5.3" ECU_ADDRESS 0x7FD5BB /end MEASUREMENT
/begin MEASUREMENT fvavst_w "Faktor ‹K-Verstellung bei Verzˆgerungsabmagerung" SWORD fak_sw_b256 1 100 -256 255.992 FORMAT "%8.4" ECU_ADDRESS 0x7FD5CA /end MEASUREMENT
/begin MEASUREMENT fwe "Faktor Wiedereinsetzen" UBYTE fak_ub_b2 1 100 0 1.99219 FORMAT "%5.3" ECU_ADDRESS 0x7FD948 /end MEASUREMENT
/begin MEASUREMENT fwl "Faktor Warmlauf" UBYTE fak_ub_b2 1 100 0 1.99219 FORMAT "%5.3" ECU_ADDRESS 0x7FD949 /end MEASUREMENT
/begin MEASUREMENT fwl0 "Rover" UBYTE fak_ub_b2 1 100 0 1.99219 FORMAT "%5.3" ECU_ADDRESS 0x7FD94A /end MEASUREMENT
/begin MEASUREMENT fwl02 "" UBYTE fak_ub_b2 1 100 0 1.99219 FORMAT "%5.3" ECU_ADDRESS 0x7FD94B /end MEASUREMENT
/begin MEASUREMENT fwl1 "Rover" UBYTE fak_ub_b2 1 100 0 1.99219 FORMAT "%5.3" ECU_ADDRESS 0x7FD94C /end MEASUREMENT
/begin MEASUREMENT fwl12 "" UBYTE fak_ub_b2 1 100 0 1.99219 FORMAT "%5.3" ECU_ADDRESS 0x7FD94D /end MEASUREMENT
/begin MEASUREMENT fwl2 "" UBYTE fak_ub_b2 1 100 0 1.99219 FORMAT "%5.3" ECU_ADDRESS 0x7FD94E /end MEASUREMENT
/begin MEASUREMENT fwlw "Rover" UBYTE fak_ub_b1 1 100 0 0.996094 ECU_ADDRESS 0x7FD94F /end MEASUREMENT
/begin MEASUREMENT fwnssm_w "Rover" UWORD fak_uw_b512 1 100 0 511.992 FORMAT "%8.4" ECU_ADDRESS 0x7FDC98 /end MEASUREMENT
/begin MEASUREMENT fwst "" UBYTE fak_ub_b2 1 100 0 1.99219 FORMAT "%5.3" ECU_ADDRESS 0x7FD932 /end MEASUREMENT
/begin MEASUREMENT fwst0_w "Rover" UWORD fak_uw_b1 1 100 0 0.999985 FORMAT "%9.7" ECU_ADDRESS 0x7FDCA2 /end MEASUREMENT
/begin MEASUREMENT fwst1 "Rover" UBYTE fak_ub_b1 1 100 0 0.996094 ECU_ADDRESS 0x7FD933 /end MEASUREMENT
/begin MEASUREMENT fzans1 "Faktor Abregelung Nachstart ohne Ber¸cksichtigung des Startmengenadaptionswerts" UBYTE fak_ub_b0p25 1 100 0 0.249023 FORMAT "%11.9" ECU_ADDRESS 0x7FD926 /end MEASUREMENT
/begin MEASUREMENT fzans2 "Faktor Abregelung Nachstart mit Ber¸cksichtigung des Startmengenadaptionswerts" UBYTE fak_ub_b0p25 1 100 0 0.249023 FORMAT "%11.9" ECU_ADDRESS 0x7FD927 /end MEASUREMENT
/begin MEASUREMENT gang "" UBYTE dez 1 100 0 255 FORMAT "%5.1" ECU_ADDRESS 0x7FD7E8 /end MEASUREMENT
/begin MEASUREMENT gangcan "Ganginformation fuer CAN mit Notlauf" UBYTE dez 1 100 0 255 FORMAT "%5.1" ECU_ADDRESS 0x7FD7E9 /end MEASUREMENT
/begin MEASUREMENT GgdsasNvBits "" UBYTE dez 1 100 0 255 FORMAT "%5.1" ECU_ADDRESS 0x7F9C0E /end MEASUREMENT
/begin MEASUREMENT ggks_cc195_Bits "" UWORD default 1 100 0 65535 FORMAT "%8.2" ECU_ADDRESS 0x7FE140 /end MEASUREMENT
/begin MEASUREMENT hsst_w "Rover" UWORD fak_uw_b64 1 100 0 63.999 FORMAT "%8.5" ECU_ADDRESS 0x7FDCA4 /end MEASUREMENT
/begin MEASUREMENT hstt0 "" UBYTE fak_ub_b64 1 100 0 63.75 FORMAT "%5.2" ECU_ADDRESS 0x7FD934 /end MEASUREMENT
/begin MEASUREMENT igod_w "Integratorgradient f¸r Nulltest-Diagnose Klopfregelung" SWORD spgg_sw_b3052 1 100 -3051.76 3051.67 FORMAT "%8.3" ECU_ADDRESS 0x7FDD62 /end MEASUREMENT
/begin MEASUREMENT igokr_w "Integratorgradient f¸r Offsetkorrektur Klopfregelung (Word)" SWORD spgg_sw_b3052 1 100 -3051.76 3051.67 FORMAT "%8.3" ECU_ADDRESS 0x7FDD64 /end MEASUREMENT
/begin MEASUREMENT ikr "Integratorwert Klopfregelung offsetkorrigiert" UBYTE spg_ub_b5 1 100 0 4.98047 FORMAT "%5.3" ARRAY_SIZE 8 ECU_ADDRESS 0x7FBCB4 /end MEASUREMENT
/begin MEASUREMENT ikrma "Integratorwert Klopfregelung Meﬂfensteranfang" UBYTE spg_ub_b5 1 100 0 4.98047 FORMAT "%5.3" ECU_ADDRESS 0x7FD95D /end MEASUREMENT
/begin MEASUREMENT ikrme "Integratorwert Klopfregelung Meﬂfensterende" UBYTE spg_ub_b5 1 100 0 4.98047 FORMAT "%5.3" ARRAY_SIZE 8 ECU_ADDRESS 0x7FBCBC /end MEASUREMENT
/begin MEASUREMENT ikrmen "Integratorwert Klopfregelung Meﬂfensterende Nulltest" UBYTE spg_ub_b5 1 100 0 4.98047 FORMAT "%5.3" ECU_ADDRESS 0x7FD95E /end MEASUREMENT
/begin MEASUREMENT ikrmet "Integratorwert Klopfregelung Meﬂfensterende Testimpuls" UBYTE spg_ub_b5 1 100 0 4.98047 FORMAT "%5.3" ECU_ADDRESS 0x7FD95F /end MEASUREMENT
/begin MEASUREMENT ikr_tst "Integratorwert Klopfregelung offsetkorregiert rollierend mit Zyl.z‰hler" UBYTE spg_ub_b5 1 100 0 4.98047 FORMAT "%5.3" ECU_ADDRESS 0x7FD960 /end MEASUREMENT
/begin MEASUREMENT inj_pres_drop "" UWORD p_uw_q0p2 1 100 0 13107 FORMAT "%8.2" ECU_ADDRESS 0x7FBCF6 /end MEASUREMENT
/begin MEASUREMENT iokkr "Integratoroffsetkorrektur Klopfregelung" UBYTE spg_ub_b5 1 100 0 4.98047 FORMAT "%5.3" ECU_ADDRESS 0x7FD961 /end MEASUREMENT
/begin MEASUREMENT klakwdk_aus "" SWORD rel_sw_b1536 1 100 -1536 1535.95 FORMAT "%8.3" ECU_ADDRESS 0x7FDCBE /end MEASUREMENT
/begin MEASUREMENT krmf_start "" UWORD krmf_to_zw 1 100 0 1535.98 FORMAT "%8.3" ECU_ADDRESS 0x7FDD66 /end MEASUREMENT
/begin MEASUREMENT ks_sym "Eingang des Klopfauswerte-IC" UBYTE dez 1 100 0 255 FORMAT "%5.1" ARRAY_SIZE 4 ECU_ADDRESS 0x7FBCC4 /end MEASUREMENT
/begin MEASUREMENT KWP2000_Diag_Info "" UBYTE dez 1 100 0 255 FORMAT "%5.1" ECU_ADDRESS 0x7FD9CF /end MEASUREMENT
/begin MEASUREMENT lamnswl_w "Lambda-Motor-Soll f¸r Nachstart und Warmlauf" UWORD fak_uw_b16 1 100 0 15.9998 FORMAT "%8.5" ECU_ADDRESS 0x7FDCE8 /end MEASUREMENT
/begin MEASUREMENT lamns_w "Lambda-Motor-Soll f¸r Nachstart" UWORD fak_uw_b16 1 100 0 15.9998 FORMAT "%8.5" ECU_ADDRESS 0x7FDC9A /end MEASUREMENT
/begin MEASUREMENT lamwl_w "Lambda-Motor-Soll f¸r Warmlauf" UWORD fak_uw_b16 1 100 0 15.9998 FORMAT "%8.5" ECU_ADDRESS 0x7FDCEA /end MEASUREMENT
/begin MEASUREMENT lans_w "Rover" UWORD fak_uw_b16 1 100 0 15.9998 FORMAT "%8.5" ECU_ADDRESS 0x7FDC9C /end MEASUREMENT
/begin MEASUREMENT laswlr "Rover" UBYTE fak_ub_b2 1 100 0 1.99219 FORMAT "%5.3" ECU_ADDRESS 0x7FD950 /end MEASUREMENT
/begin MEASUREMENT ldfki_w "Ladedruck Filterzeitkonstante aus Kennfeld" UWORD zk10msxs_uw_b655 1 100 0.0100002 655.36 FORMAT "%10.6" ECU_ADDRESS 0x7FDD4C /end MEASUREMENT
/begin MEASUREMENT mlbyp2_o_w "" UWORD m_uw_b3276p7 1 100 0 3276.75 FORMAT "%8.3" ECU_ADDRESS 0x7FDBEE /end MEASUREMENT
/begin MEASUREMENT mlbypcor_w "Korrekturwert fuer Bankabgleich" UWORD fak_uw_b2 1 100 0 1.99997 FORMAT "%8.6" ECU_ADDRESS 0x7FDBF0 /end MEASUREMENT
/begin MEASUREMENT mlbypns2_w "Korrigierte Sollluftmasse ¸ber Stepper Bank2" UWORD m_uw_b3276p7 1 100 0 3276.75 FORMAT "%8.3" ECU_ADDRESS 0x7FDBF2 /end MEASUREMENT
/begin MEASUREMENT mlbypns_w "Korrigierte Sollluftmasse ¸ber Stepper" UWORD m_uw_b3276p7 1 100 0 3276.75 FORMAT "%8.3" ECU_ADDRESS 0x7FDBF4 /end MEASUREMENT
/begin MEASUREMENT mlbypso1_w "Sollluftmasse ¸ber Stepper 1" UWORD m_uw_b3276p7 1 100 0 3276.75 FORMAT "%8.3" ECU_ADDRESS 0x7FDBF6 /end MEASUREMENT
/begin MEASUREMENT mlbypso2_w "Sollluftmasse ¸ber Stepper 2" UWORD m_uw_b3276p7 1 100 0 3276.75 FORMAT "%8.3" ECU_ADDRESS 0x7FDBF8 /end MEASUREMENT
/begin MEASUREMENT mlbypsol_w "Sollluftmasse ¸ber Stepper" UWORD m_uw_b6553p5 1 100 0 6553.5 FORMAT "%8.3" ECU_ADDRESS 0x7FDBFA /end MEASUREMENT
/begin MEASUREMENT mlbyp_o_w "" UWORD m_uw_b3276p7 1 100 0 3276.75 FORMAT "%8.3" ECU_ADDRESS 0x7FDBFC /end MEASUREMENT
/begin MEASUREMENT mldkns_w "" UWORD m_uw_b6553p5 1 100 0 6553.5 FORMAT "%8.3" ECU_ADDRESS 0x7FDC3C /end MEASUREMENT
/begin MEASUREMENT mldks_w "" UWORD m_uw_b6553p5 1 100 0 6553.5 FORMAT "%8.3" ECU_ADDRESS 0x7FDC3E /end MEASUREMENT
/begin MEASUREMENT mlsol_w "Soll-Luftmassenstrom" UWORD m_uw_b6553p5 1 100 0 6553.5 FORMAT "%8.3" ECU_ADDRESS 0x7FDC40 /end MEASUREMENT
/begin MEASUREMENT mlwdkns_w "Normierter Luftmassenstrom f¸r Sollwinkelbestimmung Drosselklappe" UWORD m_uw_b6553p5 1 100 0 6553.5 FORMAT "%8.3" ECU_ADDRESS 0x7FDC42 /end MEASUREMENT
/begin MEASUREMENT mn_inj_fmf "" SWORD mgrad_sw_b28p44 1 100 -28.4444 28.4436 FORMAT "%8.5" ECU_ADDRESS 0x7FDF96 /end MEASUREMENT
/begin MEASUREMENT mn_inj_ratio "" UWORD fak_uw_q0p001 1 100 0 65.535 FORMAT "%8.5" ECU_ADDRESS 0x7FDF98 /end MEASUREMENT
/begin MEASUREMENT msdk10ms_w "" UWORD m_uw_b6553p5 1 100 0 6553.5 FORMAT "%8.3" ECU_ADDRESS 0x7FDCC0 /end MEASUREMENT
/begin MEASUREMENT msndk10_w "" UWORD m_uw_b6553p5 1 100 0 6553.5 FORMAT "%8.3" ECU_ADDRESS 0x7FDCC2 /end MEASUREMENT
/begin MEASUREMENT mx_inj_fmf "" SWORD mgrad_sw_b28p44 1 100 -28.4444 28.4436 FORMAT "%8.5" ECU_ADDRESS 0x7FDF9A /end MEASUREMENT
/begin MEASUREMENT mx_inj_ratio "" UWORD fak_uw_q0p001 1 100 0 65.535 FORMAT "%8.5" ECU_ADDRESS 0x7FDF9C /end MEASUREMENT
/begin MEASUREMENT nsactr "Nachstartcounter" UBYTE fak_ub_b2 1 100 0 1.99219 FORMAT "%5.3" ECU_ADDRESS 0x7FD928 /end MEASUREMENT
/begin MEASUREMENT nsactr1 "Nachstartcounter ohne Ber¸cksichtigung des Startmengenadaptionswerts" UBYTE fak_ub_b2 1 100 0 1.99219 FORMAT "%5.3" ECU_ADDRESS 0x7FD929 /end MEASUREMENT
/begin MEASUREMENT nsactr2 "Nachstartcounter mit Ber¸cksichtigung des Startmengenadaptionswerts" UBYTE fak_ub_b2 1 100 0 1.99219 FORMAT "%5.3" ECU_ADDRESS 0x7FD92A /end MEASUREMENT
/begin MEASUREMENT nswrl "" UBYTE fak_ub_b2 1 100 0 1.99219 FORMAT "%5.3" ECU_ADDRESS 0x7FD92B /end MEASUREMENT
/begin MEASUREMENT phase "" UBYTE dez 1 100 0 255 FORMAT "%5.1" ECU_ADDRESS 0x7FD9E2 /end MEASUREMENT
/begin MEASUREMENT plsol "Soll-Ladedruck" UBYTE p_ub_q10 1 100 0 2550 FORMAT "%5.0" ECU_ADDRESS 0x7FD90E /end MEASUREMENT
/begin MEASUREMENT plsol_w "Soll-Ladedruck" UWORD p_uw_q0p039 1 100 0 2559.96 FORMAT "%8.3" ECU_ADDRESS 0x7FDC44 /end MEASUREMENT
/begin MEASUREMENT pm_akt "" UBYTE dez 1 100 0 255 FORMAT "%5.1" ECU_ADDRESS 0x7FD64E /end MEASUREMENT
/begin MEASUREMENT pm_fre "" UBYTE dez 1 100 0 255 FORMAT "%5.1" ECU_ADDRESS 0x7FD64F /end MEASUREMENT
/begin MEASUREMENT pm_mod "" UBYTE dez 1 100 0 255 FORMAT "%5.1" ECU_ADDRESS 0x7FD650 /end MEASUREMENT
/begin MEASUREMENT pm_ta "" UBYTE dez 1 100 0 255 FORMAT "%5.1" ECU_ADDRESS 0x7FD651 /end MEASUREMENT
/begin MEASUREMENT pm_td "" UBYTE dez 1 100 0 255 FORMAT "%5.1" ECU_ADDRESS 0x7FD652 /end MEASUREMENT
/begin MEASUREMENT prd_btwn_injns "" UWORD t8p0usxms 1 100 0 524.28 FORMAT "%8.4" ECU_ADDRESS 0x7FE1A8 /end MEASUREMENT
/begin MEASUREMENT pspvmin_w "Minimalauswahl aus pspvdk und psspvdk" UWORD fak_uw_b2 1 100 0 1.99997 FORMAT "%8.6" ECU_ADDRESS 0x7FDC46 /end MEASUREMENT
/begin MEASUREMENT pssol_w "Sollsaugrohrdruck" UWORD p_uw_q0p039 1 100 0 2559.96 FORMAT "%8.3" ECU_ADDRESS 0x7FDC48 /end MEASUREMENT
/begin MEASUREMENT psspvdkd_w "Verh‰ltnis Sollsaugrohrdruck/Druck vor Drosselklappe von Drucksensor (word)" UWORD fak_uw_b4 1 100 0 3.99994 FORMAT "%8.6" ECU_ADDRESS 0x7FDD4E /end MEASUREMENT
/begin MEASUREMENT psspvdk_w "" UWORD fak_uw_b2 1 100 0 1.99997 FORMAT "%8.6" ECU_ADDRESS 0x7FDC4A /end MEASUREMENT
/begin MEASUREMENT psukao_w "" UWORD p_uw_q0p039 1 100 0 2559.96 FORMAT "%8.3" ECU_ADDRESS 0x7FD5D0 /end MEASUREMENT
/begin MEASUREMENT pu "Umgebungsdruck" UBYTE p_ub_q5 1 100 0 1275 FORMAT "%5.0" ECU_ADDRESS 0x7FD617 /end MEASUREMENT
/begin MEASUREMENT pus_w "Umgebungsdruck ohne Umschaltung auf Ersatzwert bei Sensorfehler" UWORD p_uw_q0p039 1 100 0 2559.96 FORMAT "%8.3" ECU_ADDRESS 0x7FD622 /end MEASUREMENT
/begin MEASUREMENT pu_w "Umgebungsdruck" UWORD p_uw_q0p039 1 100 0 2559.96 FORMAT "%8.3" ECU_ADDRESS 0x7FD624 /end MEASUREMENT
/begin MEASUREMENT pvdkds "Druck vor Drosselklappe von Drucksensor" UBYTE p_ub_q10 1 100 0 2550 FORMAT "%5.0" ECU_ADDRESS 0x7FD955 /end MEASUREMENT
/begin MEASUREMENT pvdkdsl_w "Druck vor Drosselklappe von Ladedrucksensor (word)" UWORD p_uw_q0p039 1 100 0 2559.96 FORMAT "%8.3" ECU_ADDRESS 0x7FDD50 /end MEASUREMENT
/begin MEASUREMENT pvdkdsu_w "Druck vor Drosselklappe von Umgebungsdrucksensor (word)" UWORD p_uw_q0p039 1 100 0 2559.96 FORMAT "%8.3" ECU_ADDRESS 0x7FD626 /end MEASUREMENT
/begin MEASUREMENT pvdkds_w "Druck vor Drosselklappe von Drucksensor (word)" UWORD p_uw_q0p039 1 100 0 2559.96 FORMAT "%8.3" ECU_ADDRESS 0x7FDD52 /end MEASUREMENT
/begin MEASUREMENT pvdkmx_w "Maximaler Druck vor Drosselklappe Ausgangswert aus Kennlinie PVDKMX" UWORD p_uw_q0p039 1 100 0 2559.96 FORMAT "%8.3" ECU_ADDRESS 0x7FDD54 /end MEASUREMENT
/begin MEASUREMENT pvdkr_w "" UWORD p_uw_q0p039 1 100 0 2559.96 FORMAT "%8.3" ECU_ADDRESS 0x7FDC4C /end MEASUREMENT
/begin MEASUREMENT pvdksf_w "gefilterter Druck vor Drosselklappe (Ladedruck) vom Drucksensor" UWORD p_uw_q0p039 1 100 0 2559.96 FORMAT "%8.3" ECU_ADDRESS 0x7FDD56 /end MEASUREMENT
/begin MEASUREMENT pvdkspud "Differenz zwischen Umgebungsdruck und Druck vor Drosselklappe" UBYTE p_ub_q10 1 100 0 2550 FORMAT "%5.0" ECU_ADDRESS 0x7FD618 /end MEASUREMENT
/begin MEASUREMENT pvdks_w "Druck vor Drosselklappe ohne Umschaltung auf Ersatzwert bei Sensorfehler" UWORD p_uw_q0p039 1 100 0 2559.96 FORMAT "%8.3" ECU_ADDRESS 0x7FDD58 /end MEASUREMENT
/begin MEASUREMENT rinofv2_w "" UWORD r_uw_q2 1 100 0 131070 FORMAT "%8.1" ECU_ADDRESS 0x7FDD6C /end MEASUREMENT
/begin MEASUREMENT rinofva2_w "" UWORD r_uw_q2 1 100 0 131070 FORMAT "%8.1" ECU_ADDRESS 0x7FDD6E /end MEASUREMENT
/begin MEASUREMENT rinofva_w "" UWORD r_uw_q2 1 100 0 131070 FORMAT "%8.1" ECU_ADDRESS 0x7FDD70 /end MEASUREMENT
/begin MEASUREMENT rinofv_w "" UWORD r_uw_q2 1 100 0 131070 FORMAT "%8.1" ECU_ADDRESS 0x7FDD72 /end MEASUREMENT
/begin MEASUREMENT rinv2_w "Istwert (word) Innenwiderstand Ri-Nernstzelle der Lambdasonde vor KAT Bank2" UWORD r_uw_q2 1 100 0 131070 FORMAT "%8.1" ECU_ADDRESS 0x7FDD74 /end MEASUREMENT
/begin MEASUREMENT rinv_w "Istwert (word) Innenwiderstand Ri-Nernstzelle der Lambdasonde vor KAT" UWORD r_uw_q2 1 100 0 131070 FORMAT "%8.1" ECU_ADDRESS 0x7FDD76 /end MEASUREMENT
/begin MEASUREMENT rkakdk_o_w "" SWORD rel_sw_b1536 1 100 -1536 1535.95 FORMAT "%8.3" ECU_ADDRESS 0x7FDCC4 /end MEASUREMENT
/begin MEASUREMENT rkakdk_w "" SWORD rel_sw_b1536 1 100 -1536 1535.95 FORMAT "%8.3" ECU_ADDRESS 0x7FDCC6 /end MEASUREMENT
/begin MEASUREMENT rkuke_w "rel. Kraftstoffmasse ‹bergangskompensation Ersatzwert" SWORD rel_sw_q0p1875 1 100 -6144 6143.81 FORMAT "%8.3" ECU_ADDRESS 0x7FDCC8 /end MEASUREMENT
/begin MEASUREMENT rkukg10_w "" SWORD rel_sw_b1536 1 100 -1536 1535.95 FORMAT "%8.3" ECU_ADDRESS 0x7FDCCA /end MEASUREMENT
/begin MEASUREMENT rkukg_w "rel. Kraftstoffmasse ‹bergangskompensation" SWORD rel_sw_b1536 1 100 -1536 1535.95 FORMAT "%8.3" ECU_ADDRESS 0x7FDCCC /end MEASUREMENT
/begin MEASUREMENT rkukkl_w "Kurz- und Langzeitanteil der UK" SWORD rel_sw_q0p1875 1 100 -6144 6143.81 FORMAT "%8.3" ECU_ADDRESS 0x7FDCCE /end MEASUREMENT
/begin MEASUREMENT rkukk_w "rk-Kurzzeitanteil der UK" SWORD rel_sw_q0p1875 1 100 -6144 6143.81 FORMAT "%8.3" ECU_ADDRESS 0x7FDCD0 /end MEASUREMENT
/begin MEASUREMENT rkukl_w "rk-Langzeitanteil der UK" SWORD rel_sw_q0p1875 1 100 -6144 6143.81 FORMAT "%8.3" ECU_ADDRESS 0x7FDCD2 /end MEASUREMENT
/begin MEASUREMENT rkuk_w "rel. Kraftstoffmasse ‹bergangskompensation ohne Verstelleingriffe" SWORD rel_sw_q0p1875 1 100 -6144 6143.81 FORMAT "%8.3" ECU_ADDRESS 0x7FDCD4 /end MEASUREMENT
/begin MEASUREMENT rldkw_w "" UWORD rel_uw_q0p0234 1 100 0 1535.98 FORMAT "%8.3" ECU_ADDRESS 0x7FDCD6 /end MEASUREMENT
/begin MEASUREMENT rlshk "" UBYTE rel_ub_q0p75 1 100 0 191.25 FORMAT "%5.1" ECU_ADDRESS 0x7FD90D /end MEASUREMENT
/begin MEASUREMENT rlsolfdk_w "" UWORD rel_uw_q0p0234 1 100 0 1535.98 FORMAT "%8.3" ECU_ADDRESS 0x7FDCD8 /end MEASUREMENT
/begin MEASUREMENT rlsolk_w "Korrigierte relative Sollf¸llung" UWORD rel_uw_q0p0234 1 100 0 1535.98 FORMAT "%8.3" ECU_ADDRESS 0x7FDC4E /end MEASUREMENT
/begin MEASUREMENT rlsp "" UBYTE rel_ub_q0p75 1 100 0 191.25 FORMAT "%5.1" ECU_ADDRESS 0x7FD944 /end MEASUREMENT
/begin MEASUREMENT rlsp2 "" UBYTE rel_ub_q0p75 1 100 0 191.25 FORMAT "%5.1" ECU_ADDRESS 0x7FD945 /end MEASUREMENT
/begin MEASUREMENT rlvw_w "relative Luftf¸llung (druck- und hˆhenkorrigiert) Word" UWORD rel_uw_q0p0234 1 100 0 1535.98 FORMAT "%8.3" ECU_ADDRESS 0x7FE126 /end MEASUREMENT
/begin MEASUREMENT rlwped10_w "" UWORD rel_uw_q0p0234 1 100 0 1535.98 FORMAT "%8.3" ECU_ADDRESS 0x7FDCDA /end MEASUREMENT
/begin MEASUREMENT rnge_inj_fmf "" SWORD mgrad_sw_b28p44 1 100 -28.4444 28.4436 FORMAT "%8.5" ECU_ADDRESS 0x7FDF9E /end MEASUREMENT
/begin MEASUREMENT rst_akt "" UBYTE dez 1 100 0 255 FORMAT "%5.1" ECU_ADDRESS 0x7FD653 /end MEASUREMENT
/begin MEASUREMENT runtime_mfa "" UWORD txms_uw_q0p001 1 100 0 65.535 FORMAT "%8.5" ECU_ADDRESS 0x7FE142 /end MEASUREMENT
/begin MEASUREMENT runtime_mfe "" UWORD txms_uw_q0p001 1 100 0 65.535 FORMAT "%8.5" ECU_ADDRESS 0x7FE144 /end MEASUREMENT
/begin MEASUREMENT sampling_time "" UBYTE dez 1 100 0 255 FORMAT "%5.1" ECU_ADDRESS 0x7FD9E3 /end MEASUREMENT
/begin MEASUREMENT sdwfk_w "Speicherinhalt der Wandfilmdifferenz f¸r Kurzzeitanteil" SWORD rel_sw_q0p1875 1 100 -6144 6143.81 FORMAT "%8.3" ECU_ADDRESS 0x7FDCDC /end MEASUREMENT
/begin MEASUREMENT sdwfl_w "Speicherinhalt der Wandfilmdifferenz f¸r Langzeitanteil" SWORD rel_sw_q0p1875 1 100 -6144 6143.81 FORMAT "%8.3" ECU_ADDRESS 0x7FDCDE /end MEASUREMENT
/begin MEASUREMENT sen_c95 "Klopfsensoreingang am Klopfauswerte-IC" UBYTE dez 1 100 0 255 FORMAT "%5.1" ARRAY_SIZE 8 ECU_ADDRESS 0x7FD964 /end MEASUREMENT
/begin MEASUREMENT sqrt_pres_drop "" UWORD p_uw_q0p039 1 100 0 2559.96 FORMAT "%8.3" ECU_ADDRESS 0x7FBCF8 /end MEASUREMENT
/begin MEASUREMENT ST_ugetrg "" UBYTE dez 1 100 0 255 FORMAT "%5.1" ECU_ADDRESS 0x7F9CB1 /end MEASUREMENT
/begin MEASUREMENT szanssm0 "Rover" UBYTE fak_ub_b1 1 100 0 0.996094 ECU_ADDRESS 0x7FD92C /end MEASUREMENT
/begin MEASUREMENT tandt0 "Rover" UBYTE temp_ub_b191p25 1 100 0 191.25 FORMAT "%5.1" ECU_ADDRESS 0x7FD935 /end MEASUREMENT
/begin MEASUREMENT tans "Ansaugluft - Temperatur" UBYTE temp_ub_q0p75_o48 1 100 -48 143.25 FORMAT "%5.1" ECU_ADDRESS 0x7FD952 /end MEASUREMENT
/begin MEASUREMENT tansab "Ansauglufttemperatur beim Abstellen" UBYTE temp_ub_q0p75_o48 1 100 -48 143.25 FORMAT "%5.1" ECU_ADDRESS 0x7F9C02 /end MEASUREMENT
/begin MEASUREMENT tansabk_w "Ansauglufttemperatur beim Abstellen in Kelvin" UWORD temp_q0p0234_o273 1 100 -273.15 1262.83 FORMAT "%8.3" ECU_ADDRESS 0x7F9C04 /end MEASUREMENT
/begin MEASUREMENT tansk_w "Ansaugluft - Temperatur in Kelvin" UWORD temp_q0p0234_o273 1 100 -273.15 1262.83 FORMAT "%8.3" ECU_ADDRESS 0x7FDD30 /end MEASUREMENT
/begin MEASUREMENT tanslin "Ansauglufttemperatur, linearisiert und umgerechnet" UBYTE temp_ub_q0p75_o48 1 100 -48 143.25 FORMAT "%5.1" ECU_ADDRESS 0x7FD605 /end MEASUREMENT
/begin MEASUREMENT te_mx "" UWORD t8p0usxms 1 100 0 524.28 FORMAT "%8.4" ECU_ADDRESS 0x7FE1AA /end MEASUREMENT
/begin MEASUREMENT tfbyp "" UBYTE zk10msxs_ub_b2p56 1 100 0.0100392 2.56 FORMAT "%5.3" ECU_ADDRESS 0x7FD907 /end MEASUREMENT
/begin MEASUREMENT tfdmbyps "" UBYTE zk10msxs_ub_b2p56 1 100 0.0100392 2.56 FORMAT "%5.3" ECU_ADDRESS 0x7FD908 /end MEASUREMENT
/begin MEASUREMENT tfdmbyps2 "" UBYTE zk10msxs_ub_b2p56 1 100 0.0100392 2.56 FORMAT "%5.3" ECU_ADDRESS 0x7FD909 /end MEASUREMENT
/begin MEASUREMENT tfwdks_w "Zeitkonstante f¸r wdks Filterung" UWORD zk10msxs_uw_b655 1 100 0.0100002 655.36 FORMAT "%10.6" ECU_ADDRESS 0x7FDC50 /end MEASUREMENT
/begin MEASUREMENT tmfln_w "Meﬂfensterl‰nge Klopfregelung Nulltest" UWORD tus_uw_q3p2 1 100 0 209712 FORMAT "%8.1" ECU_ADDRESS 0x7FDD68 /end MEASUREMENT
/begin MEASUREMENT tmfl_w "Meﬂfensterl‰nge Klopfregelung" UWORD tus_uw_q3p2 1 100 0 209712 FORMAT "%8.1" ECU_ADDRESS 0x7FDD6A /end MEASUREMENT
/begin MEASUREMENT tmlauf_w "Motorlaufzeit vor dem Abstellen" UWORD t100msxs_uw_b6553p6 1 100 0 6553.5 FORMAT "%8.3" ECU_ADDRESS 0x7F9BC2 /end MEASUREMENT
/begin MEASUREMENT tn2 "Segmentzeit pro Z¸ndung" UWORD tus_uw_q3p2 1 100 0 209712 FORMAT "%8.1" ECU_ADDRESS 0x7FD62A /end MEASUREMENT
/begin MEASUREMENT toel "" UBYTE temp_ub_q0p75_o48 1 100 -48 143.25 FORMAT "%5.1" ECU_ADDRESS 0x7FD958 /end MEASUREMENT
/begin MEASUREMENT tpnt_aktiv "Aktivierung von KR-Funktionen" UBYTE dez 1 100 0 255 FORMAT "%5.1" ECU_ADDRESS 0x7FD96C /end MEASUREMENT
/begin MEASUREMENT Tstesuk "" UBYTE default 1 100 0 255 FORMAT "%5.1" ECU_ADDRESS 0x7FD5BC /end MEASUREMENT
/begin MEASUREMENT tstlauf_w "Zeit seit B_st auf 1" UWORD t100msxs_uw_b6553p6 1 100 0 6553.5 FORMAT "%8.3" ECU_ADDRESS 0x7FDCA6 /end MEASUREMENT
/begin MEASUREMENT uadki "eingelesener Integratorwert von Klopfauswerteschaltung" UBYTE dez 1 100 0 255 FORMAT "%5.1" ECU_ADDRESS 0x7FD628 /end MEASUREMENT
/begin MEASUREMENT udkp1mx_w "" UWORD spg_uw_q0p001222 1 100 0 80.0838 FORMAT "%8.5" ECU_ADDRESS 0x7F9C10 /end MEASUREMENT
/begin MEASUREMENT uganga "Adaptionswerte Array fuer alle Gaenge" UBYTE spg_ub_b5 1 100 0 4.98047 FORMAT "%5.3" ARRAY_SIZE 7 ECU_ADDRESS 0x7F9CB8 /end MEASUREMENT
/begin MEASUREMENT usbev2_w "" UWORD spg_uw_q0p00488_o1 1 100 -1 318.995 FORMAT "%8.4" ECU_ADDRESS 0x7FDD78 /end MEASUREMENT
/begin MEASUREMENT usbev_w "" UWORD spg_uw_q0p00488_o1 1 100 -1 318.995 FORMAT "%8.4" ECU_ADDRESS 0x7FDD7A /end MEASUREMENT
/begin MEASUREMENT usobv2_w "" UWORD spg_uw_q0p00488_o1 1 100 -1 318.995 FORMAT "%8.4" ECU_ADDRESS 0x7FDD7C /end MEASUREMENT
/begin MEASUREMENT usobv_w "" UWORD spg_uw_q0p00488_o1 1 100 -1 318.995 FORMAT "%8.4" ECU_ADDRESS 0x7FDD7E /end MEASUREMENT
/begin MEASUREMENT usvb2_w "" UWORD spg_uw_q0p00488_o1 1 100 -1 318.995 FORMAT "%8.4" ECU_ADDRESS 0x7FDD80 /end MEASUREMENT
/begin MEASUREMENT usvb_w "" UWORD spg_uw_q0p00488_o1 1 100 -1 318.995 FORMAT "%8.4" ECU_ADDRESS 0x7FDD82 /end MEASUREMENT
/begin MEASUREMENT usvk "Spannung Lambdasonde vor Kat" UBYTE spg_ub_q0p0052_o0p2 1 100 -0.2 1.13 FORMAT "%5.3" ECU_ADDRESS 0x7FD972 /end MEASUREMENT
/begin MEASUREMENT usvk2 "Spannung Lambdasonde vor Kat 2" UBYTE spg_ub_q0p0052_o0p2 1 100 -0.2 1.13 FORMAT "%5.3" ECU_ADDRESS 0x7FD973 /end MEASUREMENT
/begin MEASUREMENT usvk2_w "" UWORD spg_uw_q0p00488_o1 1 100 -1 318.995 FORMAT "%8.4" ECU_ADDRESS 0x7FDD84 /end MEASUREMENT
/begin MEASUREMENT usvkr2_w "" UWORD spg_uw_q0p00488_o1 1 100 -1 318.995 FORMAT "%8.4" ECU_ADDRESS 0x7FDD86 /end MEASUREMENT
/begin MEASUREMENT usvkr_w "" UWORD spg_uw_q0p00488_o1 1 100 -1 318.995 FORMAT "%8.4" ECU_ADDRESS 0x7FDD88 /end MEASUREMENT
/begin MEASUREMENT usvk_w "" UWORD spg_uw_q0p00488_o1 1 100 -1 318.995 FORMAT "%8.4" ECU_ADDRESS 0x7FDD8A /end MEASUREMENT
/begin MEASUREMENT usvmb2_w "" UWORD spg_uw_q0p00488_o1 1 100 -1 318.995 FORMAT "%8.4" ECU_ADDRESS 0x7FDD8C /end MEASUREMENT
/begin MEASUREMENT usvmb_w "" UWORD spg_uw_q0p00488_o1 1 100 -1 318.995 FORMAT "%8.4" ECU_ADDRESS 0x7FDD8E /end MEASUREMENT
/begin MEASUREMENT usvob2_w "" UWORD spg_uw_q0p00488_o1 1 100 -1 318.995 FORMAT "%8.4" ECU_ADDRESS 0x7FDD90 /end MEASUREMENT
/begin MEASUREMENT usvob_w "" UWORD spg_uw_q0p00488_o1 1 100 -1 318.995 FORMAT "%8.4" ECU_ADDRESS 0x7FDD92 /end MEASUREMENT
/begin MEASUREMENT uusvmb2_w "Spannung (word, 1 ms-Raster) Lambdasonde mit Widerstand belastet vor KAT Bank2" UWORD spg_uw_q0p00488 1 100 0 319.995 FORMAT "%8.4" ECU_ADDRESS 0x7FDD94 /end MEASUREMENT
/begin MEASUREMENT uusvmb_w "Spannung (word, 1 ms-Raster) Lambdasonde mit Widerstand belastet vor KAT" UWORD spg_uw_q0p00488 1 100 0 319.995 FORMAT "%8.4" ECU_ADDRESS 0x7FDD96 /end MEASUREMENT
/begin MEASUREMENT uusvob2_w "ADC-Spannung (word, 1 ms-Raster) Sonde ohne Belastung vor Katalysator Bank2" UWORD spg_uw_q0p00488 1 100 0 319.995 FORMAT "%8.4" ECU_ADDRESS 0x7FDD98 /end MEASUREMENT
/begin MEASUREMENT uusvob_w "ADC-Spannung (word, 1 ms-Raster) Sonde ohne Belastung vor Katalysator" UWORD spg_uw_q0p00488 1 100 0 319.995 FORMAT "%8.4" ECU_ADDRESS 0x7FDD9A /end MEASUREMENT
/begin MEASUREMENT wdkba "Drosselklappenwinkel bezogen auf unteren Anschlag" UBYTE relDK_ub_b100 1 100 0 100 FORMAT "%5.1" ECU_ADDRESS 0x7FD956 /end MEASUREMENT
/begin MEASUREMENT wdkbab10_w "" UWORD rel_uw_b100 1 100 0 99.9985 FORMAT "%8.5" ECU_ADDRESS 0x7FDCE0 /end MEASUREMENT
/begin MEASUREMENT wdkbap_w "fuer Einspritzung praedizierter Drosselklappenwinkel (Word)" UWORD rel_uw_b100 1 100 0 99.9985 FORMAT "%8.5" ECU_ADDRESS 0x7FDD5E /end MEASUREMENT
/begin MEASUREMENT wdkba_w "Drosselklappenwinkel bezogen auf unteren Anschlag" SWORD relDK_q0p02441 1 100 -800 799.976 FORMAT "%8.4" ECU_ADDRESS 0x7FBCEC /end MEASUREMENT
/begin MEASUREMENT wdks "Sollwert DK-Winkel, bezogen auf unteren Anschlag" UBYTE rel_ub_b99p6 1 100 0 99.6094 FORMAT "%5.2" ECU_ADDRESS 0x7FD90F /end MEASUREMENT
/begin MEASUREMENT wdksgv_w "" UWORD rel_uw_b100 1 100 0 99.9985 FORMAT "%8.5" ECU_ADDRESS 0x7FDC52 /end MEASUREMENT
/begin MEASUREMENT wdksp_w "Pr‰dizierter Drosselklappen-Sollwinkel" UWORD rel_uw_b100 1 100 0 99.9985 FORMAT "%8.5" ECU_ADDRESS 0x7FDC54 /end MEASUREMENT
/begin MEASUREMENT wdksv_w "Drosselklappen-Sollwinkel vor Applikationsschnittstelle (ungefiltert)" UWORD rel_uw_b100 1 100 0 99.9985 FORMAT "%8.5" ECU_ADDRESS 0x7FDC56 /end MEASUREMENT
/begin MEASUREMENT wdks_w "Sollwert Drosselklappenwinkel, bezogen auf (unteren) Anschlag" UWORD rel_uw_b100 1 100 0 99.9985 FORMAT "%8.5" ECU_ADDRESS 0x7FDC58 /end MEASUREMENT
/begin MEASUREMENT wdkugd_w "Drosselklappenwinkel, bei dem 95% F¸llung erreicht wird" UWORD rel_uw_b100 1 100 0 99.9985 FORMAT "%8.5" ECU_ADDRESS 0x7FDC5A /end MEASUREMENT
/begin MEASUREMENT wea "Winkelmarke Einspritzabbruch" UBYTE kw_q3 1 100 0 765 FORMAT "%5.1" ECU_ADDRESS 0x7FD825 /end MEASUREMENT
/begin MEASUREMENT weemrfa "Winkel Einspritzende im maximalem Fahrerwunschmomment" UBYTE kw_q3 1 100 0 765 FORMAT "%5.1" ECU_ADDRESS 0x7FD5D2 /end MEASUREMENT
/begin MEASUREMENT wf_w "Wandfilmmenge" SWORD rel_sw_q0p1875 1 100 -6144 6143.81 FORMAT "%8.3" ECU_ADDRESS 0x7FDCE2 /end MEASUREMENT
/begin MEASUREMENT whstt "Rover" UBYTE fak_ub_b2 1 100 0 1.99219 FORMAT "%5.3" ECU_ADDRESS 0x7FD936 /end MEASUREMENT
/begin MEASUREMENT wkstn "Rover" UBYTE fak_ub_b1 1 100 0 0.996094 ECU_ADDRESS 0x7FD937 /end MEASUREMENT
/begin MEASUREMENT wkstt "Rover" UBYTE fak_ub_b2 1 100 0 1.99219 FORMAT "%5.3" ECU_ADDRESS 0x7FD938 /end MEASUREMENT
/begin MEASUREMENT wmfa "Meﬂfensteranfang in Grad Kurbelwinkel" UBYTE zw_ub_q0p75 1 100 0 191.25 FORMAT "%5.1" ECU_ADDRESS 0x7FD96D /end MEASUREMENT
/begin MEASUREMENT wmfa_new "Meﬂfensteranfang: aktueller Wert aus KL/KF" UBYTE zw_ub_q0p75 1 100 0 191.25 FORMAT "%5.1" ECU_ADDRESS 0x7FD96E /end MEASUREMENT
/begin MEASUREMENT wmfl "Meﬂfensterl‰nge in Grad Kurbelwinkel" UBYTE zw_ub_q0p75 1 100 0 191.25 FORMAT "%5.1" ECU_ADDRESS 0x7FD96F /end MEASUREMENT
/begin MEASUREMENT wmfl_new "Meﬂfensterl‰nge KR: aktueller WErt aus KL/KF" UBYTE zw_ub_q0p75 1 100 0 191.25 FORMAT "%5.1" ECU_ADDRESS 0x7FD970 /end MEASUREMENT
/begin MEASUREMENT wped "Normierter Fahrpedalwinkel" UBYTE relPED_ub_b100 1 100 0 100 FORMAT "%5.1" ECU_ADDRESS 0x7FD957 /end MEASUREMENT
/begin MEASUREMENT wped_w "Normierter Fahrpedalwinkel" UWORD relPED_uw_b100 1 100 0 100 FORMAT "%8.4" ECU_ADDRESS 0x7FDD60 /end MEASUREMENT
/begin MEASUREMENT wvesp "Vorlagerungswinkel Einspritzung im Start und bei Normalbetrieb" UBYTE kw_q3 1 100 0 765 FORMAT "%5.1" ECU_ADDRESS 0x7FD826 /end MEASUREMENT
/begin MEASUREMENT wvespnst "Vorlagerungswinkel Einspritzung im Normalbetrieb" UBYTE kw_q3 1 100 0 765 FORMAT "%5.1" ECU_ADDRESS 0x7FD5D3 /end MEASUREMENT
/begin MEASUREMENT wvespst "Vorlagerungswinkel Einspritzung im Start" UBYTE kw_q3 1 100 0 765 FORMAT "%5.1" ECU_ADDRESS 0x7FD5D4 /end MEASUREMENT
/begin MEASUREMENT wwns "Rover" UBYTE fak_ub_b2 1 100 0 1.99219 FORMAT "%5.3" ECU_ADDRESS 0x7FD92D /end MEASUREMENT
/begin MEASUREMENT zanssa "Rover" UBYTE fak_ub_b0p25 1 100 0 0.249023 FORMAT "%11.9" ECU_ADDRESS 0x7FD92E /end MEASUREMENT
/begin MEASUREMENT zanssm "" UBYTE fak_ub_b0p25 1 100 0 0.249023 FORMAT "%11.9" ECU_ADDRESS 0x7FD92F /end MEASUREMENT
/begin MEASUREMENT zbale "Abregelfaktor Langzeitanteil bei BA" UBYTE fak_ub_b0p125 1 100 0 0.124512 FORMAT "%6.4" ECU_ADDRESS 0x7FD5BD /end MEASUREMENT
/begin MEASUREMENT zriberv "" UBYTE dez 1 100 0 255 FORMAT "%5.1" ECU_ADDRESS 0x7FD974 /end MEASUREMENT
/begin MEASUREMENT zriberv2 "" UBYTE dez 1 100 0 255 FORMAT "%5.1" ECU_ADDRESS 0x7FD975 /end MEASUREMENT
/begin MEASUREMENT zrinv2_w "" UWORD t100msxs_uw_b6553p5 1 100 0 6553.5 FORMAT "%8.3" ECU_ADDRESS 0x7FDD9C /end MEASUREMENT
/begin MEASUREMENT zrinv_w "" UWORD t100msxs_uw_b6553p5 1 100 0 6553.5 FORMAT "%8.3" ECU_ADDRESS 0x7FDD9E /end MEASUREMENT
/begin MEASUREMENT ztpnt_a "KR: Z‰hler f¸r die Freigabe von Nulltest oder Testimpuls" UBYTE dez 1 100 0 255 FORMAT "%5.1" ECU_ADDRESS 0x7FD971 /end MEASUREMENT
/begin MEASUREMENT zvale "Abregelfaktor Langzeitanteil bei VA" UBYTE fak_ub_b0p125 1 100 0 0.124512 FORMAT "%6.4" ECU_ADDRESS 0x7FD5BE /end MEASUREMENT
/begin MEASUREMENT zzylkr "Zylinderz‰hler f¸r die KR" UBYTE dez 1 100 0 255 FORMAT "%5.1" ECU_ADDRESS 0x7FBCC8 /end MEASUREMENT
/begin FUNCTION ESGRU "Grundeinspritzungen" /begin DEF_CHARACTERISTIC FRHOKRST FRKAP KFLF KFLFWDK /end DEF_CHARACTERISTIC /begin REF_CHARACTERISTIC /end REF_CHARACTERISTIC /begin IN_MEASUREMENT nmot nmotseg rl tkrst vsfrk wdkba /end IN_MEASUREMENT /begin OUT_MEASUREMENT fgru /end OUT_MEASUREMENT /begin LOC_MEASUREMENT /end LOC_MEASUREMENT /begin SUB_FUNCTION /end SUB_FUNCTION /end FUNCTION
/begin FUNCTION ESNST "Einspritzung Nachstart"
 /begin DEF_CHARACTERISTIC ANZTIBMX FNSA FNSHO FNSSM FWSTAA1 FWSTAA2 FWSTAA3 FWSTAA4 FZANSSA1 FZANSSA2 FZANSSM1 FZANSSM2 KFLANS KFNSWRL KFWWNS SZANSSM ZDGZA1 ZDGZA2 /end DEF_CHARACTERISTIC
 /begin REF_CHARACTERISTIC SAN12ESUW SKS06ESUB STA06ESUB STSZYL12ESUB /end REF_CHARACTERISTIC
 /begin IN_MEASUREMENT anzti_w B_hst B_st B_staa B_stend B_wks ESSTTbits esst_san12esuw esst_sks06esub esst_sta06esub esst_stszyl12esub fho kstaa rl rl_w tabst_w tans tmst tmstzyl_w /end IN_MEASUREMENT
 /begin OUT_MEASUREMENT anztib_w B_decay2 B_lamnse fktns0_w fktns1_w fns fnsa0 fnsho0 fnssm0 fwnssm_w lamns_w lans_w nswrl szanssm0 wwns zanssa zanssm /end OUT_MEASUREMENT
 /begin LOC_MEASUREMENT fktns fzans1 fzans2 nsactr nsactr1 nsactr2 /end LOC_MEASUREMENT
 /begin SUB_FUNCTION /end SUB_FUNCTION
/end FUNCTION
/begin FUNCTION ESSTT "Einspritzzeit Start"
 /begin DEF_CHARACTERISTIC ANZTIWS CWESSTT FHSTT FKSTT FSTHO IMLHS KFFWST KFWHSTT KFWKSTN KFWKSTT KLFWST TANDT TMH TMHSG /end DEF_CHARACTERISTIC
 /begin REF_CHARACTERISTIC /end REF_CHARACTERISTIC
 /begin IN_MEASUREMENT anzti_w B_adpini B_st B_stend fho imlatm kstaa nmotseg tabst_w tabzyl_w tans tansab tistzyl tmstzyl_w tnse_w zzyl /end IN_MEASUREMENT
 /begin OUT_MEASUREMENT B_hst B_vbemg B_wks B_wst ESSTTbits fkstt0 fst_w fwst fwst0_w fwst1 hsst_w hstt0 tandt0 tmlauf_w whstt wkstn wkstt /end OUT_MEASUREMENT
 /begin LOC_MEASUREMENT anztist B_vbmg fst0_w tstlauf_w /end LOC_MEASUREMENT
 /begin SUB_FUNCTION /end SUB_FUNCTION
/end FUNCTION
/begin FUNCTION ESUK "Einspritzung ‹bergangskompensation"
 /begin DEF_CHARACTERISTIC CW_ESUKDK DRKUKTHR DRLTOTDK DRLTOTDKLL DUKK DWFK_THR DWPNEGWF DWPPOSWF FUKE FUKNSTM FVANST FWFN KFABAK KFAKBDK KFAKTDK KFAKVDK KFAVAK KFBAKL KFFAKRLDK KFVAKL KFWFRLDWE KLAKWDK RKAKDKEMN RKAKDKEMX RKAKDKGMN RKAKDKGMX RKBAUM RKUKKLU RKVAUM SW_WPEDRL TNSUUK WFRL ZBALM ZKRLSOLDK ZUKE ZUKK ZUKNST ZVALM /end DEF_CHARACTERISTIC
 /begin REF_CHARACTERISTIC KFMSNWDK SNM07ESUB STMZYL09ESUW /end REF_CHARACTERISTIC
 /begin IN_MEASUREMENT anzti B_ll B_nswo2 B_sa B_st B_stend drlp_w dwped_w esst_snm07esub esst_stmzyl09esuw frhodk_w fukaba_w fukava_w gangi msndko_w nmot nmot_w rl rlp_w rlsol_w rl_w tans tmotzyl_w tmstzyl_w umsrln_w wdkba_w wdkugd_w /end IN_MEASUREMENT
 /begin OUT_MEASUREMENT B_ba B_bag B_dwfk B_esukdk10 B_timesync_out B_ukg B_va B_vag dwfroh dwf_w dwped_tmp rkakdk_o_w rkakdk_w rkukg10_w rkukg_w rkukk_w Tstesuk /end OUT_MEASUREMENT
 /begin LOC_MEASUREMENT abak anztis avak betrag_w B_redkl B_uk1 B_uke B_ukns B_vaau B_vakl B_val B_wf ddrkakdk_w drkakdk_w drkuke_w drlsoldk_seg drlsoldk_w dwfk_w dwfl_w fbakl_w fbans fbans_w fbavst_w fukkl_w fvakl_w fvans fvavst_w klakwdk_aus msdk10ms_w msndk10_w rkuke_w rkukkl_w rkukl_w rkuk_w rldkw_w rlsolfdk_w rlwped10_w sdwfk_w sdwfl_w wdkbab10_w wf_w zbale zvale /end LOC_MEASUREMENT
 /begin SUB_FUNCTION /end SUB_FUNCTION
/end FUNCTION
/begin FUNCTION ESUKA ""
 /begin DEF_CHARACTERISTIC ABAOVMX AMNUUKA ASPUUKA AVAOVMX CUKA DFRBAF DFRBAM DFRVAF DFRVAM DPSUKAO DRLSPMN FUKABAKI FUKABAKO FUKABAKU FUKABAWI FUKABAWO FUKABAWU FUKAVAKI FUKAVAKO FUKAVAKU FUKAVAWI FUKAVAWO FUKAVAWU NUKAO NUKAU RLUKAU TMUKAK TMUKAU TMUKAW TNSUUKA ZFUKA /end DEF_CHARACTERISTIC
 /begin REF_CHARACTERISTIC CW_TZYL /end REF_CHARACTERISTIC
 /begin IN_MEASUREMENT B_adpini B_dfrf B_dfrf2 B_dfrm B_dfrm2 B_ffuerfse B_ffuest B_fkvs B_flamad B_fosb B_frmax B_frmax2 B_frmin B_frmin2 B_ftev B_lr B_lr2 B_lrsp B_lrsp2 B_nswo1 B_te B_tehb dfrsp2_w dfrsp_w dfrst2_w dfrst_w E_akle E_llr E_ph E_slv E_tm E_TZYL1 E_TZYL2 nmot psmx_w ps_w rl tmotzyl_w tnst_w /end IN_MEASUREMENT
 /begin OUT_MEASUREMENT fukaba_w fukava_w /end OUT_MEASUREMENT
 /begin LOC_MEASUREMENT abaov abaov2 ainkba ainkva aspuka aspuka2 avaov avaov2 B_amnuka B_amnuka2 B_cfukaba B_cfukava B_dfukaba B_dfukava B_ifukaba B_ifukava B_uka B_uka2 B_ukab B_ukaba B_ukaba2 B_ukabaf B_ukabaf2 B_ukabah B_ukabal B_ukabam B_ukabam2 B_ukadba B_ukadba2 B_ukadva B_ukadva2 B_ukaiba B_ukaiba2 B_ukaiva B_ukaiva2 B_ukat B_ukava B_ukava2 B_ukavaf B_ukavaf2 B_ukavah B_ukaval B_ukavam B_ukavam2 drlsp drlsp2 fukabak_w fukabaw_w fukavak_w fukavaw_w psukao_w rlsp rlsp2 /end LOC_MEASUREMENT
 /begin SUB_FUNCTION /end SUB_FUNCTION
/end FUNCTION
/begin FUNCTION ESVW "ESVW.     Einspritzung: Berechnung der Vorlagerungswinkel"
 /begin DEF_CHARACTERISTIC CWESVW DWEEMX KFWEE KFWEEGD WEAN WEANST WEEM WEEMGD WEEMRFAN WEESTM WEESTN /end DEF_CHARACTERISTIC
 /begin REF_CHARACTERISTIC SNM08GKUB SRL08GKUB /end REF_CHARACTERISTIC
 /begin IN_MEASUREMENT B_stend B_vl dpsfak esst_snm08gkub esst_srl08gkub nmot rl tmotzyl_w vsvw /end IN_MEASUREMENT
 /begin OUT_MEASUREMENT B_esbnb B_esbst esvw_bit wea wvesp /end OUT_MEASUREMENT
 /begin LOC_MEASUREMENT weemrfa wvespnst wvespst /end LOC_MEASUREMENT
 /begin SUB_FUNCTION /end SUB_FUNCTION
/end FUNCTION
/begin FUNCTION ESWE "Einspritzung Schubabschalten Wiedereinsetzen" /begin DEF_CHARACTERISTIC FIMFMU FIMHU FIMWU NGFM /end DEF_CHARACTERISTIC /begin REF_CHARACTERISTIC /end REF_CHARACTERISTIC /begin IN_MEASUREMENT anzti B_ll B_sa ES_kupp ngfil_w /end IN_MEASUREMENT /begin OUT_MEASUREMENT fwe /end OUT_MEASUREMENT /begin LOC_MEASUREMENT anzwefim azylwe B_afwe B_fwe /end LOC_MEASUREMENT /begin SUB_FUNCTION /end SUB_FUNCTION /end FUNCTION
/begin FUNCTION ESWL "Einspritzung Warmlauf"
 /begin DEF_CHARACTERISTIC ATISLATM ATIWKSTM CWWL DLAMNSWL KFFWL KFFWLW KFLASWLR LASWLTM ZKLANSWL /end DEF_CHARACTERISTIC
 /begin REF_CHARACTERISTIC STMZYL12ESUB STSZYL12ESUB /end REF_CHARACTERISTIC
 /begin IN_MEASUREMENT anztib_w B_lrnda B_lrnda2 B_stend B_wks esst_stmzyl12esub esst_stmzyl1_12esub esst_stmzyl2_12esub esst_stszyl12esub esst_stszyl1_12esub esst_stszyl2_12esub lamns_w nmotseg rl tmotzyl_w tmstzyl_w /end IN_MEASUREMENT
 /begin OUT_MEASUREMENT atislatm_w atiwkstm_w fwl fwl0 fwl02 fwl1 fwl12 fwl2 fwlw lamnswl_w laswlr /end OUT_MEASUREMENT
 /begin LOC_MEASUREMENT B_lawlon lamwl_w /end LOC_MEASUREMENT
 /begin SUB_FUNCTION /end SUB_FUNCTION
/end FUNCTION
/begin FUNCTION ETR "Elektrische Thermostatregelung"
 /begin DEF_CHARACTERISTIC DTANSETR DTMETR DVFZETR KFETRD KFETRT TAETRMN TVETRA TVETRE TWETRS VFZETR /end DEF_CHARACTERISTIC
 /begin REF_CHARACTERISTIC /end REF_CHARACTERISTIC
 /begin IN_MEASUREMENT B_etret B_faetr B_got B_ntkw B_vl tans tmot vfzg wdkba /end IN_MEASUREMENT
 /begin OUT_MEASUREMENT B_etr /end OUT_MEASUREMENT
 /begin LOC_MEASUREMENT B_etrtam B_etrvfzg /end LOC_MEASUREMENT
 /begin SUB_FUNCTION /end SUB_FUNCTION
/end FUNCTION
/begin FUNCTION EWS "" /begin DEF_CHARACTERISTIC KW_UbEwsMin /end DEF_CHARACTERISTIC
 /begin REF_CHARACTERISTIC DEFAULT_PAGE3 DEFAULT_SK_H DEFAULT_SK_L EWS_ABIC_COM_TIME_SND EWS_ABIC_COM_TIME_SND_RCV EWS_PAGE0_GSS EWS_PAGE1_ANT_OFF EWS_PAGE1_ANT_ON EWS_PAGE2_FSS1 EWS_PAGE2_FSS2 EWS_PAGE2_FSS3 EWS_PAGE2_FSS4 EWS_PAGE2_GSS EWS_PAGE3_GSS EWS_T_OFFSET /end REF_CHARACTERISTIC
 /begin IN_MEASUREMENT B_sysbts B_zdgbts ES_kill EWS_ABICPage0 EWS_ABICPage1 EWS_ABICPage2 EWS_ABICPage3 Ews_default_auth Ews_ID_found Ews_NS_auth /end IN_MEASUREMENT
 /begin OUT_MEASUREMENT B_lowvoltage Ews_active EWS_ActualTRSP_ID Ews_auth EWS_Auth_P3 EWS_ComTrspPage_State EWS_GSS_State EWS_inhibit EWS_KeyNo EWS_ReadPageInv_Data EWS_ReadPageNumber EWS_ReadPage_Data EWS_Retry_Counter EWS_Retry_Counter_max EWS_Retry_Counter_temp EWS_SendToTRSP_Counter EWS_Start_Init EWS_State EWS_State_off EWS_status EWS_status_temp EWS_TimeOutFlags EWS_TimeOut_Cnt EWS_TRSP_Auth_State Ews_TRSP_Mode Ews_Wait_State EWS_WritePageNumber EWS_WritePage_Data EWS_WriteToTRSP_State EWS_WriteTrspPage_State phase sampling_time /end OUT_MEASUREMENT
 /begin LOC_MEASUREMENT /end LOC_MEASUREMENT
 /begin SUB_FUNCTION /end SUB_FUNCTION
/end FUNCTION
/begin FUNCTION EWS_Diag "" /begin DEF_CHARACTERISTIC DEFAULT_PAGE3 DEFAULT_SK_H DEFAULT_SK_L MECH_SC_TRSP_INIT /end DEF_CHARACTERISTIC /begin REF_CHARACTERISTIC /end REF_CHARACTERISTIC
 /begin IN_MEASUREMENT debug_uw Ews_active Ews_auth EWS_Auth_P3 EWS_KeyNo EWS_status nmot /end IN_MEASUREMENT
 /begin OUT_MEASUREMENT EE_bdm_init Ews_default_auth Ews_Diag_Auth_done Ews_Diag_check_activ Ews_Diag_check_State Ews_Diag_FGNR_equal Ews_Diag_mSC_equal Ews_Diag_no_FGNR_ECU Ews_Diag_no_mSC_ECU Ews_D_Page4 Ews_D_Page5 Ews_D_Page6 Ews_D_Page7 EWS_GetID_activ EWS_GetID_State Ews_ID_found EWS_Init_activ EWS_Init_State EWS_mechSC_A EWS_mechSC_B Ews_NS_auth Ews_Prog_Day Ews_Prog_Mon Ews_Prog_Ort Ews_Prog_Year Ews_Trsp_fz_cnt Ews_trsp_init Fgstnummer KWP2000_Diag_Info pm_akt pm_fre pm_mod pm_ta pm_td rst_akt /end OUT_MEASUREMENT
 /begin LOC_MEASUREMENT /end LOC_MEASUREMENT
 /begin SUB_FUNCTION /end SUB_FUNCTION
/end FUNCTION
/begin FUNCTION FE "F¸llungseingriffe" /begin DEF_CHARACTERISTIC /end DEF_CHARACTERISTIC /begin REF_CHARACTERISTIC /end REF_CHARACTERISTIC /begin IN_MEASUREMENT fho_w rlsol_w /end IN_MEASUREMENT /begin OUT_MEASUREMENT rlshk /end OUT_MEASUREMENT /begin LOC_MEASUREMENT /end LOC_MEASUREMENT /begin SUB_FUNCTION /end SUB_FUNCTION /end FUNCTION
/begin FUNCTION FFZ "Folgefunkenz¸ndung" /begin DEF_CHARACTERISTIC CW_FFZ FFLDZ FFZOF KFFFANZ /end DEF_CHARACTERISTIC /begin REF_CHARACTERISTIC /end REF_CHARACTERISTIC /begin IN_MEASUREMENT B_stend nmot tmotzyl_w ub zwout /end IN_MEASUREMENT /begin OUT_MEASUREMENT B_ff ffzanz ffztld ffztof /end OUT_MEASUREMENT /begin LOC_MEASUREMENT /end LOC_MEASUREMENT /begin SUB_FUNCTION /end SUB_FUNCTION /end FUNCTION
/begin FUNCTION FMFS ""
 /begin DEF_CHARACTERISTIC FRPC_WARNFCTR FUEL_CORR INJ_QSTAT MAXINJANGPRD SQRT SQRT_QSTAT_PRES_DROP /end DEF_CHARACTERISTIC
 /begin REF_CHARACTERISTIC CWFRPC TEMIN /end REF_CHARACTERISTIC
 /begin IN_MEASUREMENT B_nmin frps_w nmot_w pses_w te2_w te_w /end IN_MEASUREMENT
 /begin OUT_MEASUREMENT actl_inj_fmf actl_inj_ratio B_lowr_wrn B_uppr_wrn fmf_lowr_wrn_thd fmf_uppr_wrn_thd frpc_corr full_opn_inj_fmf inj_pres_drop mn_inj_fmf mn_inj_ratio mx_inj_fmf mx_inj_ratio prd_btwn_injns rnge_inj_fmf sqrt_pres_drop te_mx /end OUT_MEASUREMENT
 /begin LOC_MEASUREMENT /end LOC_MEASUREMENT
 /begin SUB_FUNCTION /end SUB_FUNCTION
/end FUNCTION
/begin FUNCTION FRPC ""
 /begin DEF_CHARACTERISTIC CWFRPC FRPC_ACTIVE FRPC_CLP_FCTR FRPC_CLP_MN FRPC_CLP_MX FRPC_DUTY_LIM FRPC_I_MN FRPC_I_MX FRPC_I_TERM_INIT FRPC_KI FRPC_KP FRPC_OLP_FCTR FRPC_PERIOD FRPC_PMP_PFI_CHAR FRPC_PMP_V_CHAR FRPC_RSRVFCTR FRPSP_MN FRPSP_MX FRP_SETPOINT_FORCE FRP_SETPOINT_RAMP FRP_SETPOINT_RATE /end DEF_CHARACTERISTIC
 /begin REF_CHARACTERISTIC /end REF_CHARACTERISTIC
 /begin IN_MEASUREMENT actl_inj_fmf btduty_ekp B_btekp B_ekpein B_frps B_kl15 B_nmin B_sa B_stend ES_kill E_ekpe frpsf_w frps_w mn_inj_fmf mx_inj_fmf nmot_w rnge_inj_fmf ub_w /end IN_MEASUREMENT
 /begin OUT_MEASUREMENT B_dr_lowrlim B_dr_upprlim B_fmf2frpsp B_force_frpsp B_frpc_cl_enbl B_frpc_I_frzlowr B_frpc_I_frzuppr B_frpc_i_lowrlim B_frpc_I_reset B_frpc_I_run B_frpc_I_set B_frpc_i_upprlim B_rmp_frpsp fmf_lowr_thd fmf_uppr_thd frpc_clp_w frpc_ctrllr_status frpc_duty_w frpc_err_w frpc_i_residual frpc_i_term_w frpc_ol_pmp_currnt frpc_pmp_currnt frpc_prd_w frpc_p_term_w frpc_volt_corr frps_ss_prdict frp_setpoint /end OUT_MEASUREMENT
 /begin LOC_MEASUREMENT /end LOC_MEASUREMENT
 /begin SUB_FUNCTION /end SUB_FUNCTION
/end FUNCTION
/begin FUNCTION FRPS ""
 /begin DEF_CHARACTERISTIC FRPSFILT FRPSFILT2 FRPS_GRAD FRPS_MN FRPS_MX FRPS_OFST FRPS_STA FRPS_TD /end DEF_CHARACTERISTIC
 /begin REF_CHARACTERISTIC /end REF_CHARACTERISTIC
 /begin IN_MEASUREMENT B_pwf B_stend E_u5vg1 frps_ss_prdict nmot_w udsk_w /end IN_MEASUREMENT
 /begin OUT_MEASUREMENT B_frps frpsf_w frps_filt frps_meas frps_sta_tmr frps_td_tmr frps_w /end OUT_MEASUREMENT
 /begin LOC_MEASUREMENT /end LOC_MEASUREMENT
 /begin SUB_FUNCTION /end SUB_FUNCTION
/end FUNCTION
/begin FUNCTION FUEBYP ""
 /begin DEF_CHARACTERISTIC BYP1TEV BYPAMAX BYPAMIN BYPAPP BYPCORIMN BYPCORIMX BYPCORMN BYPCORMX BYPCORRAPP BYPILD BYPKLD BYPMBDNWDK BYPMBDTMOT BYPMLMX BYPMNNM BYPMSN BYPMWREF BYPMXNM BYPMXTM BYPMXWP BYPUGDNWDK BYPUGDTMOT CWBYP CW_BYPA CW_BYPUG10 DNSBYPOF FPBYPAPP KFAFBYP KLBYPGANGI NBYPMN TBYPA TBYPDML1 TBYPDML2 TBYWDKNMOT /end DEF_CHARACTERISTIC
 /begin REF_CHARACTERISTIC KUMSRL /end REF_CHARACTERISTIC
 /begin IN_MEASUREMENT bypist_w_a B_ll B_lr B_lr2 B_lu_aktiv B_madll B_tep dns fho_w ftvdk gangi Lut_f msdk_w mste_w nmot nmot_w nsllmkl nsol rlsol_w tmot umsrln_w wdkba wdkba_w wped_w /end IN_MEASUREMENT
 /begin OUT_MEASUREMENT bypafilt_w bypaoff_w bypa_w bypg1v2_w bypg1v_w bypgv2_w bypgv_w bypistmw bypsolary bypsol_w dbyp_w mlbypcor_w mlbypso1_w mlbypso2_w mlbypsol_w /end OUT_MEASUREMENT
 /begin LOC_MEASUREMENT bypcorr bypcorr_i bypcorr_p bypugdn_w bypugdx_w bypv2_w bypv_w B_bypapp B_bypldon B_bypped B_ldon dmlbyps2_w dmlbyps_w fafbyp fthobyp fuebyperr mlbyp2_o_w mlbypns2_w mlbypns_w mlbyp_o_w tfbyp tfdmbyps tfdmbyps2 /end LOC_MEASUREMENT
 /begin SUB_FUNCTION /end SUB_FUNCTION
/end FUNCTION
/begin FUNCTION FUEDK "F¸llungssteuerung (Berechnung DK-Sollwinkel)"
 /begin DEF_CHARACTERISTIC CWRLSOL DPUPS FPWDKAPP FUEPMLD KFWDKMSN NRLMN TFUPI TFUPS TVWDKS TWDKSV WDKSAPP WDKUGDN /end DEF_CHARACTERISTIC
 /begin REF_CHARACTERISTIC KLAF KUMSRL /end REF_CHARACTERISTIC
 /begin IN_MEASUREMENT B_fpwdkap B_pwf B_wdksap dpdk drlfue_w esst_snm12feub fho fkmsdk_w frhodk_w ftvdk fupsrl_w klaf_kge lditv milsol_w mrfuemx_w mrfue_w msndko_w mste_w nmot nmot_w pdpld pirg_w pspvdk_w pu_w pvdk_w rfagr_w rlsol_w rl_w umsrln_w wped_w /end IN_MEASUREMENT
 /begin OUT_MEASUREMENT B_ugd dpsfak dwdks_w exwinks_w mlsol_w plsol plsol_w pssol_w pvdkr_w rlvw_w wdks wdksp_w wdksv_w wdks_w wdkugd_w /end OUT_MEASUREMENT
 /begin LOC_MEASUREMENT B_ldrugd B_ugdb B_ugds B_ugdset frhodkr_w mldkns_w mldks_w mlwdkns_w pspvmin_w psspvdk_w rlsolk_w tfwdks_w wdksgv_w /end LOC_MEASUREMENT
 /begin SUB_FUNCTION /end SUB_FUNCTION
/end FUNCTION
/begin FUNCTION FUEREG "1.20" /begin DEF_CHARACTERISTIC ILMRMN ILMRMX ILMRN PLMRN /end DEF_CHARACTERISTIC /begin REF_CHARACTERISTIC SNM08FEUB /end REF_CHARACTERISTIC /begin IN_MEASUREMENT B_stend B_ugd esst_snm08feub nmot rlsol_w rl_w /end IN_MEASUREMENT /begin OUT_MEASUREMENT drlfue_w /end OUT_MEASUREMENT /begin LOC_MEASUREMENT B_furena drlm_w /end LOC_MEASUREMENT /begin SUB_FUNCTION /end SUB_FUNCTION /end FUNCTION
/begin FUNCTION GANGADP "" /begin DEF_CHARACTERISTIC SDUGETRG SUGTRADP TDUGANGRS TDUGETRADP /end DEF_CHARACTERISTIC /begin REF_CHARACTERISTIC FANGGANG_A UGANG /end REF_CHARACTERISTIC
 /begin IN_MEASUREMENT B_adpini B_gangat B_kl15 B_neutral B_nmot gangi ugetrg vfzg_w /end IN_MEASUREMENT
 /begin OUT_MEASUREMENT B_dtugetrg B_frgadp B_ugetrad B_ugetrad1 B_ugetrad2 B_ugetrad3 B_ugetrad4 B_ugetrad5 B_ugetrad6 B_ugetradN B_ugetrgad uganga /end OUT_MEASUREMENT
 /begin LOC_MEASUREMENT /end LOC_MEASUREMENT
 /begin SUB_FUNCTION /end SUB_FUNCTION
/end FUNCTION
/begin FUNCTION ggairb "Gebergrˆﬂe Airbag" /begin DEF_CHARACTERISTIC TCEKP /end DEF_CHARACTERISTIC /begin REF_CHARACTERISTIC /end REF_CHARACTERISTIC /begin IN_MEASUREMENT B_nmot ekpausc /end IN_MEASUREMENT /begin OUT_MEASUREMENT B_airbag /end OUT_MEASUREMENT /begin LOC_MEASUREMENT /end LOC_MEASUREMENT /begin SUB_FUNCTION /end SUB_FUNCTION /end FUNCTION
/begin FUNCTION GGDKP ""
 /begin DEF_CHARACTERISTIC CWDKPADP DKADPCNTMX DSDKPA_MN DSDKPA_MX KFWDKNOT MAXWDKBA NDKPADO SJITT TDDKADP TDDKPADU TDDKPADWN TDDKPMXAD TEDK TMOTDKPFAD UDKP1NHUB UDKPADP_MN UDKPADP_MX UDKPAOFFS UDKPMXO UDKPMXU UDKP_MN UDKP_MX VDKPADO WDKBA_EW WDKFADPMX WDKGANG_EW WDKNOTGANG ZKDKA ZKDKAO ZKDKAT /end DEF_CHARACTERISTIC
 /begin REF_CHARACTERISTIC /end REF_CHARACTERISTIC
 /begin IN_MEASUREMENT B_adpini B_dkpt ES_kupp Ews_auth E_dkp E_dkpa E_u5vg3 gangi nmot nmot_w tmot udkp1_w udkpa_w vfzg vfzg_w /end IN_MEASUREMENT
 /begin OUT_MEASUREMENT B_dkpfado dkpadpcnt dwdkba_w udkp1mx_w wdkba wdkbap_w wdkba_w wped wped_w /end OUT_MEASUREMENT
 /begin LOC_MEASUREMENT /end LOC_MEASUREMENT
 /begin SUB_FUNCTION /end SUB_FUNCTION
/end FUNCTION
/begin FUNCTION GGDSAS "Gebergrˆﬂe Drucksensoren auﬂerhalb Saugrohr"
 /begin DEF_CHARACTERISTIC DPDSVLU DPUPVDK DSUGRAD DSUOFS FHOE NDSVLO NDSVLU NVGDSLL PUE PUMN PUMX PUSPSMX PVDKPUD TDDFU TDDFUUGD TDVGDSLL UADPUMN UADPUMX WDKDSVLU ZDSU /end DEF_CHARACTERISTIC
 /begin REF_CHARACTERISTIC /end REF_CHARACTERISTIC
 /begin IN_MEASUREMENT B_nmot ftu ml_w nmot plsol_w pspvdk_w pssol_w ps_w udsl_w udsu_w wdkba /end IN_MEASUREMENT
 /begin OUT_MEASUREMENT B_clradhoe B_edsl B_edsuu B_hag fho fho_w fpvdkds fpvdkds_w frhol_w GgdsasNvBits pu pus_w pu_w pvdkds pvdkds_w pvdkmx_w pvdksf_w pvdkspud pvdks_w /end OUT_MEASUREMENT
 /begin LOC_MEASUREMENT dpvdkspu_w fpvdkdsl_w fpvdkdsu_w ldfki_w psspvdkd_w pvdkdsl_w pvdkdsu_w /end LOC_MEASUREMENT
 /begin SUB_FUNCTION /end SUB_FUNCTION
/end FUNCTION
/begin FUNCTION GGEGAS "Gebergrˆﬂe Brems- und Kupplungsschalter" /begin DEF_CHARACTERISTIC CWGGEGAS TSTAEBR TVERBR TVKUP ZERBR /end DEF_CHARACTERISTIC /begin REF_CHARACTERISTIC /end REF_CHARACTERISTIC /begin IN_MEASUREMENT B_autget B_pwf S_bls S_brs S_kupp /end IN_MEASUREMENT /begin OUT_MEASUREMENT B_bl B_br B_br2k B_brems B_kuppl B_kupplv ctrerbr /end OUT_MEASUREMENT /begin LOC_MEASUREMENT B_erbr B_staebr /end LOC_MEASUREMENT /begin SUB_FUNCTION /end SUB_FUNCTION /end FUNCTION
/begin FUNCTION GGGANG ""
 /begin DEF_CHARACTERISTIC CW_asg FANGGANG_A GANGNP GANGRG GANGRGN IGANG MAXGANG NMOTGANG TDGANG TDHGANG TDHPLAUS TDPLAUS TUGETRGNP TUGETRGPL UGANG UGETRGMN UGETRGMX /end DEF_CHARACTERISTIC
 /begin REF_CHARACTERISTIC /end REF_CHARACTERISTIC
 /begin IN_MEASUREMENT B_frgASG B_ll B_ugetrgad ES_kupp gangi_bb gangi_poti gang_bcan gang_can nmot sfpu5vg2 uganga ugetrg /end IN_MEASUREMENT
 /begin OUT_MEASUREMENT B_gangnp B_ugetrger B_ugetrgmn B_ugetrgmx B_ugetrgnp frg_ASG gang gangcan ST_ugetrg /end OUT_MEASUREMENT
 /begin LOC_MEASUREMENT /end LOC_MEASUREMENT
 /begin SUB_FUNCTION /end SUB_FUNCTION
/end FUNCTION
/begin FUNCTION GGKS "Gebergrˆﬂe Klopfsensor"
 /begin DEF_CHARACTERISTIC DKROKD DKROKMX DKROKO FMFKRN1 FMFKRN2 FMFKRN3 FMFKRN4 FMFKRN5 FMFKRN6 FMFKRN7 FMFKRN8 KEMLN KFMAKR SENZZYL /end DEF_CHARACTERISTIC
 /begin REF_CHARACTERISTIC CWDKRTP KRANH KRFHT SNM16KRUB SRL04KRUB TMKR /end REF_CHARACTERISTIC
 /begin IN_MEASUREMENT B_kr B_krldy B_krndy B_krntfv B_krtpfv B_st B_stend B_tmkr common_rt esst_snm16krub esst_srl04krub kereffw nmot rl tmot tseg_l zzyl /end IN_MEASUREMENT
 /begin OUT_MEASUREMENT AS_bf0 AS_bf1 AS_bf2 AS_bf3 AS_g0 AS_g1 AS_g2 AS_ksa1 AS_ksa2 AS_ksa3 AS_kti B_c95bf0 B_c95bf1 B_c95bf2 B_c95bf3 B_c95ks3 B_dnt B_dntb B_dtp B_dtpb B_dummy B_fmfkrc B_fmfkrco B_fmfkrcu B_krmfok B_ntini B_tpnt_aw B_tpnt_e fmfkrakt fmfkraktne ggks_cc195_Bits igod_w igokr_w ikr ikrma ikrme ikrmen ikrmet ikr_tst iokkr krmf_start ks_sym runtime_mfa runtime_mfe sen_c95 tmfln_w tmfl_w tn2 tpnt_aktiv uadki wmfa wmfa_new wmfl wmfl_new ztpnt_a zzylkr /end OUT_MEASUREMENT
 /begin LOC_MEASUREMENT /end LOC_MEASUREMENT
 /begin SUB_FUNCTION /end SUB_FUNCTION
/end FUNCTION
/begin FUNCTION GGLSV ""
 /begin DEF_CHARACTERISTIC ANZRIBEV CWGGLSV DUSRIV DUSSPV FRINOF RBEL RINVMX RKSP TGGLS THSRIV TRIAKTV TRIIMPV TUSBELV USRIMINV USRIOV USRIUV ZFRIV /end DEF_CHARACTERISTIC
 /begin REF_CHARACTERISTIC /end REF_CHARACTERISTIC
 /begin IN_MEASUREMENT B_lsv B_lsv2 B_sa B_ttbmh B_ttbmh2 uusvk2_w uusvk_w /end IN_MEASUREMENT
 /begin OUT_MEASUREMENT B_pripv B_pripv2 B_rinv B_rinv2 B_ripuv B_ripuv2 B_svuerf B_svuerf2 rinofv2_w rinofv_w rinv2_w rinv_w usvb2_w usvb_w usvk usvk2 usvk2_w usvk_w uusvmb2_w uusvmb_w uusvob2_w uusvob_w /end OUT_MEASUREMENT
 /begin LOC_MEASUREMENT B_enrinv B_enrinv2 B_erinofv B_erinofv2 B_riakv B_riakv2 B_ribev B_ribev2 B_riibv B_riibv2 B_riimpv B_rimv B_rimv2 B_rirev B_rirev2 B_rispv B_rispv2 B_usbev B_usbev2 rinofva2_w rinofva_w usbev2_w usbev_w usobv2_w usobv_w usvkr2_w usvkr_w usvmb2_w usvmb_w usvob2_w usvob_w zriberv zriberv2 zrinv2_w zrinv_w /end LOC_MEASUREMENT
 /begin SUB_FUNCTION /end SUB_FUNCTION
/end FUNCTION
/begin FUNCTION GGOELNIV ""
 /begin DEF_CHARACTERISTIC CWDOELNIV CWVAROELN CW_TOEL OS_ENTP OS_TABST TDCLOELNIV TDOELNIV TMINOELNIV TMOTAB_MIN /end DEF_CHARACTERISTIC
 /begin REF_CHARACTERISTIC /end REF_CHARACTERISTIC
 /begin IN_MEASUREMENT A_anlasser B_kl15 B_ll B_nmot B_sa B_stend ES_oelniv ES_sst E_os E_tm tabst_w tmot tmotab /end IN_MEASUREMENT
 /begin OUT_MEASUREMENT B_los B_oelnll toel /end OUT_MEASUREMENT
 /begin LOC_MEASUREMENT /end LOC_MEASUREMENT
 /begin SUB_FUNCTION /end SUB_FUNCTION
/end FUNCTION
/begin FUNCTION GGTFA "Gebergrˆﬂe TFA Temperaturf¸hler Ansaugluft" /begin DEF_CHARACTERISTIC TADE TADMN TADMX TANSELI TDNSTA TDTA TDTAL ZFTANS /end DEF_CHARACTERISTIC /begin REF_CHARACTERISTIC /end REF_CHARACTERISTIC /begin IN_MEASUREMENT B_adpini B_ll B_sa B_stend wtans /end IN_MEASUREMENT /begin OUT_MEASUREMENT tans tansab tansabk_w tansk_w tanslin /end OUT_MEASUREMENT /begin LOC_MEASUREMENT /end LOC_MEASUREMENT /begin SUB_FUNCTION /end SUB_FUNCTION /end FUNCTION
/begin COMPU_METHOD apsec_q0p00078 "" RAT_FUNC "%6.5" "A/sec" COEFFS 0 32767 0 0 0 25.6 /end COMPU_METHOD
/begin COMPU_METHOD B_los "" TAB_VERB "%6.3" "" COMPU_TAB_REF B_los /end COMPU_METHOD
/begin COMPU_VTAB B_los "" TAB_VERB 4 0 "reserved" 1 "÷lstand in Ordnung" 2 "÷lstand zu gering" 3 "Signal ung¸ltig" /end COMPU_VTAB
/begin COMPU_METHOD B_SET "" TAB_VERB "%6.3" "" COMPU_TAB_REF B_SET /end COMPU_METHOD
/begin COMPU_VTAB B_SET "" TAB_VERB 2 0 "clear" 1 "SET" /end COMPU_VTAB
/begin COMPU_METHOD B_TRUE "" TAB_VERB "%6.3" "" COMPU_TAB_REF B_TRUE /end COMPU_METHOD
/begin COMPU_VTAB B_TRUE "" TAB_VERB 2 0 "false" 1 "TRUE" /end COMPU_VTAB
/begin COMPU_METHOD DEZ "" RAT_FUNC "%6.2" "" COEFFS 0 1 0 0 0 1 /end COMPU_METHOD
/begin COMPU_METHOD dez "" RAT_FUNC "%6.2" "" COEFFS 0 1 0 0 0 1 /end COMPU_METHOD
/begin COMPU_METHOD dezsub1 "" RAT_FUNC "%6.2" "-" COEFFS 0 1 -1 0 0 1 /end COMPU_METHOD
/begin COMPU_METHOD dgrad_uw_q0p015 "" RAT_FUNC "%6.4" "hPa/V" COEFFS 0 65536 0 0 0 1024 /end COMPU_METHOD
/begin COMPU_METHOD dgrad_uw_q0p031 "" RAT_FUNC "%6.4" "hPa/V" COEFFS 0 65536 0 0 0 2048 /end COMPU_METHOD
/begin COMPU_METHOD fak_sb_b1 "" RAT_FUNC "%6.4" "-" COEFFS 0 256 0 0 0 2 /end COMPU_METHOD
/begin COMPU_METHOD fak_sw_b1 "" RAT_FUNC "%7.6" "-" COEFFS 0 65536 0 0 0 2 /end COMPU_METHOD
/begin COMPU_METHOD fak_sw_b2 "" RAT_FUNC "%7.6" "-" COEFFS 0 65536 0 0 0 4 /end COMPU_METHOD
/begin COMPU_METHOD fak_sw_b256 "" RAT_FUNC "%6.4" "-" COEFFS 0 65536 0 0 0 512 /end COMPU_METHOD
/begin COMPU_METHOD fak_ub_b0p125 "" RAT_FUNC "%6.5" "-" COEFFS 0 256 0 0 0 0.125 /end COMPU_METHOD
/begin COMPU_METHOD fak_ub_b0p25 "" RAT_FUNC "%10.7" "-" COEFFS 0 256 0 0 0 0.25 /end COMPU_METHOD
/begin COMPU_METHOD fak_ub_b1 "" RAT_FUNC "%6.4" "-" COEFFS 0 256 0 0 0 1 /end COMPU_METHOD
/begin COMPU_METHOD fak_ub_b12p45 "" RAT_FUNC "%6.4" "%" COEFFS 0 2048 0 0 0 100 /end COMPU_METHOD
/begin COMPU_METHOD fak_ub_b16 "" RAT_FUNC "%6.4" "-" COEFFS 0 256 0 0 0 16 /end COMPU_METHOD
/begin COMPU_METHOD fak_ub_b1p25_o0p75 "" RAT_FUNC "%6.3" "-" COEFFS 0 1 -0.75 0 0 0.00195313 /end COMPU_METHOD
/begin COMPU_METHOD fak_ub_b2 "" RAT_FUNC "%6.4" "-" COEFFS 0 256 0 0 0 2 /end COMPU_METHOD
/begin COMPU_METHOD fak_ub_b4 "" RAT_FUNC "%6.4" "-" COEFFS 0 256 0 0 0 4 /end COMPU_METHOD
/begin COMPU_METHOD fak_ub_b64 "" RAT_FUNC "%6.3" "-" COEFFS 0 256 0 0 0 64 /end COMPU_METHOD
/begin COMPU_METHOD fak_ub_b8 "" RAT_FUNC "%6.4" "-" COEFFS 0 256 0 0 0 8 /end COMPU_METHOD
/begin COMPU_METHOD fak_ub_q0p00392 "" RAT_FUNC "%6.4" "-" COEFFS 0 255 0 0 0 1 /end COMPU_METHOD
/begin COMPU_METHOD fak_ub_q0p01 "" RAT_FUNC "%6.4" "-" COEFFS 0 1 0 0 0 0.01 /end COMPU_METHOD
/begin COMPU_METHOD fak_uw_b1 "" RAT_FUNC "%7.6" "-" COEFFS 0 65536 0 0 0 1 /end COMPU_METHOD
/begin COMPU_METHOD fak_uw_b1024 "" RAT_FUNC "%6.4" "-" COEFFS 0 65536 0 0 0 1024 /end COMPU_METHOD
/begin COMPU_METHOD fak_uw_b16 "" RAT_FUNC "%6.5" "-" COEFFS 0 65536 0 0 0 16 /end COMPU_METHOD
/begin COMPU_METHOD fak_uw_b2 "" RAT_FUNC "%7.6" "-" COEFFS 0 65536 0 0 0 2 /end COMPU_METHOD
/begin COMPU_METHOD fak_uw_b4 "" RAT_FUNC "%7.6" "-" COEFFS 0 65536 0 0 0 4 /end COMPU_METHOD
/begin COMPU_METHOD fak_uw_b512 "" RAT_FUNC "%6.4" "-" COEFFS 0 65536 0 0 0 512 /end COMPU_METHOD
/begin COMPU_METHOD fak_uw_b64 "" RAT_FUNC "%6.5" "-" COEFFS 0 65536 0 0 0 64 /end COMPU_METHOD
/begin COMPU_METHOD fak_uw_b8 "" RAT_FUNC "%6.5" "-" COEFFS 0 65536 0 0 0 8 /end COMPU_METHOD
/begin COMPU_METHOD fak_uw_q0p001 "" RAT_FUNC "%6.5" "-" COEFFS 0 65536 0 0 0 65.536 /end COMPU_METHOD
/begin COMPU_METHOD fmfkr_dez "" RAT_FUNC "%5.2" "kHz" COEFFS 0 1 0 0 0 1 /end COMPU_METHOD
/begin COMPU_METHOD GrelPED_sw_b100 "" RAT_FUNC "%6.4" "%PED" COEFFS 0 65535 0 0 0 100 /end COMPU_METHOD
/begin COMPU_METHOD krmf_to_zw "" RAT_FUNC "%6.4" "Grad KW" COEFFS 0 8160 0 0 0 191.25 /end COMPU_METHOD
/begin COMPU_METHOD kw_q0p1 "" RAT_FUNC "%6.3" "Grad KW" COEFFS 0 10 0 0 0 1 /end COMPU_METHOD
/begin COMPU_METHOD kw_q3 "" RAT_FUNC "%6.2" "Grad KW" COEFFS 0 1 0 0 0 3 /end COMPU_METHOD
/begin COMPU_METHOD mgrad_sw_b28p44 "" RAT_FUNC "%6.5" "g/s" COEFFS 0 230.4 0 0 0 0.2 /end COMPU_METHOD
/begin COMPU_METHOD m_ub_b23p3 "" RAT_FUNC "%6.3" "kg" COEFFS 0 2812.5 0 0 0 256 /end COMPU_METHOD
/begin COMPU_METHOD m_ul_6553p6 "" RAT_FUNC "%11.10" "kg/h" COEFFS 0 4.29497e+009 0 0 0 6553.6 /end COMPU_METHOD
/begin COMPU_METHOD m_uw_b25p6 "" RAT_FUNC "%6.5" "kg/h" COEFFS 0 65536 0 0 0 25.6 /end COMPU_METHOD
/begin COMPU_METHOD m_uw_b3276p7 "" RAT_FUNC "%6.4" "" COEFFS 0 1 0 0 0 0.05 /end COMPU_METHOD
/begin COMPU_METHOD m_uw_b6553p5 "" RAT_FUNC "%6.3" "kg/h" COEFFS 0 1 0 0 0 0.1 /end COMPU_METHOD
/begin COMPU_METHOD nmotd_sb_q10 "" RAT_FUNC "%6.1" "1/min" COEFFS 0 1 0 0 0 10 /end COMPU_METHOD
/begin COMPU_METHOD nmotg_sw_q0p39 "" RAT_FUNC "%6.3" "1/min/s" COEFFS 0 1 0 0 0 0.39063 /end COMPU_METHOD
/begin COMPU_METHOD nmot_ub_q10 "" RAT_FUNC "%6.1" "1/min" COEFFS 0 1 0 0 0 10 /end COMPU_METHOD
/begin COMPU_METHOD nmot_ub_q40 "" RAT_FUNC "%6.1" "1/min" COEFFS 0 1 0 0 0 40 /end COMPU_METHOD
/begin COMPU_METHOD nmot_uw_q0p25 "" RAT_FUNC "%6.3" "1/min" COEFFS 0 1 0 0 0 0.25 /end COMPU_METHOD
/begin COMPU_METHOD PER0100 "" RAT_FUNC "%6.4" "%" COEFFS 0 100 0 0 0 1 /end COMPU_METHOD
/begin COMPU_METHOD p_grad_uw_q0p039 "" RAT_FUNC "%6.4" "hPa/10msec" COEFFS 0 256 0 0 0 10 /end COMPU_METHOD
/begin COMPU_METHOD p_sw_q0p039 "" RAT_FUNC "%6.4" "hPa" COEFFS 0 256 0 0 0 10 /end COMPU_METHOD
/begin COMPU_METHOD p_ub_q10 "" RAT_FUNC "%6.1" "hPa" COEFFS 0 1 0 0 0 10 /end COMPU_METHOD
/begin COMPU_METHOD p_ub_q5 "" RAT_FUNC "%6.2" "hPa" COEFFS 0 1 0 0 0 5 /end COMPU_METHOD
/begin COMPU_METHOD p_uw_q0p039 "" RAT_FUNC "%6.4" "hPa" COEFFS 0 256 0 0 0 10 /end COMPU_METHOD
/begin COMPU_METHOD p_uw_q0p2 "" RAT_FUNC "%6.3" "hPa" COEFFS 0 5 0 0 0 1 /end COMPU_METHOD
/begin COMPU_METHOD relDK_q0p02441 "" RAT_FUNC "%6.4" "%DK" COEFFS 0 65536 0 0 0 1600 /end COMPU_METHOD
/begin COMPU_METHOD relDK_ub_b100 "" RAT_FUNC "%6.3" "%DK" COEFFS 0 255 0 0 0 100 /end COMPU_METHOD
/begin COMPU_METHOD relPED_ub_b100 "" RAT_FUNC "%6.3" "%PED" COEFFS 0 255 0 0 0 100 /end COMPU_METHOD
/begin COMPU_METHOD relPED_uw_b100 "" RAT_FUNC "%6.4" "%PED" COEFFS 0 65535 0 0 0 100 /end COMPU_METHOD
/begin COMPU_METHOD rel_sb_q0p75 "" RAT_FUNC "%6.3" "%" COEFFS 0 1 0 0 0 0.75 /end COMPU_METHOD
/begin COMPU_METHOD rel_sw_b100 "" RAT_FUNC "%6.4" "%" COEFFS 0 32768 0 0 0 100 /end COMPU_METHOD
/begin COMPU_METHOD rel_sw_b1536 "" RAT_FUNC "%6.4" "%" COEFFS 0 65536 0 0 0 3072 /end COMPU_METHOD
/begin COMPU_METHOD rel_sw_b50 "" RAT_FUNC "%6.4" "%" COEFFS 0 65536 0 0 0 100 /end COMPU_METHOD
/begin COMPU_METHOD rel_sw_q0p0234 "" RAT_FUNC "%6.4" "%/seg" COEFFS 0 32 0 0 0 0.75 /end COMPU_METHOD
/begin COMPU_METHOD rel_sw_q0p1875 "" RAT_FUNC "%6.3" "%" COEFFS 0 65536 0 0 0 12288 /end COMPU_METHOD
/begin COMPU_METHOD rel_ub_b0p03125 "" RAT_FUNC "%6.4" "-" COEFFS 0 256 0 0 0 8 /end COMPU_METHOD
/begin COMPU_METHOD rel_ub_b1p4941 "" RAT_FUNC "%6.4" "%" COEFFS 0 256 0 0 0 1.5 /end COMPU_METHOD
/begin COMPU_METHOD rel_ub_b99p6 "" RAT_FUNC "%6.3" "%" COEFFS 0 256 0 0 0 100 /end COMPU_METHOD
/begin COMPU_METHOD rel_ub_q0p75 "" RAT_FUNC "%6.3" "%" COEFFS 0 1 0 0 0 0.75 /end COMPU_METHOD
/begin COMPU_METHOD rel_uw_b100 "" RAT_FUNC "%6.4" "%" COEFFS 0 65536 0 0 0 100 /end COMPU_METHOD
/begin COMPU_METHOD rel_uw_b6144 "" RAT_FUNC "%6.3" "%" COEFFS 0 65536 0 0 0 6144 /end COMPU_METHOD
/begin COMPU_METHOD rel_uw_q0p0234 "" RAT_FUNC "%6.4" "%" COEFFS 0 32 0 0 0 0.75 /end COMPU_METHOD
/begin COMPU_METHOD rel_uw_q0p1875 "" RAT_FUNC "%6.3" "%" COEFFS 0 65536 0 0 0 12288 /end COMPU_METHOD
/begin COMPU_METHOD r_uw_q2 "" RAT_FUNC "%6.2" "Ohm" COEFFS 0 1 0 0 0 2 /end COMPU_METHOD
/begin COMPU_METHOD spgg_sw_b3052 "" RAT_FUNC "%6.3" "V/s" COEFFS 0 1 0 0 0 0.0931323 /end COMPU_METHOD
/begin COMPU_METHOD spg_sw_q0p00488 "" RAT_FUNC "%6.4" "V" COEFFS 0 1024 0 0 0 5 /end COMPU_METHOD
/begin COMPU_METHOD spg_ubatt "" RAT_FUNC "%6.3" "V" COEFFS 0 1 0 0 0 0.0942 /end COMPU_METHOD
/begin COMPU_METHOD spg_ub_b5 "" RAT_FUNC "%6.4" "V" COEFFS 0 256 0 0 0 5 /end COMPU_METHOD
/begin COMPU_METHOD spg_ub_q0p0052_o0p2 "" RAT_FUNC "%6.3" "V" COEFFS 0 255 51 0 0 1.33 /end COMPU_METHOD
/begin COMPU_METHOD spg_ub_q0p019 "" RAT_FUNC "%6.4" "V" COEFFS 0 1 0 0 0 0.019 /end COMPU_METHOD
/begin COMPU_METHOD spg_uw_q0p001222 "" RAT_FUNC "%6.4" "V" COEFFS 0 1 0 0 0 0.001222 /end COMPU_METHOD
/begin COMPU_METHOD spg_uw_q0p00488 "" RAT_FUNC "%6.4" "V" COEFFS 0 1024 0 0 0 5 /end COMPU_METHOD
/begin COMPU_METHOD spg_uw_q0p00488_o1 "" RAT_FUNC "%6.3" "V" COEFFS 0 1024 1024 0 0 5 /end COMPU_METHOD
/begin COMPU_METHOD strom_b0p00078 "" RAT_FUNC "%10.9" "A" COEFFS 0 65535 0 0 0 0.000781 /end COMPU_METHOD
/begin COMPU_METHOD strom_q0p00078 "" RAT_FUNC "%6.5" "A" COEFFS 0 32767 0 0 0 25.6 /end COMPU_METHOD
/begin COMPU_METHOD t100msxs_ub_b25p5 "" RAT_FUNC "%6.3" "s" COEFFS 0 1 0 0 0 0.1 /end COMPU_METHOD
/begin COMPU_METHOD t100msxs_uw_b6553p5 "" RAT_FUNC "%6.3" "s" COEFFS 0 1 0 0 0 0.1 /end COMPU_METHOD
/begin COMPU_METHOD t100msxs_uw_b6553p6 "" RAT_FUNC "%6.3" "s" COEFFS 0 10 0 0 0 1 /end COMPU_METHOD
/begin COMPU_METHOD t100msxs_uw_q100 "" RAT_FUNC "%6.3" "s" COEFFS 0 1 0 0 0 0.1 /end COMPU_METHOD
/begin COMPU_METHOD t10msxs_ub_b2p55 "" RAT_FUNC "%6.4" "s" COEFFS 0 1 0 0 0 0.01 /end COMPU_METHOD
/begin COMPU_METHOD t10msxs_uw_b655p35 "" RAT_FUNC "%6.4" "s" COEFFS 0 1 0 0 0 0.01 /end COMPU_METHOD
/begin COMPU_METHOD t1msxms_q1 "" RAT_FUNC "%6.2" "ms" COEFFS 0 1 0 0 0 1 /end COMPU_METHOD
/begin COMPU_METHOD t1sxs_ub_b255 "" RAT_FUNC "%6.2" "s" COEFFS 0 1 0 0 0 1 /end COMPU_METHOD
/begin COMPU_METHOD t1sxs_uw_q1 "" RAT_FUNC "%6.2" "s" COEFFS 0 1 0 0 0 1 /end COMPU_METHOD
/begin COMPU_METHOD t200msxs_ub_b51 "" RAT_FUNC "%6.3" "s" COEFFS 0 1 0 0 0 0.2 /end COMPU_METHOD
/begin COMPU_METHOD t20msxs_ub_b5p1 "" RAT_FUNC "%6.4" "s" COEFFS 0 1 0 0 0 0.02 /end COMPU_METHOD
/begin COMPU_METHOD t8p0usxms "" RAT_FUNC "%6.4" "ms" COEFFS 0 1000 0 0 0 8 /end COMPU_METHOD
/begin COMPU_METHOD temp_q0p0234_o273 "" RAT_FUNC "%6.1" "Grad C" COEFFS 0 1 273.15 0 0 0.0234375 /end COMPU_METHOD
/begin COMPU_METHOD temp_ub_b191p25 "" RAT_FUNC "%6.3" "Grad C" COEFFS 0 1 0 0 0 0.75 /end COMPU_METHOD
/begin COMPU_METHOD temp_ub_q0p75_o48 "" RAT_FUNC "%6.2" "Grad C" COEFFS 0 1 48 0 0 0.75 /end COMPU_METHOD
/begin COMPU_METHOD tus_uw_q3p2 "" RAT_FUNC "%6.2" "us" COEFFS 0 1 0 0 0 3.2 /end COMPU_METHOD
/begin COMPU_METHOD txms_ub_q0p05 "" RAT_FUNC "%6.4" "ms" COEFFS 0 20 0 0 0 1 /end COMPU_METHOD
/begin COMPU_METHOD txms_ub_q0p1 "" RAT_FUNC "%6.3" "ms" COEFFS 0 10 0 0 0 1 /end COMPU_METHOD
/begin COMPU_METHOD txms_uw_q0p001 "" RAT_FUNC "%6.5" "ms" COEFFS 0 1000 0 0 0 1 /end COMPU_METHOD
/begin COMPU_METHOD txms_uw_q0p1 "" RAT_FUNC "%6.3" "ms" COEFFS 0 10 0 0 0 1 /end COMPU_METHOD
/begin COMPU_METHOD vfzg_ub_q1p25 "" RAT_FUNC "%6.2" "km/h" COEFFS 0 1 0 0 0 1.25 /end COMPU_METHOD
/begin COMPU_METHOD vfzg_uw_b512 "" RAT_FUNC "%6.4" "km/h" COEFFS 0 65536 0 0 0 512 /end COMPU_METHOD
/begin COMPU_METHOD wink_uw_q0p1 "" RAT_FUNC "%6.3" "Grad" COEFFS 0 10 0 0 0 1 /end COMPU_METHOD
/begin COMPU_METHOD zk100msxs_ub_b25p5 "" RAT_FUNC "%6.3" "s" COEFFS 0 0 256 0 10 0 /end COMPU_METHOD
/begin COMPU_METHOD zk100msxs_uw_b6553 "" RAT_FUNC "%10.3" "s" COEFFS 0 0 65536 0 10 0 /end COMPU_METHOD
/begin COMPU_METHOD zk10msxs_ub_b2p56 "" RAT_FUNC "%6.4" "s" COEFFS 0 0 256 0 100 0 /end COMPU_METHOD
/begin COMPU_METHOD zk10msxs_uw_b655 "" RAT_FUNC "%10.4" "s" COEFFS 0 0 65536 0 100 0 /end COMPU_METHOD
/begin COMPU_METHOD zw_ub_q0p75 "" RAT_FUNC "%6.3" "Grad KW" COEFFS 0 255 0 0 0 191.25 /end COMPU_METHOD
/begin COMPU_METHOD default "" RAT_FUNC "%6.2" "" COEFFS 0 1 0 0 0 1 /end COMPU_METHOD
/begin RECORD_LAYOUT FklWUb FNC_VALUES 1 UBYTE COLUMN_DIR DIRECT /end RECORD_LAYOUT
/begin RECORD_LAYOUT FklWUw FNC_VALUES 1 UWORD COLUMN_DIR DIRECT /end RECORD_LAYOUT
/begin RECORD_LAYOUT GkfWU8 FNC_VALUES 1 UBYTE COLUMN_DIR DIRECT /end RECORD_LAYOUT
/begin RECORD_LAYOUT GkfWUb FNC_VALUES 1 UBYTE COLUMN_DIR DIRECT /end RECORD_LAYOUT
/begin RECORD_LAYOUT GkfWUw FNC_VALUES 1 UWORD COLUMN_DIR DIRECT /end RECORD_LAYOUT
/begin RECORD_LAYOUT GklWSb FNC_VALUES 1 SBYTE COLUMN_DIR DIRECT /end RECORD_LAYOUT
/begin RECORD_LAYOUT GklWSw FNC_VALUES 1 SWORD COLUMN_DIR DIRECT /end RECORD_LAYOUT
/begin RECORD_LAYOUT GklWU8 FNC_VALUES 1 UBYTE COLUMN_DIR DIRECT /end RECORD_LAYOUT
/begin RECORD_LAYOUT GklWUb FNC_VALUES 1 UBYTE COLUMN_DIR DIRECT /end RECORD_LAYOUT
/begin RECORD_LAYOUT GklWUw FNC_VALUES 1 UWORD COLUMN_DIR DIRECT /end RECORD_LAYOUT
/begin RECORD_LAYOUT KfAxSwAySwSstxSwSstySwWSw NO_AXIS_PTS_X 1 SWORD NO_AXIS_PTS_Y 2 SWORD AXIS_PTS_X 3 SWORD INDEX_INCR DIRECT AXIS_PTS_Y 4 SWORD INDEX_INCR DIRECT FNC_VALUES 5 SWORD COLUMN_DIR DIRECT /end RECORD_LAYOUT
/begin RECORD_LAYOUT KfAxUbAyUbSstxUbSstyUbWUb NO_AXIS_PTS_X 1 UBYTE NO_AXIS_PTS_Y 2 UBYTE AXIS_PTS_X 3 UBYTE INDEX_INCR DIRECT AXIS_PTS_Y 4 UBYTE INDEX_INCR DIRECT FNC_VALUES 5 UBYTE COLUMN_DIR DIRECT /end RECORD_LAYOUT
/begin RECORD_LAYOUT KfAxUbAyUbSstxUwSstyUbWUb NO_AXIS_PTS_X 1 UBYTE NO_AXIS_PTS_Y 2 UBYTE AXIS_PTS_X 3 UWORD INDEX_INCR DIRECT AXIS_PTS_Y 4 UBYTE INDEX_INCR DIRECT FNC_VALUES 5 UBYTE COLUMN_DIR DIRECT /end RECORD_LAYOUT
/begin RECORD_LAYOUT KfAxUwAyUwSstxSwSstyUwWUw NO_AXIS_PTS_X 1 UWORD NO_AXIS_PTS_Y 2 UWORD AXIS_PTS_X 3 SWORD INDEX_INCR DIRECT AXIS_PTS_Y 4 UWORD INDEX_INCR DIRECT FNC_VALUES 5 UWORD COLUMN_DIR DIRECT /end RECORD_LAYOUT
/begin RECORD_LAYOUT KfAxUwAyUwSstxUwSstyUwWUw NO_AXIS_PTS_X 1 UWORD NO_AXIS_PTS_Y 2 UWORD AXIS_PTS_X 3 UWORD INDEX_INCR DIRECT AXIS_PTS_Y 4 UWORD INDEX_INCR DIRECT FNC_VALUES 5 UWORD COLUMN_DIR DIRECT /end RECORD_LAYOUT
/begin RECORD_LAYOUT KlASwSstSwWSw NO_AXIS_PTS_X 1 SWORD AXIS_PTS_X 2 SWORD INDEX_INCR DIRECT FNC_VALUES 3 SWORD COLUMN_DIR DIRECT /end RECORD_LAYOUT
/begin RECORD_LAYOUT KlAUbSstUbWUb NO_AXIS_PTS_X 1 UBYTE AXIS_PTS_X 2 UBYTE INDEX_INCR DIRECT FNC_VALUES 3 UBYTE COLUMN_DIR DIRECT /end RECORD_LAYOUT
/begin RECORD_LAYOUT KlAUbSstUwWUw NO_AXIS_PTS_X 1 UWORD AXIS_PTS_X 2 UWORD INDEX_INCR DIRECT FNC_VALUES 3 UWORD COLUMN_DIR DIRECT /end RECORD_LAYOUT
/begin RECORD_LAYOUT KlAUwSstSwWUw NO_AXIS_PTS_X 1 UWORD AXIS_PTS_X 2 SWORD INDEX_INCR DIRECT FNC_VALUES 3 UWORD COLUMN_DIR DIRECT /end RECORD_LAYOUT
/begin RECORD_LAYOUT KlAUwSstUwWSw NO_AXIS_PTS_X 1 UWORD AXIS_PTS_X 2 UWORD INDEX_INCR DIRECT FNC_VALUES 3 SWORD COLUMN_DIR DIRECT /end RECORD_LAYOUT
/begin RECORD_LAYOUT KlAUwSstUwWUw NO_AXIS_PTS_X 1 UWORD AXIS_PTS_X 2 UWORD INDEX_INCR DIRECT FNC_VALUES 3 UWORD COLUMN_DIR DIRECT /end RECORD_LAYOUT
/begin RECORD_LAYOUT KlAxU16SstxU16WU16 NO_AXIS_PTS_X 1 UWORD AXIS_PTS_X 2 UWORD INDEX_INCR DIRECT FNC_VALUES 3 UWORD COLUMN_DIR DIRECT /end RECORD_LAYOUT
/begin RECORD_LAYOUT KlAxU8SstxS16WS16 NO_AXIS_PTS_X 1 SWORD AXIS_PTS_X 2 SWORD INDEX_INCR DIRECT FNC_VALUES 3 SWORD COLUMN_DIR DIRECT /end RECORD_LAYOUT
/begin RECORD_LAYOUT KlAxU8SstxU16WU16 NO_AXIS_PTS_X 1 UWORD AXIS_PTS_X 2 UWORD INDEX_INCR DIRECT FNC_VALUES 3 UWORD COLUMN_DIR DIRECT /end RECORD_LAYOUT
/begin RECORD_LAYOUT KlAxU8SstxU8WU16 NO_AXIS_PTS_X 1 UBYTE AXIS_PTS_X 2 UBYTE INDEX_INCR DIRECT FNC_VALUES 3 UWORD COLUMN_DIR DIRECT /end RECORD_LAYOUT
/begin RECORD_LAYOUT KlAxU8SstxU8WU8 NO_AXIS_PTS_X 1 UBYTE AXIS_PTS_X 2 UBYTE INDEX_INCR DIRECT FNC_VALUES 3 UBYTE COLUMN_DIR DIRECT /end RECORD_LAYOUT
/begin RECORD_LAYOUT KwbUb FNC_VALUES 1 UBYTE COLUMN_DIR DIRECT /end RECORD_LAYOUT
/begin RECORD_LAYOUT KwSb FNC_VALUES 1 SBYTE COLUMN_DIR DIRECT /end RECORD_LAYOUT
/begin RECORD_LAYOUT KwSw FNC_VALUES 1 SWORD COLUMN_DIR DIRECT /end RECORD_LAYOUT
/begin RECORD_LAYOUT KwUb FNC_VALUES 1 UBYTE COLUMN_DIR DIRECT /end RECORD_LAYOUT
/begin RECORD_LAYOUT KwUw FNC_VALUES 1 UWORD COLUMN_DIR DIRECT /end RECORD_LAYOUT
/begin RECORD_LAYOUT KwWS16 FNC_VALUES 1 SWORD COLUMN_DIR DIRECT /end RECORD_LAYOUT
/begin RECORD_LAYOUT KwWU16 FNC_VALUES 1 UWORD COLUMN_DIR DIRECT /end RECORD_LAYOUT
/begin RECORD_LAYOUT KwWU32 FNC_VALUES 1 ULONG COLUMN_DIR DIRECT /end RECORD_LAYOUT
/begin RECORD_LAYOUT KwWU8 FNC_VALUES 1 UBYTE COLUMN_DIR DIRECT /end RECORD_LAYOUT
/begin RECORD_LAYOUT SstAU8SstU8 NO_AXIS_PTS_X 1 UBYTE AXIS_PTS_X 2 UBYTE INDEX_INCR DIRECT /end RECORD_LAYOUT
/begin RECORD_LAYOUT SstAUbSstUb NO_AXIS_PTS_X 1 UBYTE AXIS_PTS_X 2 UBYTE INDEX_INCR DIRECT /end RECORD_LAYOUT
/begin RECORD_LAYOUT SstAUwSstUw NO_AXIS_PTS_X 1 UWORD AXIS_PTS_X 2 UWORD INDEX_INCR DIRECT /end RECORD_LAYOUT
/end MODULE
/end PROJECT
