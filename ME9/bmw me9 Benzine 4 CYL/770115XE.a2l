/* Erstellt von DAMOS++ V1.17 */
ASAP2_VERSION 1 3
/begin PROJECT basisme9 ""
/begin HEADER "" VERSION "basisme9" PROJECT_NO basisme9 /end HEADER
/begin MODULE DIM ""
/begin MOD_PAR "" VERSION "" CUSTOMER_NO "" USER "BMSK" PHONE_NO "" CPU_TYPE "GoldenOak" ECU ""
 /begin MEMORY_SEGMENT Pst2000 "" CODE EPROM EXTERN 0x2000 0x4000 -1 -1 -1 -1 -1 /begin IF_DATA ETK ADDRESS_MAPPING 0x2000 0x2000 0x4000 /end IF_DATA /begin IF_DATA ASAP1B_CCP ADDRESS_MAPPING 0x2000 0x2000 0x4000 /end IF_DATA /begin IF_DATA ASAP1B_KWP2000 ADDRESS_MAPPING 0x2000 0x2000 0x4000 /end IF_DATA /end MEMORY_SEGMENT
 /begin MEMORY_SEGMENT Pst20000 "" CODE EPROM EXTERN 0x20000 0xE0000 -1 -1 -1 -1 -1 /begin IF_DATA ETK ADDRESS_MAPPING 0x20000 0x20000 0xE0000 /end IF_DATA /begin IF_DATA ASAP1B_CCP ADDRESS_MAPPING 0x20000 0x20000 0xE0000 /end IF_DATA /begin IF_DATA ASAP1B_KWP2000 ADDRESS_MAPPING 0x20000 0x20000 0xE0000 /end IF_DATA /end MEMORY_SEGMENT
 /begin MEMORY_SEGMENT Dst4E2000 "" DATA EPROM INTERN 0x4E2000 0x1E000 -1 -1 -1 -1 -1 /begin IF_DATA ETK ADDRESS_MAPPING 0x4E2000 0x902000 0x1E000 /end IF_DATA /begin IF_DATA ASAP1B_CCP ADDRESS_MAPPING 0x4E2000 0x4E2000 0x1E000 /end IF_DATA /begin IF_DATA ASAP1B_KWP2000 ADDRESS_MAPPING 0x4E2000 0x4E2000 0x1E000 /end IF_DATA /end MEMORY_SEGMENT
 /begin MEMORY_SEGMENT ExtRam900000 "" VARIABLES RAM EXTERN 0x900000 0x2000 -1 -1 -1 -1 -1 /* AsapMLXFm - CCP_V2_1 */ /begin IF_DATA ETK ADDRESS_MAPPING 0x900000 0x900000 0x2000 /end IF_DATA /* AsapMLXFm - KWP2000 */ /end MEMORY_SEGMENT
 /begin MEMORY_SEGMENT Ram7F8000 "" VARIABLES RAM INTERN 0x7F8000 0x8000 -1 -1 -1 -1 -1 /end MEMORY_SEGMENT
 SYSTEM_CONSTANT "DPS_AKLE" "1"
 SYSTEM_CONSTANT "DPS_EKPE" "1"
 SYSTEM_CONSTANT "DPS_EVE" "2"
 SYSTEM_CONSTANT "DPS_EWSE" "1"
 SYSTEM_CONSTANT "DPS_LSHVKE" "2"
 SYSTEM_CONSTANT "DPS_SLVE" "1"
 SYSTEM_CONSTANT "DPS_SSTE" "1"
 SYSTEM_CONSTANT "DPS_STARTE" "1"
 SYSTEM_CONSTANT "DPS_TDE" "1"
 SYSTEM_CONSTANT "DPS_TEVE" "1"
 SYSTEM_CONSTANT "EWS_FEHLERANZAHL" "6"
 SYSTEM_CONSTANT "IMAX" "9"
 SYSTEM_CONSTANT "KW_EepromEnable" "1"
 SYSTEM_CONSTANT "L9935_NUM_CHIPS" "2"
 SYSTEM_CONSTANT "L9935_NUM_SDO_MSGS" "4"
 SYSTEM_CONSTANT "L9935_NUM_STATUSBITS" "8"
 SYSTEM_CONSTANT "N_BEGIN" "9000"
 SYSTEM_CONSTANT "N_END" "11250"
 SYSTEM_CONSTANT "N_STEP" "250"
 SYSTEM_CONSTANT "SPI_ERROR_QUEUE_SIZE" "8"
 SYSTEM_CONSTANT "SWOFFDL_REQUEST_MASK" "16383"
 SYSTEM_CONSTANT "SYNWS1" "1"
 SYSTEM_CONSTANT "SY_2SG" "0"
 SYSTEM_CONSTANT "SY_AAU" "0"
 SYSTEM_CONSTANT "SY_AAV" "0"
 SYSTEM_CONSTANT "SY_ABGY" "1"
 SYSTEM_CONSTANT "SY_ABMZND" "0"
 SYSTEM_CONSTANT "SY_AGR" "0"
 SYSTEM_CONSTANT "SY_AGR_DSS" "0"
 SYSTEM_CONSTANT "SY_AIRBAG" "1"
 SYSTEM_CONSTANT "SY_ANNWSYN" "4"
 SYSTEM_CONSTANT "SY_ASC" "1"
 SYSTEM_CONSTANT "SY_ASR" "1"
 SYSTEM_CONSTANT "SY_ATR" "0"
 SYSTEM_CONSTANT "SY_BATTSG" "0"
 SYSTEM_CONSTANT "SY_BDE" "0"
 SYSTEM_CONSTANT "SY_BLOOP" "0"
 SYSTEM_CONSTANT "SY_BYPNO" "2"
 SYSTEM_CONSTANT "SY_C95ANZ" "1"
 SYSTEM_CONSTANT "SY_CAN" "0"
 SYSTEM_CONSTANT "SY_CARBPROT" "1"
 SYSTEM_CONSTANT "SY_CDCSIZE" "4"
 SYSTEM_CONSTANT "SY_CDKSIZE" "1"
 SYSTEM_CONSTANT "SY_CDTSIZE" "1"
 SYSTEM_CONSTANT "SY_CLASIZE" "1"
 SYSTEM_CONSTANT "SY_CONFSL" "1"
 SYSTEM_CONSTANT "SY_CSBVAR" "0"
 SYSTEM_CONSTANT "SY_DEGFE" "1"
 SYSTEM_CONSTANT "SY_DELFCMS" "0"
 SYSTEM_CONSTANT "SY_DFPMENV" "4"
 SYSTEM_CONSTANT "SY_DFPMTIM" "2"
 SYSTEM_CONSTANT "SY_DFPMVAR" "3"
 SYSTEM_CONSTANT "SY_DGANZ" "1"
 SYSTEM_CONSTANT "SY_DISA" "1"
 SYSTEM_CONSTANT "SY_DKAT" "0"
 SYSTEM_CONSTANT "SY_DKATLRS" "0"
 SYSTEM_CONSTANT "SY_DKATSP" "0"
 SYSTEM_CONSTANT "SY_DKPSTP" "0"
 SYSTEM_CONSTANT "SY_DLCKD" "10"
 SYSTEM_CONSTANT "SY_DLCPEN" "20"
 SYSTEM_CONSTANT "SY_DLDP" "0"
 SYSTEM_CONSTANT "SY_DLSHV" "0"
 SYSTEM_CONSTANT "SY_DMDZAG" "0"
 SYSTEM_CONSTANT "SY_DOPZW" "0"
 SYSTEM_CONSTANT "SY_DSL10MS" "0"
 SYSTEM_CONSTANT "SY_DSL2MS" "0"
 SYSTEM_CONSTANT "SY_DTES" "2"
 SYSTEM_CONSTANT "SY_DVEADA" "0"
 SYSTEM_CONSTANT "SY_DZKDMD" "1"
 SYSTEM_CONSTANT "SY_EEPROMDEBUG" "0"
 SYSTEM_CONSTANT "SY_EGAS" "1"
 SYSTEM_CONSTANT "SY_EGFE" "9"
 SYSTEM_CONSTANT "SY_ELKUP" "0"
 SYSTEM_CONSTANT "SY_ENVBLOK" "3"
 SYSTEM_CONSTANT "SY_ERCOS_TIMER_INPUT_SEL" "5"
 SYSTEM_CONSTANT "SY_ESTZ" "0"
 SYSTEM_CONSTANT "SY_ETKBYP" "1"
 SYSTEM_CONSTANT "SY_EWS_PAGE0_WITHOUT_GAIN" "0"
 SYSTEM_CONSTANT "SY_EWS_PAGE1_HYSTERESE" "0"
 SYSTEM_CONSTANT "SY_F1GETR" "0"
 SYSTEM_CONSTANT "SY_FCMDISP" "1"
 SYSTEM_CONSTANT "SY_FCMIRD" "0"
 SYSTEM_CONSTANT "SY_FCMSIZE" "11"
 SYSTEM_CONSTANT "SY_FFESIZE" "0"
 SYSTEM_CONSTANT "SY_FFTSIZE" "4"
 SYSTEM_CONSTANT "SY_FFXSIZE" "11"
 SYSTEM_CONSTANT "SY_FLC" "3"
 SYSTEM_CONSTANT "SY_GAP" "2"
 SYSTEM_CONSTANT "SY_GRDWOF" "0"
 SYSTEM_CONSTANT "SY_GRDWRT" "18"
 SYSTEM_CONSTANT "SY_GRUNDWERT" "108"
 SYSTEM_CONSTANT "SY_HLCCARB" "4"
 SYSTEM_CONSTANT "SY_IEGR" "1"
 SYSTEM_CONSTANT "SY_IGNMX" "15"
 SYSTEM_CONSTANT "SY_INGASOS" "4"
 SYSTEM_CONSTANT "SY_KOPWM" "0"
 SYSTEM_CONSTANT "SY_KS1" "0"
 SYSTEM_CONSTANT "SY_KS2" "1"
 SYSTEM_CONSTANT "SY_KS3" "2"
 SYSTEM_CONSTANT "SY_KS4" "3"
 SYSTEM_CONSTANT "SY_LAMBTS" "1"
 SYSTEM_CONSTANT "SY_LECK" "0"
 SYSTEM_CONSTANT "SY_LOWRA" "0"
 SYSTEM_CONSTANT "SY_M1I00A" "190"
 SYSTEM_CONSTANT "SY_M1I00B" "31"
 SYSTEM_CONSTANT "SY_M1I00C" "249"
 SYSTEM_CONSTANT "SY_M1I00D" "17"
 SYSTEM_CONSTANT "SY_M1I20A" "128"
 SYSTEM_CONSTANT "SY_M1I20B" "0"
 SYSTEM_CONSTANT "SY_M1I20C" "0"
 SYSTEM_CONSTANT "SY_M1I20D" "0"
 SYSTEM_CONSTANT "SY_M2I00A" "126"
 SYSTEM_CONSTANT "SY_M2I00B" "24"
 SYSTEM_CONSTANT "SY_M2I00C" "0"
 SYSTEM_CONSTANT "SY_M2I00D" "0"
 SYSTEM_CONSTANT "SY_M5IH00A" "195"
 SYSTEM_CONSTANT "SY_M5IH00B" "0"
 SYSTEM_CONSTANT "SY_M5IH00C" "0"
 SYSTEM_CONSTANT "SY_M5IH00D" "0"
 SYSTEM_CONSTANT "SY_M5IH20A" "0"
 SYSTEM_CONSTANT "SY_M5IH20B" "0"
 SYSTEM_CONSTANT "SY_M5IH20C" "0"
 SYSTEM_CONSTANT "SY_M5IH20D" "0"
 SYSTEM_CONSTANT "SY_M5IH40A" "0"
 SYSTEM_CONSTANT "SY_M5IH40B" "0"
 SYSTEM_CONSTANT "SY_M5IH40C" "0"
 SYSTEM_CONSTANT "SY_M5IH40D" "0"
 SYSTEM_CONSTANT "SY_M5IH60A" "0"
 SYSTEM_CONSTANT "SY_M5IH60B" "0"
 SYSTEM_CONSTANT "SY_M5IH60C" "0"
 SYSTEM_CONSTANT "SY_M5IH60D" "0"
 SYSTEM_CONSTANT "SY_M5IH80A" "0"
 SYSTEM_CONSTANT "SY_M5IH80B" "0"
 SYSTEM_CONSTANT "SY_M5IH80C" "0"
 SYSTEM_CONSTANT "SY_M5IH80D" "0"
 SYSTEM_CONSTANT "SY_M5IV00A" "195"
 SYSTEM_CONSTANT "SY_M5IV00B" "128"
 SYSTEM_CONSTANT "SY_M5IV00C" "0"
 SYSTEM_CONSTANT "SY_M5IV00D" "1"
 SYSTEM_CONSTANT "SY_M5IV20A" "0"
 SYSTEM_CONSTANT "SY_M5IV20B" "1"
 SYSTEM_CONSTANT "SY_M5IV20C" "192"
 SYSTEM_CONSTANT "SY_M5IV20D" "0"
 SYSTEM_CONSTANT "SY_M5IV40A" "0"
 SYSTEM_CONSTANT "SY_M5IV40B" "0"
 SYSTEM_CONSTANT "SY_M5IV40C" "0"
 SYSTEM_CONSTANT "SY_M5IV40D" "0"
 SYSTEM_CONSTANT "SY_M5IV60A" "0"
 SYSTEM_CONSTANT "SY_M5IV60B" "0"
 SYSTEM_CONSTANT "SY_M5IV60C" "0"
 SYSTEM_CONSTANT "SY_M5IV60D" "0"
 SYSTEM_CONSTANT "SY_M5IV80A" "0"
 SYSTEM_CONSTANT "SY_M5IV80B" "0"
 SYSTEM_CONSTANT "SY_M5IV80C" "0"
 SYSTEM_CONSTANT "SY_M5IV80D" "0"
 SYSTEM_CONSTANT "SY_M6I00A" "168"
 SYSTEM_CONSTANT "SY_M6I00B" "0"
 SYSTEM_CONSTANT "SY_M6I00C" "0"
 SYSTEM_CONSTANT "SY_M6I00D" "0"
 SYSTEM_CONSTANT "SY_M7VAR" "0"
 SYSTEM_CONSTANT "SY_M8I00B" "0"
 SYSTEM_CONSTANT "SY_M8I00C" "0"
 SYSTEM_CONSTANT "SY_M8I00D" "0"
 SYSTEM_CONSTANT "SY_M8I00E" "0"
 SYSTEM_CONSTANT "SY_M9I00A" "0"
 SYSTEM_CONSTANT "SY_M9I00B" "0"
 SYSTEM_CONSTANT "SY_M9I00C" "0"
 SYSTEM_CONSTANT "SY_M9I00D" "0"
 SYSTEM_CONSTANT "SY_MLSUBREF" "138"
 SYSTEM_CONSTANT "SY_NWACED1" "1"
 SYSTEM_CONSTANT "SY_NWACED2" "0"
 SYSTEM_CONSTANT "SY_NWACED3" "0"
 SYSTEM_CONSTANT "SY_NWACED4" "0"
 SYSTEM_CONSTANT "SY_NWGA" "0"
 SYSTEM_CONSTANT "SY_NWGA2" "0"
 SYSTEM_CONSTANT "SY_NWGE" "1"
 SYSTEM_CONSTANT "SY_NWGE2" "0"
 SYSTEM_CONSTANT "SY_NWS" "2"
 SYSTEM_CONSTANT "SY_NWSA" "0"
 SYSTEM_CONSTANT "SY_NWVAR" "1"
 SYSTEM_CONSTANT "SY_NWZUHW1" "1"
 SYSTEM_CONSTANT "SY_NWZUHW2" "0"
 SYSTEM_CONSTANT "SY_NWZUHW3" "0"
 SYSTEM_CONSTANT "SY_NWZUHW4" "0"
 SYSTEM_CONSTANT "SY_ODT_100MS" "10"
 SYSTEM_CONSTANT "SY_ODT_10MS" "7"
 SYSTEM_CONSTANT "SY_ODT_SYN" "2"
 SYSTEM_CONSTANT "SY_OVERSIZE" "2"
 SYSTEM_CONSTANT "SY_OZ" "0"
 SYSTEM_CONSTANT "SY_PBRPW" "1"
 SYSTEM_CONSTANT "SY_PGRAD" "1"
 SYSTEM_CONSTANT "SY_PGRAD2" "0"
 SYSTEM_CONSTANT "SY_PGRAD3" "0"
 SYSTEM_CONSTANT "SY_PGRAD4" "0"
 SYSTEM_CONSTANT "SY_PGTPO" "0"
 SYSTEM_CONSTANT "SY_PHTWIN" "0"
 SYSTEM_CONSTANT "SY_PTCAN" "0"
 SYSTEM_CONSTANT "SY_RASFAKM" "128"
 SYSTEM_CONSTANT "SY_RASNMAX" "150"
 SYSTEM_CONSTANT "SY_RASNMIN" "75"
 SYSTEM_CONSTANT "SY_REDMX" "4"
 SYSTEM_CONSTANT "SY_RLTEST" "50"
 SYSTEM_CONSTANT "SY_SEGL" "360"
 SYSTEM_CONSTANT "SY_SGANZ" "1"
 SYSTEM_CONSTANT "SY_SLPANZ" "1"
 SYSTEM_CONSTANT "SY_SLS" "0"
 SYSTEM_CONSTANT "SY_SLWG" "0"
 SYSTEM_CONSTANT "SY_STA" "0"
 SYSTEM_CONSTANT "SY_STEREO" "1"
 SYSTEM_CONSTANT "SY_STERHK" "0"
 SYSTEM_CONSTANT "SY_STERSY" "0"
 SYSTEM_CONSTANT "SY_STERVK" "1"
 SYSTEM_CONSTANT "SY_STETLR" "0"
 SYSTEM_CONSTANT "SY_STPPRNO" "2"
 SYSTEM_CONSTANT "SY_SWE_B" "0"
 SYSTEM_CONSTANT "SY_SWE_C" "1"
 SYSTEM_CONSTANT "SY_SWE_S" "0"
 SYSTEM_CONSTANT "SY_TABST" "1"
 SYSTEM_CONSTANT "SY_TEBF" "0"
 SYSTEM_CONSTANT "SY_TEETH" "60"
 SYSTEM_CONSTANT "SY_TFA" "0"
 SYSTEM_CONSTANT "SY_TFBA" "0"
 SYSTEM_CONSTANT "SY_TFMA" "1"
 SYSTEM_CONSTANT "SY_TFMAP" "1"
 SYSTEM_CONSTANT "SY_TFMHST" "0"
 SYSTEM_CONSTANT "SY_TFNS" "0"
 SYSTEM_CONSTANT "SY_TFRK" "0"
 SYSTEM_CONSTANT "SY_TFVA" "0"
 SYSTEM_CONSTANT "SY_TFWL" "0"
 SYSTEM_CONSTANT "SY_TGET" "0"
 SYSTEM_CONSTANT "SY_TKAT" "0"
 SYSTEM_CONSTANT "SY_TLR" "0"
 SYSTEM_CONSTANT "SY_TN" "1"
 SYSTEM_CONSTANT "SY_TRLX" "0"
 SYSTEM_CONSTANT "SY_TSFSIZE" "1"
 SYSTEM_CONSTANT "SY_TURBO" "0"
 SYSTEM_CONSTANT "SY_TVVR" "0"
 SYSTEM_CONSTANT "SY_TWDKS" "0"
 SYSTEM_CONSTANT "SY_TWINSPARK" "1"
 SYSTEM_CONSTANT "SY_UB13V" "138"
 SYSTEM_CONSTANT "SY_UBDEDIS" "74"
 SYSTEM_CONSTANT "SY_UBDEEN" "86"
 SYSTEM_CONSTANT "SY_UBOKDIS" "63"
 SYSTEM_CONSTANT "SY_UBOKEN" "74"
 SYSTEM_CONSTANT "SY_UBR" "0"
 SYSTEM_CONSTANT "SY_UBSQ_W" "965"
 SYSTEM_CONSTANT "SY_UMALS" "0"
 SYSTEM_CONSTANT "SY_USOFF" "205"
 SYSTEM_CONSTANT "SY_VVT" "0"
 SYSTEM_CONSTANT "SY_WFS" "1"
 SYSTEM_CONSTANT "SY_WMAX" "96"
 SYSTEM_CONSTANT "SY_WMIN" "-126"
 SYSTEM_CONSTANT "SY_WNBM" "6"
 SYSTEM_CONSTANT "SY_ZAS" "0"
 SYSTEM_CONSTANT "SY_ZKANZ" "2"
 SYSTEM_CONSTANT "SY_ZNDAUS" "1"
 SYSTEM_CONSTANT "SY_ZYLZA" "2"
 SYSTEM_CONSTANT "SY_ZZBANK" "2" /end MOD_PAR
/begin MOD_COMMON "" BYTE_ORDER MSB_FIRST ALIGNMENT_BYTE 1 ALIGNMENT_WORD 2 ALIGNMENT_LONG 2 ALIGNMENT_FLOAT32_IEEE 4 /end MOD_COMMON
/* --- AgI-Objekt f¸r CCP (ASAP V1.21), Stand 1.0 31.7.98 --- */
/begin IF_DATA ASAP1B_CCP
 /begin SOURCE "time synchronous event channel - 10 ms" 4 1 /begin QP_BLOB 0 LENGTH 7 CAN_ID_FIXED 0x7F1 RASTER 0 /end QP_BLOB /end SOURCE
 /begin SOURCE "time synchronous event channel - 100 ms" 5 1 /begin QP_BLOB 1 LENGTH 10 CAN_ID_FIXED 0x7F2 RASTER 1 /end QP_BLOB /end SOURCE
 /begin SOURCE "segment synchronous event channel" 103 1 /begin QP_BLOB 2 LENGTH 2 CAN_ID_FIXED 0x7F3 RASTER 2 /end QP_BLOB /end SOURCE
 /begin RASTER "time synchronous event channel - 10 ms" "10_ms" 0 4 1 /end RASTER
 /begin RASTER "time synchronous event channel - 100 ms" "100_ms" 1 5 1 /end RASTER
 /begin RASTER "segment synchronous event channel" "seg_sync" 2 103 1 /end RASTER
 /begin SEED_KEY /* seed&key dll for CAL privilege */ "" /* seed&key dll for DAQ privilege */ "" /* seed&key dll for PGM privilege */ "" /end SEED_KEY
 /begin TP_BLOB /* CCP version */ 0x201 /* Blob version */ 0x202 /* CAN msg ID - send */ 0x7BC /* CAN msg ID - recv */ 0x7BD /* station address */ 0x12ED /* byte order */ 1
  /begin CAN_PARAM /* crystal frequency */ 0x1F4 /* timing register 0 */ 0x41 /* timing register 1 */ 0x25 /end CAN_PARAM
  DAQ_MODE BURST CONSISTENCY ODT ADDRESS_EXTENSION ODT
  /begin CHECKSUM_PARAM /* algorithm */ 0xC001 /* limit */ 0xFFFFFFFF CHECKSUM_CALCULATION ACTIVE_PAGE /end CHECKSUM_PARAM
  /begin DEFINED_PAGES 1 "reference page" /* address ext. */ 0x1 /* base address */ 0xE2000 /* page length */ 0x1DFFF ROM /end DEFINED_PAGES
  OPTIONAL_CMD 0xC /* SELECT_CAL_PAGE */ OPTIONAL_CMD 0xD /* BUILD_CHKSUM */ OPTIONAL_CMD 0xE /* MOVE */ OPTIONAL_CMD 0x11 /* GET_ACTIVE_CAL_PAGE */ OPTIONAL_CMD 0x19 /* SET_S_STATUS */ OPTIONAL_CMD 0xD /* GET_S_STATUS */ OPTIONAL_CMD 0x12 /* GET_SEED */ OPTIONAL_CMD 0x13 /* UNLOCK */ /end TP_BLOB
/end IF_DATA
/* --- Default-AgI-Objekt */ /* --- AgI-Objekt f¸r ETK (ASAP V1.3B0), Stand 1.0 16.7.98 --- */
/begin IF_DATA ETK
 /begin TP_BLOB /*version:*/ 0x1000001 /*pba:*/ 0x0 /*reset_cfg:*/ 0x40001800
  /begin DISTAB_CFG /*dsptab:*/ 0xD /*dat_mod:*/ 0x1 /*rfg:*/ 0x1 /*trgsegad:*/ 0x900000 /*trg_cfg:*/ 0x1020100 TRG_MOD /*Id:*/ 0x0 /*trg_mod:*/ 0xFF 0x0 0x0 0x0 /end DISTAB_CFG
  CODE_CHK /*prg_data:*/ 0x902210 /*prg_length:*/ 0xC /*prg_eram:*/ 0x90019C /*prg_length:*/ 0xC ETK_CFG 0x2 0xc2 0x3d 0xff 0xef 0x3e 0xdf 0xef 0x3d 0xff 0xfb 0xfe 0xff 0xff 0xfe 0xff 0xff 0xff 0xff 0xff 0x3 0x60 0x5 0xff /* EMU_RAM start_addr length CS offset >>>>> (multiple) */ /* EMU_DATA start_addr length CS offset >>>>> (multiple) */ /* EMU_CODE start_addr length CS offset >>>>> (multiple) */ /* RESERVED start_addr length CS offset >>>>> (multiple) */ RESERVED /*start_addr:*/ 0x902390 0x618 EXTERN -1 -1 -1 -1 -1 ETK_MAILBOX /*pattern:*/ 0x55555555 /*page_ecu:*/ DATA /*ecu_adr:*/ 0x903000 /*..length:*/ 0x8000 /*page_am:*/ EXRAM /*am_adr:*/ 0x901000 /*..length:*/ 0x7000 /end TP_BLOB
 /begin SOURCE "Synchro" 103 1 QP_BLOB 1 0x38 0x902390 0x900054 0x900040 0 0 0 /end SOURCE
 /begin SOURCE "10ms" 4 1 QP_BLOB 2 0x58 0x902478 0x90008C 0x900044 10 0 0 /end SOURCE
 /begin SOURCE "100ms" 5 1 QP_BLOB 3 0x58 0x9025E0 0x9000E4 0x900048 100 0 0 /end SOURCE
 /begin SOURCE "Bypass_Synchro" 103 1 QP_BLOB 4 0x30 0x902748 0x90013C 0x90004C 0 0x30 0x9028D8 /end SOURCE
 /begin SOURCE "Bypass_10ms" 4 1 QP_BLOB 5 0x30 0x902810 0x90016C 0x900050 10 0x30 0x902940 /end SOURCE
/end IF_DATA
/begin IF_DATA ASAP1B_KWP2000
 /begin SOURCE "timeslot" 0 0 QP_BLOB 0 BLOCKMODE 0xF0 0 20 /end SOURCE
 /begin TP_BLOB /* Blob version */ 0x100 /* ECU address on k line */ 0x12 /* requ. tester address */ 0xF1 /* ECU stimulation mode */ WuP /* byte order */ MSB_FIRST 1 /* project base address */ 0x0 SERAM /* SERAM_A */ 0x1C0000 /* SERAM_O */ 0x1C0000 /* SERAM_U */ 0x1DFFFE /* SERAM_E */ 0x1DFFFE /* Flash address */ 0x000000 /* RAM address */ 0x000000 /* Data Read */ 1 /* Code Verify */ 0 /* Code Read */ 0 /* Load mode */ 1 /begin CHECKSUM 0x010201 1 1 RequestRoutineResults RNC_RESULT 0x23 /end CHECKSUM
  /begin FLASH_COPY NOFLASHBACK 3 RequestRoutineResults RAM_InitByECU 0x86 COPY_FRAME 1 RNC_RESULT 0x23 0xFB 0xFC /end FLASH_COPY
  BAUD_DEF /* BaudRate */ 10400 /* DiagMode */ 0x86 0x14 BAUD_DEF /* BaudRate */ 20800 /* DiagMode */ 0x86 0x34 TIME_DEF 0x0005 0x0000 0x0032 0x000F 0x1388 0x0002 TIME_DEF 0x0005 0x0000 0x0032 0x0014 0x1388 0x0003 TIME_DEF 0x0014 0x000A 0x0032 0x0014 0x1388 0x0004 TIME_DEF 0x0014 0x0019 0x0032 0x001E 0x1388 0x0005 /end TP_BLOB
/end IF_DATA
/begin CHARACTERISTIC A0 "‹bertragungsfunktionskoeffizient" VALUE 0x4E5F3C KwSw 0.1249981 fak_sw_b0p0625 -0.06250000 0.06249809 FORMAT "%10.8" /end CHARACTERISTIC
/begin CHARACTERISTIC A1 "‹bertragungsfunktionskoeffizient" VALUE 0x4E5F3E KwSw 0.1249981 fak_sw_b0p0625 -0.06250000 0.06249809 FORMAT "%10.8" /end CHARACTERISTIC
/begin CHARACTERISTIC A2 "‹bertragungsfunktionskoeffizient" VALUE 0x4E5F40 KwSw 0.1249981 fak_sw_b0p0625 -0.06250000 0.06249809 FORMAT "%10.8" /end CHARACTERISTIC
/begin CHARACTERISTIC ABOLRAR "Schwelle Anzahl Starts mit Benzin im ÷l f¸r reduzierte LRA" VALUE 0x4EC585 KwUb 255.0 dez 0.00 255.0 FORMAT "%5.1" /end CHARACTERISTIC
/begin CHARACTERISTIC ABOMX "max. Anzahl Start-Z‰hler f¸r Erkennung Benzin im ÷l" VALUE 0x4EC586 KwUb 255.0 dez 0.00 255.0 FORMAT "%5.1" /end CHARACTERISTIC
/begin CHARACTERISTIC ATMTANS "Temperaturkorrektur der Abgas-Modell-Temperatur" CURVE 0x4EA6E6 KlAUbSstUbWSb 1275. temp_q5 -640.0 635.0 FORMAT "%5.1"
 /begin AXIS_DESCR STD_AXIS tatu temp_ub_q0p75_o48 3 -48.00 143.3 FORMAT "%5.1" DEPOSIT ABSOLUTE /end AXIS_DESCR
/end CHARACTERISTIC
/begin CHARACTERISTIC B1 "‹bertragungsfunktionskoeffizient" VALUE 0x4E5F42 KwSw 3.999939 fak_sw_b2 -2.000000 1.999939 FORMAT "%8.6" /end CHARACTERISTIC
/begin CHARACTERISTIC B2 "‹bertragungsfunktionskoeffizient" VALUE 0x4E5F44 KwSw 3.999939 fak_sw_b2 -2.000000 1.999939 FORMAT "%8.6" /end CHARACTERISTIC
/begin CHARACTERISTIC BTRKHTMS "Kennline zur Freigabe B_trkh" CURVE 0x4ECB14 KlAUbSstUwWUw 255.0000 dez 0.00 255.0000 FORMAT "%8.4"
 /begin AXIS_DESCR STD_AXIS tmstzyl_w temp_ub_q0p75_o48 8 -48.00000 49103.25 FORMAT "%8.2" DEPOSIT ABSOLUTE /end AXIS_DESCR
/end CHARACTERISTIC
/begin CHARACTERISTIC CAN2GANG "Zuordnungskennline von Ganginfo auf CAN zu Ganginfo real" CURVE 0x4E2C8C KlAxU8SstxU8WU8 15.00 dez 0.00 15.00 FORMAT "%5.2"
 /begin AXIS_DESCR STD_AXIS zaehler dez 10 0.00 15.00 FORMAT "%5.2" DEPOSIT ABSOLUTE /end AXIS_DESCR
/end CHARACTERISTIC
/begin CHARACTERISTIC CWEVAB "Codewort zur Abschaltung von Einspritzventilen" VALUE 0x4EB7E4 KwUb 255.0 dez 0.00 255.0 FORMAT "%5.1" /end CHARACTERISTIC
/begin CHARACTERISTIC CWKHZ "Codewort f¸r Katheizsteuerung" VALUE 0x4ECAFC KwUb 255.0 dez 0.00 255.0 FORMAT "%5.1" /end CHARACTERISTIC
/begin CHARACTERISTIC CW_AKL "" VALUE 0x4EB7E0 KwWU8 255.0 dez 0.00 255.0 FORMAT "%5.1" /end CHARACTERISTIC
/begin CHARACTERISTIC CW_RAMAIR "" VALUE 0x4E2DAC KwUb 255.0 dez 0.00 255.0 FORMAT "%5.1" /end CHARACTERISTIC
/begin CHARACTERISTIC DFKMSMN "Delta FKMSDKMN zum R¸cksetzen von B_fkmsmn" VALUE 0x4E2DAD KwUb 3.984 fak_ub_b4 0.00 3.984 FORMAT "%5.3" /end CHARACTERISTIC
/begin CHARACTERISTIC DFKMSMX "Delta FKMSDKMX zum R¸cksetzen von B_fkmsmx" VALUE 0x4E2DAE KwUb 3.984 fak_ub_b4 0.00 3.984 FORMAT "%5.3" /end CHARACTERISTIC
/begin CHARACTERISTIC DFKPVMN "Delta FKPVDKMN zum R¸cksetzen von B_fkpvmn" VALUE 0x4E2DAF KwUb 3.984 fak_ub_b4 0.00 3.984 FORMAT "%5.3" /end CHARACTERISTIC
/begin CHARACTERISTIC DFKPVMX "Delta FKPVDKMX zum R¸cksetzen von B_fkpvmx" VALUE 0x4E2DB0 KwUb 3.984 fak_ub_b4 0.00 3.984 FORMAT "%5.3" /end CHARACTERISTIC
/begin CHARACTERISTIC DFTEDS "Hysteresebreite Beladung f¸r Umschaltung auf Dauertankentl¸ftung" VALUE 0x4EB80C KwSw 127.9980 fak_sw_b64 -64.00000 63.99805 FORMAT "%8.5" /end CHARACTERISTIC
/begin CHARACTERISTIC DMDAROG "obere Schwelle f¸r Momenteneingriff Gangabh‰ngig" CURVE 0x4ED920 GklWSw 199.9969 rel_sw_b100 -100.0000 99.99695 FORMAT "%8.4" /begin AXIS_DESCR COM_AXIS gangi dez 7 0.00 255.0 AXIS_PTS_REF SGA07MDUB /end AXIS_DESCR /end CHARACTERISTIC
/begin CHARACTERISTIC DMDARUG "untere Schwelle f¸r Momenteneingriff Gangabh‰ngig" CURVE 0x4ED92E GklWSw 199.9969 rel_sw_b100 -100.0000 99.99695 FORMAT "%8.4" /begin AXIS_DESCR COM_AXIS gangi dez 7 0.00 255.0 AXIS_PTS_REF SGA07MDUB /end AXIS_DESCR /end CHARACTERISTIC
/begin CHARACTERISTIC DMRFATE "Hysterese Hochlasterkennung" VALUE 0x4EB7FC KwUb 99.61 rel_ub_b99p6 0.00 99.61 FORMAT "%5.2" /end CHARACTERISTIC
/begin CHARACTERISTIC DNARAO "Drehzahlhysterese f¸r AR aktiv" VALUE 0x4E5F18 KwUb 10200. nmot_ub_q40 0.00 10200. FORMAT "%5.0" /end CHARACTERISTIC
/begin CHARACTERISTIC DNFILO "obere Schwelle f¸r Gradient des Filterausgangs ndfil" VALUE 0x4E5F46 KwSw 8191.750 nmot_sw_q0p25 0.00 8191.750 FORMAT "%8.3" /end CHARACTERISTIC
/begin CHARACTERISTIC DNIARNG "Delta Drehzahl f¸r nmod-Initialisierung von Drehzahlgradient" CURVE 0x4E5F48 KlASwSstSwWSw 16383.75 nmot_sw_q0p25 -8192.000 8191.750 FORMAT "%8.3"
 /begin AXIS_DESCR STD_AXIS ngfar_w nmotg_sw_q0p39 6 -12800.16 12799.77 FORMAT "%8.2" DEPOSIT ABSOLUTE /end AXIS_DESCR
/end CHARACTERISTIC
/begin CHARACTERISTIC DNSAH "Delta n SA high bezogen auf nWE" VALUE 0x4E59E0 KwUb 5080. nmot_ub_q40 0.00 5080. FORMAT "%5.0" /end CHARACTERISTIC
/begin CHARACTERISTIC DNSAL "Delta n SA low bezogen auf nWE" VALUE 0x4E59E1 KwUb 5080. nmot_ub_q40 0.00 5080. FORMAT "%5.0" /end CHARACTERISTIC
/begin CHARACTERISTIC DNSLL "Schubabschalte-Hysterese bei WE im Leerlauf" VALUE 0x4E59E2 KwUb 10200. nmot_ub_q40 0.00 10200. FORMAT "%5.0" /end CHARACTERISTIC
/begin CHARACTERISTIC DNVSA "Schubabschaltedrehzahlanhebung bei kleiner Geschwindigkeit" VALUE 0x4E59E3 KwUb 10200. nmot_ub_q40 0.00 10200. FORMAT "%5.0" /end CHARACTERISTIC
/begin CHARACTERISTIC DNWEK "Delta n f¸r WE bei Klima (AC)" VALUE 0x4E59E4 KwUb 10200. nmot_ub_q40 0.00 10200. FORMAT "%5.0" /end CHARACTERISTIC
/begin CHARACTERISTIC DTKATMN "Hysterese Katalysatortemperaturregelschwelle f¸r Kat warmhalten" VALUE 0x4ECAFD KwUb 1275. temp_ub_q5_o50 -50.00 1225. FORMAT "%5.0" /end CHARACTERISTIC
/begin CHARACTERISTIC DTKH "Betrag Differenztemperatur (tans-tmst) f¸r Katheizen" VALUE 0x4ECB36 KwUw 49151.25 temp_ub_b191p25 0.00 49151.25 FORMAT "%8.2" /end CHARACTERISTIC
/begin CHARACTERISTIC DTMABKH "Temperaturdifferenz zwischen Abstellen und Neustart f¸r Freigabe Katheizen" VALUE 0x4ECB38 KwUw 49151.25 temp_ub_b191p25 0.00 49151.25 FORMAT "%8.2" /end CHARACTERISTIC
/begin CHARACTERISTIC DTUMTAT "Offset Ansauglufttemperatur -> Umgebungstemperatur" VALUE 0x4EA2D4 KwUb 191.3 temp_ub_b191p25 0.00 191.3 FORMAT "%5.1" /end CHARACTERISTIC
/begin CHARACTERISTIC DVFZAR "Hysterese fuer Geschwindigkeitsschwelle bei AR" VALUE 0x4E5F19 KwUb 318.8 vfzg_ub_q1p25 0.00 318.8 FORMAT "%5.1" /end CHARACTERISTIC
/begin CHARACTERISTIC DVSA "delta Geschwindigkeitsschwelle f¸r SA-Drehzahlanhebung" VALUE 0x4E59E5 KwUb 318.8 vfzg_ub_q1p25 0.00 318.8 FORMAT "%5.1" /end CHARACTERISTIC
/begin CHARACTERISTIC ENASAG "Freigabe SA gangabhaengig" VALUE 0x4E59E6 KwUb 255.0 dez 0.00 255.0 FORMAT "%5.1" /end CHARACTERISTIC
/begin CHARACTERISTIC EWS_ABIC_COM_TIME_SND "" VALUE 0x4E5456 KwUw 65535.00 dez 0.00 65535.00 FORMAT "%8.2" /end CHARACTERISTIC
/begin CHARACTERISTIC EWS_ABIC_COM_TIME_SND_RCV "" VALUE 0x4E5458 KwUw 65535.00 dez 0.00 65535.00 FORMAT "%8.2" /end CHARACTERISTIC
/begin CHARACTERISTIC EWS_DATA_PERIOD "" VALUE 0x4E545A KwUw 65535.00 dez 0.00 65535.00 FORMAT "%8.2" /end CHARACTERISTIC
/begin CHARACTERISTIC EWS_PAGE0_GSS "" VALUE 0x4E544C KwWU8 255.0 default 0.00 255.0 FORMAT "%5.1" /end CHARACTERISTIC
/begin CHARACTERISTIC EWS_PAGE1_ANT_OFF "" VALUE 0x4E544D KwWU8 255.0 default 0.00 255.0 FORMAT "%5.1" /end CHARACTERISTIC
/begin CHARACTERISTIC EWS_PAGE1_ANT_ON "" VALUE 0x4E544E KwWU8 255.0 default 0.00 255.0 FORMAT "%5.1" /end CHARACTERISTIC
/begin CHARACTERISTIC EWS_PAGE2_FSS1 "" VALUE 0x4E544F KwWU8 255.0 default 0.00 255.0 FORMAT "%5.1" /end CHARACTERISTIC
/begin CHARACTERISTIC EWS_PAGE2_FSS2 "" VALUE 0x4E5450 KwWU8 255.0 default 0.00 255.0 FORMAT "%5.1" /end CHARACTERISTIC
/begin CHARACTERISTIC EWS_PAGE2_FSS3 "" VALUE 0x4E5451 KwWU8 255.0 default 0.00 255.0 FORMAT "%5.1" /end CHARACTERISTIC
/begin CHARACTERISTIC EWS_PAGE2_FSS4 "" VALUE 0x4E5452 KwWU8 255.0 default 0.00 255.0 FORMAT "%5.1" /end CHARACTERISTIC
/begin CHARACTERISTIC EWS_PAGE2_GSS "" VALUE 0x4E5453 KwWU8 255.0 default 0.00 255.0 FORMAT "%5.1" /end CHARACTERISTIC
/begin CHARACTERISTIC EWS_PAGE3_GSS "" VALUE 0x4E5454 KwWU8 255.0 default 0.00 255.0 FORMAT "%5.1" /end CHARACTERISTIC
/begin CHARACTERISTIC EWS_T_DIN_EXT "" VALUE 0x4E545C KwUw 65535.00 dez 0.00 65535.00 FORMAT "%8.2" /end CHARACTERISTIC
/begin CHARACTERISTIC EWS_T_OFFSET "" VALUE 0x4E5455 KwWU8 255.0 default 0.00 255.0 FORMAT "%5.1" /end CHARACTERISTIC
/begin CHARACTERISTIC EWS_T_SAMPLE_DELAY "" VALUE 0x4E545E KwUw 65535.00 dez 0.00 65535.00 FORMAT "%8.2" /end CHARACTERISTIC
/begin CHARACTERISTIC EWS_T_SETUP "" VALUE 0x4E5460 KwUw 65535.00 dez 0.00 65535.00 FORMAT "%8.2" /end CHARACTERISTIC
/begin CHARACTERISTIC FATMAHK "Faktor W‰rmeverlust an Wand vor Hauptkat" CURVE 0x4EA6EE KlAUwSstUwWUw 0.9999847 fak_uw_b1 0.00 0.9999847 FORMAT "%9.7"
 /begin AXIS_DESCR STD_AXIS msabvhk_w m_uw_b6553p5 8 0.00 6553.500 FORMAT "%8.3" DEPOSIT ABSOLUTE /end AXIS_DESCR
/end CHARACTERISTIC
/begin CHARACTERISTIC FATMLSRML "Faktor fuer die Aufteilung Abgas-/Abgas-Rohrwandtemp.(LSH Boxer-Motoren)" CURVE 0x4EA2D8 GklWUb 0.9961 fak_ub_b1 0.00 0.9961
 /begin AXIS_DESCR COM_AXIS ml_w m_uw_b6553p5 7 0.00 6553.500 AXIS_PTS_REF SML07TMUW /end AXIS_DESCR
/end CHARACTERISTIC
/begin CHARACTERISTIC FATMLSRML2 "" CURVE 0x4EA2E0 GklWUb 0.9961 fak_ub_b1 0.00 0.9961
 /begin AXIS_DESCR COM_AXIS ml_w m_uw_b6553p5 7 0.00 6553.500 AXIS_PTS_REF SML07TMUW /end AXIS_DESCR
/end CHARACTERISTIC
/begin CHARACTERISTIC FATMLSVM "Abgastemp.aenderung abhaengig von der Fahrgeschw.(LSH bei Boxer-Motoren)" CURVE 0x4EA2E8 KlAUbSstUbWUb 1.992 fak_ub_b2 0.00 1.992 FORMAT "%5.3"
 /begin AXIS_DESCR STD_AXIS vfzg vfzg_ub_q1p25 6 0.00 318.8 FORMAT "%5.1" DEPOSIT ABSOLUTE /end AXIS_DESCR
/end CHARACTERISTIC
/begin CHARACTERISTIC FATMRML "Faktor fuer die Aufteilung Abgas-/Abgas-Rohrwandtemperatur" CURVE 0x4EA2F8 GklWUb 0.9961 fak_ub_b1 0.00 0.9961
 /begin AXIS_DESCR COM_AXIS ml_w m_uw_b6553p5 7 0.00 6553.500 AXIS_PTS_REF SML07TMUW /end AXIS_DESCR
/end CHARACTERISTIC
/begin CHARACTERISTIC FATMRML2 "Faktor fuer die Aufteilung Abgas-/Abgas-Rohrwandtemperatur Bank2" CURVE 0x4EA300 GklWUb 0.9961 fak_ub_b1 0.00 0.9961
 /begin AXIS_DESCR COM_AXIS ml_w m_uw_b6553p5 7 0.00 6553.500 AXIS_PTS_REF SML07TMUW /end AXIS_DESCR
/end CHARACTERISTIC
/begin CHARACTERISTIC FATMTWHK "Reduktionsfaktor f¸r Initialisierung Wandtemperatur vor HK im Verh‰ltnis zu tats" VALUE 0x4EA307 KwUb 0.9961 fak_ub_b1 0.00 0.9961 /end CHARACTERISTIC
/begin CHARACTERISTIC FATMVHK "W‰rmeverlust von Rohr vor Hauptkat an Umgebung durch Fahrtwind" CURVE 0x4EA710 KlAUbSstUbWUw 113.7760 fak_q0p00174_JsK 0.00 113.7760 FORMAT "%8.4"
 /begin AXIS_DESCR STD_AXIS vfzg vfzg_ub_q1p25 7 0.00 318.8 FORMAT "%5.1" DEPOSIT ABSOLUTE /end AXIS_DESCR
/end CHARACTERISTIC
/begin CHARACTERISTIC FATMVM "Abgastemperaturaenderung abhaengig von der Fahrgeschwindigkeit" CURVE 0x4EA308 KlAUbSstUbWUb 1.992 fak_ub_b2 0.00 1.992 FORMAT "%5.3"
 /begin AXIS_DESCR STD_AXIS vfzg vfzg_ub_q1p25 6 0.00 318.8 FORMAT "%5.1" DEPOSIT ABSOLUTE /end AXIS_DESCR
/end CHARACTERISTIC
/begin CHARACTERISTIC FHOKH "minimaler Hˆhenfaktor f¸r Katheizen" VALUE 0x4ECB3A KwUw 3.999939 fak_uw_b4 0.00 3.999939 FORMAT "%8.6" /end CHARACTERISTIC
/begin CHARACTERISTIC FKEEV0N "Korrekturfaktor zur Einspritzzeitkorrektur Ev1" CURVE 0x4E3FA8 GklWU8 1.992 fak_ub_b2 0.00 1.992 FORMAT "%5.3"
 /begin AXIS_DESCR COM_AXIS nmot nmot_ub_q40 8 0.00 10200. AXIS_PTS_REF SNM08GKUB /end AXIS_DESCR
/end CHARACTERISTIC
/begin CHARACTERISTIC FKEEV1N "Korrekturfaktor zur Einspritzzeitkorrektur Ev2" CURVE 0x4E3FB0 GklWU8 1.992 fak_ub_b2 0.00 1.992 FORMAT "%5.3"
 /begin AXIS_DESCR COM_AXIS nmot nmot_ub_q40 8 0.00 10200. AXIS_PTS_REF SNM08GKUB /end AXIS_DESCR
/end CHARACTERISTIC
/begin CHARACTERISTIC FKEEV2N "Korrekturfaktor zur Einspritzzeitkorrektur Ev3" CURVE 0x4E3FB8 GklWU8 1.992 fak_ub_b2 0.00 1.992 FORMAT "%5.3"
 /begin AXIS_DESCR COM_AXIS nmot nmot_ub_q40 8 0.00 10200. AXIS_PTS_REF SNM08GKUB /end AXIS_DESCR
/end CHARACTERISTIC
/begin CHARACTERISTIC FKEEV3N "Korrekturfaktor zur Einspritzzeitkorrektur Ev4" CURVE 0x4E3FC0 GklWU8 1.992 fak_ub_b2 0.00 1.992 FORMAT "%5.3"
 /begin AXIS_DESCR COM_AXIS nmot nmot_ub_q40 8 0.00 10200. AXIS_PTS_REF SNM08GKUB /end AXIS_DESCR
/end CHARACTERISTIC
/begin CHARACTERISTIC FKEEV4N "Korrekturfaktor zur Einspritzzeitkorrektur Ev5" CURVE 0x4E3FC8 GklWU8 1.992 fak_ub_b2 0.00 1.992 FORMAT "%5.3"
 /begin AXIS_DESCR COM_AXIS nmot nmot_ub_q40 8 0.00 10200. AXIS_PTS_REF SNM08GKUB /end AXIS_DESCR
/end CHARACTERISTIC
/begin CHARACTERISTIC FKEEV5N "Korrekturfaktor zur Einspritzzeitkorrektur Ev6" CURVE 0x4E3FD0 GklWU8 1.992 fak_ub_b2 0.00 1.992 FORMAT "%5.3"
 /begin AXIS_DESCR COM_AXIS nmot nmot_ub_q40 8 0.00 10200. AXIS_PTS_REF SNM08GKUB /end AXIS_DESCR
/end CHARACTERISTIC
/begin CHARACTERISTIC FKEEV6N "Korrekturfaktor zur Einspritzzeitkorrektur Ev7" CURVE 0x4E3FD8 GklWU8 1.992 fak_ub_b2 0.00 1.992 FORMAT "%5.3"
 /begin AXIS_DESCR COM_AXIS nmot nmot_ub_q40 8 0.00 10200. AXIS_PTS_REF SNM08GKUB /end AXIS_DESCR
/end CHARACTERISTIC
/begin CHARACTERISTIC FKEEV7N "Korrekturfaktor zur Einspritzzeitkorrektur Ev8" CURVE 0x4E3FE0 GklWU8 1.992 fak_ub_b2 0.00 1.992 FORMAT "%5.3"
 /begin AXIS_DESCR COM_AXIS nmot nmot_ub_q40 8 0.00 10200. AXIS_PTS_REF SNM08GKUB /end AXIS_DESCR
/end CHARACTERISTIC
/begin CHARACTERISTIC FKHABMN "Schwelle Abregelfaktor Katheizen" VALUE 0x4ECAFE KwUb 0.9961 fak_ub_b1 0.00 0.9961 /end CHARACTERISTIC
/begin CHARACTERISTIC FKHLA "Wichtungsfaktor Lambda-Soll f¸r Katheizen" CURVE 0x4ECB3C KlAUwSstUwWUw 0.9999847 fak_uw_b1 0.00 0.9999847 FORMAT "%9.7"
 /begin AXIS_DESCR STD_AXIS imlpr_w fak_uw_b1 8 0.00 0.9999847 FORMAT "%9.7" DEPOSIT ABSOLUTE /end AXIS_DESCR
/end CHARACTERISTIC
/begin CHARACTERISTIC FKHMD "Wichtungsfaktor Drehmomentreserve f¸r Katheizen" CURVE 0x4ECB5E KlAUwSstUwWUw 0.9999847 fak_uw_b1 0.00 0.9999847 FORMAT "%9.7"
 /begin AXIS_DESCR STD_AXIS imlpr_w fak_uw_b1 8 0.00 0.9999847 FORMAT "%9.7" DEPOSIT ABSOLUTE /end AXIS_DESCR
/end CHARACTERISTIC
/begin CHARACTERISTIC FKMSDKMN "min.Korrekturfaktor schneller Massenstromabgleich" VALUE 0x4E2DB1 KwUb 3.984 fak_ub_b4 0.00 3.984 FORMAT "%5.3" /end CHARACTERISTIC
/begin CHARACTERISTIC FKMSDKMX "max.Korrekturfaktor schneller Massenstromabgleich" VALUE 0x4E2DB2 KwUb 3.984 fak_ub_b4 0.00 3.984 FORMAT "%5.3" /end CHARACTERISTIC
/begin CHARACTERISTIC FKPVDKE "Initialisierungswert f¸r Integrator Korrekturfaktor Massenstromabgleich" VALUE 0x4E2DB3 KwUb 3.984 fak_ub_b4 0.00 3.984 FORMAT "%5.3" /end CHARACTERISTIC
/begin CHARACTERISTIC FKPVDKMN "Minimaler Korrekturfaktor langsamer Massenstomabgleich" VALUE 0x4E2DB4 KwUb 3.984 fak_ub_b4 0.00 3.984 FORMAT "%5.3" /end CHARACTERISTIC
/begin CHARACTERISTIC FKPVDKMX "Maximaler Korrekturfaktor langsamer Massenstomabgleich" VALUE 0x4E2DB5 KwUb 3.984 fak_ub_b4 0.00 3.984 FORMAT "%5.3" /end CHARACTERISTIC
/begin CHARACTERISTIC FLRAG "Verst‰rkung Lastregler bei AT" CURVE 0x4ED8E4 GklWUb 15.94 fak_ub_b16 0.00 15.94 FORMAT "%5.2" /begin AXIS_DESCR COM_AXIS gangi dez 7 0.00 255.0 AXIS_PTS_REF SGA07MDUB /end AXIS_DESCR /end CHARACTERISTIC
/begin CHARACTERISTIC FLRAWG "Verst‰rkung Lastregler bei AT, WK geschlossen" CURVE 0x4ED8EC GklWUb 15.94 fak_ub_b16 0.00 15.94 FORMAT "%5.2" /begin AXIS_DESCR COM_AXIS gangi dez 7 0.00 255.0 AXIS_PTS_REF SGA07MDUB /end AXIS_DESCR /end CHARACTERISTIC
/begin CHARACTERISTIC FLRHG "Verst‰rkung Lastregler" CURVE 0x4ED8F4 GklWUb 15.94 fak_ub_b16 0.00 15.94 FORMAT "%5.2" /begin AXIS_DESCR COM_AXIS gangi dez 7 0.00 255.0 AXIS_PTS_REF SGA07MDUB /end AXIS_DESCR /end CHARACTERISTIC
/begin CHARACTERISTIC FMRFAZTE "Gewichtung der Drehzahl um jetzige Leistung zu berechnen" CURVE 0x4EB800 KlAUbSstUbWUb 3.984 fak_ub_b4 0.00 3.984 FORMAT "%5.3"
 /begin AXIS_DESCR STD_AXIS nmot nmot_ub_q40 4 0.00 10200. FORMAT "%5.0" DEPOSIT ABSOLUTE /end AXIS_DESCR
/end CHARACTERISTIC
/begin CHARACTERISTIC FNSKHLL "Faktor f¸r Drehzahlanhebung direkt nach Start" CURVE 0x4ECB00 KlAUbSstUbWUb 1.992 fak_ub_b2 0.00 1.992 FORMAT "%5.3" /begin AXIS_DESCR STD_AXIS imlpr fak_ub_b1 5 0.00 0.9961 DEPOSIT ABSOLUTE /end AXIS_DESCR /end CHARACTERISTIC
/begin CHARACTERISTIC FRARAG "Verst‰rkungsfaktor bei AT" CURVE 0x4ED8FC GklWUb 3.113 fak_ub_b3p125 0.00 3.113 FORMAT "%5.3" /begin AXIS_DESCR COM_AXIS gangi dez 7 0.00 255.0 AXIS_PTS_REF SGA07MDUB /end AXIS_DESCR /end CHARACTERISTIC
/begin CHARACTERISTIC FRARAWG "Verst‰rkungsfaktor bei AT, WK geschlossen" CURVE 0x4ED904 GklWUb 3.113 fak_ub_b3p125 0.00 3.113 FORMAT "%5.3" /begin AXIS_DESCR COM_AXIS gangi dez 7 0.00 255.0 AXIS_PTS_REF SGA07MDUB /end AXIS_DESCR /end CHARACTERISTIC
/begin CHARACTERISTIC FRARHG "Verst‰rkungsfaktor" CURVE 0x4ED90C GklWUb 3.113 fak_ub_b3p125 0.00 3.113 FORMAT "%5.3" /begin AXIS_DESCR COM_AXIS gangi dez 7 0.00 255.0 AXIS_PTS_REF SGA07MDUB /end AXIS_DESCR /end CHARACTERISTIC
/begin CHARACTERISTIC FTEADZU "Schwelle Beladung f¸r Unterbrechung TE-Phase f¸r Diagnose Funktionen" VALUE 0x4EB80E KwSw 127.9980 fak_sw_b64 -64.00000 63.99805 FORMAT "%8.5" /end CHARACTERISTIC
/begin CHARACTERISTIC FTEDS "Schwelle Beladung f¸r Umschaltung auf Dauertankentl¸ftung" VALUE 0x4EB810 KwSw 127.9980 fak_sw_b64 -64.00000 63.99805 FORMAT "%8.5" /end CHARACTERISTIC
/begin CHARACTERISTIC FTMLAKH "tmot-Korrektur der Lambda-Bewertung bei Katheizen" CURVE 0x4ECB80 KlAUbSstUwWUw 0.9960938 fak_ub_b1 0.00 0.9960938 FORMAT "%9.7"
 /begin AXIS_DESCR STD_AXIS tmotzyl_w temp_ub_q0p75_o48 4 -48.00000 49103.25 FORMAT "%8.2" DEPOSIT ABSOLUTE /end AXIS_DESCR
/end CHARACTERISTIC
/begin CHARACTERISTIC FTMOTKHK "Faktor des Motortemperatureinfluﬂes auf  W‰rmeverluste Hauptkat" VALUE 0x4EA315 KwUb 2.361 fak_q0p00926_JsKK 0.00 2.361 FORMAT "%5.3" /end CHARACTERISTIC
/begin CHARACTERISTIC Fwemx "" VALUE 0x4EB7E5 KwUb 3.984 fak_ub_b4 0.00 3.984 FORMAT "%5.3" /end CHARACTERISTIC
/begin CHARACTERISTIC FWMABGW "Faktor f¸r W‰rmemengen bei Wiederholstart Abgas" VALUE 0x4EA316 KwUb 0.9961 fak_ub_b1 0.00 0.9961 /end CHARACTERISTIC
/begin CHARACTERISTIC FWMABGW2 "Faktor f¸r W‰rmemengen bei Wiederholstart Abgas Bank2" VALUE 0x4EA317 KwUb 0.9961 fak_ub_b1 0.00 0.9961 /end CHARACTERISTIC
/begin CHARACTERISTIC FWMKATW "Faktor f¸r W‰rmemengen bei Wiederholstart Kat f¸r Taupunktende" VALUE 0x4EA318 KwUb 0.9961 fak_ub_b1 0.00 0.9961 /end CHARACTERISTIC
/begin CHARACTERISTIC FWMKATW2 "Faktor f¸r W‰rmemengen bei Wiederholstart Kat f¸r Taupunktende Bank2" VALUE 0x4EA319 KwUb 0.9961 fak_ub_b1 0.00 0.9961 /end CHARACTERISTIC
/begin CHARACTERISTIC GANG2V "Umrechnungskennline zum berechnen von V aus Ganginfo und nmot" CURVE 0x4E2CAC KlAUwSstUwWUw 10.00004 nmot2vfzg_uw 0.00 10.00004 FORMAT "%8.5"
 /begin AXIS_DESCR STD_AXIS gangi dez 10 0.00 15.00000 FORMAT "%8.5" DEPOSIT ABSOLUTE /end AXIS_DESCR
/end CHARACTERISTIC
/begin CHARACTERISTIC IGESGA "Gesamt-‹bersetzungsverh‰ltnis" CURVE 0x4E2CA4 FklWUb 25.50 fak_q0p1 0.00 25.50 FORMAT "%5.2"
 /begin AXIS_DESCR FIX_AXIS gangi dez 8 0.00 7.000 FORMAT "%5.3" FIX_AXIS_PAR 0 0 8 /end AXIS_DESCR
/end CHARACTERISTIC
/begin CHARACTERISTIC IKURUN "Schwelle Erkennung Kupplung rutscht negativ" CURVE 0x4E2CF2 GklWSw 511.9922 qnv_sw_q0p0078 -256.0000 255.9922 FORMAT "%8.4" /begin AXIS_DESCR COM_AXIS gangi dez 7 0.00 255.0 AXIS_PTS_REF SGA07MDUB /end AXIS_DESCR /end CHARACTERISTIC
/begin CHARACTERISTIC IKURUP "Schwelle Erkennung Kupplung rutscht positiv" CURVE 0x4E2D00 GklWSw 511.9922 qnv_sw_q0p0078 -256.0000 255.9922 FORMAT "%8.4" /begin AXIS_DESCR COM_AXIS gangi dez 7 0.00 255.0 AXIS_PTS_REF SGA07MDUB /end AXIS_DESCR /end CHARACTERISTIC
/begin CHARACTERISTIC IMLATWS "Luftmassen-Schwelle f¸r Kat-Heizen nach Wiederholstart" VALUE 0x4ECB92 KwUw 23.30133 m_uw_b23p3 0.00 23.30133 FORMAT "%8.5" /end CHARACTERISTIC
/begin CHARACTERISTIC IMLKHMX "max. Verh‰ltnisfaktor psum_w/mlsu f¸r Einschaltung Katheizen" VALUE 0x4ECB0B KwUb 0.9961 fak_ub_b1 0.00 0.9961 /end CHARACTERISTIC
/begin CHARACTERISTIC IMLKHTMS "imlpr-Schwelle f¸r ‹bergang auf Lambda-Katheizen" CURVE 0x4E54C4 KlAUbSstUwWUw 0.9960938 fak_ub_b1 0.00 0.9960938 FORMAT "%9.7"
 /begin AXIS_DESCR STD_AXIS tmstzyl_w temp_ub_q0p75_o48 8 -48.00000 49103.25 FORMAT "%8.2" DEPOSIT ABSOLUTE /end AXIS_DESCR
/end CHARACTERISTIC
/begin CHARACTERISTIC IMLKS "Schwelle f¸r integrierten Luftmassenstrom f¸r Erkennung Benzin im ÷l" VALUE 0x4EC587 KwUb 23.21 m_ub_b23p3 0.00 23.21 FORMAT "%5.2" /end CHARACTERISTIC
/begin CHARACTERISTIC IMTUMTAT "Schwelle integrierte Luftmasse f¸r Bestimmung Umgebungstemperatur aus TANS" VALUE 0x4EA31A KwUb 23.21 m_ub_b23p3 0.00 23.21 FORMAT "%5.2" /end CHARACTERISTIC
/begin CHARACTERISTIC KATMCPHK "Absolute W‰rmekapazit‰t Rohr vor Hauptkat = cp_Rohr*Masse Rohr Hauptkat" VALUE 0x4EA726 KwUw 14563.33 fak_q0p2222_JK 0.00 14563.33 FORMAT "%8.2" /end CHARACTERISTIC
/begin CHARACTERISTIC KATMEXML "Exotherme Temperatur im KAT tkatm" CURVE 0x4EA31C GklWSb 1275. temp_q5 -640.0 635.0 FORMAT "%5.1"
 /begin AXIS_DESCR COM_AXIS ml_w m_uw_b6553p5 7 0.00 6553.500 AXIS_PTS_REF SML07TMUW /end AXIS_DESCR
/end CHARACTERISTIC
/begin CHARACTERISTIC KATMEXML2 "Exotherme Temperatur im Kat, Bank 2" CURVE 0x4EA324 GklWSb 1275. temp_q5 -640.0 635.0 FORMAT "%5.1"
 /begin AXIS_DESCR COM_AXIS ml_w m_uw_b6553p5 7 0.00 6553.500 AXIS_PTS_REF SML07TMUW /end AXIS_DESCR
/end CHARACTERISTIC
/begin CHARACTERISTIC KATMIEXML "Exotherme Temperatur im KAT tikatm" CURVE 0x4EA32C GklWSb 1275. temp_q5 -640.0 635.0 FORMAT "%5.1"
 /begin AXIS_DESCR COM_AXIS ml_w m_uw_b6553p5 7 0.00 6553.500 AXIS_PTS_REF SML07TMUW /end AXIS_DESCR
/end CHARACTERISTIC
/begin CHARACTERISTIC KATMIEXML2 "Exotherme Temperatur im KAT tikatm, Bank 2" CURVE 0x4EA334 GklWSb 1275. temp_q5 -640.0 635.0 FORMAT "%5.1"
 /begin AXIS_DESCR COM_AXIS ml_w m_uw_b6553p5 7 0.00 6553.500 AXIS_PTS_REF SML07TMUW /end AXIS_DESCR
/end CHARACTERISTIC
/begin CHARACTERISTIC KATMVEXML2 "Exotherme Temperatur im Vorkat, Bank2" CURVE 0x4EA33C GklWSb 1275. temp_q5 -640.0 635.0 FORMAT "%5.1"
 /begin AXIS_DESCR COM_AXIS ml_w m_uw_b6553p5 6 0.00 6553.500 AXIS_PTS_REF SML06TMUW /end AXIS_DESCR
/end CHARACTERISTIC
/begin CHARACTERISTIC KFATMABKA "Faktor f¸r Abgastemperaturabnahme = f(Abstellzeit,Umgebungstemperatur)" MAP 0x4EA344 GkfWUb 0.9961 fak_ub_b1 0.00 0.9961
 /begin AXIS_DESCR COM_AXIS tabstatm_w t1sxs_uw_q1 6 0.00 65535.00 AXIS_PTS_REF STS06TMUW /end AXIS_DESCR
 /begin AXIS_DESCR COM_AXIS tatu temp_ub_q0p75_o48 5 -48.00 143.3 AXIS_PTS_REF STU05TMUB /end AXIS_DESCR
/end CHARACTERISTIC
/begin CHARACTERISTIC KFATMABKA2 "Faktor f¸r Abgastemperaturabnahme = f(Abstellzeit,Umgebungstemperatur), Bank2" MAP 0x4EA364 GkfWUb 0.9961 fak_ub_b1 0.00 0.9961
 /begin AXIS_DESCR COM_AXIS tabstatm_w t1sxs_uw_q1 6 0.00 65535.00 AXIS_PTS_REF STS06TMUW /end AXIS_DESCR
 /begin AXIS_DESCR COM_AXIS tatu temp_ub_q0p75_o48 5 -48.00 143.3 AXIS_PTS_REF STU05TMUB /end AXIS_DESCR
/end CHARACTERISTIC
/begin CHARACTERISTIC KFATMABKK "Faktor f¸r Abnahme der Katalysatortemperatur = f(Abstellzeit,Umg.temp.)" MAP 0x4EA384 GkfWUb 0.9961 fak_ub_b1 0.00 0.9961
 /begin AXIS_DESCR COM_AXIS tabstatm_w t1sxs_uw_q1 6 0.00 65535.00 AXIS_PTS_REF STS06TMUW /end AXIS_DESCR
 /begin AXIS_DESCR COM_AXIS tatu temp_ub_q0p75_o48 5 -48.00 143.3 AXIS_PTS_REF STU05TMUB /end AXIS_DESCR
/end CHARACTERISTIC
/begin CHARACTERISTIC KFATMABKK2 "Faktor f¸r Abnahme der Katalysatortemperatur = f(Abstellzeit,Umg.temp.), Bank2" MAP 0x4EA3A4 GkfWUb 0.9961 fak_ub_b1 0.00 0.9961
 /begin AXIS_DESCR COM_AXIS tabstatm_w t1sxs_uw_q1 6 0.00 65535.00 AXIS_PTS_REF STS06TMUW /end AXIS_DESCR
 /begin AXIS_DESCR COM_AXIS tatu temp_ub_q0p75_o48 5 -48.00 143.3 AXIS_PTS_REF STU05TMUB /end AXIS_DESCR
/end CHARACTERISTIC
/begin CHARACTERISTIC KFATMLA "Kennfeld Abgastemperatur-Korrektur = f(Lambda)" MAP 0x4EA3C4 GkfWSb 1275. temp_q5 -640.0 635.0 FORMAT "%5.1"
 /begin AXIS_DESCR COM_AXIS ml_w m_uw_b6553p5 6 0.00 6553.500 AXIS_PTS_REF SML06TMUW /end AXIS_DESCR
 /begin AXIS_DESCR COM_AXIS lamsons_w fak_uw_b16 6 0.00 15.99976 AXIS_PTS_REF SLX06TMUW /end AXIS_DESCR
/end CHARACTERISTIC
/begin CHARACTERISTIC KFATMLA2 "Kennfeld Abgastemperatur-Korrektur = f(lambda) Bank2" MAP 0x4EA3E8 GkfWSb 1275. temp_q5 -640.0 635.0 FORMAT "%5.1"
 /begin AXIS_DESCR COM_AXIS ml_w m_uw_b6553p5 6 0.00 6553.500 AXIS_PTS_REF SML06TMUW /end AXIS_DESCR
 /begin AXIS_DESCR COM_AXIS lamsbg2_w fak_uw_b16 6 0.00 15.99976 AXIS_PTS_REF SLY06TMUW /end AXIS_DESCR
/end CHARACTERISTIC
/begin CHARACTERISTIC KFATMLSABKA "" MAP 0x4EA40C GkfWUb 0.9961 fak_ub_b1 0.00 0.9961
 /begin AXIS_DESCR COM_AXIS tabstatm_w t1sxs_uw_q1 6 0.00 65535.00 AXIS_PTS_REF STS06TMUW /end AXIS_DESCR
 /begin AXIS_DESCR COM_AXIS tatu temp_ub_q0p75_o48 5 -48.00 143.3 AXIS_PTS_REF STU05TMUB /end AXIS_DESCR
/end CHARACTERISTIC
/begin CHARACTERISTIC KFATMLSABKA2 "" MAP 0x4EA42C GkfWUb 0.9961 fak_ub_b1 0.00 0.9961
 /begin AXIS_DESCR COM_AXIS tabstatm_w t1sxs_uw_q1 6 0.00 65535.00 AXIS_PTS_REF STS06TMUW /end AXIS_DESCR
 /begin AXIS_DESCR COM_AXIS tatu temp_ub_q0p75_o48 5 -48.00 143.3 AXIS_PTS_REF STU05TMUB /end AXIS_DESCR
/end CHARACTERISTIC
/begin CHARACTERISTIC KFATMLSLA "Kennfeld Abgastemp.-Korrektur=f(lambda)(LSH bei Boxer-Motoren)" MAP 0x4EA44C GkfWSb 1275. temp_q5 -640.0 635.0 FORMAT "%5.1"
 /begin AXIS_DESCR COM_AXIS ml_w m_uw_b6553p5 6 0.00 6553.500 AXIS_PTS_REF SML06TMUW /end AXIS_DESCR
 /begin AXIS_DESCR COM_AXIS lamsons_w fak_uw_b16 6 0.00 15.99976 AXIS_PTS_REF SLX06TMUW /end AXIS_DESCR
/end CHARACTERISTIC
/begin CHARACTERISTIC KFATMLSLA2 "Kennfeld Abgastemp.-Korrektur=f(lambda) Bank2(LSH Boxer-Motoren)" MAP 0x4EA470 GkfWSb 1275. temp_q5 -640.0 635.0 FORMAT "%5.1"
 /begin AXIS_DESCR COM_AXIS ml_w m_uw_b6553p5 6 0.00 6553.500 AXIS_PTS_REF SML06TMUW /end AXIS_DESCR
 /begin AXIS_DESCR COM_AXIS lamsbg2_w fak_uw_b16 6 0.00 15.99976 AXIS_PTS_REF SLY06TMUW /end AXIS_DESCR
/end CHARACTERISTIC
/begin CHARACTERISTIC KFATMLSZW "Kennfeld Abgastemp.-Korrektur = f(Z¸nd.)(LSH bei Boxer-Motoren)" MAP 0x4EA494 GkfWSb 1275. temp_q5 -640.0 635.0 FORMAT "%5.1"
 /begin AXIS_DESCR COM_AXIS ml_w m_uw_b6553p5 6 0.00 6553.500 AXIS_PTS_REF SML06TMUW /end AXIS_DESCR
 /begin AXIS_DESCR COM_AXIS etazwimt rel_ub_b127p5 6 0.00 127.5 AXIS_PTS_REF SEZ06TMUB /end AXIS_DESCR
/end CHARACTERISTIC
/begin CHARACTERISTIC KFATMLSZW2 "Kennfeld Abgastemp.-Korrektur=f(Z¸ndw.)Bank2(LSH Boxer-Motoren)" MAP 0x4EA4B8 GkfWSb 1275. temp_q5 -640.0 635.0 FORMAT "%5.1"
 /begin AXIS_DESCR COM_AXIS ml_w m_uw_b6553p5 6 0.00 6553.500 AXIS_PTS_REF SML06TMUW /end AXIS_DESCR
 /begin AXIS_DESCR COM_AXIS etazwimt rel_ub_b127p5 6 0.00 127.5 AXIS_PTS_REF SEZ06TMUB /end AXIS_DESCR
/end CHARACTERISTIC
/begin CHARACTERISTIC KFATMZW "Kennfeld Abgastemperatur-Korrektur = f(Z¸ndwinkelverstellung)" MAP 0x4EA4DC GkfWSb 1275. temp_q5 -640.0 635.0 FORMAT "%5.1"
 /begin AXIS_DESCR COM_AXIS ml_w m_uw_b6553p5 6 0.00 6553.500 AXIS_PTS_REF SML06TMUW /end AXIS_DESCR
 /begin AXIS_DESCR COM_AXIS etazwimt rel_ub_b127p5 6 0.00 127.5 AXIS_PTS_REF SEZ06TMUB /end AXIS_DESCR
/end CHARACTERISTIC
/begin CHARACTERISTIC KFATMZW2 "Kennfeld Abgastemperatur-Korrektur = f(Z¸ndwinkel) Bank2" MAP 0x4EA500 GkfWSb 1275. temp_q5 -640.0 635.0 FORMAT "%5.1"
 /begin AXIS_DESCR COM_AXIS ml_w m_uw_b6553p5 6 0.00 6553.500 AXIS_PTS_REF SML06TMUW /end AXIS_DESCR
 /begin AXIS_DESCR COM_AXIS etazwimt rel_ub_b127p5 6 0.00 127.5 AXIS_PTS_REF SEZ06TMUB /end AXIS_DESCR
/end CHARACTERISTIC
/begin CHARACTERISTIC KFMSNWDK "Kennfeld normierter Massenstrom ¸ber DK" MAP 0x4E2DCE KfAxUwAyUwSstxUwSstyUwWUw 6553.500 m_uw_b6553p5 0.00 6553.500 FORMAT "%8.3"
 /begin AXIS_DESCR STD_AXIS wdkbab_w rel_uw_b100 24 0.00 99.99847 FORMAT "%8.5" DEPOSIT ABSOLUTE /end AXIS_DESCR
 /begin AXIS_DESCR STD_AXIS nmot_w nmot_uw_q0p25 24 0.00 16383.75 FORMAT "%8.2" DEPOSIT ABSOLUTE /end AXIS_DESCR
/end CHARACTERISTIC
/begin CHARACTERISTIC KFNFSKHM "Leerlaufsolldrehzahl bei Katheizen mit eingelegter Fahrstufe" MAP 0x4E5484 GkfWU8 2550. nmot_ub_q10 0.00 2550. FORMAT "%5.0"
 /begin AXIS_DESCR COM_AXIS tmotzyl_w temp_ub_q0p75_o48 8 -48.00000 49103.25 AXIS_PTS_REF STMZYL08BBUW /end AXIS_DESCR
 /begin AXIS_DESCR COM_AXIS frhol_w fak_uw_b2 4 0.00 1.999969 AXIS_PTS_REF SFR04BBUW /end AXIS_DESCR
/end CHARACTERISTIC
/begin CHARACTERISTIC KFNLLKHM "Leerlaufsolldrehzahl bei Kat.-Heizung" MAP 0x4E54A4 GkfWU8 2550. nmot_ub_q10 0.00 2550. FORMAT "%5.0"
 /begin AXIS_DESCR COM_AXIS tmotzyl_w temp_ub_q0p75_o48 8 -48.00000 49103.25 AXIS_PTS_REF STMZYL08BBUW /end AXIS_DESCR
 /begin AXIS_DESCR COM_AXIS frhol_w fak_uw_b2 4 0.00 1.999969 AXIS_PTS_REF SFR04BBUW /end AXIS_DESCR
/end CHARACTERISTIC
/begin CHARACTERISTIC KFRAMAIREF "" MAP 0x4E32B2 KfAxUwAyUwSstxUwSstyUwWUw 6553.500 m_uw_b6553p5 0.00 6553.500 FORMAT "%8.3"
 /begin AXIS_DESCR STD_AXIS vfzg_w vfzg_uw_b512 12 0.00 511.9922 FORMAT "%8.4" DEPOSIT ABSOLUTE /end AXIS_DESCR
 /begin AXIS_DESCR STD_AXIS wdkbab_w rel_uw_b100 12 0.00 99.99847 FORMAT "%8.5" DEPOSIT ABSOLUTE /end AXIS_DESCR
/end CHARACTERISTIC
/begin CHARACTERISTIC KFTATM "Kennfeld Abgastemperatur   f(nmot,rl)" MAP 0x4EA524 KfAxUbAyUbSstxUbSstyUbWUb 1275. temp_ub_q5_o50 -50.00 1225. FORMAT "%5.0"
 /begin AXIS_DESCR STD_AXIS nmot nmot_ub_q40 8 0.00 10200. FORMAT "%5.0" DEPOSIT ABSOLUTE /end AXIS_DESCR
 /begin AXIS_DESCR STD_AXIS rl rel_ub_q0p75 8 0.00 191.3 FORMAT "%5.1" DEPOSIT ABSOLUTE /end AXIS_DESCR
/end CHARACTERISTIC
/begin CHARACTERISTIC KFTATM2 "Kennfeld Abgastemperatur f(nmot,rl) Bank2" MAP 0x4EA578 KfAxUbAyUbSstxUbSstyUbWUb 1275. temp_ub_q5_o50 -50.00 1225. FORMAT "%5.0"
 /begin AXIS_DESCR STD_AXIS nmot nmot_ub_q40 8 0.00 10200. FORMAT "%5.0" DEPOSIT ABSOLUTE /end AXIS_DESCR
 /begin AXIS_DESCR STD_AXIS rl rel_ub_q0p75 8 0.00 191.3 FORMAT "%5.1" DEPOSIT ABSOLUTE /end AXIS_DESCR
/end CHARACTERISTIC
/begin CHARACTERISTIC KFTATMLS "Kennfeld Abgastemp. f(nmot,rl) (fuer LSH bei Boxer-Motoren)" MAP 0x4EA5CC KfAxUbAyUbSstxUbSstyUbWUb 1275. temp_ub_q5_o50 -50.00 1225. FORMAT "%5.0"
 /begin AXIS_DESCR STD_AXIS nmot nmot_ub_q40 8 0.00 10200. FORMAT "%5.0" DEPOSIT ABSOLUTE /end AXIS_DESCR
 /begin AXIS_DESCR STD_AXIS rl rel_ub_q0p75 8 0.00 191.3 FORMAT "%5.1" DEPOSIT ABSOLUTE /end AXIS_DESCR
/end CHARACTERISTIC
/begin CHARACTERISTIC KFTATMLS2 "Kennfeld Abgastemp. f(nmot,rl) Bank2 (fuer LSH bei Boxer-Motoren)" MAP 0x4EA620 KfAxUbAyUbSstxUbSstyUbWUb 1275. temp_ub_q5_o50 -50.00 1225. FORMAT "%5.0"
 /begin AXIS_DESCR STD_AXIS nmot nmot_ub_q40 8 0.00 10200. FORMAT "%5.0" DEPOSIT ABSOLUTE /end AXIS_DESCR
 /begin AXIS_DESCR STD_AXIS rl rel_ub_q0p75 8 0.00 191.3 FORMAT "%5.1" DEPOSIT ABSOLUTE /end AXIS_DESCR
/end CHARACTERISTIC
/begin CHARACTERISTIC KFTEVP "Kennfeld Periodendauer TEV" MAP 0x4EE29C KfAxUbAyUbSstxUbSstyUbWUb 127.5 t500usxms_ub_q0p5 0.00 127.5 FORMAT "%5.1"
 /begin AXIS_DESCR STD_AXIS nmot nmot_ub_q40 5 0.00 10200. FORMAT "%5.0" DEPOSIT ABSOLUTE /end AXIS_DESCR
 /begin AXIS_DESCR STD_AXIS tateroh rel_ub_b99p6 9 0.00 99.61 FORMAT "%5.2" DEPOSIT ABSOLUTE /end AXIS_DESCR
/end CHARACTERISTIC
/begin CHARACTERISTIC KFTVSA "Verzˆgerungszeit f¸r Schubabschalten" MAP 0x4ED4F4 GkfWUb 5.100 t20msxs_ub_b5p1 0.00 5.100 FORMAT "%5.3"
 /begin AXIS_DESCR COM_AXIS tmot temp_ub_q0p75_o48 5 -48.00 143.3 AXIS_PTS_REF STM05SAUB /end AXIS_DESCR
 /begin AXIS_DESCR COM_AXIS nmot nmot_ub_q40 8 0.00 10200. AXIS_PTS_REF SNM08__UB /end AXIS_DESCR
/end CHARACTERISTIC
/begin CHARACTERISTIC KFTVSAM "Verzˆgerungszeit f¸r Schubabschalten" MAP 0x4ED51C GkfWUb 5.100 t20msxs_ub_b5p1 0.00 5.100 FORMAT "%5.3"
 /begin AXIS_DESCR COM_AXIS tmot temp_ub_q0p75_o48 5 -48.00 143.3 AXIS_PTS_REF STM05SAUB /end AXIS_DESCR
 /begin AXIS_DESCR COM_AXIS nmot nmot_ub_q40 8 0.00 10200. AXIS_PTS_REF SNM08__UB /end AXIS_DESCR
/end CHARACTERISTIC
/begin CHARACTERISTIC KFTVTEV "Kennfeld Verzugszeit Tankentl¸ftungsventil" MAP 0x4EE2EE KfAxUwAyUwSstxUwSstyUwWUw 25.50000 txms_uw_q0p1 0.00 25.50000 FORMAT "%8.5"
 /begin AXIS_DESCR STD_AXIS ub_w spg_ubatt 6 0.00 6173.397 FORMAT "%8.3" DEPOSIT ABSOLUTE /end AXIS_DESCR
 /begin AXIS_DESCR STD_AXIS dps_uw p_q0p039s32768 6 -1280.00 1279.96 FORMAT "%7.2" DEPOSIT ABSOLUTE /end AXIS_DESCR
/end CHARACTERISTIC
/begin CHARACTERISTIC KFWMABG "Kennfeld f¸r W‰rmemengen-Schwellwert Taupunktende Abgas" MAP 0x4EA728 GkfWUw 29825.71 q_q0p4551 0.00 29825.71 FORMAT "%8.2"
 /begin AXIS_DESCR COM_AXIS tabgmst temp_ub_q5_o50 7 -50.00 1225. AXIS_PTS_REF ST107TMUB /end AXIS_DESCR
 /begin AXIS_DESCR COM_AXIS tmstzyl1_w temp_ub_q0p75_o48 5 -48.00000 49103.25 AXIS_PTS_REF STM05TMUB1 /end AXIS_DESCR
/end CHARACTERISTIC
/begin CHARACTERISTIC KFWMABG2 "Kennfeld f¸r W‰rmemengen-Schwellwert Taupunktende Abgas Bank2" MAP 0x4EA76E GkfWUw 29825.71 q_q0p4551 0.00 29825.71 FORMAT "%8.2"
 /begin AXIS_DESCR COM_AXIS tabgmst2 temp_ub_q5_o50 7 -50.00 1225. AXIS_PTS_REF ST207TMUB /end AXIS_DESCR
 /begin AXIS_DESCR COM_AXIS tmstzyl2_w temp_ub_q0p75_o48 5 -48.00000 49103.25 AXIS_PTS_REF STM05TMUB2 /end AXIS_DESCR
/end CHARACTERISTIC
/begin CHARACTERISTIC KFWMKAT "Kennfeld f¸r W‰rmemengen-Schwellwert Taupunktende hinter Kat" MAP 0x4EA7B4 GkfWUw 29825.71 q_q0p4551 0.00 29825.71 FORMAT "%8.2"
 /begin AXIS_DESCR COM_AXIS tkatmst temp_ub_q5_o50 7 -50.00 1225. AXIS_PTS_REF ST307TMUB /end AXIS_DESCR
 /begin AXIS_DESCR COM_AXIS tmstzyl1_w temp_ub_q0p75_o48 5 -48.00000 49103.25 AXIS_PTS_REF STM05TMUB1 /end AXIS_DESCR
/end CHARACTERISTIC
/begin CHARACTERISTIC KFWMKAT2 "Kennfeld f¸r W‰rmemengen-Schwellwert Taupunktende hinter Kat Bank2" MAP 0x4EA7FA GkfWUw 29825.71 q_q0p4551 0.00 29825.71 FORMAT "%8.2"
 /begin AXIS_DESCR COM_AXIS tkatmst2 temp_ub_q5_o50 7 -50.00 1225. AXIS_PTS_REF ST407TMUB /end AXIS_DESCR
 /begin AXIS_DESCR COM_AXIS tmstzyl2_w temp_ub_q0p75_o48 5 -48.00000 49103.25 AXIS_PTS_REF STM05TMUB2 /end AXIS_DESCR
/end CHARACTERISTIC
/begin CHARACTERISTIC KIFZGAG "Integratorverst‰rkung des Fahrzeugmodells bei AT" CURVE 0x4ED93C GklWUw 4863.926 fak_uw_b4864 0.00 4863.926 FORMAT "%8.3" /begin AXIS_DESCR COM_AXIS gangi dez 7 0.00 255.0 AXIS_PTS_REF SGA07MDUB /end AXIS_DESCR /end CHARACTERISTIC
/begin CHARACTERISTIC KIFZGAWG "Integratorverst‰rkung des Fahrzeugmodells bei AT,geschlossene WK" CURVE 0x4ED94A GklWUw 4863.926 fak_uw_b4864 0.00 4863.926 FORMAT "%8.3" /begin AXIS_DESCR COM_AXIS gangi dez 7 0.00 255.0 AXIS_PTS_REF SGA07MDUB /end AXIS_DESCR /end CHARACTERISTIC
/begin CHARACTERISTIC KIFZGHG "Integratorverst‰rkung des Fahrzeugmodells bei AT" CURVE 0x4ED958 GklWUw 4863.926 fak_uw_b4864 0.00 4863.926 FORMAT "%8.3" /begin AXIS_DESCR COM_AXIS gangi dez 7 0.00 255.0 AXIS_PTS_REF SGA07MDUB /end AXIS_DESCR /end CHARACTERISTIC
/begin CHARACTERISTIC KIMSA "Beiwert f¸r Leerlaufluftmassenintegrator f¸r E-Gas" VALUE 0x4EA9E4 KwUb 0.1660 m_ub_b0p166 0.00 0.1660 FORMAT "%6.4" /end CHARACTERISTIC
/begin CHARACTERISTIC KIMSALL "Beiwert f¸r Leerlaufluftmassenintegrator f¸r E-Gas" VALUE 0x4EA9E5 KwUb 10.58 m_ub_q0p0415 0.00 10.58 FORMAT "%5.2" /end CHARACTERISTIC
/begin CHARACTERISTIC KLAF "Ausfluﬂkennlinie" CURVE 0x4E3406 FklWUw 0.9999847 fak_uw_b1 0.00 0.9999847 FORMAT "%9.7"
 /begin AXIS_DESCR FIX_AXIS klaf_kge fak_uw_q0p001 501 0.5000000 1.000000 FORMAT "%8.6" FIX_AXIS_PAR 500 0 501 /end AXIS_DESCR
/end CHARACTERISTIC
/begin CHARACTERISTIC KLATMILAE "Exotherme Temperaturabnahme bei Anfettung tikatm" CURVE 0x4EA674 GklWUb 1.992 fak_ub_b2 0.00 1.992 FORMAT "%5.3"
 /begin AXIS_DESCR COM_AXIS lamsons_w fak_uw_b16 6 0.00 15.99976 AXIS_PTS_REF SLX06TMUW /end AXIS_DESCR
/end CHARACTERISTIC
/begin CHARACTERISTIC KLATMILAE2 "Exotherme Temperaturabnahme bei Anfettung tikatm, Bank 2" CURVE 0x4EA67C GklWUb 1.992 fak_ub_b2 0.00 1.992 FORMAT "%5.3"
 /begin AXIS_DESCR COM_AXIS lamsbg2_w fak_uw_b16 6 0.00 15.99976 AXIS_PTS_REF SLY06TMUW /end AXIS_DESCR
/end CHARACTERISTIC
/begin CHARACTERISTIC KLATMIZWE "Exotherme Temperaturabnahme im Kat bei sp‰terem Z¸ndwinkel tikatm" CURVE 0x4EA684 GklWUb 1.992 fak_ub_b2 0.00 1.992 FORMAT "%5.3"
 /begin AXIS_DESCR COM_AXIS etazwimt rel_ub_b127p5 6 0.00 127.5 AXIS_PTS_REF SEZ06TMUB /end AXIS_DESCR
/end CHARACTERISTIC
/begin CHARACTERISTIC KLATMIZWE2 "Exotherme Temperaturabnahme im Kat bei sp‰terem Z¸ndwinkel tikatm, Bank2" CURVE 0x4EA68C GklWUb 1.992 fak_ub_b2 0.00 1.992 FORMAT "%5.3"
 /begin AXIS_DESCR COM_AXIS etazwimt rel_ub_b127p5 6 0.00 127.5 AXIS_PTS_REF SEZ06TMUB /end AXIS_DESCR
/end CHARACTERISTIC
/begin CHARACTERISTIC KLATMLAE "Exotherme Temperaturabnahme bei Anfettung" CURVE 0x4EA694 GklWUb 1.992 fak_ub_b2 0.00 1.992 FORMAT "%5.3"
 /begin AXIS_DESCR COM_AXIS lamsons_w fak_uw_b16 6 0.00 15.99976 AXIS_PTS_REF SLX06TMUW /end AXIS_DESCR
/end CHARACTERISTIC
/begin CHARACTERISTIC KLATMLAE2 "Exotherme Temperaturabnahme bei Anfettung, Bank 2" CURVE 0x4EA69C GklWUb 1.992 fak_ub_b2 0.00 1.992 FORMAT "%5.3"
 /begin AXIS_DESCR COM_AXIS lamsbg2_w fak_uw_b16 6 0.00 15.99976 AXIS_PTS_REF SLY06TMUW /end AXIS_DESCR
/end CHARACTERISTIC
/begin CHARACTERISTIC KLATMVLAE2 "Exotherme Temperaturabnahme im Vorkat bei Anfettung f¸r tnvkatm" CURVE 0x4EA6A4 GklWUb 1.992 fak_ub_b2 0.00 1.992 FORMAT "%5.3"
 /begin AXIS_DESCR COM_AXIS lamsbg2_w fak_uw_b16 6 0.00 15.99976 AXIS_PTS_REF SLY06TMUW /end AXIS_DESCR
/end CHARACTERISTIC
/begin CHARACTERISTIC KLATMVZWE2 "Exotherme Temperaturabnahme im Vorkat bei sp‰terem Z¸ndwinkel f¸r tnvkatm, Bank2" CURVE 0x4EA6AC GklWUb 1.992 fak_ub_b2 0.00 1.992 FORMAT "%5.3"
 /begin AXIS_DESCR COM_AXIS etazwimt rel_ub_b127p5 6 0.00 127.5 AXIS_PTS_REF SEZ06TMUB /end AXIS_DESCR
/end CHARACTERISTIC
/begin CHARACTERISTIC KLATMZWE "Exotherme Temperaturabnahme im Kat bei sp‰terem Z¸ndwinkel tkatm" CURVE 0x4EA6B4 GklWUb 1.992 fak_ub_b2 0.00 1.992 FORMAT "%5.3"
 /begin AXIS_DESCR COM_AXIS etazwimt rel_ub_b127p5 6 0.00 127.5 AXIS_PTS_REF SEZ06TMUB /end AXIS_DESCR
/end CHARACTERISTIC
/begin CHARACTERISTIC KLATMZWE2 "Exotherme Temperaturabnahme im Kat bei sp‰terem Z¸ndwinkel, Bank 2" CURVE 0x4EA6BC GklWUb 1.992 fak_ub_b2 0.00 1.992 FORMAT "%5.3"
 /begin AXIS_DESCR COM_AXIS etazwimt rel_ub_b127p5 6 0.00 127.5 AXIS_PTS_REF SEZ06TMUB /end AXIS_DESCR
/end CHARACTERISTIC
/begin CHARACTERISTIC KLTEVTANS "" CURVE 0x4EE2DC KlAxU8SstxU8WU8 25.50 txms_ub_q0p1 0.00 25.50 FORMAT "%5.2"
 /begin AXIS_DESCR STD_AXIS tans temp_ub_q0p75_o48 8 -48.00 143.3 FORMAT "%5.1" DEPOSIT ABSOLUTE /end AXIS_DESCR
/end CHARACTERISTIC
/begin CHARACTERISTIC KTMOTW "Motortemperatur bei warmen Motor" VALUE 0x4EA840 KwUw 1535.977 temp_q0p0234_o273 -273.1500 1262.827 FORMAT "%8.3" /end CHARACTERISTIC
/begin CHARACTERISTIC KTNDMRKH "Int.-Konstante f¸r Anforderung Drehmomentenreserve Katheizen" VALUE 0x4ECB94 KwUw 0.9999847 fak_uw_b1 0.00 0.9999847 FORMAT "%9.7" /end CHARACTERISTIC
/begin CHARACTERISTIC KUMSRL "Umrechnungskonstante von Massenstrom in relative Luftf¸llung" VALUE 0x4E2DB6 KwUb 0.001992 kumsrl_ub_b0p002 0.00 0.001992 FORMAT "%8.6" /end CHARACTERISTIC
/begin CHARACTERISTIC KVLAD "Konstante f¸r Umrechnung von Ladedruck in Luftmasse" VALUE 0x4E2DB7 KwUb 1.992 rel_ub_b2p0 0.00 1.992 FORMAT "%5.3" /end CHARACTERISTIC
/begin CHARACTERISTIC K_akl_nmot "" VALUE 0x4EB7E2 KwWU16 16383.75 Def_n4 0.00 16383.75 FORMAT "%8.2" /end CHARACTERISTIC
/begin CHARACTERISTIC K_btrh_noi "Schwelle Sperre d. Betreibstundenz‰hler" VALUE 0x4E3F86 KwUw 65535.00 Stunden 0.00 65535.00 FORMAT "%8.2" /end CHARACTERISTIC
/begin CHARACTERISTIC k_B_akBetr "Schalter Freigabe der Sperre durch Betrh. Z‰hler" VALUE 0x4E3F82 KwUb 1.000 dez 0.00 1.000 FORMAT "%5.3" /end CHARACTERISTIC
/begin CHARACTERISTIC k_B_akkl15 "Schalter Freigabe Sperre durch Zeit nach Reset" VALUE 0x4E3F83 KwUb 1.000 dez 0.00 1.000 FORMAT "%5.3" /end CHARACTERISTIC
/begin CHARACTERISTIC k_B_akusti "Schalter Freischaltung Akustikfunktion" VALUE 0x4E3F84 KwUb 1.000 dez 0.00 1.000 FORMAT "%5.3" /end CHARACTERISTIC
/begin CHARACTERISTIC K_noisen2m "Untere Austrittsdrehzahl 2. Gang" VALUE 0x4E3F88 KwUw 16383.75 nmot_uw_q0p25 0.00 16383.75 FORMAT "%8.2" /end CHARACTERISTIC
/begin CHARACTERISTIC K_noisen3m "Untere Austrittsdrehzahl 3. Gang" VALUE 0x4E3F8A KwUw 16383.75 nmot_uw_q0p25 0.00 16383.75 FORMAT "%8.2" /end CHARACTERISTIC
/begin CHARACTERISTIC K_noisen4m "" VALUE 0x4E3F8C KwUw 16383.75 nmot_uw_q0p25 0.00 16383.75 FORMAT "%8.2" /end CHARACTERISTIC
/begin CHARACTERISTIC K_noiset3m "min. Zeit fuer v zwischen Schwellen 3" VALUE 0x4E3F8E KwUw 65535.00 Sekunden 0.00 65535.00 FORMAT "%8.2" /end CHARACTERISTIC
/begin CHARACTERISTIC K_noiset3x "max. Zeit fuer v zwischen Schwellen 3" VALUE 0x4E3F90 KwUw 65535.00 Sekunden 0.00 65535.00 FORMAT "%8.2" /end CHARACTERISTIC
/begin CHARACTERISTIC K_noisevm1 "Untere Eintrittsgeschwindigkeit" VALUE 0x4E3F92 KwUw 511.9922 vfzg_uw_b512 0.00 511.9922 FORMAT "%8.4" /end CHARACTERISTIC
/begin CHARACTERISTIC K_noisevm3 "Untere Geschwindigkeit f. Profilerkennung" VALUE 0x4E3F94 KwUw 511.9922 vfzg_uw_b512 0.00 511.9922 FORMAT "%8.4" /end CHARACTERISTIC
/begin CHARACTERISTIC K_noisevx1 "Obere Eintrittsgeschwindigkeit" VALUE 0x4E3F96 KwUw 511.9922 vfzg_uw_b512 0.00 511.9922 FORMAT "%8.4" /end CHARACTERISTIC
/begin CHARACTERISTIC K_noisevx3 "Obere Geschwindigkeit f. Profilerkennung" VALUE 0x4E3F98 KwUw 511.9922 vfzg_uw_b512 0.00 511.9922 FORMAT "%8.4" /end CHARACTERISTIC
/begin CHARACTERISTIC K_noise_dw "Einstiegsschwelle Dk-Gradient Akustikfkt." VALUE 0x4E3F9A KwSw 100.0000 GrelPED_sw_b100 -50.00076 49.99924 FORMAT "%8.5" /end CHARACTERISTIC
/begin CHARACTERISTIC K_noise_t4 "Totzeit nach Akustikmessung" VALUE 0x4E3F85 KwUb 255.0 Sekunden 0.00 255.0 FORMAT "%5.1" /end CHARACTERISTIC
/begin CHARACTERISTIC K_noise_t5 "Aktivierungszeit nach Startende" VALUE 0x4E3F9C KwUw 65535.00 Sekunden 0.00 65535.00 FORMAT "%8.2" /end CHARACTERISTIC
/begin CHARACTERISTIC LADFIL "Ladedruckfilterung" VALUE 0x4E2DB8 KwUb 0.9961 fak_ub_b1 0.00 0.9961 /end CHARACTERISTIC
/begin CHARACTERISTIC LOWBATCOU "" VALUE 0x4EF388 KwUb 2.550 t10msxs_ub_b2p55 0.00 2.550 FORMAT "%5.3" /end CHARACTERISTIC
/begin CHARACTERISTIC MLFKMSDK "Luftmassenstromschwelle f¸r multipl. Abgleich von HFM- und DK-Massenstrom" VALUE 0x4E37F0 KwUw 6553.500 m_uw_b6553p5 0.00 6553.500 FORMAT "%8.3" /end CHARACTERISTIC
/begin CHARACTERISTIC MLKHMX "max. Luftmasse f¸r Katheizen" VALUE 0x4ECB0C KwUb 1020. m_ub_b1020 0.00 1020. FORMAT "%5.0" /end CHARACTERISTIC
/begin CHARACTERISTIC MLSUS "Sollwert Luftmassen-Integral f¸r motorisches Katheizen" CURVE 0x4ECB96 KlAUbSstUwWUw 5.802667 m_ub_b5p8 0.00 5.802667 FORMAT "%8.6"
 /begin AXIS_DESCR STD_AXIS tmstzyl_w temp_ub_q0p75_o48 12 -48.00000 49103.25 FORMAT "%8.2" DEPOSIT ABSOLUTE /end AXIS_DESCR
/end CHARACTERISTIC
/begin CHARACTERISTIC MRFABNTE "Schwelle zur Erkennung von Dauer-Hochlastfahrt" VALUE 0x4EB809 KwUb 99.61 rel_ub_b99p6 0.00 99.61 FORMAT "%5.2" /end CHARACTERISTIC
/begin CHARACTERISTIC MRFAVLN "Vollasterkennungsschwelle des relativen Fahrerwunsches" CURVE 0x4E84D8 KlAUwSstUwWUw 199.9969 rel_uw_b200 0.00 199.9969 FORMAT "%8.4"
 /begin AXIS_DESCR STD_AXIS nmot_w nmot_uw_q0p25 14 0.00 16383.75 FORMAT "%8.2" DEPOSIT ABSOLUTE /end AXIS_DESCR
/end CHARACTERISTIC
/begin CHARACTERISTIC MSALLMN "Minimale Leerlaufluftmassenadaption f¸r E-Gas" VALUE 0x4E2DB9 KwUb 25.50 m_ub_q0p1 0.00 25.50 FORMAT "%5.2" /end CHARACTERISTIC
/begin CHARACTERISTIC MSALLMX "Maximale Leerlaufluftmassenadaption f¸r E-Gas" VALUE 0x4E2DBA KwUb 25.50 m_ub_q0p1 0.00 25.50 FORMAT "%5.2" /end CHARACTERISTIC
/begin CHARACTERISTIC MSLG "Massenstrom Leckluft gesamt" VALUE 0x4E2DBB KwUb 25.50 m_ub_q0p1 0.00 25.50 FORMAT "%5.2" /end CHARACTERISTIC
/begin CHARACTERISTIC MSNBYP "map of airflow vs bypass position at standard conditions" CURVE 0x4E3B5E KlAUwSstUwWUw 25.59961 m_uw_b25p6 0.00 25.59961 FORMAT "%8.5"
 /begin AXIS_DESCR STD_AXIS msnbyp_kge rel_uw_b100 10 0.00 99.99847 FORMAT "%8.5" DEPOSIT ABSOLUTE /end AXIS_DESCR
/end CHARACTERISTIC
/begin CHARACTERISTIC NARA "Drehzahlschwelle f¸r Antiruckelfunktion" VALUE 0x4E5F1A KwUb 10200. nmot_ub_q40 0.00 10200. FORMAT "%5.0" /end CHARACTERISTIC
/begin CHARACTERISTIC NARASTG "Drehzahlschwelle in hoeherem Gang fuer AR aktiv" CURVE 0x4E5F1C KlAUbSstUbWUb 10200. nmot_ub_q40 0.00 10200. FORMAT "%5.0"
 /begin AXIS_DESCR STD_AXIS gangi dez 6 0.00 255.0 FORMAT "%5.1" DEPOSIT ABSOLUTE /end AXIS_DESCR
/end CHARACTERISTIC
/begin CHARACTERISTIC NARLL "Drehzahlschwelle f¸r AR im Leerlauf" VALUE 0x4E5F29 KwUb 10200. nmot_ub_q40 0.00 10200. FORMAT "%5.0" /end CHARACTERISTIC
/begin CHARACTERISTIC NGANGMIN "Schwelle fuer Gangerkennung, Mindestwert PLausibilitaetstest" VALUE 0x4E2CD6 KwUw 16383.75 nmot_uw_q0p25 0.00 16383.75 FORMAT "%8.2" /end CHARACTERISTIC
/begin CHARACTERISTIC NGDNSA "Drehzahlgradient beim Absteuern der Schubabschalthysterese" VALUE 0x4E59E8 KwSw 10239.84 nmotg_sw_q0p15625 -5120.000 5119.844 FORMAT "%8.3" /end CHARACTERISTIC
/begin CHARACTERISTIC NLLKT "Leerlaufsolldrehzahl bei Kurztest Sekund‰rluftdiagnose" VALUE 0x4ECB0D KwUb 2550. nmot_ub_q10 0.00 2550. FORMAT "%5.0" /end CHARACTERISTIC
/begin CHARACTERISTIC nmax_Anl "obere Drehzahlschwelle der Anlasser-Startende Hystrese" VALUE 0x4E9726 KwUw 4000.000 nmot_uw_q0p25 0.00 4000.000 FORMAT "%8.3" /end CHARACTERISTIC
/begin CHARACTERISTIC nmin_Anl "untere Drehzahlschwelle der Anlasser-Startende Hystrese" VALUE 0x4E9728 KwUw 2000.000 nmot_uw_q0p25 0.00 2000.000 FORMAT "%8.3" /end CHARACTERISTIC
/begin CHARACTERISTIC NMSNDKO "Drehzahlschwelle f¸r Integratorfreigabe zur Adaption der Leckluft" VALUE 0x4E2DBC KwUb 10200. nmot_ub_q40 0.00 10200. FORMAT "%5.0" /end CHARACTERISTIC
/begin CHARACTERISTIC NNSTA "Drehzahl¸bergang Normal -> Start" CURVE 0x4EA9BC KlAUbSstUbWUb 10200. nmot_ub_q40 0.00 10200. FORMAT "%5.0"
 /begin AXIS_DESCR STD_AXIS tans temp_ub_q0p75_o48 3 -48.00 143.3 FORMAT "%5.1" DEPOSIT ABSOLUTE /end AXIS_DESCR
/end CHARACTERISTIC
/begin CHARACTERISTIC NSTNM "‹bergang Start -> Normal" CURVE 0x4EA9C4 KlAUbSstUbWUb 10200. nmot_ub_q40 0.00 10200. FORMAT "%5.0"
 /begin AXIS_DESCR STD_AXIS tmot temp_ub_q0p75_o48 3 -48.00 143.3 FORMAT "%5.1" DEPOSIT ABSOLUTE /end AXIS_DESCR
/end CHARACTERISTIC
/begin CHARACTERISTIC NTAREIN "Sperrzeit f¸r Antiruckelfunktion" CURVE 0x4E5F2C KlAUbSstUbWUb 2.550 t10msxs_ub_b2p55 0.00 2.550 FORMAT "%5.3"
 /begin AXIS_DESCR STD_AXIS nmot nmot_ub_q40 5 0.00 10200. FORMAT "%5.0" DEPOSIT ABSOLUTE /end AXIS_DESCR
/end CHARACTERISTIC
/begin CHARACTERISTIC NTUMTAT "Schwelle Drehzahl f¸r Bestimmung Umgebungstemperatur aus TANS" VALUE 0x4EA6C2 KwUb 10200. nmot_ub_q40 0.00 10200. FORMAT "%5.0" /end CHARACTERISTIC
/begin CHARACTERISTIC NUEMAX "Motor¸berdrehzahlgrenzwert" VALUE 0x4E2BF0 KwUw 16383.75 nmot_uw_q0p25 0.00 16383.75 FORMAT "%8.2" /end CHARACTERISTIC
/begin CHARACTERISTIC NVQUOT1O "Gangerkennung n/v 1 Gang oben" VALUE 0x4E2CD8 KwUw 511.9922 qnv_uw_b512 0.00 511.9922 FORMAT "%8.4" /end CHARACTERISTIC
/begin CHARACTERISTIC NVQUOT1U "Gangerekennung n/v 1 Gang unten" VALUE 0x4E2CDA KwUw 511.9922 qnv_uw_b512 0.00 511.9922 FORMAT "%8.4" /end CHARACTERISTIC
/begin CHARACTERISTIC NVQUOT2O "Gangerkennung n/v 2 Gang oben" VALUE 0x4E2CDC KwUw 511.9922 qnv_uw_b512 0.00 511.9922 FORMAT "%8.4" /end CHARACTERISTIC
/begin CHARACTERISTIC NVQUOT2U "Gangerkennung n/v 2 Gang unten" VALUE 0x4E2CDE KwUw 511.9922 qnv_uw_b512 0.00 511.9922 FORMAT "%8.4" /end CHARACTERISTIC
/begin CHARACTERISTIC NVQUOT3O "Gangerkennung n/v 3 Gang oben" VALUE 0x4E2CE0 KwUw 511.9922 qnv_uw_b512 0.00 511.9922 FORMAT "%8.4" /end CHARACTERISTIC
/begin CHARACTERISTIC NVQUOT3U "Gangerkennung n/v 3 Gang unten" VALUE 0x4E2CE2 KwUw 511.9922 qnv_uw_b512 0.00 511.9922 FORMAT "%8.4" /end CHARACTERISTIC
/begin CHARACTERISTIC NVQUOT4O "Gangerkennung n/v 4 Gang oben" VALUE 0x4E2CE4 KwUw 511.9922 qnv_uw_b512 0.00 511.9922 FORMAT "%8.4" /end CHARACTERISTIC
/begin CHARACTERISTIC NVQUOT4U "Gangerkennung n/v 4 Gang unten" VALUE 0x4E2CE6 KwUw 511.9922 qnv_uw_b512 0.00 511.9922 FORMAT "%8.4" /end CHARACTERISTIC
/begin CHARACTERISTIC NVQUOT5O "Gangerkennung n/v 5 Gang oben" VALUE 0x4E2CE8 KwUw 511.9922 qnv_uw_b512 0.00 511.9922 FORMAT "%8.4" /end CHARACTERISTIC
/begin CHARACTERISTIC NVQUOT5U "Gangerkennung n/v 5 Gang unten" VALUE 0x4E2CEA KwUw 511.9922 qnv_uw_b512 0.00 511.9922 FORMAT "%8.4" /end CHARACTERISTIC
/begin CHARACTERISTIC NVQUOT6O "Gangerkennung n/v 6 Gang oben" VALUE 0x4E2CEC KwUw 511.9922 qnv_uw_b512 0.00 511.9922 FORMAT "%8.4" /end CHARACTERISTIC
/begin CHARACTERISTIC NVQUOT6U "Gangerkennung n/v 6 Gang unten" VALUE 0x4E2CEE KwUw 511.9922 qnv_uw_b512 0.00 511.9922 FORMAT "%8.4" /end CHARACTERISTIC
/begin CHARACTERISTIC NWDKSA "" MAP 0x4ED5AA KfAxUwAyUwSstxUwSstyUwWUw 1.000000 dez 0.00 1.000000 FORMAT "%8.6"
 /begin AXIS_DESCR STD_AXIS nmot_w nmot_uw_q0p25 10 0.00 16383.75 FORMAT "%8.2" DEPOSIT ABSOLUTE /end AXIS_DESCR
 /begin AXIS_DESCR STD_AXIS wdkba_w relDK_q0p02441 12 0.00 1599.976 FORMAT "%8.3" DEPOSIT ABSOLUTE /end AXIS_DESCR
/end CHARACTERISTIC
/begin CHARACTERISTIC NWEM "Wiedereinsetzdrehzahl" MAP 0x4ED544 KfAxUbAyUbSstxUbSstyUbWUb 10200. nmot_ub_q40 0.00 10200. FORMAT "%5.0"
 /begin AXIS_DESCR STD_AXIS tmot temp_ub_q0p75_o48 8 -48.00 143.3 FORMAT "%5.1" DEPOSIT ABSOLUTE /end AXIS_DESCR
 /begin AXIS_DESCR STD_AXIS gangi dez 8 0.00 255.0 FORMAT "%5.1" DEPOSIT ABSOLUTE /end AXIS_DESCR
/end CHARACTERISTIC
/begin CHARACTERISTIC NWENG "Wiedereinsetzdrehzahl" CURVE 0x4E59EA KlAUbSstSbWUb 10200. nmot_ub_q40 0.00 10200. FORMAT "%5.0"
 /begin AXIS_DESCR STD_AXIS ngfil nmotg_sb_q100 5 -12800. 12700. FORMAT "%5.0" DEPOSIT ABSOLUTE /end AXIS_DESCR
/end CHARACTERISTIC
/begin CHARACTERISTIC PSPVDKUGN "Verh‰ltnis pspvdk ungedrosselt" CURVE 0x4E37F2 KlAUwSstUwWUw 1.999969 fak_uw_b2 0.00 1.999969 FORMAT "%8.6"
 /begin AXIS_DESCR STD_AXIS nmot_w nmot_uw_q0p25 12 0.00 16383.75 FORMAT "%8.2" DEPOSIT ABSOLUTE /end AXIS_DESCR
/end CHARACTERISTIC
/begin CHARACTERISTIC REDANZ "" VALUE 0x4EB7E6 KwUb 4.000 dez 0.00 4.000 FORMAT "%5.3" /end CHARACTERISTIC
/begin CHARACTERISTIC RED_FKT_M "" VAL_BLK 0x4EB7EA KwbUw 65535.00 dez 0.00 65535.00 FORMAT "%8.2" NUMBER 4 /end CHARACTERISTIC
/begin CHARACTERISTIC RED_SET_M "" VAL_BLK 0x4EB7F2 KwbUw 65535.00 dez 0.00 65535.00 FORMAT "%8.2" NUMBER 4 /end CHARACTERISTIC
/begin CHARACTERISTIC RLFAVLN "" CURVE 0x4E8512 KlAUwSstUwWUw 199.9969 rel_uw_b200 0.00 199.9969 FORMAT "%8.4"
 /begin AXIS_DESCR STD_AXIS nmot_w nmot_uw_q0p25 14 0.00 16383.75 FORMAT "%8.2" DEPOSIT ABSOLUTE /end AXIS_DESCR
/end CHARACTERISTIC
/begin CHARACTERISTIC RLNOT "Notlauf rl bei E_DK und E_LM" CURVE 0x4E2DC0 KlAUbSstUbWUb 191.3 rel_ub_q0p75 0.00 191.3 FORMAT "%5.1"
 /begin AXIS_DESCR STD_AXIS nmot nmot_ub_q40 6 0.00 10200. FORMAT "%5.0" DEPOSIT ABSOLUTE /end AXIS_DESCR
/end CHARACTERISTIC
/begin AXIS_PTS SEZ06TMUB "St¸tzstellenverteilung, Z¸ndwinkelwirkungsgrad" 0x4EA0FC etazwimt SstAUbSstUb 127.5 rel_ub_b127p5 6 0.00 127.5 FORMAT "%5.1" DEPOSIT ABSOLUTE /end AXIS_PTS
/begin AXIS_PTS SFR04BBUW "" 0x4E29F0 frhol_w SstAU8SstU16 1.999969 fak_uw_b2 4 0.00 1.999969 FORMAT "%8.6" DEPOSIT ABSOLUTE /end AXIS_PTS
/begin AXIS_PTS SGA07MDUB "" 0x4E2A5C gangi SstAUbSstUb 255.0 dez 7 0.00 255.0 FORMAT "%5.1" DEPOSIT ABSOLUTE /end AXIS_PTS
/begin AXIS_PTS SLX06TMUW "St¸tzstellenverteilung, Lambdasoll" 0x4EA1DC lamsons_w SstAUwSstUw 15.99976 fak_uw_b16 6 0.00 15.99976 FORMAT "%8.5" DEPOSIT ABSOLUTE /end AXIS_PTS
/begin AXIS_PTS SLY06TMUW "St¸tzstellenverteilung, Lambdasoll Bank2" 0x4EA1EA lamsbg2_w SstAUwSstUw 15.99976 fak_uw_b16 6 0.00 15.99976 FORMAT "%8.5" DEPOSIT ABSOLUTE /end AXIS_PTS
/begin AXIS_PTS SML06TMUW "St¸tzstellenverteilung, Luftmasse, 6 St¸tzstellen" 0x4EA1F8 ml_w SstAUwSstUw 6553.500 m_uw_b6553p5 6 0.00 6553.500 FORMAT "%8.3" DEPOSIT ABSOLUTE /end AXIS_PTS
/begin AXIS_PTS SML07TMUW "St¸tzstellenverteilung, Luftmasse, 7 St¸tzstellen" 0x4EA206 ml_w SstAUwSstUw 6553.500 m_uw_b6553p5 7 0.00 6553.500 FORMAT "%8.3" DEPOSIT ABSOLUTE /end AXIS_PTS
/begin AXIS_PTS SNM08GKUB "St¸tzstellenverteilung Gemischkontrolle 8 nmot St¸tzstellen" 0x4E2A44 nmot SstAU8SstU8 10200. nmot_ub_q40 8 0.00 10200. FORMAT "%5.0" DEPOSIT ABSOLUTE /end AXIS_PTS
/begin AXIS_PTS SNM08__UB "St¸tzstellenverteilung Drehzahl, 8 Sst." 0x4E2AD4 nmot SstAUbSstUb 10200. nmot_ub_q40 8 0.00 10200. FORMAT "%5.0" DEPOSIT ABSOLUTE /end AXIS_PTS
/begin AXIS_PTS ST107TMUB "St¸tzstellenverteilung, Starttemperatur an Sonde vorne" 0x4EA174 tabgmst SstAUbSstUb 1275. temp_ub_q5_o50 7 -50.00 1225. FORMAT "%5.0" DEPOSIT ABSOLUTE /end AXIS_PTS
/begin AXIS_PTS ST207TMUB "St¸tzstellenverteilung, Starttemperatur an Sonde vorne, Bank2" 0x4EA17C tabgmst2 SstAUbSstUb 1275. temp_ub_q5_o50 7 -50.00 1225. FORMAT "%5.0" DEPOSIT ABSOLUTE /end AXIS_PTS
/begin AXIS_PTS ST307TMUB "St¸tzstellenverteilung, Starttemperatur an Sonde hinten" 0x4EA184 tkatmst SstAUbSstUb 1275. temp_ub_q5_o50 7 -50.00 1225. FORMAT "%5.0" DEPOSIT ABSOLUTE /end AXIS_PTS
/begin AXIS_PTS ST407TMUB "St¸tzstellenverteilung, Starttemperatur an Sonde hinten, Bank2" 0x4EA18C tkatmst2 SstAUbSstUb 1275. temp_ub_q5_o50 7 -50.00 1225. FORMAT "%5.0" DEPOSIT ABSOLUTE /end AXIS_PTS
/begin AXIS_PTS STM05SAUB "St¸tzstellenverteilung" 0x4EA19C tmot SstAUbSstUb 191.3 temp_ub_q0p75_o48 5 -48.00 143.3 FORMAT "%5.1" DEPOSIT ABSOLUTE /end AXIS_PTS
/begin AXIS_PTS STM05TMUB1 "" 0x4EA242 tmstzyl1_w SstAUwSstUw 49151.25 temp_ub_q0p75_o48 5 -48.00000 49103.25 FORMAT "%8.2" DEPOSIT ABSOLUTE /end AXIS_PTS
/begin AXIS_PTS STM05TMUB2 "" 0x4EA24E tmstzyl2_w SstAUwSstUw 49151.25 temp_ub_q0p75_o48 5 -48.00000 49103.25 FORMAT "%8.2" DEPOSIT ABSOLUTE /end AXIS_PTS
/begin AXIS_PTS STMZYL08BBUW "" 0x4E29FA tmotzyl_w SstAU8SstU16 49151.25 temp_ub_q0p75_o48 8 -48.00000 49103.25 FORMAT "%8.2" DEPOSIT ABSOLUTE /end AXIS_PTS
/begin AXIS_PTS STS06TMUW "St¸tzstellenverteilung, Abgasmassenfluﬂ" 0x4EA842 tabstatm_w SstAUwSstUw 65535.00 t1sxs_uw_q1 6 0.00 65535.00 FORMAT "%8.2" DEPOSIT ABSOLUTE /end AXIS_PTS
/begin AXIS_PTS STU05TMUB "St¸tzstellenverteilung, Ersatz-Umgebungstemperatur" 0x4EA6C4 tatu SstAUbSstUb 191.3 temp_ub_q0p75_o48 5 -48.00 143.3 FORMAT "%5.1" DEPOSIT ABSOLUTE /end AXIS_PTS
/begin CHARACTERISTIC TABGMEX "Abgastemperatur unterhalb der Kat-Anspringtemperatur" VALUE 0x4EA6CA KwUb 1275. temp_ub_q5_o50 -50.00 1225. FORMAT "%5.0" /end CHARACTERISTIC
/begin CHARACTERISTIC TABSTKH "Mindestabstellzeit f¸r Freigabe Kat-Heizen" VALUE 0x4ECBC8 KwUw 65535.00 t1sxs_uw_b65535 0.00 65535.00 FORMAT "%8.2" /end CHARACTERISTIC
/begin CHARACTERISTIC TABSTKHX "Mindestabstellzeit f¸r Reset imlatmw_w-ACCU" VALUE 0x4ECBCA KwUw 65535.00 t1sxs_uw_b65535 0.00 65535.00 FORMAT "%8.2" /end CHARACTERISTIC
/begin CHARACTERISTIC TAPVLTM "Schwelle Abstellzeit f¸r EKP-Vorlauf" CURVE 0x4E9698 KlAUbSstUbWUw 65535.00 t1sxs_uw_b65535 0.00 65535.00 FORMAT "%8.2"
 /begin AXIS_DESCR STD_AXIS tmotab temp_ub_q0p75_o48 12 -48.00 143.3 FORMAT "%5.1" DEPOSIT ABSOLUTE /end AXIS_DESCR
/end CHARACTERISTIC
/begin CHARACTERISTIC TAREIN "Sperrzeit f¸r Antiruckelfunktion" VALUE 0x4E5F37 KwUb 2.550 t10msxs_ub_b2p55 0.00 2.550 FORMAT "%5.3" /end CHARACTERISTIC
/begin CHARACTERISTIC TASCBLINK "" VALUE 0x4E9C84 KwUw 10.00000 t10msxs_sb_q0p01 0.00 10.00000 FORMAT "%8.5" /end CHARACTERISTIC
/begin CHARACTERISTIC TASCHOLD "" VALUE 0x4E9C86 KwUw 100.0000 t10msxs_sb_q0p01 0.00 100.0000 FORMAT "%8.4" /end CHARACTERISTIC
/begin CHARACTERISTIC TASCREL "" VALUE 0x4E9C88 KwUw 100.0000 t10msxs_sb_q0p01 0.00 100.0000 FORMAT "%8.4" /end CHARACTERISTIC
/begin CHARACTERISTIC TASTBFA "Modell-Temperatur Abgas Startwert bei B_faatm Anford. (kurze Taupunktende Zeit)" VALUE 0x4EA6CB KwUb 1275. temp_ub_q5_o50 -50.00 1225. FORMAT "%5.0" /end CHARACTERISTIC
/begin CHARACTERISTIC TATEGRDO "Obere Schwelle Tastverh‰ltnis TEV zur Erkennung eines neg. Gradienten tatesoll" VALUE 0x4E8820 KwUb 99.61 rel_ub_b99p6 0.00 99.61 FORMAT "%5.2" /end CHARACTERISTIC
/begin CHARACTERISTIC TATEGRDU "Untere Schwelle Tastverh‰ltnis TEV zur Erkennung eines neg. Gradienten tatesoll" VALUE 0x4E8821 KwUb 99.61 rel_ub_b99p6 0.00 99.61 FORMAT "%5.2" /end CHARACTERISTIC
/begin CHARACTERISTIC TATELL "tans- Schwelle f¸r Tankentl¸fung bei B_ll = 1" VALUE 0x4EB80A KwUb 191.3 temp_ub_q0p75_o48 -48.00 143.3 FORMAT "%5.1" /end CHARACTERISTIC
/begin CHARACTERISTIC TATMKH "Abgastemperaturkorrektur bei Kat-Heizen aktiv" VALUE 0x4EA6CC KwUb 1275. temp_q5 0.00 1275. FORMAT "%5.0" /end CHARACTERISTIC
/begin CHARACTERISTIC TATMKH2 "Abgastemperaturkorrektur bei Kat-Heizen aktiv Bank2" VALUE 0x4EA6CD KwUb 1275. temp_q5 0.00 1275. FORMAT "%5.0" /end CHARACTERISTIC
/begin CHARACTERISTIC TATMKW "Abgastemperaturkorrektur bei Kat warmhalten aktiv" VALUE 0x4EA6CE KwUb 1275. temp_q5 0.00 1275. FORMAT "%5.0" /end CHARACTERISTIC
/begin CHARACTERISTIC TATMSA "Abgastemperatur bei Schubabschneiden" VALUE 0x4EA6CF KwUb 1275. temp_ub_q5_o50 -50.00 1225. FORMAT "%5.0" /end CHARACTERISTIC
/begin CHARACTERISTIC TATMSAE "exotherme Temperaturerhˆhung im Schub" VALUE 0x4EA6D0 KwUb 1275. temp_ub_q5_o50 -50.00 1225. FORMAT "%5.0" /end CHARACTERISTIC
/begin CHARACTERISTIC TATMSAE2 "exotherme Temperaturerhˆhung im Schub Bank 2" VALUE 0x4EA6D1 KwUb 1275. temp_ub_q5_o50 -50.00 1225. FORMAT "%5.0" /end CHARACTERISTIC
/begin CHARACTERISTIC TATMSTI "Initialisierungswert f¸r tabgm, tkatm Startwert bei Powerfail" VALUE 0x4EA6D2 KwUb 1275. temp_ub_q5_o50 -50.00 1225. FORMAT "%5.0" /end CHARACTERISTIC
/begin CHARACTERISTIC TATMTMOT "Motortemperatur warmer Motor , f¸r Temperaturkorrektur beim Kaltstart" VALUE 0x4EA6D3 KwUb 191.3 temp_ub_q0p75_o48 -48.00 143.3 FORMAT "%5.1" /end CHARACTERISTIC
/begin CHARACTERISTIC TATMTP "Abgastaupunkttemperatur" VALUE 0x4EA6D4 KwUb 1275. temp_ub_q5_o50 -50.00 1225. FORMAT "%5.0" /end CHARACTERISTIC
/begin CHARACTERISTIC TATMTRKH "Abgastemperaturkorrektur bei Thermoreaktor-Katheizen" VALUE 0x4EA6D5 KwUb 1275. temp_q5 0.00 1275. FORMAT "%5.0" /end CHARACTERISTIC
/begin CHARACTERISTIC TATMTRKH2 "Abgastemperaturkorrektur bei Thermoreaktor-Katheizen Bank 2" VALUE 0x4EA6D6 KwUb 1275. temp_q5 0.00 1275. FORMAT "%5.0" /end CHARACTERISTIC
/begin CHARACTERISTIC TATMWMK "Temperaturoffset  f¸r W‰rmemengenberechnung" VALUE 0x4EA6D7 KwSb 1275. temp_q5 -640.0 635.0 FORMAT "%5.1" /end CHARACTERISTIC
/begin CHARACTERISTIC TDSTART1 "" VALUE 0x4E9722 KwWU16 1310.70 t20msxs_uw_b1310 0.00 1310.70 FORMAT "%7.2" /end CHARACTERISTIC
/begin CHARACTERISTIC TDSTART2 "" VALUE 0x4E9724 KwWU16 1310.70 t20msxs_uw_b1310 0.00 1310.70 FORMAT "%7.2" /end CHARACTERISTIC
/begin CHARACTERISTIC TEVDTAUF "" VALUE 0x4E8822 KwUb 25.50 txms_ub_q0p1 0.00 25.50 FORMAT "%5.2" /end CHARACTERISTIC
/begin CHARACTERISTIC TEVPMN1 "Minimale Ansteuerzeit f¸r TEV Schwelle 1" VALUE 0x4E8823 KwUb 127.5 t500usxms_ub_q0p5 0.00 127.5 FORMAT "%5.1" /end CHARACTERISTIC
/begin CHARACTERISTIC TEVPMN2 "Minimale Ansteuerzeit f¸r TEV Schwelle 2" VALUE 0x4E8824 KwUb 127.5 t500usxms_ub_q0p5 0.00 127.5 FORMAT "%5.1" /end CHARACTERISTIC
/begin CHARACTERISTIC TFASCBLINK "" VALUE 0x4E9C8A KwUw 10.00000 t10msxs_sb_q0p01 0.00 10.00000 FORMAT "%8.5" /end CHARACTERISTIC
/begin CHARACTERISTIC TIKATMOE "Temperaturkorrektur im Kat ohne Exotherme tikatm" VALUE 0x4EA6D8 KwSb 1275. temp_q5 -640.0 635.0 FORMAT "%5.1" /end CHARACTERISTIC
/begin CHARACTERISTIC TIKATMOE2 "Temperaturkorrektur im Kat ohne Exotherme tikatm (Bank2)" VALUE 0x4EA6D9 KwSb 1275. temp_q5 -640.0 635.0 FORMAT "%5.1" /end CHARACTERISTIC
/begin CHARACTERISTIC TIMSA "Integratorsteigung f¸r multi. Adaption" VALUE 0x4EA9E6 KwUb 51.00 t200msxs_ub_b51 0.00 51.00 FORMAT "%5.2" /end CHARACTERISTIC
/begin CHARACTERISTIC TIMSALL "Integratorsteigung f¸r multi. Adaption  (langsam)" VALUE 0x4EA9E7 KwUb 51.00 t200msxs_ub_b51 0.00 51.00 FORMAT "%5.2" /end CHARACTERISTIC
/begin CHARACTERISTIC TKATMN "Katalysatortemperaturregelschwelle f¸r Kat warmhalten" VALUE 0x4ECB0E KwUb 1275. temp_ub_q5_o50 -50.00 1225. FORMAT "%5.0" /end CHARACTERISTIC
/begin CHARACTERISTIC TKATMOE "Temperaturkorrektur Kat ohne Exotherme tkatm" VALUE 0x4EA6DA KwSb 1275. temp_q5 -640.0 635.0 FORMAT "%5.1" /end CHARACTERISTIC
/begin CHARACTERISTIC TKATMOE2 "Temperaturkorrektur Kat ohne Exotherme tkatm (Bank2)" VALUE 0x4EA6DB KwSb 1275. temp_q5 -640.0 635.0 FORMAT "%5.1" /end CHARACTERISTIC
/begin CHARACTERISTIC TKATMVOE2 "Temperaturkorrektur Vorkat ohne Exotherme tkatm" VALUE 0x4EA6DC KwSb 1275. temp_q5 -640.0 635.0 FORMAT "%5.1" /end CHARACTERISTIC
/begin CHARACTERISTIC TKATSAN "Katalysator-Temperaturschwelle f¸r Schubabschalten f(nmot)" CURVE 0x4ED598 KlAUbSstUbWUb 1275. temp_ub_q5_o50 -50.00 1225. FORMAT "%5.0"
 /begin AXIS_DESCR STD_AXIS nmot nmot_ub_q40 4 0.00 10200. FORMAT "%5.0" DEPOSIT ABSOLUTE /end AXIS_DESCR
/end CHARACTERISTIC
/begin CHARACTERISTIC TKATW "Katalysatortemperaturschwelle f¸r Kat warmhalten" VALUE 0x4ECB0F KwUb 1275. temp_ub_q5_o50 -50.00 1225. FORMAT "%5.0" /end CHARACTERISTIC
/begin CHARACTERISTIC TKHABB "Entprellzeit f¸r Abbruchbedingungen der Funktion Katheizen" VALUE 0x4ECB10 KwUb 25.50 t100msxs_ub_b25p5 0.00 25.50 FORMAT "%5.2" /end CHARACTERISTIC
/begin CHARACTERISTIC TKHFSAB "Entprellzeit f¸r Umschaltung auf Katheizdrehzahl bei Fahrstufe" VALUE 0x4ECB11 KwUb 25.50 t100msxs_ub_b25p5 0.00 25.50 FORMAT "%5.2" /end CHARACTERISTIC
/begin CHARACTERISTIC TKHLL "Abbruchzeit Katheizen Leerlauf" VALUE 0x4ECBCC KwUw 6553.500 t100msxs_uw_b6553p5 0.00 6553.500 FORMAT "%8.3" /end CHARACTERISTIC
/begin CHARACTERISTIC TKHLLAB "Entprellzeit f¸r Ende Katheizdrehzahl im LL" VALUE 0x4ECB12 KwUb 25.50 t100msxs_ub_b25p5 0.00 25.50 FORMAT "%5.2" /end CHARACTERISTIC
/begin CHARACTERISTIC TKHLLMX "Maximale Zeit f¸r angehobene Katheiz-Drehzahl" VALUE 0x4ECBCE KwUw 655.3500 t10msxs_uw_b655p35 0.00 655.3500 FORMAT "%8.4" /end CHARACTERISTIC
/begin CHARACTERISTIC TKHMX "Maximale Einschaltdauer der Funktion Katheizen" VALUE 0x4ECBD0 KwUw 655.3500 t10msxs_uw_b655p35 0.00 655.3500 FORMAT "%8.4" /end CHARACTERISTIC
/begin CHARACTERISTIC TKHNAB "Zeitdauer Absteuern Katheizdrehzahl" VALUE 0x4ECBD2 KwUw 6553.500 t100msxs_uw_b6553p5 0.00 6553.500 FORMAT "%8.3" /end CHARACTERISTIC
/begin CHARACTERISTIC TKSTBFA "Modell-Temperatur Kat Startwert bei B_faatm Anford.    (kurze Taupunktendezeit)" VALUE 0x4EA6DD KwUb 1275. temp_ub_q5_o50 -50.00 1225. FORMAT "%5.0" /end CHARACTERISTIC
/begin CHARACTERISTIC TMAR "Untere tmot-Schwelle f¸r AR-Freigabe" VALUE 0x4E5F38 KwUb 191.3 temp_ub_q0p75_o48 -48.00 143.3 FORMAT "%5.1" /end CHARACTERISTIC
/begin CHARACTERISTIC TMARSTM "Untere tmot-Schwelle von Starttemperatur f¸r Antiruckel" CURVE 0x4ED914 KlAUbSstUbWUb 191.3 temp_ub_q0p75_o48 -48.00 143.3 FORMAT "%5.1"
 /begin AXIS_DESCR STD_AXIS tmst temp_ub_q0p75_o48 5 -48.00 143.3 FORMAT "%5.1" DEPOSIT ABSOLUTE /end AXIS_DESCR
/end CHARACTERISTIC
/begin CHARACTERISTIC TMFKMSDKA "Mot.-Temperaturschwelle f¸r multi. Adaption" VALUE 0x4E3824 KwUw 49151.25 temp_ub_q0p75_o48 -48.00000 49103.25 FORMAT "%8.2" /end CHARACTERISTIC
/begin CHARACTERISTIC TMNTEVZU "Minimale Zeit bis TEV nach Ansteuerung schlieﬂt" VALUE 0x4E8825 KwUb 0.1245 t_tev0p0005 0.00 0.1245 FORMAT "%6.4" /end CHARACTERISTIC
/begin CHARACTERISTIC TMSKLH "Motortemperaturschwelle f¸r kurze LRA-Anfangsphase bei Heiﬂstart" VALUE 0x4EB812 KwUw 49151.25 temp_ub_q0p75_o48 -48.00000 49103.25 FORMAT "%8.2" /end CHARACTERISTIC
/begin CHARACTERISTIC TMSKS "Motortemperaturschwelle f¸r Erkennung Benzin im ÷l" VALUE 0x4EC588 KwUb 191.3 temp_ub_q0p75_o48 -48.00 143.3 FORMAT "%5.1" /end CHARACTERISTIC
/begin CHARACTERISTIC TMSLOF "Motortemperaturschwelle f¸r Sperre Sekund‰rluft" VALUE 0x4ECBD4 KwUw 49151.25 temp_ub_q0p75_o48 -48.00000 49103.25 FORMAT "%8.2" /end CHARACTERISTIC
/begin CHARACTERISTIC TMSNOGA "Schwelle tms f¸r Dauersp¸len nach Fahrzyklus mit erfolgter Gemischadaption" VALUE 0x4EB814 KwUw 49151.25 temp_ub_q0p75_o48 -48.00000 49103.25 FORMAT "%8.2" /end CHARACTERISTIC
/begin CHARACTERISTIC TNKL15DC "Zeit nach KL15 ein zur Freigabe der CAN-Diagnosen." VALUE 0x4E29B8 KwWU8 25.50 t100msxs_ub_b25p5 0.00 25.50 FORMAT "%5.2" /end CHARACTERISTIC
/begin CHARACTERISTIC TNLATM "Minimale SG-Nachlaufzeit f¸r ATM - Abstellzeit" VALUE 0x4EA850 KwUw 65535.00 t1sxs_uw_q1 0.00 65535.00 FORMAT "%8.2" /end CHARACTERISTIC
/begin CHARACTERISTIC TNLATMTM "bei tmot > Schwellert  SG-Nachlauf-Anforderung B_nlatm = 1" VALUE 0x4EA6DE KwUb 191.3 temp_ub_q0p75_o48 -48.00 143.3 FORMAT "%5.1" /end CHARACTERISTIC
/begin CHARACTERISTIC TNLATMTU "bei tumg (tatu -ATM) > Schwellwert SG-Nachlauf-Anforderung" VALUE 0x4EA6DF KwUb 191.3 temp_ub_q0p75_o48 -48.00 143.3 FORMAT "%5.1" /end CHARACTERISTIC
/begin CHARACTERISTIC TNLEKPVL "Schwelle SG-Nachlaufzeit f¸r EKP-Vorlauf" VALUE 0x4E9692 KwUb 255.0 t1sxs_ub_b255 0.00 255.0 FORMAT "%5.1" /end CHARACTERISTIC
/begin CHARACTERISTIC TNSDMRKH "Zeit nach Start f¸r Drehmomentenreserve Katheizen" VALUE 0x4ECBD6 KwUw 655.3500 t10msxs_uw_b655p35 0.00 655.3500 FORMAT "%8.4" /end CHARACTERISTIC
/begin CHARACTERISTIC TPVL "Zeit f¸r Pumpenvorlauf" VALUE 0x4E9693 KwUb 2.550 t10msxs_ub_b2p55 0.00 2.550 FORMAT "%5.3" /end CHARACTERISTIC
/begin CHARACTERISTIC TTE "Zeit f¸r Tankentl¸ftungsphase" VALUE 0x4EB816 KwUw 6553.500 t100msxs_uw_b6553p6 0.00 6553.500 FORMAT "%8.3" /end CHARACTERISTIC
/begin CHARACTERISTIC TTEAE "Zeit f¸r Tankentl¸ftungsphase bei eingeschwungener Gemischadaption" VALUE 0x4EB818 KwUw 6553.500 t100msxs_uw_b6553p6 0.00 6553.500 FORMAT "%8.3" /end CHARACTERISTIC
/begin CHARACTERISTIC TTEBSTP "Maximal Zeit f¸r TE-Stop im Leerlauf bei nicht gesetzten Zyklusflags" VALUE 0x4EB81A KwUw 6553.500 t100msxs_uw_b6553p6 0.00 6553.500 FORMAT "%8.3" /end CHARACTERISTIC
/begin CHARACTERISTIC TTEGA "Zeit bei der Tankentl¸ftung f¸r Grundadaption" VALUE 0x4EB81C KwUw 6553.500 t100msxs_uw_b6553p6 0.00 6553.500 FORMAT "%8.3" /end CHARACTERISTIC
/begin CHARACTERISTIC TTEGAI "Zeitdauer der ersten  Gemischadaptionsphase" VALUE 0x4EB81E KwUw 6553.500 t100msxs_uw_b6553p6 0.00 6553.500 FORMAT "%8.3" /end CHARACTERISTIC
/begin CHARACTERISTIC TTEGAIH "Zeitdauer der ersten  Gemischadaptionsphase bei Heiﬂstart" VALUE 0x4EB820 KwUw 6553.500 t100msxs_uw_b6553p6 0.00 6553.500 FORMAT "%8.3" /end CHARACTERISTIC
/begin CHARACTERISTIC TTEGAZO "Zeit f¸r Tankentl¸ftungsstop wg. Gemischadaption, obere Schwelle" VALUE 0x4EB822 KwUw 6553.500 t100msxs_uw_b6553p6 0.00 6553.500 FORMAT "%8.3" /end CHARACTERISTIC
/begin CHARACTERISTIC TTEGAZU "Zeit f¸r Tankentl¸ftungsstop wg. Gemischadaption, untere Schwelle" VALUE 0x4EB824 KwUw 6553.500 t100msxs_uw_b6553p6 0.00 6553.500 FORMAT "%8.3" /end CHARACTERISTIC
/begin CHARACTERISTIC TTEINI "Zeit f¸r Tankentl¸ftung in erster TE-Phase nach Initialisierung (B_ini)" VALUE 0x4EB826 KwUw 6553.500 t100msxs_uw_b6553p6 0.00 6553.500 FORMAT "%8.3" /end CHARACTERISTIC
/begin CHARACTERISTIC TTEMN "Zeit f¸r Tankentl¸ftungsphase minimal" VALUE 0x4EB828 KwUw 6553.500 t100msxs_uw_b6553p6 0.00 6553.500 FORMAT "%8.3" /end CHARACTERISTIC
/begin CHARACTERISTIC TTEPRIO "Zeit ab Start f¸r Umschalten auf Dauertankentl¸ftung" VALUE 0x4EB82A KwUw 6553.500 t100msxs_uw_b6553p6 0.00 6553.500 FORMAT "%8.3" /end CHARACTERISTIC
/begin CHARACTERISTIC TTEZAO "Zeit f¸r Tankentl¸ftung Daueraktivierung, obere Schwelle" VALUE 0x4EB82C KwUw 6553.500 t100msxs_uw_b6553p6 0.00 6553.500 FORMAT "%8.3" /end CHARACTERISTIC
/begin CHARACTERISTIC TTEZAU "Zeit f¸r Tankentl¸ftung Daueraktivierung, untere Schwelle" VALUE 0x4EB82E KwUw 6553.500 t100msxs_uw_b6553p6 0.00 6553.500 FORMAT "%8.3" /end CHARACTERISTIC
/begin CHARACTERISTIC TUMTAIT "Initialisierungswert Umgebungstemperatur aus TANS" VALUE 0x4EA6E0 KwUb 191.3 temp_ub_q0p75_o48 -48.00 143.3 FORMAT "%5.1" /end CHARACTERISTIC
/begin CHARACTERISTIC TVKURU "Verzˆgerung der Differenzbildung um x Sekunden" VALUE 0x4E2CF0 KwUb 0.08000 t20msxs_ub_b5p1 0.02000 0.1000 /end CHARACTERISTIC
/begin CHARACTERISTIC TVSATM "Sperrzeit Schubabschalten nach Startende" CURVE 0x4ED5A4 GklWUb 255.0 t1sxs_ub_b255 0.00 255.0 FORMAT "%5.1"
 /begin AXIS_DESCR COM_AXIS tmot temp_ub_q0p75_o48 5 -48.00 143.3 AXIS_PTS_REF STM05SAUB /end AXIS_DESCR
/end CHARACTERISTIC
/begin CHARACTERISTIC TWPEDBR "Entprellzeit f¸r Plausibilisierung Fahrpedalwert mit Bremspedal" VALUE 0x4E2D10 KwUb 2.550 t10msxs_ub_b2p55 0.00 2.550 FORMAT "%5.3" /end CHARACTERISTIC
/begin CHARACTERISTIC TZMIN "Zeitfenster f¸r Zahnerkennung nach UBatt-Einbruch" VALUE 0x4E9694 KwUb 2.550 t10msxs_ub_b2p55 0.00 2.550 FORMAT "%5.3" /end CHARACTERISTIC
/begin CHARACTERISTIC TZSPINI "Sperrzeit fuer Filterinitialisierung" VALUE 0x4E5F39 KwUb 2.550 t10msxs_ub_b2p55 0.00 2.550 FORMAT "%5.3" /end CHARACTERISTIC
/begin CHARACTERISTIC UBDCAN "UBatt-Schwelle f¸r Diagnose CAN-Timeout" VALUE 0x4E29B9 KwWU8 24.02 spg_ubatt 0.00 24.02 FORMAT "%5.2" /end CHARACTERISTIC
/begin CHARACTERISTIC UBSTS "Schwelle zur Erkennung UBatt-Einbruch im Start" VALUE 0x4E9695 KwUb 24.02 spg_ubatt 0.00 24.02 FORMAT "%5.2" /end CHARACTERISTIC
/begin CHARACTERISTIC VARAU "minimale Fahrzeuggeschwindigkeit f¸r ARA - Funktion" VALUE 0x4E5F3A KwUb 317.5 fak_ub_b318p75 0.00 317.5 FORMAT "%5.1" /end CHARACTERISTIC
/begin CHARACTERISTIC VSAA "Geschwindigkeitsschwelle f¸r SA-Drehzahlanhebung" VALUE 0x4E59E7 KwUb 318.8 vfzg_ub_q1p25 0.00 318.8 FORMAT "%5.1" /end CHARACTERISTIC
/begin CHARACTERISTIC VTUMTAT "Schwelle Fahrzeuggeschwindigkeit f¸r TANS -> Umgebungstemperatur" VALUE 0x4EA6E1 KwUb 318.8 vfzg_ub_q1p25 0.00 318.8 FORMAT "%5.1" /end CHARACTERISTIC
/begin CHARACTERISTIC WDKFMAON "min. Schwelle Freigabe der mult. Adaption" CURVE 0x4EA9E8 KlAUbSstUbWUb 100.0 relDK_ub_b100 0.00 100.0 FORMAT "%5.1"
 /begin AXIS_DESCR STD_AXIS nmot nmot_ub_q40 4 0.00 10200. FORMAT "%5.0" DEPOSIT ABSOLUTE /end AXIS_DESCR
/end CHARACTERISTIC
/begin CHARACTERISTIC WDKFMAUN "max. Schwelle Freigabe der multi. Adaption" CURVE 0x4EA9F4 KlAUbSstUbWUb 100.0 relDK_ub_b100 0.00 100.0 FORMAT "%5.1"
 /begin AXIS_DESCR STD_AXIS nmot nmot_ub_q40 4 0.00 10200. FORMAT "%5.0" DEPOSIT ABSOLUTE /end AXIS_DESCR
/end CHARACTERISTIC
/begin CHARACTERISTIC WDKMSON "min. Schwelle Freigabe der addi. Adaption" CURVE 0x4EAA00 KlAUbSstUbWUb 100.0 relDK_ub_b100 0.00 100.0 FORMAT "%5.1"
 /begin AXIS_DESCR STD_AXIS nmot nmot_ub_q40 4 0.00 10200. FORMAT "%5.0" DEPOSIT ABSOLUTE /end AXIS_DESCR
/end CHARACTERISTIC
/begin CHARACTERISTIC WDKVLN "Drosselklappenwinkelschwelle f¸r Vollasterkennung" CURVE 0x4E854C KlAUwSstUwWUw 1599.976 relDK_q0p02441 0.00 1599.976 FORMAT "%8.3"
 /begin AXIS_DESCR STD_AXIS nmot_w nmot_uw_q0p25 14 0.00 16383.75 FORMAT "%8.2" DEPOSIT ABSOLUTE /end AXIS_DESCR
/end CHARACTERISTIC
/begin CHARACTERISTIC WMABGKH "Faktor f¸r W‰rmemengenkorrektur bei Katheizen f¸r Taupunktende" VALUE 0x4EA6E2 KwUb 1.000 fak_ub_b2 0.00 1.000 FORMAT "%5.3" /end CHARACTERISTIC
/begin CHARACTERISTIC WMABGKH2 "Faktor f¸r W‰rmemengenkorrektur bei Katheizen f¸r Taupunktende Bank2" VALUE 0x4EA6E3 KwUb 1.000 fak_ub_b2 0.00 1.000 FORMAT "%5.3" /end CHARACTERISTIC
/begin CHARACTERISTIC WMKATKH "Faktor f¸r W‰rmemengenkorrektur bei Katheizen f¸r Taupunktende hinter Kat" VALUE 0x4EA6E4 KwUb 1.000 fak_ub_b2 0.00 1.000 FORMAT "%5.3" /end CHARACTERISTIC
/begin CHARACTERISTIC WMKATKH2 "Faktor f¸r W‰rmemengenkorrektur bei Katheizen f¸r Taupunktende hinter Kat, Bank2" VALUE 0x4EA6E5 KwUb 1.000 fak_ub_b2 0.00 1.000 FORMAT "%5.3" /end CHARACTERISTIC
/begin CHARACTERISTIC WPEDFMX "Fahrpedalschwelle f¸r PWG-Bremspedal Plausibilisierung" VALUE 0x4E2D12 KwUw 100.0000 relPED_uw_b100 0.00 100.0000 FORMAT "%8.4" /end CHARACTERISTIC
/begin CHARACTERISTIC WP_G2_TRH "" VALUE 0x4E3F9E KwUw 100.0000 relPED_uw_b100 0.00 100.0000 FORMAT "%8.4" /end CHARACTERISTIC
/begin CHARACTERISTIC WP_G3_TRH "" VALUE 0x4E3FA0 KwUw 100.0000 relPED_uw_b100 0.00 100.0000 FORMAT "%8.4" /end CHARACTERISTIC
/begin CHARACTERISTIC WP_G4_TRH "" VALUE 0x4E3FA2 KwUw 100.0000 relPED_uw_b100 0.00 100.0000 FORMAT "%8.4" /end CHARACTERISTIC
/begin CHARACTERISTIC WP_TRH_HYS "" VALUE 0x4E3FA4 KwUw 100.0000 relPED_uw_b100 0.00 100.0000 FORMAT "%8.4" /end CHARACTERISTIC
/begin CHARACTERISTIC ZATMAML "Zeitkonstante fuer Abgastemperaturmodell" CURVE 0x4EA852 GklWUw 13106.800000 zk200msxs_uw_b13107 0.20000000000 13107.000000 FORMAT "%12.6"
 /begin AXIS_DESCR COM_AXIS ml_w m_uw_b6553p5 7 0.00 6553.500 AXIS_PTS_REF SML07TMUW /end AXIS_DESCR
/end CHARACTERISTIC
/begin CHARACTERISTIC ZATMAML2 "Zeitkonstante fuer Abgastemperaturmodell Bank2" CURVE 0x4EA860 GklWUw 13106.800000 zk200msxs_uw_b13107 0.20000000000 13107.000000 FORMAT "%12.6"
 /begin AXIS_DESCR COM_AXIS ml_w m_uw_b6553p5 7 0.00 6553.500 AXIS_PTS_REF SML07TMUW /end AXIS_DESCR
/end CHARACTERISTIC
/begin CHARACTERISTIC ZATMIKML "Zeitkonstante fuer Katalysatortemperaturmodell - Temperatur im Kat tikatm" CURVE 0x4EA86E GklWUw 13106.800000 zk200msxs_uw_b13107 0.20000000000 13107.000000 FORMAT "%12.6"
 /begin AXIS_DESCR COM_AXIS ml_w m_uw_b6553p5 7 0.00 6553.500 AXIS_PTS_REF SML07TMUW /end AXIS_DESCR
/end CHARACTERISTIC
/begin CHARACTERISTIC ZATMIKML2 "Zeitkonstante fuer Katalysatortemperaturmodell - Temperatur im Kat Bank 2" CURVE 0x4EA87C GklWUw 13106.800000 zk200msxs_uw_b13107 0.20000000000 13107.000000 FORMAT "%12.6"
 /begin AXIS_DESCR COM_AXIS ml_w m_uw_b6553p5 7 0.00 6553.500 AXIS_PTS_REF SML07TMUW /end AXIS_DESCR
/end CHARACTERISTIC
/begin CHARACTERISTIC ZATMKML "Zeitkonstante fuer Katalysatortemperaturmodell - Kat-Temperatur tkatm" CURVE 0x4EA88A GklWUw 13106.800000 zk200msxs_uw_b13107 0.20000000000 13107.000000 FORMAT "%12.6"
 /begin AXIS_DESCR COM_AXIS ml_w m_uw_b6553p5 7 0.00 6553.500 AXIS_PTS_REF SML07TMUW /end AXIS_DESCR
/end CHARACTERISTIC
/begin CHARACTERISTIC ZATMKML2 "Zeitkonstante fuer Katalysatortemperaturmodell - Kat-Temperatur Bank2" CURVE 0x4EA898 GklWUw 13106.800000 zk200msxs_uw_b13107 0.20000000000 13107.000000 FORMAT "%12.6"
 /begin AXIS_DESCR COM_AXIS ml_w m_uw_b6553p5 7 0.00 6553.500 AXIS_PTS_REF SML07TMUW /end AXIS_DESCR
/end CHARACTERISTIC
/begin CHARACTERISTIC ZATMLSAML "Zeitkonstante fuer Abgastemperaturmodell (fuer LSH bei Boxer-Motoren)" CURVE 0x4EA8A6 GklWUw 13106.800000 zk200msxs_uw_b13107 0.20000000000 13107.000000 FORMAT "%12.6"
 /begin AXIS_DESCR COM_AXIS ml_w m_uw_b6553p5 7 0.00 6553.500 AXIS_PTS_REF SML07TMUW /end AXIS_DESCR
/end CHARACTERISTIC
/begin CHARACTERISTIC ZATMLSAML2 "Zeitkonstante fuer Abgastemperaturmodell Bank2(fuer LSH bei Boxer-Motoren)" CURVE 0x4EA8B4 GklWUw 13106.800000 zk200msxs_uw_b13107 0.20000000000 13107.000000 FORMAT "%12.6"
 /begin AXIS_DESCR COM_AXIS ml_w m_uw_b6553p5 7 0.00 6553.500 AXIS_PTS_REF SML07TMUW /end AXIS_DESCR
/end CHARACTERISTIC
/begin CHARACTERISTIC ZATMLSRML "Zeitkonstante fuer Abgastemp.modell-Rohrwandtemp.(fuer LSH bei Boxer-Motoren)" CURVE 0x4EA8C2 GklWUw 13106.800000 zk200msxs_uw_b13107 0.20000000000 13107.000000 FORMAT "%12.6"
 /begin AXIS_DESCR COM_AXIS ml_w m_uw_b6553p5 7 0.00 6553.500 AXIS_PTS_REF SML07TMUW /end AXIS_DESCR
/end CHARACTERISTIC
/begin CHARACTERISTIC ZATMLSRML2 "Zeitkonstante fuer Abgastemp.modell-Rohrwandtemp. Bank2(LSH Boxer-Motoren)" CURVE 0x4EA8D0 GklWUw 13106.800000 zk200msxs_uw_b13107 0.20000000000 13107.000000 FORMAT "%12.6"
 /begin AXIS_DESCR COM_AXIS ml_w m_uw_b6553p5 7 0.00 6553.500 AXIS_PTS_REF SML07TMUW /end AXIS_DESCR
/end CHARACTERISTIC
/begin CHARACTERISTIC ZATMRML "Zeitkonstante fuer Abgastemperaturmodell - Rohrwandtemperatur" CURVE 0x4EA8DE GklWUw 13106.800000 zk200msxs_uw_b13107 0.20000000000 13107.000000 FORMAT "%12.6"
 /begin AXIS_DESCR COM_AXIS ml_w m_uw_b6553p5 7 0.00 6553.500 AXIS_PTS_REF SML07TMUW /end AXIS_DESCR
/end CHARACTERISTIC
/begin CHARACTERISTIC ZATMRML2 "Zeitkonstante fuer Abgastemperaturmodell - Rohrwandtemperatur Bank2" CURVE 0x4EA8EC GklWUw 13106.800000 zk200msxs_uw_b13107 0.20000000000 13107.000000 FORMAT "%12.6"
 /begin AXIS_DESCR COM_AXIS ml_w m_uw_b6553p5 7 0.00 6553.500 AXIS_PTS_REF SML07TMUW /end AXIS_DESCR
/end CHARACTERISTIC
/begin CHARACTERISTIC ZATMVKML2 "Zeitkonstante fuer Katalysatortemperaturmodell - Temperatur im Vorkat Bank 2" CURVE 0x4EA8FA GklWUw 13106.800000 zk200msxs_uw_b13107 0.20000000000 13107.000000 FORMAT "%12.6"
 /begin AXIS_DESCR COM_AXIS ml_w m_uw_b6553p5 7 0.00 6553.500 AXIS_PTS_REF SML07TMUW /end AXIS_DESCR
/end CHARACTERISTIC
/begin CHARACTERISTIC ZKHABB "Zeitkonstante f¸r Abbruch-Tiefpass Katheizen" VALUE 0x4ECB13 KwUb 25.4996 zk100msxs_ub_b25p5 0.100392 25.6000 FORMAT "%7.4" /end CHARACTERISTIC
/begin CHARACTERISTIC ZKLAMKH "Zeitkonstante Lambda-Motor-Soll bei Katheizen" VALUE 0x4E54E6 KwUw 655.350000 zk10msxs_uw_b655 0.0100001526 655.360000 FORMAT "%10.6" /end CHARACTERISTIC
/begin CHARACTERISTIC ZKMSDK "Zeitkonstante schnelle Massenstromadaption" CURVE 0x4E3826 KlAUwSstUwWUw 7.812269 mk10ms_uw_q2p384e5n 0.00 7.812269 FORMAT "%8.6"
 /begin AXIS_DESCR STD_AXIS pspvdk_w fak_uw_b2 8 0.00 1.999969 FORMAT "%8.6" DEPOSIT ABSOLUTE /end AXIS_DESCR
/end CHARACTERISTIC
/begin CHARACTERISTIC ZKURU "Zeitkonstante Filterung Differenz nmot zu vfzg -Quotient" VALUE 0x4E2D0E KwUw 1309.9800107 zk20msxs_uw_b1310 0.019989318685 1310.0000000 FORMAT "%12.7" /end CHARACTERISTIC
/begin CHARACTERISTIC ZMRFABN "berechnet aktuelle Zeitkonstante des Tiefpaﬂ (Dauerhochlast) mrfabnf_w" CURVE 0x4EB830 KlAUwSstSwWUw 6553.50000 zk100msxs_uw_b6553 0.100001526 6553.60000 FORMAT "%10.5"
 /begin AXIS_DESCR STD_AXIS dmrfabn_w rel_sw_b100 5 -100.0000 99.99695 FORMAT "%8.4" DEPOSIT ABSOLUTE /end AXIS_DESCR
/end CHARACTERISTIC
/begin CHARACTERISTIC ZNGAR "Zeitkonstante f¸r Drehzahlgradient AR" VALUE 0x4E5F62 KwUw 655.350000 zk10msxs_uw_b655 0.0100001526 655.360000 FORMAT "%10.6" /end CHARACTERISTIC
/begin CHARACTERISTIC ZNGFIL "Zeitkonstante f¸r Drehzahlgradient-Filter" VALUE 0x4E2BF2 KwUw 655.350000 zk10msxs_uw_b655 0.0100001526 655.360000 FORMAT "%10.6" /end CHARACTERISTIC
/begin CHARACTERISTIC ZNOSTMX "Anzahl Z¸ndung=ein ohne Erreichen von Startende f¸r kein EKP-Vorlauf" VALUE 0x4E9696 KwUb 255.0 dez 0.00 255.0 FORMAT "%5.1" /end CHARACTERISTIC
/begin CHARACTERISTIC Zweab "" VALUE 0x4EB7E7 KwUb 0.9961 fak_ub_b1 0.00 0.9961 /end CHARACTERISTIC
/begin CHARACTERISTIC Zweauf "" VALUE 0x4EB7E8 KwUb 0.9961 fak_ub_b1 0.00 0.9961 /end CHARACTERISTIC
/begin MEASUREMENT abmf "Festeinspritzausblendmuster" UBYTE dez 1 100 0 255 FORMAT "%5.1" ECU_ADDRESS 0x7FD910 /end MEASUREMENT
/begin MEASUREMENT abo "Anzahl Starts mit Benzin im ÷l" UBYTE dez 1 100 0 255 FORMAT "%5.1" ECU_ADDRESS 0x7F9C00 /end MEASUREMENT
/begin MEASUREMENT AEKPintbits "" UBYTE dez 1 100 0 255 FORMAT "%5.1" ECU_ADDRESS 0x7F9C7E /end MEASUREMENT
/begin MEASUREMENT anznmax "Anzahl NMAX-‹berschreitungen" UBYTE dez 1 100 0 255 FORMAT "%5.1" ECU_ADDRESS 0x7F9AF0 /end MEASUREMENT
/begin MEASUREMENT anzpbr_w "Anzahl Ereignisse PWG-Bremspedal Plausibilisierung" UWORD dez 1 100 0 65535 FORMAT "%8.2" ECU_ADDRESS 0x7F9B4C /end MEASUREMENT
/begin MEASUREMENT ascModus "" ULONG AscModus 1 100 0 2 FORMAT "%13.11" ECU_ADDRESS 0x7F9CC8 /end MEASUREMENT
/begin MEASUREMENT ascStatus "" ULONG AscStatus 1 100 0 7 FORMAT "%13.11" ECU_ADDRESS 0x7FB68C /end MEASUREMENT
/begin MEASUREMENT ATMbits "" UBYTE dez 1 100 0 255 FORMAT "%5.1" ECU_ADDRESS 0x7F9B1C /end MEASUREMENT
/begin MEASUREMENT ATMbits1 "" UBYTE dez 1 100 0 255 FORMAT "%5.1" ECU_ADDRESS 0x7FD4C4 /end MEASUREMENT
/begin MEASUREMENT A_anlasser "Ausgangsvariable zum Ansteuern des Anlasserrelais" UBYTE B_TRUE 1 100 0 1 BIT_MASK 0x1 FORMAT "%13.11" ECU_ADDRESS 0x7FBC97 /end MEASUREMENT
/begin MEASUREMENT BBKHZlokBits "" UWORD dez 1 100 0 65535 FORMAT "%8.2" ECU_ADDRESS 0x7FD656 /end MEASUREMENT
/begin MEASUREMENT BBSAWElokbits "" UBYTE dez 1 100 0 255 FORMAT "%5.1" ECU_ADDRESS 0x7FDA3F /end MEASUREMENT
/begin MEASUREMENT BGBNausbits0 "" UBYTE dez 1 100 0 255 FORMAT "%5.1" ECU_ADDRESS 0x7FDB19 /end MEASUREMENT
/begin MEASUREMENT B_abor "Bedigung Anzahl Starts mit Benzin im ÷l f¸r reduzierte LRA" UBYTE B_TRUE 1 100 0 1 BIT_MASK 0x1 FORMAT "%13.11" ECU_ADDRESS 0x7FBA68 /end MEASUREMENT
/begin MEASUREMENT B_adpini "" UBYTE B_TRUE 1 100 0 1 BIT_MASK 0x1 FORMAT "%13.11" ECU_ADDRESS 0x7FD803 /end MEASUREMENT
/begin MEASUREMENT B_akl "" UBYTE B_TRUE 1 100 0 1 BIT_MASK 0x1 FORMAT "%13.11" ECU_ADDRESS 0x7FB9D2 /end MEASUREMENT
/begin MEASUREMENT B_Anlabr "Bedingung zum Abruch der Anlasseransteuerung" UBYTE B_TRUE 1 100 0 1 BIT_MASK 0x1 FORMAT "%13.11" ECU_ADDRESS 0x7FBC98 /end MEASUREMENT
/begin MEASUREMENT B_anlasser "Anlasser Flag: signalisiert ob Anlasser betaetigt wurde" UBYTE B_TRUE 1 100 0 1 BIT_MASK 0x1 FORMAT "%13.11" ECU_ADDRESS 0x7FBC99 /end MEASUREMENT
/begin MEASUREMENT B_anlschu "Anlasserschutz Flag: signalisiert ob Anlasser betaetigt wurde" UBYTE B_TRUE 1 100 0 1 BIT_MASK 0x1 FORMAT "%13.11" ECU_ADDRESS 0x7FBC9A /end MEASUREMENT
/begin MEASUREMENT B_ar "Antiruckeleingriff aktiv" UBYTE B_TRUE 1 100 0 1 BIT_MASK 0x1 FORMAT "%13.11" ECU_ADDRESS 0x7FBB3F /end MEASUREMENT
/begin MEASUREMENT B_ar_help "" UBYTE B_TRUE 1 100 0 1 BIT_MASK 0x1 FORMAT "%13.11" ECU_ADDRESS 0x7FBB40 /end MEASUREMENT
/begin MEASUREMENT B_ascLampe "" UBYTE B_TRUE 1 100 0 1 BIT_MASK 0x1 FORMAT "%13.11" ECU_ADDRESS 0x7FBCAB /end MEASUREMENT
/begin MEASUREMENT B_atmst "Bedingung Startwert tabgmst,tkatmst berechnet" UBYTE B_TRUE 1 100 0 1 BIT_MASK 0x2 FORMAT "%13.11" ECU_ADDRESS 0x7FD4C4 /end MEASUREMENT
/begin MEASUREMENT B_atmst2 "Bedingung Startwert tabgmst, tkatmst berechnet Bank2" UBYTE B_TRUE 1 100 0 1 BIT_MASK 0x4 FORMAT "%13.11" ECU_ADDRESS 0x7FD4C4 /end MEASUREMENT
/begin MEASUREMENT B_atmtpa "Bedingung Taupunkt vor Kat ueberschritten" UBYTE B_TRUE 1 100 0 1 BIT_MASK 0x1 FORMAT "%13.11" ECU_ADDRESS 0x7FB94E /end MEASUREMENT
/begin MEASUREMENT B_atmtpa2 "Bedingung Taupunkt2 vor Kat ueberschritten" UBYTE B_TRUE 1 100 0 1 BIT_MASK 0x1 FORMAT "%13.11" ECU_ADDRESS 0x7FB94F /end MEASUREMENT
/begin MEASUREMENT B_atmtpf "Bedingung Taupunkt vor Kat ¸berschritten (last trip)" UBYTE B_TRUE 1 100 0 1 BIT_MASK 0x4 FORMAT "%13.11" ECU_ADDRESS 0x7F9B1C /end MEASUREMENT
/begin MEASUREMENT B_atmtpf2 "Bedingung Taupunkt vor Kat ¸berschritten (last trip) Bank2" UBYTE B_TRUE 1 100 0 1 BIT_MASK 0x8 FORMAT "%13.11" ECU_ADDRESS 0x7F9B1C /end MEASUREMENT
/begin MEASUREMENT B_atmtpk "Bedingung Taupunkt hinter Kat ueberschritten" UBYTE B_TRUE 1 100 0 1 BIT_MASK 0x1 FORMAT "%13.11" ECU_ADDRESS 0x7FB950 /end MEASUREMENT
/begin MEASUREMENT B_atmtpk2 "Bedingung Taupunkt2 hinter Kat ueberschritten" UBYTE B_TRUE 1 100 0 1 BIT_MASK 0x1 FORMAT "%13.11" ECU_ADDRESS 0x7FB951 /end MEASUREMENT
/begin MEASUREMENT B_atmtpl "Bedingung Taupunkt hinter Kat ¸berschritten (last trip)" UBYTE B_TRUE 1 100 0 1 BIT_MASK 0x1 FORMAT "%13.11" ECU_ADDRESS 0x7F9B1C /end MEASUREMENT
/begin MEASUREMENT B_atmtpl2 "Bedingung Taupunkt hinter Kat ¸berschritten (last trip) Bank2" UBYTE B_TRUE 1 100 0 1 BIT_MASK 0x2 FORMAT "%13.11" ECU_ADDRESS 0x7F9B1C /end MEASUREMENT
/begin MEASUREMENT B_A_schutz "Ausgangs-Flag: wird bei Fehlstart gesetzt zum Schutz des Anlassers" UBYTE B_TRUE 1 100 0 1 BIT_MASK 0x1 FORMAT "%13.11" ECU_ADDRESS 0x7FBC9B /end MEASUREMENT
/begin MEASUREMENT B_bevab "Bedingung EV-Abschaltung auf Bank/Bank1" UBYTE B_TRUE 1 100 0 1 BIT_MASK 0x1 FORMAT "%13.11" ECU_ADDRESS 0x7FB9E3 /end MEASUREMENT
/begin MEASUREMENT B_bevab2 "Bedingung EV-Abschaltung auf Bank2" UBYTE B_TRUE 1 100 0 1 BIT_MASK 0x1 FORMAT "%13.11" ECU_ADDRESS 0x7FB9E4 /end MEASUREMENT
/begin MEASUREMENT B_bvhfm "Bedingung: Bordnetzversorgung HFM" UBYTE B_TRUE 1 100 0 1 BIT_MASK 0x1 FORMAT "%13.11" ECU_ADDRESS 0x7FDB19 /end MEASUREMENT
/begin MEASUREMENT B_bvhls "Bedingung: Bordnetzversorgung Lambdasondenheizung" UBYTE B_TRUE 1 100 0 1 BIT_MASK 0x2 FORMAT "%13.11" ECU_ADDRESS 0x7FDB19 /end MEASUREMENT
/begin MEASUREMENT B_cksbrdy "Checksummemberechnung ist fertig (ready)" UBYTE B_TRUE 1 100 0 1 BIT_MASK 0x1 FORMAT "%13.11" ECU_ADDRESS 0x7FBB1C /end MEASUREMENT
/begin MEASUREMENT B_cksbrdy2 "" UBYTE B_TRUE 1 100 0 1 BIT_MASK 0x1 FORMAT "%13.11" ECU_ADDRESS 0x7FBB1D /end MEASUREMENT
/begin MEASUREMENT B_dnsll "Bedingung SA-Drehzahl-Hysterese DNSLL" UBYTE B_TRUE 1 100 0 1 BIT_MASK 0x1 FORMAT "%13.11" ECU_ADDRESS 0x7FDA3F /end MEASUREMENT
/begin MEASUREMENT B_dslvh "Bedingung Ladedrucksensor vorhanden" UBYTE B_TRUE 1 100 0 1 BIT_MASK 0x1 FORMAT "%13.11" ECU_ADDRESS 0x7FB9BE /end MEASUREMENT
/begin MEASUREMENT B_dssv "Bedingung Saugrohr-Drucksensor vorhanden als Hauptlastsensor" UBYTE B_TRUE 1 100 0 1 BIT_MASK 0x1 FORMAT "%13.11" ECU_ADDRESS 0x7FB9BF /end MEASUREMENT
/begin MEASUREMENT B_ekpd "Bedingung EKP Dauerbetrieb" UBYTE B_TRUE 1 100 0 1 BIT_MASK 0x8 FORMAT "%13.11" ECU_ADDRESS 0x7FD7AA /end MEASUREMENT
/begin MEASUREMENT B_ekpn "Bedingung EKP-Einschaltbedingung Drehzahl erf¸llt" UBYTE B_TRUE 1 100 0 1 BIT_MASK 0x10 FORMAT "%13.11" ECU_ADDRESS 0x7FD7AA /end MEASUREMENT
/begin MEASUREMENT B_ekpubn "Bedingung EKP-Einschaltbedingung UBatt-Einbruch und Zahnsignal erf¸llt" UBYTE B_TRUE 1 100 0 1 BIT_MASK 0x20 FORMAT "%13.11" ECU_ADDRESS 0x7FD7AA /end MEASUREMENT
/begin MEASUREMENT B_ekpvl "Bedingung EKP-Vorlauf" UBYTE B_TRUE 1 100 0 1 BIT_MASK 0x40 FORMAT "%13.11" ECU_ADDRESS 0x7FD7AA /end MEASUREMENT
/begin MEASUREMENT B_evabsecu "Flag zur Erkennung der EV-Abschaltung durch Starfreigabefkt." UBYTE B_TRUE 1 100 0 1 BIT_MASK 0x1 FORMAT "%13.11" ECU_ADDRESS 0x7FB9D4 /end MEASUREMENT
/begin MEASUREMENT B_evloc "Status alle lokalen Einspritzventile werden angesteuert, = B_EVTOT bei einen SG" UBYTE B_TRUE 1 100 0 1 BIT_MASK 0x1 FORMAT "%13.11" ECU_ADDRESS 0x7FB9E5 /end MEASUREMENT
/begin MEASUREMENT B_EZA "" UBYTE B_TRUE 1 100 0 1 BIT_MASK 0x80 FORMAT "%13.11" ECU_ADDRESS 0x7FD914 /end MEASUREMENT
/begin MEASUREMENT B_EZZW "" UBYTE B_TRUE 1 100 0 1 BIT_MASK 0x4 FORMAT "%13.11" ECU_ADDRESS 0x7FD914 /end MEASUREMENT
/begin MEASUREMENT B_fgdcan "Bedingung CAN Diagnosen freigegeben" UBYTE B_TRUE 1 100 0 1 BIT_MASK 0x1 FORMAT "%13.11" ECU_ADDRESS 0x7FB919 /end MEASUREMENT
/begin MEASUREMENT B_fkmsmn "schnelle Massenstromadaption fkmsdks im unteren Anschlag" UBYTE B_TRUE 1 100 0 1 BIT_MASK 0x1 FORMAT "%13.11" ECU_ADDRESS 0x7FB9C0 /end MEASUREMENT
/begin MEASUREMENT B_fkmsmx "schnelle Massenstromadaption fkmsdks im oberen Anschlag" UBYTE B_TRUE 1 100 0 1 BIT_MASK 0x1 FORMAT "%13.11" ECU_ADDRESS 0x7FB9C1 /end MEASUREMENT
/begin MEASUREMENT B_fkpvmn "langsame Massenstromadaption fkpvdk im unteren Anschlag" UBYTE B_TRUE 1 100 0 1 BIT_MASK 0x1 FORMAT "%13.11" ECU_ADDRESS 0x7FB9C2 /end MEASUREMENT
/begin MEASUREMENT B_fkpvmx "langsame Massenstromadaption fkpvdk im oberen Anschlag" UBYTE B_TRUE 1 100 0 1 BIT_MASK 0x1 FORMAT "%13.11" ECU_ADDRESS 0x7FB9C3 /end MEASUREMENT
/begin MEASUREMENT B_fraoan "Anforderung TEV schnell schlieﬂen zur Aktivierung der Gemischadaption" UBYTE B_TRUE 1 100 0 1 BIT_MASK 0x1 FORMAT "%13.11" ECU_ADDRESS 0x7FB9D5 /end MEASUREMENT
/begin MEASUREMENT B_gap "Bedingung Gemischadaptionsphase aktiv" UBYTE B_TRUE 1 100 0 1 BIT_MASK 0x1 FORMAT "%13.11" ECU_ADDRESS 0x7FB9D6 /end MEASUREMENT
/begin MEASUREMENT B_gwhs "" UBYTE B_TRUE 1 100 0 1 BIT_MASK 0x1 FORMAT "%13.11" ECU_ADDRESS 0x7FB99E /end MEASUREMENT
/begin MEASUREMENT B_hfmv "Bedingung HFM vorhanden" UBYTE B_TRUE 1 100 0 1 BIT_MASK 0x1 FORMAT "%13.11" ECU_ADDRESS 0x7FB9C4 /end MEASUREMENT
/begin MEASUREMENT B_hwpwf "" UBYTE B_TRUE 1 100 0 1 BIT_MASK 0x1 FORMAT "%13.11" ECU_ADDRESS 0x7FD804 /end MEASUREMENT
/begin MEASUREMENT B_imlprini "Initialisierung imlpr/imlpr_w" UWORD B_TRUE 1 100 0 1 BIT_MASK 0x200 FORMAT "%13.11" ECU_ADDRESS 0x7FD656 /end MEASUREMENT
/begin MEASUREMENT B_iniar "Bedingung Initialisierung der AR-Funktion" UBYTE B_TRUE 1 100 0 1 BIT_MASK 0x1 FORMAT "%13.11" ECU_ADDRESS 0x7FBB41 /end MEASUREMENT
/begin MEASUREMENT B_intzwv "Bedingung ZW-Verstellung durch MD-Struktur aktiv" UBYTE B_TRUE 1 100 0 1 BIT_MASK 0x1 FORMAT "%13.11" ECU_ADDRESS 0x7FBB68 /end MEASUREMENT
/begin MEASUREMENT B_k15_nab "" UBYTE B_TRUE 1 100 0 1 BIT_MASK 0x1 FORMAT "%13.11" ECU_ADDRESS 0x7FBC36 /end MEASUREMENT
/begin MEASUREMENT B_kh "Bedingung Kat-Heizung" UBYTE B_TRUE 1 100 0 1 BIT_MASK 0x1 FORMAT "%13.11" ECU_ADDRESS 0x7FBACB /end MEASUREMENT
/begin MEASUREMENT B_kha "Anforderung Katheizen" UBYTE B_TRUE 1 100 0 1 BIT_MASK 0x1 FORMAT "%13.11" ECU_ADDRESS 0x7FBACC /end MEASUREMENT
/begin MEASUREMENT B_khab "Bedingung Katheizen Abbruch" UBYTE B_TRUE 1 100 0 1 BIT_MASK 0x1 FORMAT "%13.11" ECU_ADDRESS 0x7FBACD /end MEASUREMENT
/begin MEASUREMENT B_khares "Bedingung R¸cksetzen von Bit B_kha" UWORD B_TRUE 1 100 0 1 BIT_MASK 0x40 FORMAT "%13.11" ECU_ADDRESS 0x7FD656 /end MEASUREMENT
/begin MEASUREMENT B_khaset "Bedingung Setzen von Bit B_kha" UWORD B_TRUE 1 100 0 1 BIT_MASK 0x20 FORMAT "%13.11" ECU_ADDRESS 0x7FD656 /end MEASUREMENT
/begin MEASUREMENT B_kherr "Fehler bedingte Sperrbedingung f¸r Bit B_kh" UWORD B_TRUE 1 100 0 1 BIT_MASK 0x100 FORMAT "%13.11" ECU_ADDRESS 0x7FD656 /end MEASUREMENT
/begin MEASUREMENT B_khll "Bedingung Katheizen Leerlauf (Abbruchbedingung)" UWORD B_TRUE 1 100 0 1 BIT_MASK 0x4 FORMAT "%13.11" ECU_ADDRESS 0x7FD656 /end MEASUREMENT
/begin MEASUREMENT B_khlle "Bedingung Leerlauf w‰hrend Katheizen verlassen" UWORD B_TRUE 1 100 0 1 BIT_MASK 0x1 FORMAT "%13.11" ECU_ADDRESS 0x7FD656 /end MEASUREMENT
/begin MEASUREMENT B_khllmx "Bedingung max. Katheitzeit im Leerlauf erreicht" UWORD B_TRUE 1 100 0 1 BIT_MASK 0x2 FORMAT "%13.11" ECU_ADDRESS 0x7FD656 /end MEASUREMENT
/begin MEASUREMENT B_khn "Bedingung Katheiz-Drehzahl" UBYTE B_TRUE 1 100 0 1 BIT_MASK 0x1 FORMAT "%13.11" ECU_ADDRESS 0x7FBACE /end MEASUREMENT
/begin MEASUREMENT B_khno "" UBYTE B_TRUE 1 100 0 1 BIT_MASK 0x1 FORMAT "%13.11" ECU_ADDRESS 0x7FBACF /end MEASUREMENT
/begin MEASUREMENT B_khres "Bedingung R¸cksetzen von Bit B_kh" UWORD B_TRUE 1 100 0 1 BIT_MASK 0x10 FORMAT "%13.11" ECU_ADDRESS 0x7FD656 /end MEASUREMENT
/begin MEASUREMENT B_khset "Bedingung Setzen von Bit B_kh" UWORD B_TRUE 1 100 0 1 BIT_MASK 0x8 FORMAT "%13.11" ECU_ADDRESS 0x7FD656 /end MEASUREMENT
/begin MEASUREMENT B_khstc "von Temperaturen oder Abstellzeit abh‰ngige Freigabe Kat-Heizen" UWORD B_TRUE 1 100 0 1 BIT_MASK 0x400 FORMAT "%13.11" ECU_ADDRESS 0x7FD656 /end MEASUREMENT
/begin MEASUREMENT B_kurn "Bedingung Kupplung rutscht negativ" UBYTE B_TRUE 1 100 0 1 BIT_MASK 0x1 FORMAT "%13.11" ECU_ADDRESS 0x7FB99F /end MEASUREMENT
/begin MEASUREMENT B_kurp "Bedingung Kupplung rutscht positiv" UBYTE B_TRUE 1 100 0 1 BIT_MASK 0x1 FORMAT "%13.11" ECU_ADDRESS 0x7FB9A0 /end MEASUREMENT
/begin MEASUREMENT B_kw "Bedingung Kat warmhalten" UBYTE B_TRUE 1 100 0 1 BIT_MASK 0x1 FORMAT "%13.11" ECU_ADDRESS 0x7FBAD0 /end MEASUREMENT
/begin MEASUREMENT B_lowbat "Bedingung wenn U-Bat zwischen 6 Volt und 7 Volt" UBYTE B_TRUE 1 100 0 1 BIT_MASK 0x1 FORMAT "%13.11" ECU_ADDRESS 0x7F9CB0 /end MEASUREMENT
/begin MEASUREMENT B_MDEE "" UBYTE B_TRUE 1 100 0 1 BIT_MASK 0x2 FORMAT "%13.11" ECU_ADDRESS 0x7FD914 /end MEASUREMENT
/begin MEASUREMENT B_mflai "Bedingung FGR-ACC-Abschaltung irrev." UBYTE B_TRUE 1 100 0 1 FORMAT "%13.11" ECU_ADDRESS 0x7FD7F5 /end MEASUREMENT
/begin MEASUREMENT B_mflal "Bedingung FGR-ACC-Abschaltung langsam" UBYTE B_TRUE 1 100 0 1 FORMAT "%13.11" ECU_ADDRESS 0x7FD7F6 /end MEASUREMENT
/begin MEASUREMENT B_mflar "Bedingung FGR-Abschaltung rev." UBYTE B_TRUE 1 100 0 1 FORMAT "%13.11" ECU_ADDRESS 0x7FD7F7 /end MEASUREMENT
/begin MEASUREMENT B_mflas "Bedingung FGR-ACC-Abschaltung schnell" UBYTE B_TRUE 1 100 0 1 FORMAT "%13.11" ECU_ADDRESS 0x7FD7F8 /end MEASUREMENT
/begin MEASUREMENT B_mflen "Bedingung FGR-ACC-Regelung aktiv" UBYTE B_TRUE 1 100 0 1 FORMAT "%13.11" ECU_ADDRESS 0x7FD7F9 /end MEASUREMENT
/begin MEASUREMENT B_miext "Bedingung externer Momenteneingriff" UBYTE B_TRUE 1 100 0 1 BIT_MASK 0x1 FORMAT "%13.11" ECU_ADDRESS 0x7FBB69 /end MEASUREMENT
/begin MEASUREMENT B_mlsu "Bedingung mslu nicht grˆﬂer 0" UWORD B_TRUE 1 100 0 1 BIT_MASK 0x80 FORMAT "%13.11" ECU_ADDRESS 0x7FD656 /end MEASUREMENT
/begin MEASUREMENT B_nachlauf "Steuerung SG-Nachlauf" UBYTE B_TRUE 1 100 0 1 BIT_MASK 0x1 FORMAT "%13.11" ECU_ADDRESS 0x7FD805 /end MEASUREMENT
/begin MEASUREMENT B_nftev "Bedingung Drehzahlanhebung f¸r erhˆhte TE-Sp¸lrate" UBYTE B_TRUE 1 100 0 1 BIT_MASK 0x1 FORMAT "%13.11" ECU_ADDRESS 0x7FB9D7 /end MEASUREMENT
/begin MEASUREMENT B_ngasok "Bedingung Ringspeicher f¸r ngas-Berechnung ok" UBYTE B_TRUE 1 100 0 1 BIT_MASK 0x1 FORMAT "%13.11" ECU_ADDRESS 0x7FB947 /end MEASUREMENT
/begin MEASUREMENT B_nl "" UBYTE B_TRUE 1 100 0 1 BIT_MASK 0x1 FORMAT "%13.11" ECU_ADDRESS 0x7FBC37 /end MEASUREMENT
/begin MEASUREMENT B_nloff "" UBYTE B_TRUE 1 100 0 1 BIT_MASK 0x1 FORMAT "%13.11" ECU_ADDRESS 0x7FD806 /end MEASUREMENT
/begin MEASUREMENT B_nl_rst "" UBYTE B_TRUE 1 100 0 1 BIT_MASK 0x1 FORMAT "%13.11" ECU_ADDRESS 0x7FBC38 /end MEASUREMENT
/begin MEASUREMENT B_noise_er "Bedingung Akustikmessung erkannt" UBYTE dez 1 100 0 255 FORMAT "%5.1" ECU_ADDRESS 0x7FD817 /end MEASUREMENT
/begin MEASUREMENT B_norm "SG-Bedingung normaler Motorsteuerungsbetrieb" UBYTE B_TRUE 1 100 0 1 BIT_MASK 0x1 FORMAT "%13.11" ECU_ADDRESS 0x7FD807 /end MEASUREMENT
/begin MEASUREMENT B_NREDGD "" UBYTE B_TRUE 1 100 0 1 BIT_MASK 0x20 FORMAT "%13.11" ECU_ADDRESS 0x7FD914 /end MEASUREMENT
/begin MEASUREMENT B_psoff "" UBYTE B_TRUE 1 100 0 1 BIT_MASK 0x1 FORMAT "%13.11" ECU_ADDRESS 0x7FBC39 /end MEASUREMENT
/begin MEASUREMENT B_pvl1 "Bedingung Pumpenvorlauf bei Systemen mit Uhr" UBYTE B_TRUE 1 100 0 1 BIT_MASK 0x1 FORMAT "%13.11" ECU_ADDRESS 0x7FD7AA /end MEASUREMENT
/begin MEASUREMENT B_pvl2 "Bedingung Pumpenvorlauf bei Systemen ohne Uhr" UBYTE B_TRUE 1 100 0 1 BIT_MASK 0x2 FORMAT "%13.11" ECU_ADDRESS 0x7FD7AA /end MEASUREMENT
/begin MEASUREMENT B_pvlnl "Bedingung EKP-Vorlauf aus Nachlaufzeit¸berschreitung" UBYTE B_TRUE 1 100 0 1 BIT_MASK 0x1 FORMAT "%13.11" ECU_ADDRESS 0x7F9C7E /end MEASUREMENT
/begin MEASUREMENT B_pwf "Bedingung Powerfail" UBYTE B_TRUE 1 100 0 1 BIT_MASK 0x1 FORMAT "%13.11" ECU_ADDRESS 0x7FBC35 /end MEASUREMENT
/begin MEASUREMENT B_REDGD "" UBYTE B_TRUE 1 100 0 1 BIT_MASK 0x1 FORMAT "%13.11" ECU_ADDRESS 0x7FD914 /end MEASUREMENT
/begin MEASUREMENT B_REDPREL "" UBYTE B_TRUE 1 100 0 1 BIT_MASK 0x40 FORMAT "%13.11" ECU_ADDRESS 0x7FD914 /end MEASUREMENT
/begin MEASUREMENT B_sab "Bedingung Schubabschaltebereitschaft" UBYTE B_TRUE 1 100 0 1 BIT_MASK 0x1 FORMAT "%13.11" ECU_ADDRESS 0x7FBB21 /end MEASUREMENT
/begin MEASUREMENT B_sabt "Bedingung Schubabschaltebereitschaft" UBYTE B_TRUE 1 100 0 1 BIT_MASK 0x2 FORMAT "%13.11" ECU_ADDRESS 0x7FDA3F /end MEASUREMENT
/begin MEASUREMENT B_st "Bedingung Start" UBYTE B_TRUE 1 100 0 1 BIT_MASK 0x1 FORMAT "%13.11" ECU_ADDRESS 0x7FB9A1 /end MEASUREMENT
/begin MEASUREMENT B_stend "Bedingung Startende erreicht" UBYTE B_TRUE 1 100 0 1 BIT_MASK 0x1 FORMAT "%13.11" ECU_ADDRESS 0x7FB9A2 /end MEASUREMENT
/begin MEASUREMENT B_stendAnl "Bedingung Startende Anlasser" UBYTE B_TRUE 1 100 0 1 BIT_MASK 0x1 FORMAT "%13.11" ECU_ADDRESS 0x7FBC9C /end MEASUREMENT
/begin MEASUREMENT B_stndnl "Bedingung Beginn SG-Nachlauf oder Startende (1->0)" UBYTE B_TRUE 1 100 0 1 BIT_MASK 0x1 FORMAT "%13.11" ECU_ADDRESS 0x7FD4C4 /end MEASUREMENT
/begin MEASUREMENT B_TABS "" UBYTE B_TRUE 1 100 0 1 BIT_MASK 0x8 FORMAT "%13.11" ECU_ADDRESS 0x7FD914 /end MEASUREMENT
/begin MEASUREMENT B_tedtev "Bedingung Tankentl¸ftung zum Sp¸len vor TEV-Diagnose" UBYTE B_TRUE 1 100 0 1 BIT_MASK 0x1 FORMAT "%13.11" ECU_ADDRESS 0x7FB9D8 /end MEASUREMENT
/begin MEASUREMENT B_tehbxf "Bedingung Beladungsintegrator ftead am Maximalanschlag, gefiltert" UBYTE B_TRUE 1 100 0 1 BIT_MASK 0x1 FORMAT "%13.11" ECU_ADDRESS 0x7FB9D9 /end MEASUREMENT
/begin MEASUREMENT B_tep "Bedingung Tankentl¸ftungsphase" UBYTE B_TRUE 1 100 0 1 BIT_MASK 0x1 FORMAT "%13.11" ECU_ADDRESS 0x7FB9DA /end MEASUREMENT
/begin MEASUREMENT B_tepi "Bedingung TE-Phase intern aktiv" UBYTE B_TRUE 1 100 0 1 BIT_MASK 0x1 FORMAT "%13.11" ECU_ADDRESS 0x7FB9DB /end MEASUREMENT
/begin MEASUREMENT B_tepzhl "Bedingung Tankentl¸ftungphase zus‰tzlich wegen Dauerhochlast" UBYTE B_TRUE 1 100 0 1 BIT_MASK 0x1 FORMAT "%13.11" ECU_ADDRESS 0x7FB9DC /end MEASUREMENT
/begin MEASUREMENT B_tepzus "Bedingung zus‰tzliche Tankentl¸ftungsphase" UBYTE B_TRUE 1 100 0 1 BIT_MASK 0x1 FORMAT "%13.11" ECU_ADDRESS 0x7FB9DD /end MEASUREMENT
/begin MEASUREMENT B_tesstp "Bedingung Tankentl¸ftung schnell stoppen" UBYTE B_TRUE 1 100 0 1 BIT_MASK 0x1 FORMAT "%13.11" ECU_ADDRESS 0x7FB9DE /end MEASUREMENT
/begin MEASUREMENT B_testop "Bedingung Tankentl¸ftung stoppen" UBYTE B_TRUE 1 100 0 1 BIT_MASK 0x1 FORMAT "%13.11" ECU_ADDRESS 0x7FB9DF /end MEASUREMENT
/begin MEASUREMENT B_tevtstp "Bedingung Stop f¸r TEV Timer" UBYTE B_TRUE 1 100 0 1 BIT_MASK 0x1 FORMAT "%13.11" ECU_ADDRESS 0x7FBC3A /end MEASUREMENT
/begin MEASUREMENT B_tezstp "Bedingung Tankentl¸ftung zwang stoppen" UBYTE B_TRUE 1 100 0 1 BIT_MASK 0x1 FORMAT "%13.11" ECU_ADDRESS 0x7FB9E0 /end MEASUREMENT
/begin MEASUREMENT B_timsa "Bedingung Integrator f¸r multip. Adaption freigegeben" UBYTE B_TRUE 1 100 0 1 BIT_MASK 0x1 FORMAT "%13.11" ECU_ADDRESS 0x7FB9C5 /end MEASUREMENT
/begin MEASUREMENT B_timsall "Bedingung Integrator f¸r additive Adaption freigegeben" UBYTE B_TRUE 1 100 0 1 BIT_MASK 0x1 FORMAT "%13.11" ECU_ADDRESS 0x7FB9C6 /end MEASUREMENT
/begin MEASUREMENT B_TKAT "" UBYTE B_TRUE 1 100 0 1 BIT_MASK 0x10 FORMAT "%13.11" ECU_ADDRESS 0x7FD914 /end MEASUREMENT
/begin MEASUREMENT B_tpvl "Bedingung Pumpenvorlauf der L‰nge TPVL Sekunden" UBYTE B_TRUE 1 100 0 1 BIT_MASK 0x4 FORMAT "%13.11" ECU_ADDRESS 0x7FD7AA /end MEASUREMENT
/begin MEASUREMENT B_trkh "Bedingung Katheizen, Thermoreaktor wirksam" UBYTE B_TRUE 1 100 0 1 BIT_MASK 0x1 FORMAT "%13.11" ECU_ADDRESS 0x7FBAD1 /end MEASUREMENT
/begin MEASUREMENT B_tteae "Bedingung Umschaltung auf lange TE-Phase" UBYTE B_TRUE 1 100 0 1 BIT_MASK 0x1 FORMAT "%13.11" ECU_ADDRESS 0x7FB9E1 /end MEASUREMENT
/begin MEASUREMENT B_ttegais "Bedingung erste GA-Phase ist kurz" UBYTE B_TRUE 1 100 0 1 BIT_MASK 0x1 FORMAT "%13.11" ECU_ADDRESS 0x7FB9E2 /end MEASUREMENT
/begin MEASUREMENT B_tzarni "Bedingung Wartezeit nach AR Initialisierung abgelaufen" UBYTE B_TRUE 1 100 0 1 BIT_MASK 0x1 FORMAT "%13.11" ECU_ADDRESS 0x7FBB42 /end MEASUREMENT
/begin MEASUREMENT B_vl "Bedingung Vollast" UBYTE B_TRUE 1 100 0 1 BIT_MASK 0x1 FORMAT "%13.11" ECU_ADDRESS 0x7FBB65 /end MEASUREMENT
/begin MEASUREMENT B_vlb "Vollastbereitschaft vom Fahrerwunsch" UBYTE B_TRUE 1 100 0 1 BIT_MASK 0x1 FORMAT "%13.11" ECU_ADDRESS 0x7FBB66 /end MEASUREMENT
/begin MEASUREMENT B_vlrl "" UBYTE B_TRUE 1 100 0 1 BIT_MASK 0x1 FORMAT "%13.11" ECU_ADDRESS 0x7FBB67 /end MEASUREMENT
/begin MEASUREMENT B_vl_a "" UBYTE B_TRUE 1 100 0 1 BIT_MASK 0x1 FORMAT "%13.11" ECU_ADDRESS 0x7FB9D3 /end MEASUREMENT
/begin MEASUREMENT B_wakeup "SG-Bedingung: wake up Betrieb" UBYTE B_TRUE 1 100 0 1 BIT_MASK 0x1 FORMAT "%13.11" ECU_ADDRESS 0x7FD808 /end MEASUREMENT
/begin MEASUREMENT B_wdapwf "Bedingung Neuinitialisierung NVRAM angefordert nach WDA-Abschaltung" UBYTE B_TRUE 1 100 0 1 BIT_MASK 0x1 FORMAT "%13.11" ECU_ADDRESS 0x7F9C6C /end MEASUREMENT
/begin MEASUREMENT CALIBID1 "" UBYTE dez 1 100 0 255 FORMAT "%5.1" ARRAY_SIZE 12 ECU_ADDRESS 0x7FD6AC /end MEASUREMENT
/begin MEASUREMENT CALIBID2 "Calibration ID 2 zur SG Identifikation f¸r Mode $09" UBYTE dez 1 100 0 255 FORMAT "%5.1" ARRAY_SIZE 12 ECU_ADDRESS 0x7FD6B8 /end MEASUREMENT
/begin MEASUREMENT cvn "auszugebende Checksumme (CVN) entsprechend SAE J1979 Mode $09" UBYTE dez 1 100 0 255 FORMAT "%5.1" ARRAY_SIZE 4 ECU_ADDRESS 0x7FD6C4 /end MEASUREMENT
/begin MEASUREMENT cvn2 "" UBYTE dez 1 100 0 255 FORMAT "%5.1" ARRAY_SIZE 4 ECU_ADDRESS 0x7FD6C8 /end MEASUREMENT
/begin MEASUREMENT dekpub "Differenz der Batteriespannung zwischen zwei Messungen bis EKP-Dauerbetrieb" UBYTE spg_ubatt 1 100 0 24.021 FORMAT "%5.2" ECU_ADDRESS 0x7FDB18 /end MEASUREMENT
/begin MEASUREMENT dmar_w "Delta Drehmoment antiruckel" SWORD rel_sw_b100 1 100 -100 99.9969 FORMAT "%8.4" ECU_ADDRESS 0x7FDE90 /end MEASUREMENT
/begin MEASUREMENT dmrfabn_w "Aktuelle gewichtete Leistung um Schwelle MRFABNTE verschoben" SWORD rel_sw_b100 1 100 -100 99.9969 FORMAT "%8.4" ECU_ADDRESS 0x7FD58A /end MEASUREMENT
/begin MEASUREMENT dniar_w "Delta-Drehzahl bei Initialisierung AR-Drehzahl" SWORD nmot_sw_q0p25 1 100 -8192 8191.75 FORMAT "%8.3" ECU_ADDRESS 0x7FDE92 /end MEASUREMENT
/begin MEASUREMENT dnmotas_w "Differenzdrehzahl ¸ber ein Arbeitsspiel" SWORD nmot_sw_q0p25 1 100 -8192 8191.75 FORMAT "%8.3" ECU_ADDRESS 0x7FDB5E /end MEASUREMENT
/begin MEASUREMENT dnmot_w "Differenzdrehzahl zwischen zwei folgenden Segmenten" SWORD nmot_sw_q0p25 1 100 -8192 8191.75 FORMAT "%8.3" ECU_ADDRESS 0x7FDB60 /end MEASUREMENT
/begin MEASUREMENT dnsa "Zeitabh‰ngige Schubhysterese" UBYTE nmot_ub_q40 1 100 0 10200 FORMAT "%5.0" ECU_ADDRESS 0x7FDA40 /end MEASUREMENT
/begin MEASUREMENT dnvquotf_w "Gefilterte Differenz Drehzahl/Geschwindigkeitsquotient" SWORD qnv_sw_q0p0078 1 100 -256 255.992 FORMAT "%8.4" ECU_ADDRESS 0x7FDB8A /end MEASUREMENT
/begin MEASUREMENT dnvquot_w "Differenz Drehzahl/Geschwindigkeitsquotient" SWORD qnv_sw_q0p0078 1 100 -256 255.992 FORMAT "%8.4" ECU_ADDRESS 0x7FDB8C /end MEASUREMENT
/begin MEASUREMENT dqatmhk_w "W‰rmemengendifferenz Hauptkat" SWORD qg_q5p333 1 100 -174763 174757 FORMAT "%8.1" ECU_ADDRESS 0x7FD4F0 /end MEASUREMENT
/begin MEASUREMENT drllad_w "Dynamikanteil der relativen F¸llung rl bei Laderdynamik" SWORD rel_sw_q0p0234 1 100 -768 767.977 FORMAT "%8.4" ECU_ADDRESS 0x7FDB9E /end MEASUREMENT
/begin MEASUREMENT dtatwhk_w "Temperaturdifferenz Abgas - Wandtemperatur im Rohr vor Hauptkat" SWORD temp_q0p0468 1 100 -1536 1535.95 FORMAT "%8.3" ECU_ADDRESS 0x7FD4F2 /end MEASUREMENT
/begin MEASUREMENT dwped_w "Gradient des normierten Fahrpedalwinkels" SWORD GrelPED_sw_b100 1 100 -50.0008 49.9992 FORMAT "%8.5" ECU_ADDRESS 0x7FDC6A /end MEASUREMENT
/begin MEASUREMENT eevx "EV Fehlerbyte" UBYTE dez 1 100 0 255 FORMAT "%5.1" ECU_ADDRESS 0x7FD584 /end MEASUREMENT
/begin MEASUREMENT esst_sts06tmuw "" ULONG dez 1 100 0 4.29497e+009 FORMAT "%13.2" ECU_ADDRESS 0x7FE434 /end MEASUREMENT
/begin MEASUREMENT esst_stu05tmub "" ULONG dez 1 100 0 4.29497e+009 FORMAT "%13.2" ECU_ADDRESS 0x7FE438 /end MEASUREMENT
/begin MEASUREMENT ES_asc "" UBYTE B_TRUE 1 100 0 1 BIT_MASK 0x1 FORMAT "%13.11" ECU_ADDRESS 0x7FBCAC /end MEASUREMENT
/begin MEASUREMENT etazabas "Ist-Zylinderausblendungswirkungsgrad (ohne ext. Ausblendungsanforderung)" UBYTE rel_ub_b127p5 1 100 0 127.5 FORMAT "%5.1" ECU_ADDRESS 0x7FDA77 /end MEASUREMENT
/begin MEASUREMENT etazwimt "Ist_Z¸ndwinkelwirkungsgrad f¸r ATM gemittelt (200 ms)" UBYTE rel_ub_b127p5 1 100 0 127.5 FORMAT "%5.1" ECU_ADDRESS 0x7FD4C5 /end MEASUREMENT
/begin MEASUREMENT etxfrao "" UBYTE dez 1 100 0 255 FORMAT "%5.1" ECU_ADDRESS 0x7FD4AB /end MEASUREMENT
/begin MEASUREMENT etxfrao2 "" UBYTE dez 1 100 0 255 FORMAT "%5.1" ECU_ADDRESS 0x7FD4AC /end MEASUREMENT
/begin MEASUREMENT etxfrau "" UBYTE dez 1 100 0 255 FORMAT "%5.1" ECU_ADDRESS 0x7FD4AD /end MEASUREMENT
/begin MEASUREMENT etxfrau2 "" UBYTE dez 1 100 0 255 FORMAT "%5.1" ECU_ADDRESS 0x7FD4AE /end MEASUREMENT
/begin MEASUREMENT etxhsv "Fehlerart-Erweiterungsbyte: Diagnosestatus Heizung Lambdasonde v.Kat" UBYTE dez 1 100 0 255 FORMAT "%5.1" ECU_ADDRESS 0x7FD4AF /end MEASUREMENT
/begin MEASUREMENT etxhsv2 "Fehlerart-Erweiterungsbyte: Diagnosestatus Heizung Lambdasonde v.Kat 2" UBYTE dez 1 100 0 255 FORMAT "%5.1" ECU_ADDRESS 0x7FD4B0 /end MEASUREMENT
/begin MEASUREMENT etxhsvsa "Fehlerart-Erweiterungsbyte: Diagnosestatus Heizung/Kennlinie Lambdasonde v.Kat" UBYTE dez 1 100 0 255 FORMAT "%5.1" ECU_ADDRESS 0x7FD4B1 /end MEASUREMENT
/begin MEASUREMENT etxhsvsa2 "Fehlerart-Erweiterungsbyte: Diagnosestatus Heizung/Kennlinie Lambdasonde v.K. 2" UBYTE dez 1 100 0 255 FORMAT "%5.1" ECU_ADDRESS 0x7FD4B2 /end MEASUREMENT
/begin MEASUREMENT etxkatsp "" UBYTE dez 1 100 0 255 FORMAT "%5.1" ECU_ADDRESS 0x7FD4B3 /end MEASUREMENT
/begin MEASUREMENT etxlatp "" UBYTE dez 1 100 0 255 FORMAT "%5.1" ECU_ADDRESS 0x7FD4B4 /end MEASUREMENT
/begin MEASUREMENT etxlatp2 "" UBYTE dez 1 100 0 255 FORMAT "%5.1" ECU_ADDRESS 0x7FD4B5 /end MEASUREMENT
/begin MEASUREMENT etxlatv "" UBYTE dez 1 100 0 255 FORMAT "%5.1" ECU_ADDRESS 0x7FD4B6 /end MEASUREMENT
/begin MEASUREMENT etxlatv2 "" UBYTE dez 1 100 0 255 FORMAT "%5.1" ECU_ADDRESS 0x7FD4B7 /end MEASUREMENT
/begin MEASUREMENT etxlsv "" UBYTE dez 1 100 0 255 FORMAT "%5.1" ECU_ADDRESS 0x7FD4B8 /end MEASUREMENT
/begin MEASUREMENT etxlsv2 "" UBYTE dez 1 100 0 255 FORMAT "%5.1" ECU_ADDRESS 0x7FD4B9 /end MEASUREMENT
/begin MEASUREMENT etxrkat "" UBYTE dez 1 100 0 255 FORMAT "%5.1" ECU_ADDRESS 0x7FD4BA /end MEASUREMENT
/begin MEASUREMENT etxrkat2 "" UBYTE dez 1 100 0 255 FORMAT "%5.1" ECU_ADDRESS 0x7FD4BB /end MEASUREMENT
/begin MEASUREMENT etxrkaz "" UBYTE dez 1 100 0 255 FORMAT "%5.1" ECU_ADDRESS 0x7FD4BC /end MEASUREMENT
/begin MEASUREMENT etxrkaz2 "" UBYTE dez 1 100 0 255 FORMAT "%5.1" ECU_ADDRESS 0x7FD4BD /end MEASUREMENT
/begin MEASUREMENT etxsls "Fehlerart-Erweiterungsbyte: Diagnosestatus Sekund‰rluft-System" UBYTE dez 1 100 0 255 FORMAT "%5.1" ECU_ADDRESS 0x7FD4BE /end MEASUREMENT
/begin MEASUREMENT etxsls2 "Fehlerart-Erweiterungsbyte: Diagnosestatus Sekund‰rluft-System, Bank 2" UBYTE dez 1 100 0 255 FORMAT "%5.1" ECU_ADDRESS 0x7FD4BF /end MEASUREMENT
/begin MEASUREMENT etxslv "Fehlerart-Erweiterungsbyte: Diagnosestatus Sekund‰rluft-Ventil" UBYTE dez 1 100 0 255 FORMAT "%5.1" ECU_ADDRESS 0x7FD4C0 /end MEASUREMENT
/begin MEASUREMENT etxslv2 "Fehlerart-Erweiterungsbyte: Diagnosestatus Sekund‰rluft-Ventil, Bank 2" UBYTE dez 1 100 0 255 FORMAT "%5.1" ECU_ADDRESS 0x7FD4C1 /end MEASUREMENT
/begin MEASUREMENT etxtes "" UBYTE dez 1 100 0 255 FORMAT "%5.1" ECU_ADDRESS 0x7FD4C2 /end MEASUREMENT
/begin MEASUREMENT evzabm "" UBYTE dez 1 100 0 255 FORMAT "%5.1" ECU_ADDRESS 0x7FD917 /end MEASUREMENT
/begin MEASUREMENT evz_aus "Einspritzausblendmuster" UBYTE dez 1 100 0 255 FORMAT "%5.1" ECU_ADDRESS 0x7FD911 /end MEASUREMENT
/begin MEASUREMENT evz_austot "Einspritzausblendmuster total" UBYTE dez 1 100 0 255 FORMAT "%5.1" ECU_ADDRESS 0x7FD916 /end MEASUREMENT
/begin MEASUREMENT EWS_ABICPage0 "" UWORD dez 1 100 0 65535 FORMAT "%8.2" ECU_ADDRESS 0x7FDE22 /end MEASUREMENT
/begin MEASUREMENT EWS_ABICPage1 "" UWORD dez 1 100 0 65535 FORMAT "%8.2" ECU_ADDRESS 0x7FDE24 /end MEASUREMENT
/begin MEASUREMENT EWS_ABICPage2 "" UWORD dez 1 100 0 65535 FORMAT "%8.2" ECU_ADDRESS 0x7FDE26 /end MEASUREMENT
/begin MEASUREMENT EWS_ABICPage3 "" UWORD dez 1 100 0 65535 FORMAT "%8.2" ECU_ADDRESS 0x7FDE28 /end MEASUREMENT
/begin MEASUREMENT fdar "Verst‰rkungsfaktor des AR-Eingriffs" UBYTE fak_ub_b3p125 1 100 0 3.11279 FORMAT "%5.3" ECU_ADDRESS 0x7FDA57 /end MEASUREMENT
/begin MEASUREMENT fevab "festes Muster EV-Abschaltung" UBYTE dez 1 100 0 255 FORMAT "%5.1" ECU_ADDRESS 0x7FD585 /end MEASUREMENT
/begin MEASUREMENT fevabe "Ausblendmuster aus erkannten Fehlern" UBYTE dez 1 100 0 255 FORMAT "%5.1" ECU_ADDRESS 0x7FD586 /end MEASUREMENT
/begin MEASUREMENT fgr_stat "Status Fahrgeschwindigkeitsregler" UBYTE dez 1 100 0 255 FORMAT "%5.1" ECU_ADDRESS 0x7FD814 /end MEASUREMENT
/begin MEASUREMENT fhost_w "Korrekturfaktor Hˆhe bei Start(word)" UWORD fak_uw_b4 1 100 0 3.99994 FORMAT "%8.6" ECU_ADDRESS 0x7FD658 /end MEASUREMENT
/begin MEASUREMENT fkez "Faktor Korrektur Einspritzzeit zylinderindividuell" UBYTE fak_ub_b2 1 100 0 1.99219 FORMAT "%5.3" ARRAY_SIZE 8 ECU_ADDRESS 0x7FD81C /end MEASUREMENT
/begin MEASUREMENT fkhab "Faktor Katheizen zur Abregelung" UBYTE fak_ub_b1 1 100 0 0.996094 ECU_ADDRESS 0x7FD9E4 /end MEASUREMENT
/begin MEASUREMENT fkhnab "Leerlaufdrehzahl-Absteuerfaktor" UBYTE fak_ub_b1 1 100 0 0.996094 ECU_ADDRESS 0x7FD9E5 /end MEASUREMENT
/begin MEASUREMENT fkmsdka_w "Korrekturfaktor schneller Massenstromausgleich" UWORD fak_uw_b4 1 100 0 3.99994 FORMAT "%8.6" ECU_ADDRESS 0x7F9B98 /end MEASUREMENT
/begin MEASUREMENT fkmsdks_w "Korrekturfaktor schneller Massenstromabgleich" UWORD fak_uw_b4 1 100 0 3.99994 FORMAT "%8.6" ECU_ADDRESS 0x7F9B9A /end MEASUREMENT
/begin MEASUREMENT fkmsdk_w "Korrekturfaktor Massenstrom Nebenf¸llungssignal" UWORD fak_uw_b4 1 100 0 3.99994 FORMAT "%8.6" ECU_ADDRESS 0x7F9B9C /end MEASUREMENT
/begin MEASUREMENT flakh "Faktor Lambda-Steuerung bei Katheizen" UBYTE fak_ub_b1 1 100 0 0.996094 ECU_ADDRESS 0x7FD9E6 /end MEASUREMENT
/begin MEASUREMENT flamkh "Faktor Aufregelung Lambda-Motor-Soll bei Katheizen" UBYTE fak_ub_b1 1 100 0 0.996094 ECU_ADDRESS 0x7FD9E7 /end MEASUREMENT
/begin MEASUREMENT flrar "Verst‰rkungsfaktor zum Nachbilden der externen Last" UBYTE fak_ub_b16 1 100 0 15.9375 FORMAT "%5.2" ECU_ADDRESS 0x7FDA58 /end MEASUREMENT
/begin MEASUREMENT fmdkh "Faktor Steuerung Drehmomentreserve f¸r Katheizen" UBYTE fak_ub_b1 1 100 0 0.996094 ECU_ADDRESS 0x7FD9E8 /end MEASUREMENT
/begin MEASUREMENT fmdkhtns_w "" UWORD fak_uw_b1 1 100 0 0.999985 FORMAT "%9.7" ECU_ADDRESS 0x7FDE2C /end MEASUREMENT
/begin MEASUREMENT fpvdk "Korrekturfaktor Druck vor Drosselklappe" UBYTE fak_ub_b4 1 100 0 3.98438 FORMAT "%5.3" ECU_ADDRESS 0x7FD904 /end MEASUREMENT
/begin MEASUREMENT fpvdk_w "Korrekturfaktor Druck vor Drosselklappe 16-Bit" UWORD fak_uw_b4 1 100 0 3.99994 FORMAT "%8.6" ECU_ADDRESS 0x7FDBA0 /end MEASUREMENT
/begin MEASUREMENT frhodk_w "Faktor Luftdichtekorrektur f¸r DK-Durchfluﬂ f(Ansauglufttemp.,Hˆhe) 16 Bit" UWORD fak_uw_b2 1 100 0 1.99997 FORMAT "%8.6" ECU_ADDRESS 0x7FDBA2 /end MEASUREMENT
/begin MEASUREMENT ftkhk_w "Temperatureinfluﬂ vor Hauptkatalysator durch kalten Motor" SWORD fak_q0p00347_JsK 1 100 -113.778 113.774 FORMAT "%8.4" ECU_ADDRESS 0x7FD4F4 /end MEASUREMENT
/begin MEASUREMENT Fweza "" UWORD fak_uw_b4 1 100 0 3.99994 FORMAT "%8.6" ARRAY_SIZE 2 ECU_ADDRESS 0x7FDC6E /end MEASUREMENT
/begin MEASUREMENT gangi "Ist-Gang" UBYTE dez 1 100 0 255 FORMAT "%5.1" ECU_ADDRESS 0x7FD8F2 /end MEASUREMENT
/begin MEASUREMENT gangi_bb "berechneter Gangwert durch Plausibilisierung" UBYTE dez 1 100 0 255 FORMAT "%5.1" ECU_ADDRESS 0x7FD8F3 /end MEASUREMENT
/begin MEASUREMENT gangi_poti "berechneter Gangwert aus Getriebeschaltwalzenpoti" UBYTE dez 1 100 0 255 FORMAT "%5.1" ECU_ADDRESS 0x7FD8F4 /end MEASUREMENT
/begin MEASUREMENT gang_bcan "Ganginfo f¸r CAN aus berechnetem Ersatzwert" UBYTE dez 1 100 0 255 FORMAT "%5.1" ECU_ADDRESS 0x7FD8F5 /end MEASUREMENT
/begin MEASUREMENT imlatm "integr. Luftmassenfluss ab Motorstart bis Max.wert" UBYTE m_ub_b23p3 1 100 0 23.2107 FORMAT "%5.2" ECU_ADDRESS 0x7FD4C6 /end MEASUREMENT
/begin MEASUREMENT imlatmw_w "Dauer-RAM integr. Luftmassenfluss bei Abstellen" UWORD m_uw_b23p3 1 100 0 23.3013 FORMAT "%8.5" ECU_ADDRESS 0x7F9C2A /end MEASUREMENT
/begin MEASUREMENT imlatm_w "integr. Luftmassenfluss ab Startende bis max. Wert, (Word)" UWORD m_uw_b23p3 1 100 0 23.3013 FORMAT "%8.5" ECU_ADDRESS 0x7FD4F6 /end MEASUREMENT
/begin MEASUREMENT imlbbo "Integrator Luftmasse f¸r Erkennung Benzin im ÷l" UBYTE m_ub_b23p3 1 100 0 23.2107 FORMAT "%5.2" ECU_ADDRESS 0x7FD600 /end MEASUREMENT
/begin MEASUREMENT imlbbo_w "" UWORD m_uw_b23p3 1 100 0 23.3013 FORMAT "%8.5" ECU_ADDRESS 0x7FD602 /end MEASUREMENT
/begin MEASUREMENT imlpr "Relatives Luftmassenintegral bei Katheizung" UBYTE fak_ub_b1 1 100 0 0.996094 ECU_ADDRESS 0x7FD9E9 /end MEASUREMENT
/begin MEASUREMENT imlpr_w "Relatives Luftmassenintegral bei Katheizung (word)" UWORD fak_uw_b1 1 100 0 0.999985 FORMAT "%9.7" ECU_ADDRESS 0x7FDE2E /end MEASUREMENT
/begin MEASUREMENT irspsyn "Index f¸r Ringspeicheradressierung tsegrsp_w, nmotrsp_w, rlrsp_w" UBYTE dez 1 100 0 255 FORMAT "%5.1" ECU_ADDRESS 0x7FD8CE /end MEASUREMENT
/begin MEASUREMENT irspsynold "Ein  Arbeitsspiel alter Index f¸r die Ringspeicheradressierung" UBYTE dez 1 100 0 255 FORMAT "%5.1" ECU_ADDRESS 0x7FD8CF /end MEASUREMENT
/begin MEASUREMENT iwmatm2_w "W‰rmemenge f¸r Kondenswasser-Taupunktende Abgas/Kat (word) bank2" UWORD q_q0p4551 1 100 0 29825.7 FORMAT "%8.2" ECU_ADDRESS 0x7FD4F8 /end MEASUREMENT
/begin MEASUREMENT iwmatm_w "W‰rmemenge f¸r Kondenswasser-Taupunktende Abgas/Kat (word)" UWORD q_q0p4551 1 100 0 29825.7 FORMAT "%8.2" ECU_ADDRESS 0x7FD4FA /end MEASUREMENT
/begin MEASUREMENT kftevp "" UBYTE t500usxms_ub_q0p5 1 100 0 127.5 FORMAT "%5.1" ECU_ADDRESS 0x7FDAC9 /end MEASUREMENT
/begin MEASUREMENT kifz_w "Verst‰rkung des Fahrzeugmodells" UWORD fak_uw_b4864 1 100 0 4863.93 FORMAT "%8.3" ECU_ADDRESS 0x7FDE94 /end MEASUREMENT
/begin MEASUREMENT klaf_kge "" UWORD fak_uw_q0p001 1 100 0 65.535 FORMAT "%8.5" ECU_ADDRESS 0x7FDBA4 /end MEASUREMENT
/begin MEASUREMENT kmstmil_w "Zur¸ckgelegte Fahrstrecke mit MIL on" UWORD s_q1_km 1 100 0 65535 FORMAT "%8.2" ECU_ADDRESS 0x7F9ACE /end MEASUREMENT
/begin MEASUREMENT kmstnmax "Bezugspunkt beim Auftreten der ‹berdrehzahl" UWORD km_uw_q10 1 100 0 655350 FORMAT "%8.1" ECU_ADDRESS 0x7F9AF2 /end MEASUREMENT
/begin MEASUREMENT kmstpbr_w "Bezugspunkt beim Auftreten der PWG-Bremspedal Plausibilisierung" UWORD km_uw_q10 1 100 0 655350 FORMAT "%8.1" ECU_ADDRESS 0x7F9B4E /end MEASUREMENT
/begin MEASUREMENT kmst_w "Zur¸ckgelegte Fahrstrecke seit Powerfail" UWORD s_q6_km 1 100 0 393210 FORMAT "%8.1" ECU_ADDRESS 0x7F9AD0 /end MEASUREMENT
/begin MEASUREMENT kryptoCounter "" UWORD dez 1 100 0 65535 FORMAT "%8.2" ECU_ADDRESS 0x7FD6CC /end MEASUREMENT
/begin MEASUREMENT lokBits_Aekp "" UBYTE dez 1 100 0 255 FORMAT "%5.1" ECU_ADDRESS 0x7FD7AA /end MEASUREMENT
/begin MEASUREMENT lws_w "Lenkwinkel" SWORD lws_q0p04375 1 100 -1433.6 1433.56 FORMAT "%8.3" ECU_ADDRESS 0x7FDE30 /end MEASUREMENT
/begin MEASUREMENT mbyp_ary "airflow through airbypass" UWORD m_uw_b6553p5 1 100 0 6553.5 FORMAT "%8.3" ARRAY_SIZE 2 ECU_ADDRESS 0x7FDBFE /end MEASUREMENT
/begin MEASUREMENT mbyp_w_ary "airflow through bypass (word)" UWORD m_uw_b25p6 1 100 0 25.5996 FORMAT "%8.5" ARRAY_SIZE 2 ECU_ADDRESS 0x7FDC02 /end MEASUREMENT
/begin MEASUREMENT mdbes_w "Beschleunigungsmoment" SWORD rel_sw_b100 1 100 -100 99.9969 FORMAT "%8.4" ECU_ADDRESS 0x7FDE96 /end MEASUREMENT
/begin MEASUREMENT mdindegs_w "indiziertes Motormoment; R¸ckmeldung an Getriebesteuerung" UWORD rel_uw_b100 1 100 0 99.9985 FORMAT "%8.5" ECU_ADDRESS 0x7FDF6A /end MEASUREMENT
/begin MEASUREMENT mdindlm_w "indiziertes Motormoment; R¸ckmeldung an ASR" UWORD rel_uw_b100 1 100 0 99.9985 FORMAT "%8.5" ECU_ADDRESS 0x7FDF6C /end MEASUREMENT
/begin MEASUREMENT miint1_w "Berechnetes Ist-Moment;interne Eingriffe mit AR, LLR, MDBEG" UWORD rel_uw_b100 1 100 0 99.9985 FORMAT "%8.5" ECU_ADDRESS 0x7FDF6E /end MEASUREMENT
/begin MEASUREMENT miint2_w "Berechnetes Ist-Moment; Begrenzung auf mizwmn" UWORD rel_uw_b100 1 100 0 99.9985 FORMAT "%8.5" ECU_ADDRESS 0x7FDF70 /end MEASUREMENT
/begin MEASUREMENT miint3_w "Berechnetes Ist-Moment; Begrenzung auf mibas, miszul" UWORD rel_uw_b100 1 100 0 99.9985 FORMAT "%8.5" ECU_ADDRESS 0x7FDF72 /end MEASUREMENT
/begin MEASUREMENT miintegs_w "Berechnetes Ist-Moment Getriebe" UWORD rel_uw_b100 1 100 0 99.9985 FORMAT "%8.5" ECU_ADDRESS 0x7FDF74 /end MEASUREMENT
/begin MEASUREMENT miintv_w "Berechnetes Ist-Moment;interne Eingriffe ohne AR, LLR, MDBEG" UWORD rel_uw_b100 1 100 0 99.9985 FORMAT "%8.5" ECU_ADDRESS 0x7FDF76 /end MEASUREMENT
/begin MEASUREMENT miint_w "Berechnetes Ist-Moment mit allen internen Eingriffen" UWORD rel_uw_b100 1 100 0 99.9985 FORMAT "%8.5" ECU_ADDRESS 0x7FDF78 /end MEASUREMENT
/begin MEASUREMENT mkar_w "Berechnetes Kupplungsmoment f¸r Antiruckelfunktion" SWORD rel_sw_b100 1 100 -100 99.9969 FORMAT "%8.4" ECU_ADDRESS 0x7FDE98 /end MEASUREMENT
/begin MEASUREMENT mlast_w "gesch‰tztes Lastmoment" SWORD rel_sw_b100 1 100 -100 99.9969 FORMAT "%8.4" ECU_ADDRESS 0x7FDE9A /end MEASUREMENT
/begin MEASUREMENT mlbb "Luftmassenfluﬂ gefiltert (Byte), Bank1 bezogen" UBYTE m_ub_b1020 1 100 0 1020 FORMAT "%5.0" ECU_ADDRESS 0x7FD8D1 /end MEASUREMENT
/begin MEASUREMENT mlbb2 "Luftmassenfluﬂ gefiltert (Byte), Bank2 bezogen" UBYTE m_ub_b1020 1 100 0 1020 FORMAT "%5.0" ECU_ADDRESS 0x7FD8D2 /end MEASUREMENT
/begin MEASUREMENT mlbb2_w "Luftmassenfluﬂ gefiltert (Word), Bank2 bezogen" UWORD m_uw_b6553p5 1 100 0 6553.5 FORMAT "%8.3" ECU_ADDRESS 0x7FDB68 /end MEASUREMENT
/begin MEASUREMENT mlbb_w "Luftmassenfluﬂ gefiltert (Word), Bank1 bezogen" UWORD m_uw_b6553p5 1 100 0 6553.5 FORMAT "%8.3" ECU_ADDRESS 0x7FDB6A /end MEASUREMENT
/begin MEASUREMENT mlsu "Soll-Luftmasse f¸r Katheizen" UBYTE m_ub_b5p8 1 100 0 5.80267 FORMAT "%5.3" ECU_ADDRESS 0x7FD654 /end MEASUREMENT
/begin MEASUREMENT mrfabn "aktuelle gewichtete Leistung (f¸r Dauer-Hochlasterkennung)" UBYTE rel_ub_b100 1 100 0 100 FORMAT "%5.1" ECU_ADDRESS 0x7FD588 /end MEASUREMENT
/begin MEASUREMENT mrfabnf "Tiefpaﬂ-gefilterte gewichtete Leistung - DauerHochlasterkenung" UBYTE rel_ub_b100 1 100 0 100 FORMAT "%5.1" ECU_ADDRESS 0x7FD589 /end MEASUREMENT
/begin MEASUREMENT msabg "Abgasmassenfluﬂ gefiltert, Bank 1" UBYTE m_ub_b1020 1 100 0 1020 FORMAT "%5.0" ECU_ADDRESS 0x7FD8D3 /end MEASUREMENT
/begin MEASUREMENT msabg2 "Abgasmassenfluﬂ gefiltert, Bank 2" UBYTE m_ub_b1020 1 100 0 1020 FORMAT "%5.0" ECU_ADDRESS 0x7FD8D4 /end MEASUREMENT
/begin MEASUREMENT msabg2_w "Abgasmassenfluﬂ gefiltert (Word), Bank 2" UWORD m_uw_b6553p5 1 100 0 6553.5 FORMAT "%8.3" ECU_ADDRESS 0x7FDB6C /end MEASUREMENT
/begin MEASUREMENT msabg_w "Abgasmassenstrom gefiltert (Word), Bank 1" UWORD m_uw_b6553p5 1 100 0 6553.5 FORMAT "%8.3" ECU_ADDRESS 0x7FDB6E /end MEASUREMENT
/begin MEASUREMENT msabvhk_w "Massenstrom Abgas vor Hauptkat" UWORD m_uw_b6553p5 1 100 0 6553.5 FORMAT "%8.3" ECU_ADDRESS 0x7FD4FC /end MEASUREMENT
/begin MEASUREMENT msdif_w "Massenstromdifferenz mshfm_w - msdk_w" SWORD m_sw_q0p1 1 100 -3276.8 3276.7 FORMAT "%8.3" ECU_ADDRESS 0x7FDBA6 /end MEASUREMENT
/begin MEASUREMENT msdkalm_w "Massenstrom ¸ber Drosselklappe (abgeglichen mit HFM Signal)" UWORD m_uw_b6553p5 1 100 0 6553.5 FORMAT "%8.3" ECU_ADDRESS 0x7FDBA8 /end MEASUREMENT
/begin MEASUREMENT msdkue_w "" UWORD m_uw_b6553p5 1 100 0 6553.5 FORMAT "%8.3" ECU_ADDRESS 0x7FDBAA /end MEASUREMENT
/begin MEASUREMENT msdk_w "Massenstrom ¸ber Drosselklappe (word)" UWORD m_uw_b6553p5 1 100 0 6553.5 FORMAT "%8.3" ECU_ADDRESS 0x7FDBAC /end MEASUREMENT
/begin MEASUREMENT msnbyp_kge "" UWORD rel_uw_b100 1 100 0 99.9985 FORMAT "%8.5" ECU_ADDRESS 0x7FDC06 /end MEASUREMENT
/begin MEASUREMENT msndko_w "normierter Leckluftmassenstrom ¸ber Drosselklappe (word)" UWORD m_uw_b6553p5 1 100 0 6553.5 FORMAT "%8.3" ECU_ADDRESS 0x7F9B9E /end MEASUREMENT
/begin MEASUREMENT msndk_w "normierter Massenstrom ¸ber Drosselklappe (word)" UWORD m_uw_b6553p5 1 100 0 6553.5 FORMAT "%8.3" ECU_ADDRESS 0x7FDBAE /end MEASUREMENT
/begin MEASUREMENT msntebyp "" UWORD m_uw_b25p6 1 100 0 25.5996 FORMAT "%8.5" ARRAY_SIZE 2 ECU_ADDRESS 0x7FDC08 /end MEASUREMENT
/begin MEASUREMENT mss_w "Massenstrom vom Sensor (Auswahl zwischen mshfm_w und ml_w)" UWORD m_uw_b6553p5 1 100 0 6553.5 FORMAT "%8.3" ECU_ADDRESS 0x7FDBB0 /end MEASUREMENT
/begin MEASUREMENT mstebyp "Combined airflow through purge valve and air≠bypass" UWORD m_uw_b6553p5 1 100 0 6553.5 FORMAT "%8.3" ECU_ADDRESS 0x7FDBB2 /end MEASUREMENT
/begin MEASUREMENT ndar_w "Differenzdrehzahl f¸r Momenteneingriff" SWORD nmot_sw_q0p25 1 100 -8192 8191.75 FORMAT "%8.3" ECU_ADDRESS 0x7FDE9C /end MEASUREMENT
/begin MEASUREMENT ndfdif_w "Gradient aus AR-Differenzdrehzahl" SWORD nmot_sw_q0p25 1 100 -8192 8191.75 FORMAT "%8.3" ECU_ADDRESS 0x7FDE9E /end MEASUREMENT
/begin MEASUREMENT ndfil_w "gefilterte Differenzdrehzahl" SWORD nmot_sw_q0p25 1 100 -8192 8191.75 FORMAT "%8.3" ECU_ADDRESS 0x7FDEA0 /end MEASUREMENT
/begin MEASUREMENT ndiff_w "Differenzdrehzahl f¸r LFR-HS-Verst‰rkungen" SWORD nmot_sw_q0p25 1 100 -8192 8191.75 FORMAT "%8.3" ECU_ADDRESS 0x7FDEA2 /end MEASUREMENT
/begin MEASUREMENT nfskh "Leerlaufdrehzahl Fahrstufe bei Katheizen" UBYTE nmot_ub_q10 1 100 0 2550 FORMAT "%5.0" ECU_ADDRESS 0x7FD9EA /end MEASUREMENT
/begin MEASUREMENT ngas_w "Drehzahlgradient ¸ber ein Arbeitsspiel" SWORD nmotg_sw_q0p39 1 100 -12800.2 12799.8 FORMAT "%8.2" ECU_ADDRESS 0x7FDB62 /end MEASUREMENT
/begin MEASUREMENT ngfar_w "gefilterter Drehzahlgradient AR-Funktion" SWORD nmotg_sw_q0p39 1 100 -12800.2 12799.8 FORMAT "%8.2" ECU_ADDRESS 0x7FDEA4 /end MEASUREMENT
/begin MEASUREMENT ngfil "gefilterter Drehzahlgradient" SBYTE nmotg_sb_q100 1 100 -12800 12700 FORMAT "%5.0" ECU_ADDRESS 0x7FD8D0 /end MEASUREMENT
/begin MEASUREMENT ngfil_w "gefilterter Drehzahlgradient" SWORD nmotg_sw_q0p39 1 100 -12800.2 12799.8 FORMAT "%8.2" ECU_ADDRESS 0x7FDB64 /end MEASUREMENT
/begin MEASUREMENT nllkh "Leerlaufdrehzahl bei Katheizen" UBYTE nmot_ub_q10 1 100 0 2550 FORMAT "%5.0" ECU_ADDRESS 0x7FD9EB /end MEASUREMENT
/begin MEASUREMENT nmaxvk_w "vorgekommene Maximaldrehzahl" UWORD nmot_uw_q0p15625 1 100 0 10239.8 FORMAT "%8.2" ECU_ADDRESS 0x7F9AF4 /end MEASUREMENT
/begin MEASUREMENT nmod_w "Motordrehzahl aus Modell" UWORD nmot_uw_q0p25 1 100 0 16383.8 FORMAT "%8.2" ECU_ADDRESS 0x7FDEA6 /end MEASUREMENT
/begin MEASUREMENT nmotarr_w "Ringspeicher f¸r Drehzahlen" UWORD nmot_uw_q0p25 1 100 0 16383.8 FORMAT "%8.2" ARRAY_SIZE 4 ECU_ADDRESS 0x7FE110 /end MEASUREMENT
/begin MEASUREMENT nmotas_w "Motordrehzahl von 2 Umdrehungen (1 Arbeitsspiel) zuvor" UWORD nmot_uw_q0p25 1 100 0 16383.8 FORMAT "%8.2" ECU_ADDRESS 0x7FDB66 /end MEASUREMENT
/begin MEASUREMENT noise_t2 "Zeit seit Steuergeraete Reset Altwert" ULONG Sekunden 1 100 0 4.29497e+009 FORMAT "%13.2" ECU_ADDRESS 0x7FE440 /end MEASUREMENT
/begin MEASUREMENT noise_t3 "Zeit fuer v zwischen Schwellen 3" ULONG Sekunden 1 100 0 4.29497e+009 FORMAT "%13.2" ECU_ADDRESS 0x7FE444 /end MEASUREMENT
/begin MEASUREMENT noise_t4 "Totzeit Zaehler nach Akustikstrecke" UBYTE Sekunden 1 100 0 255 FORMAT "%5.1" ECU_ADDRESS 0x7FD818 /end MEASUREMENT
/begin MEASUREMENT nsa "Drehzahl Schub" UBYTE nmot_ub_q40 1 100 0 10200 FORMAT "%5.0" ECU_ADDRESS 0x7FDA41 /end MEASUREMENT
/begin MEASUREMENT nvquot_w "Quotient Motordrehzahl nmot / Fahrgeschwindigkeit vfzg" UWORD qnv_uw_b512 1 100 0 511.992 FORMAT "%8.4" ECU_ADDRESS 0x7FDB88 /end MEASUREMENT
/begin MEASUREMENT nwe "Wiedereinsetzdrehzahl" UBYTE nmot_ub_q40 1 100 0 10200 FORMAT "%5.0" ECU_ADDRESS 0x7FDA42 /end MEASUREMENT
/begin MEASUREMENT nwem_out "Ausgangsgrˆﬂe von NWEM" UBYTE nmot_ub_q40 1 100 0 10200 FORMAT "%5.0" ECU_ADDRESS 0x7FDA43 /end MEASUREMENT
/begin MEASUREMENT pspvdb_w "Quotient Saugrohrduck/Druck vor DK begrenzt (word)" UWORD fak_uw_b2 1 100 0 1.99997 FORMAT "%8.6" ECU_ADDRESS 0x7FDBB4 /end MEASUREMENT
/begin MEASUREMENT pspvdk_w "Quotient Saugrohrdruck/Druck vor Drosselklappe (word)" UWORD fak_uw_b2 1 100 0 1.99997 FORMAT "%8.6" ECU_ADDRESS 0x7FDBB6 /end MEASUREMENT
/begin MEASUREMENT pvdk "Druck vor Drosselklappe" UBYTE p_ub_q10 1 100 0 2550 FORMAT "%5.0" ECU_ADDRESS 0x7FD905 /end MEASUREMENT
/begin MEASUREMENT pvdk_w "Druck vor Drosselklappe 16-Bit" UWORD p_uw_q0p039 1 100 0 2559.96 FORMAT "%8.3" ECU_ADDRESS 0x7FDBB8 /end MEASUREMENT
/begin MEASUREMENT quatmhk_w "W‰rmestrom an Umgebung vor Hauptkat" SWORD qg_q5p333 1 100 -174763 174757 FORMAT "%8.1" ECU_ADDRESS 0x7FD4FE /end MEASUREMENT
/begin MEASUREMENT qwatmhk_w "W‰rmestrom an Wand vor Hauptkat" SWORD qg_q5p333 1 100 -174763 174757 FORMAT "%8.1" ECU_ADDRESS 0x7FD500 /end MEASUREMENT
/begin MEASUREMENT recRes5vSt "" UBYTE dez 1 100 0 255 FORMAT "%5.1" ECU_ADDRESS 0x7FD783 /end MEASUREMENT
/begin MEASUREMENT recWDASt "" UBYTE dez 1 100 0 255 FORMAT "%5.1" ECU_ADDRESS 0x7FD784 /end MEASUREMENT
/begin MEASUREMENT redbas "Basis-Reduzierstufe" UBYTE dez 1 100 0 255 FORMAT "%5.1" ECU_ADDRESS 0x7FD918 /end MEASUREMENT
/begin MEASUREMENT redist "Ist-Reduzierstufe" UBYTE dez 1 100 0 255 FORMAT "%5.1" ECU_ADDRESS 0x7FD919 /end MEASUREMENT
/begin MEASUREMENT redistb1 "Ist-Reduzierstufe Bank 1" UBYTE dez 1 100 0 255 FORMAT "%5.1" ECU_ADDRESS 0x7FD91A /end MEASUREMENT
/begin MEASUREMENT redistb2 "Ist-Reduzierstufe Bank 2" UBYTE dez 1 100 0 255 FORMAT "%5.1" ECU_ADDRESS 0x7FD91B /end MEASUREMENT
/begin MEASUREMENT redsolr "Realisierte Reduzierstufe" UBYTE dez 1 100 0 255 FORMAT "%5.1" ECU_ADDRESS 0x7FD912 /end MEASUREMENT
/begin MEASUREMENT Redst "" UBYTE dez 1 100 0 255 FORMAT "%5.1" ECU_ADDRESS 0x7FD913 /end MEASUREMENT
/begin MEASUREMENT Red_cnt "" UWORD dez 1 100 0 65535 FORMAT "%8.2" ECU_ADDRESS 0x7FDC72 /end MEASUREMENT
/begin MEASUREMENT Red_fkt "" UWORD dez 1 100 0 65535 FORMAT "%8.2" ECU_ADDRESS 0x7FDC74 /end MEASUREMENT
/begin MEASUREMENT Red_set "" UWORD dez 1 100 0 65535 FORMAT "%8.2" ECU_ADDRESS 0x7FDC76 /end MEASUREMENT
/begin MEASUREMENT res5vsta_l "" ULONG dez 1 100 0 4.29497e+009 FORMAT "%13.2" ECU_ADDRESS 0x7F9AA0 /end MEASUREMENT
/begin MEASUREMENT res5vsts_l "" ULONG dez 1 100 0 4.29497e+009 FORMAT "%13.2" ECU_ADDRESS 0x7F9AA4 /end MEASUREMENT
/begin MEASUREMENT resetCounter "" UBYTE dez 1 100 0 255 FORMAT "%5.1" ECU_ADDRESS 0x7F9C6D /end MEASUREMENT
/begin MEASUREMENT rldvs_w "relative Luftf¸llung durch Drosselventile am Saugrohr 16-Bit" UWORD rel_uw_q0p0234 1 100 0 1535.98 FORMAT "%8.3" ECU_ADDRESS 0x7FDBBA /end MEASUREMENT
/begin MEASUREMENT rlroh_w "relative Luftf¸llung: Rohwert vom Lastsensor (word)" UWORD rel_uw_q0p0234 1 100 0 1535.98 FORMAT "%8.3" ECU_ADDRESS 0x7FDBBC /end MEASUREMENT
/begin MEASUREMENT rlvwvugd_w "geforderter Luftvolumenstrom bezogen auf maximalen Volumenstrom" UWORD rel_uw_b200 1 100 0 199.997 FORMAT "%8.4" ECU_ADDRESS 0x7FDF68 /end MEASUREMENT
/begin MEASUREMENT rlwped_w "relative load for driver throttle and purge (no air bypass)" UWORD rel_uw_q0p0234 1 100 0 1535.98 FORMAT "%8.3" ECU_ADDRESS 0x7FDBBE /end MEASUREMENT
/begin MEASUREMENT St_eza "" UBYTE dez 1 100 0 255 FORMAT "%5.1" ECU_ADDRESS 0x7FD914 /end MEASUREMENT
/begin MEASUREMENT St_ezaseg "" UBYTE dez 1 100 0 255 FORMAT "%5.1" ECU_ADDRESS 0x7FD915 /end MEASUREMENT
/begin MEASUREMENT st_noise "Status Akustikfunktion" UBYTE st_akust 1 100 0 8 FORMAT "%13.11" ECU_ADDRESS 0x7FD819 /end MEASUREMENT
/begin MEASUREMENT tabgm "Abgastemperatur vor Kat aus Modell" UBYTE temp_ub_q5_o50 1 100 -50 1225 FORMAT "%5.0" ECU_ADDRESS 0x7FD4C7 /end MEASUREMENT
/begin MEASUREMENT tabgm2 "Abgastemperatur vor Kat aus Modell Bank2" UBYTE temp_ub_q5_o50 1 100 -50 1225 FORMAT "%5.0" ECU_ADDRESS 0x7FD4C8 /end MEASUREMENT
/begin MEASUREMENT tabgm2_w "Abgastemperatur vor Kat aus Modell (Word) Bank2" UWORD temp_uw_q0p0195_o50 1 100 -50 1229.98 FORMAT "%8.3" ECU_ADDRESS 0x7FD502 /end MEASUREMENT
/begin MEASUREMENT tabgmab "Abgastemperatur beim Abstellen des Motors" UBYTE temp_ub_q5_o50 1 100 -50 1225 FORMAT "%5.0" ECU_ADDRESS 0x7F9B1D /end MEASUREMENT
/begin MEASUREMENT tabgmab2 "Abgastemperatur beim Abstellen des Motors (Modell) Bank2" UBYTE temp_ub_q5_o50 1 100 -50 1225 FORMAT "%5.0" ECU_ADDRESS 0x7F9B1E /end MEASUREMENT
/begin MEASUREMENT tabgmls "Abgastemperatur vor Kat aus Modell (fuer LSH bei Boxer-Motoren)" UBYTE temp_ub_q5_o50 1 100 -50 1225 FORMAT "%5.0" ECU_ADDRESS 0x7FD4C9 /end MEASUREMENT
/begin MEASUREMENT tabgmls2 "Abgastemperatur vor Kat aus Modell Bank2 (fuer LSH bei Boxer-Motoren)" UBYTE temp_ub_q5_o50 1 100 -50 1225 FORMAT "%5.0" ECU_ADDRESS 0x7FD4CA /end MEASUREMENT
/begin MEASUREMENT tabgmls2_w "Abgastemperatur vor Kat aus Modell (Word) Bank2 (fuer LSH bei Boxer-Motoren)" UWORD temp_uw_q0p0195_o50 1 100 -50 1229.98 FORMAT "%8.3" ECU_ADDRESS 0x7FD504 /end MEASUREMENT
/begin MEASUREMENT tabgmlsab "Abgastemperatur beim Abstellen des Motors (fuer LSH bei Boxer-Motoren)" UBYTE temp_ub_q5_o50 1 100 -50 1225 FORMAT "%5.0" ECU_ADDRESS 0x7F9B1F /end MEASUREMENT
/begin MEASUREMENT tabgmlsab2 "Abgastemp. beim Abstellen des Motors (Modell) Bank2 (fuer LSH bei Boxer-Motoren)" UBYTE temp_ub_q5_o50 1 100 -50 1225 FORMAT "%5.0" ECU_ADDRESS 0x7F9B20 /end MEASUREMENT
/begin MEASUREMENT tabgmlsst "Abgastemperatur bei Motorstart(fuer LSH bei Boxer-Motoren)" UBYTE temp_ub_q5_o50 1 100 -50 1225 FORMAT "%5.0" ECU_ADDRESS 0x7FD4CB /end MEASUREMENT
/begin MEASUREMENT tabgmlsst2 "Abgastemperatur bei Motorstart Bank2(fuer LSH bei Boxer-Motoren)" UBYTE temp_ub_q5_o50 1 100 -50 1225 FORMAT "%5.0" ECU_ADDRESS 0x7FD4CC /end MEASUREMENT
/begin MEASUREMENT tabgmls_w "Abgastemperatur vor Kat aus Modell (Word) (fuer LSH bei Boxer-Motoren)" UWORD temp_uw_q0p0195_o50 1 100 -50 1229.98 FORMAT "%8.3" ECU_ADDRESS 0x7FD506 /end MEASUREMENT
/begin MEASUREMENT tabgmst "Abgastemperatur bei Motorstart" UBYTE temp_ub_q5_o50 1 100 -50 1225 FORMAT "%5.0" ECU_ADDRESS 0x7FD4CD /end MEASUREMENT
/begin MEASUREMENT tabgmst2 "Abgastemperatur bei Motorstart Bank2" UBYTE temp_ub_q5_o50 1 100 -50 1225 FORMAT "%5.0" ECU_ADDRESS 0x7FD4CE /end MEASUREMENT
/begin MEASUREMENT tabgm_w "Abgastemperatur vor Kat aus Modell (Word)" UWORD temp_uw_q0p0195_o50 1 100 -50 1229.98 FORMAT "%8.3" ECU_ADDRESS 0x7FD508 /end MEASUREMENT
/begin MEASUREMENT tabstatm_w "Abstellzeit im SG-Nachlauf f¸r ATM" UWORD t1sxs_uw_q1 1 100 0 65535 FORMAT "%8.2" ECU_ADDRESS 0x7FD50A /end MEASUREMENT
/begin MEASUREMENT tabstmx_w "Abstellzeit Maximumabfrage f¸r ATM" UWORD t1sxs_uw_q1 1 100 0 65535 FORMAT "%8.2" ECU_ADDRESS 0x7F9B28 /end MEASUREMENT
/begin MEASUREMENT tanskhst "Ansaugluft - Temperatur bei start" UWORD temp_ub_q0p75_o48 1 100 -48 49103.3 FORMAT "%8.2" ECU_ADDRESS 0x7FD65A /end MEASUREMENT
/begin MEASUREMENT tanym_w "Abgastemperatur im Rohrstuck nachY-Zusammenf¸hrung modelliert" UWORD temp_q0p0234_o273 1 100 -273.15 1262.83 FORMAT "%8.3" ECU_ADDRESS 0x7FD50C /end MEASUREMENT
/begin MEASUREMENT tateist "aktuelles Ist-Tastverh‰ltnis Tankentl¸ftungsventil" UBYTE rel_ub_b99p6 1 100 0 99.6094 FORMAT "%5.2" ECU_ADDRESS 0x7FDACA /end MEASUREMENT
/begin MEASUREMENT tatemxfq "max Tastverh‰ltnis TEV ˆffnet" UBYTE rel_ub_b99p6 1 100 0 99.6094 FORMAT "%5.2" ECU_ADDRESS 0x7FDACB /end MEASUREMENT
/begin MEASUREMENT tateout "ausgegebenes Tastverh‰ltnis f¸r Tankentl¸ftungsventil" UBYTE rel_ub_b99p6 1 100 0 99.6094 FORMAT "%5.2" ECU_ADDRESS 0x7FDACC /end MEASUREMENT
/begin MEASUREMENT tateovzz "" UBYTE rel_ub_b99p6 1 100 0 99.6094 FORMAT "%5.2" ECU_ADDRESS 0x7FDACD /end MEASUREMENT
/begin MEASUREMENT tateroh "Rohwert Tastverh‰ltnis TEV" UBYTE rel_ub_b99p6 1 100 0 99.6094 FORMAT "%5.2" ECU_ADDRESS 0x7FDACE /end MEASUREMENT
/begin MEASUREMENT tatesoll "gew¸nschtes Soll-Tastverh‰ltnis Tankentl¸ftungsventil" UBYTE rel_ub_b99p6 1 100 0 99.6094 FORMAT "%5.2" ECU_ADDRESS 0x7FDACF /end MEASUREMENT
/begin MEASUREMENT tatmaml "Ausgang aus PT1-Glied Abgastemperatur-Einfluﬂ auf tabgm" UBYTE temp_ub_q5_o50 1 100 -50 1225 FORMAT "%5.0" ECU_ADDRESS 0x7FD4CF /end MEASUREMENT
/begin MEASUREMENT tatmaml2 "Ausgang aus PT1-Glied Abgastemperatur-Einfluﬂ auf tabgm, Bank2" UBYTE temp_ub_q5_o50 1 100 -50 1225 FORMAT "%5.0" ECU_ADDRESS 0x7FD4D0 /end MEASUREMENT
/begin MEASUREMENT tatmkf "Abgastemperatur vor Kat aus Kennfeld KFTATM" UBYTE temp_ub_q5_o50 1 100 -50 1225 FORMAT "%5.0" ECU_ADDRESS 0x7FD4D1 /end MEASUREMENT
/begin MEASUREMENT tatmkf2 "Abgastemperatur vor Kat aus Kennfeld KFTATM Bank2" UBYTE temp_ub_q5_o50 1 100 -50 1225 FORMAT "%5.0" ECU_ADDRESS 0x7FD4D2 /end MEASUREMENT
/begin MEASUREMENT tatmlsaml "Ausgang aus PT1-Glied Abgastemp.-Einfluﬂ auf tabgm(fuer LSH bei Boxer-Motoren)" UBYTE temp_ub_q5_o50 1 100 -50 1225 FORMAT "%5.0" ECU_ADDRESS 0x7FD4D3 /end MEASUREMENT
/begin MEASUREMENT tatmlsaml2 "Ausgang aus PT1-Glied Abgastemp.-Einfluﬂ auf tabgm, Bank2(LSH Boxer-Motoren)" UBYTE temp_ub_q5_o50 1 100 -50 1225 FORMAT "%5.0" ECU_ADDRESS 0x7FD4D4 /end MEASUREMENT
/begin MEASUREMENT tatmlskf "Abgastemp. vor Kat aus Kennfeld KFTATM(fuer LSH bei Boxer-Motoren)" UBYTE temp_ub_q5_o50 1 100 -50 1225 FORMAT "%5.0" ECU_ADDRESS 0x7FD4D5 /end MEASUREMENT
/begin MEASUREMENT tatmlskf2 "Abgastemp. vor Kat aus Kennfeld KFTATM Bank2 (fuer LSH bei Boxer-Motoren)" UBYTE temp_ub_q5_o50 1 100 -50 1225 FORMAT "%5.0" ECU_ADDRESS 0x7FD4D6 /end MEASUREMENT
/begin MEASUREMENT tatmlsrml "Ausgang aus PT1-Glied Rohrwandtemp.-Einfluﬂ auf tabgm(LSH Boxer-Motoren)" UBYTE temp_ub_q5_o50 1 100 -50 1225 FORMAT "%5.0" ECU_ADDRESS 0x7FD4D7 /end MEASUREMENT
/begin MEASUREMENT tatmlsrml2 "Ausgang aus PT1-Glied Rohrwandtemp.-Einfluﬂ auf tabgm,Bank2(LSH Boxer-Motoren)" UBYTE temp_ub_q5_o50 1 100 -50 1225 FORMAT "%5.0" ECU_ADDRESS 0x7FD4D8 /end MEASUREMENT
/begin MEASUREMENT tatmlssta "Abgastemp. vor Kat aus Modell station‰r(fuer LSH bei Boxer-Motoren)" UBYTE temp_ub_q5_o50 1 100 -50 1225 FORMAT "%5.0" ECU_ADDRESS 0x7FD4D9 /end MEASUREMENT
/begin MEASUREMENT tatmlssta2 "Abgastemp. vor Kat aus Modell station‰r Bank2(fuer LSH bei Boxer-Motoren)" UBYTE temp_ub_q5_o50 1 100 -50 1225 FORMAT "%5.0" ECU_ADDRESS 0x7FD4DA /end MEASUREMENT
/begin MEASUREMENT tatmrml "Ausgang aus PT1-Glied Rohrwandtemperatur-Einfluﬂ auf tabgm" UBYTE temp_ub_q5_o50 1 100 -50 1225 FORMAT "%5.0" ECU_ADDRESS 0x7FD4DB /end MEASUREMENT
/begin MEASUREMENT tatmrml2 "Ausgang aus PT1-Glied Rohrwandtemperatur-Einfluﬂ auf tabgm, Bank2" UBYTE temp_ub_q5_o50 1 100 -50 1225 FORMAT "%5.0" ECU_ADDRESS 0x7FD4DC /end MEASUREMENT
/begin MEASUREMENT tatmsta "Abgastemperatur vor Kat aus Modell station‰r" UBYTE temp_ub_q5_o50 1 100 -50 1225 FORMAT "%5.0" ECU_ADDRESS 0x7FD4DD /end MEASUREMENT
/begin MEASUREMENT tatmsta2 "Abgastemperatur vor Kat aus Modell station‰r Bank2" UBYTE temp_ub_q5_o50 1 100 -50 1225 FORMAT "%5.0" ECU_ADDRESS 0x7FD4DE /end MEASUREMENT
/begin MEASUREMENT tatu "Ansaugluft- oder Umgebungstemperatur" UBYTE temp_ub_q0p75_o48 1 100 -48 143.25 FORMAT "%5.1" ECU_ADDRESS 0x7FD4DF /end MEASUREMENT
/begin MEASUREMENT tavhkm_w "Abgastemperatur vor Hauptkat aus Modell" UWORD temp_q0p0234_o273 1 100 -273.15 1262.83 FORMAT "%8.3" ECU_ADDRESS 0x7FD50E /end MEASUREMENT
/begin MEASUREMENT tephc "Phasenz‰hler Grundadaption / Tankentl¸ftung" UWORD t100msxs_uw_b6553p6 1 100 0 6553.5 FORMAT "%8.3" ECU_ADDRESS 0x7FD58C /end MEASUREMENT
/begin MEASUREMENT tevper "Periodendauer bei Ansteuerung Tankentl¸ftungsventil" UBYTE t500usxms_ub_q0p5 1 100 0 127.5 FORMAT "%5.1" ECU_ADDRESS 0x7FD785 /end MEASUREMENT
/begin MEASUREMENT texkor "Korrektur der exothermen Temperaturerhˆhung im Kat texom_w" UBYTE fak_ub_b2 1 100 0 1.99219 FORMAT "%5.3" ECU_ADDRESS 0x7FD4E0 /end MEASUREMENT
/begin MEASUREMENT texkor2 "Korrektur der exothermen Temperaturerhˆhung im Kat texom2_w, Bank2" UBYTE fak_ub_b2 1 100 0 1.99219 FORMAT "%5.3" ECU_ADDRESS 0x7FD4E1 /end MEASUREMENT
/begin MEASUREMENT texml "Exotherme Temperaturerhˆhung im Kat f¸r tkatm aus Kennlinie" SBYTE temp_q5 1 100 -640 635 FORMAT "%5.1" ECU_ADDRESS 0x7FD4E2 /end MEASUREMENT
/begin MEASUREMENT texml2 "Exotherme Temperaturerhˆhung im Kat f¸r tkatm aus Kennlinie, Bank2" SBYTE temp_q5 1 100 -640 635 FORMAT "%5.1" ECU_ADDRESS 0x7FD4E3 /end MEASUREMENT
/begin MEASUREMENT texoikm2_w "Exotherme Temperaturerhˆhung im Kat  f¸r tikatm, Bank2" SWORD temp_q0p0195 1 100 -640 639.98 FORMAT "%8.4" ECU_ADDRESS 0x7FD510 /end MEASUREMENT
/begin MEASUREMENT texoikm_w "Exotherme Temperaturerhˆhung im Kat f¸r tikatm" SWORD temp_q0p0195 1 100 -640 639.98 FORMAT "%8.4" ECU_ADDRESS 0x7FD512 /end MEASUREMENT
/begin MEASUREMENT texom2_w "Exotherme Temperaturerhˆhung im Kat  f¸r tkatm2, Bank2" SWORD temp_q0p0195 1 100 -640 639.98 FORMAT "%8.4" ECU_ADDRESS 0x7FD514 /end MEASUREMENT
/begin MEASUREMENT texom_w "Exotherme Temperaturerhˆhung im Kat f¸r tkatm" SWORD temp_q0p0195 1 100 -640 639.98 FORMAT "%8.4" ECU_ADDRESS 0x7FD516 /end MEASUREMENT
/begin MEASUREMENT tiexkor "Korrektur der exothermen Temperaturerhˆhung im Kat texoikm_w" UBYTE fak_ub_b2 1 100 0 1.99219 FORMAT "%5.3" ECU_ADDRESS 0x7FD4E4 /end MEASUREMENT
/begin MEASUREMENT tiexkor2 "Korrektur der exothermen Temperaturerhˆhung im Kat texoikm2_w, Bank2" UBYTE fak_ub_b2 1 100 0 1.99219 FORMAT "%5.3" ECU_ADDRESS 0x7FD4E5 /end MEASUREMENT
/begin MEASUREMENT tiexml "Exotherme Temperaturerhˆhung im Kat f¸r tikatm aus Kennlinie" SBYTE temp_q5 1 100 -640 635 FORMAT "%5.1" ECU_ADDRESS 0x7FD4E6 /end MEASUREMENT
/begin MEASUREMENT tiexml2 "Exotherme Temperaturerhˆhung im Kat f¸r tikatm aus Kennlinie, Bank2" SBYTE temp_q5 1 100 -640 635 FORMAT "%5.1" ECU_ADDRESS 0x7FD4E7 /end MEASUREMENT
/begin MEASUREMENT tikatm "Abgastemperatur im Katalysator aus Modell" UBYTE temp_ub_q5_o50 1 100 -50 1225 FORMAT "%5.0" ECU_ADDRESS 0x7FD4E8 /end MEASUREMENT
/begin MEASUREMENT tikatm2 "Abgastemperatur im Katalysator aus Modell Bank 2" UBYTE temp_ub_q5_o50 1 100 -50 1225 FORMAT "%5.0" ECU_ADDRESS 0x7FD4E9 /end MEASUREMENT
/begin MEASUREMENT tikatm2_w "Abgastemperatur im Katalysator aus Modell Bank 2" UWORD temp_uw_q0p0195_o50 1 100 -50 1229.98 FORMAT "%8.3" ECU_ADDRESS 0x7FD518 /end MEASUREMENT
/begin MEASUREMENT tikatm_w "Abgastemperatur im Katalysator aus Modell" UWORD temp_uw_q0p0195_o50 1 100 -50 1229.98 FORMAT "%8.3" ECU_ADDRESS 0x7FD51A /end MEASUREMENT
/begin MEASUREMENT tirq1ofd_w "" UWORD dez 1 100 0 65535 FORMAT "%8.2" ECU_ADDRESS 0x7F9F62 /end MEASUREMENT
/begin MEASUREMENT tkatm "Katalysatortemperatur aus Modell" UBYTE temp_ub_q5_o50 1 100 -50 1225 FORMAT "%5.0" ECU_ADDRESS 0x7FD4EA /end MEASUREMENT
/begin MEASUREMENT tkatm2 "Katalysatortemperatur aus Modell,  Bank2" UBYTE temp_ub_q5_o50 1 100 -50 1225 FORMAT "%5.0" ECU_ADDRESS 0x7FD4EB /end MEASUREMENT
/begin MEASUREMENT tkatm2_w "Katalysatortemperatur aus Modell (Word) Bank2" UWORD temp_uw_q0p0195_o50 1 100 -50 1229.98 FORMAT "%8.3" ECU_ADDRESS 0x7FD51C /end MEASUREMENT
/begin MEASUREMENT tkatmab "Abgastemperatur hinter Kat beim Abstellen des Motors (Modell)" UBYTE temp_ub_q5_o50 1 100 -50 1225 FORMAT "%5.0" ECU_ADDRESS 0x7F9B21 /end MEASUREMENT
/begin MEASUREMENT tkatmab2 "Abgastemperatur hinter Kat beim Abstellen des Motors (Modell) Bank2" UBYTE temp_ub_q5_o50 1 100 -50 1225 FORMAT "%5.0" ECU_ADDRESS 0x7F9B22 /end MEASUREMENT
/begin MEASUREMENT tkatmst "Katalysatortemperatur Modell Startwert = f(Abstellwert, Abstellzeit)" UBYTE temp_ub_q5_o50 1 100 -50 1225 FORMAT "%5.0" ECU_ADDRESS 0x7FD4EC /end MEASUREMENT
/begin MEASUREMENT tkatmst2 "Katalysatortemperatur Modell Startwert = f(Abstellwert,Abstellzeit) Bank2" UBYTE temp_ub_q5_o50 1 100 -50 1225 FORMAT "%5.0" ECU_ADDRESS 0x7FD4ED /end MEASUREMENT
/begin MEASUREMENT tkatm_w "Katalysatortemperatur aus Modell (Word)" UWORD temp_uw_q0p0195_o50 1 100 -50 1229.98 FORMAT "%8.3" ECU_ADDRESS 0x7FD51E /end MEASUREMENT
/begin MEASUREMENT tkhnab_ctr "" UWORD t100msxs_uw_b6553p5 1 100 0 6553.5 FORMAT "%8.3" ECU_ADDRESS 0x7FDE32 /end MEASUREMENT
/begin MEASUREMENT tnhkatm_w "Abgastemperatur nach Hauptkat aus Modell" UWORD temp_uw_q0p0195_o50 1 100 -50 1229.98 FORMAT "%8.3" ECU_ADDRESS 0x7FD520 /end MEASUREMENT
/begin MEASUREMENT tnse_w "Zeitz‰hler ab Startende (16bit)" UWORD t100msxs_uw_b6553p5 1 100 0 6553.5 FORMAT "%8.3" ECU_ADDRESS 0x7FD570 /end MEASUREMENT
/begin MEASUREMENT tnst_w "Zeit nach Startende" UWORD t10msxs_uw_b655p35 1 100 0 655.35 FORMAT "%8.4" ECU_ADDRESS 0x7FDB8E /end MEASUREMENT
/begin MEASUREMENT tnvkatm2_w "Abgastemperatur nach Vorkat aus Modell, Bank2" UWORD temp_uw_q0p0195_o50 1 100 -50 1229.98 FORMAT "%8.3" ECU_ADDRESS 0x7FD522 /end MEASUREMENT
/begin MEASUREMENT tnvkatm_w "Abgastemperatur nach Vorkat aus Modell" UWORD temp_uw_q0p0195_o50 1 100 -50 1229.98 FORMAT "%8.3" ECU_ADDRESS 0x7FD524 /end MEASUREMENT
/begin MEASUREMENT tsast_l "Zeit ¸ber ein Arbeitsspiel genau" ULONG t_q0p0001_ms 1 100 0 429497 FORMAT "%13.6" ECU_ADDRESS 0x7FE3D4 /end MEASUREMENT
/begin MEASUREMENT tsas_w "Zeit ¸ber ein Arbeitsspiel f¸r ngas_w" UWORD t_q0p04_ms 1 100 0 2621.4 FORMAT "%8.3" ECU_ADDRESS 0x7FE118 /end MEASUREMENT
/begin MEASUREMENT tsegrsp_l "Array mit Segmentzeiten ¸ber das letzte Arbeitsspiel" ULONG t_q0p0001_ms 1 100 0 429497 FORMAT "%13.6" ARRAY_SIZE 4 ECU_ADDRESS 0x7FE3D8 /end MEASUREMENT
/begin MEASUREMENT ttevein "aktuelle Einschaltdauer TEV" UWORD t128ms_uw 1 100 0 127.998 FORMAT "%5.1" ECU_ADDRESS 0x7FE046 /end MEASUREMENT
/begin MEASUREMENT tteveroh "TEV-Soll-Ansteuerzeit" UWORD t128ms_uw 1 100 0 127.998 FORMAT "%5.1" ECU_ADDRESS 0x7FE048 /end MEASUREMENT
/begin MEASUREMENT tvexkor2 "Korrektur der exothermen Temperaturerhˆhung im Vorkat tvexom2_w, Bank2" UBYTE fak_ub_b2 1 100 0 1.99219 FORMAT "%5.3" ECU_ADDRESS 0x7FD4EE /end MEASUREMENT
/begin MEASUREMENT tvexml2 "Exotherme Temperaturerhˆhung im Vorkat f¸r tnvkatm2 aus Kennlinie, Bank2" SBYTE temp_q5 1 100 -640 635 FORMAT "%5.1" ECU_ADDRESS 0x7FD4EF /end MEASUREMENT
/begin MEASUREMENT tvexom2_w "Exotherme Temperaturerhˆhung des Vorkat  f¸r tnvkatm2, Bank2" SWORD temp_q0p0195 1 100 -640 639.98 FORMAT "%8.4" ECU_ADDRESS 0x7FD526 /end MEASUREMENT
/begin MEASUREMENT tvhkatm_w "Abgastemperatur vor Hauptkat aus Modell" UWORD temp_uw_q0p0195_o50 1 100 -50 1229.98 FORMAT "%8.3" ECU_ADDRESS 0x7FD528 /end MEASUREMENT
/begin MEASUREMENT tvtevptu "Verzugszeit von TEV  (druck-, batteriespannung- und temperaturabh‰ngig)" UBYTE txms_ub_q0p1 1 100 0 25.5 FORMAT "%5.2" ECU_ADDRESS 0x7FDAD0 /end MEASUREMENT
/begin MEASUREMENT twatmhk_w "Differenztemperatur Wand vor Hauptkat vor twvhk-Integrator" SWORD tempg_q0p0234 1 100 -768 767.977 FORMAT "%8.4" ECU_ADDRESS 0x7FD52A /end MEASUREMENT
/begin MEASUREMENT twvhkm_w "Wandtemperatur vor Hauptkat aus Modell" UWORD temp_q0p0234_o273 1 100 -273.15 1262.83 FORMAT "%8.3" ECU_ADDRESS 0x7FD52C /end MEASUREMENT
/begin MEASUREMENT tzarni "Zeitz‰hler AR nach Initialisierung" UBYTE t10msxs_ub_b2p55 1 100 0 2.55 FORMAT "%5.3" ECU_ADDRESS 0x7FDA59 /end MEASUREMENT
/begin MEASUREMENT uevges "" UBYTE fak_q0p1 1 100 0 25.5 FORMAT "%5.2" ECU_ADDRESS 0x7FD8F6 /end MEASUREMENT
/begin MEASUREMENT umsrln_w "Umrechnungsfaktor F¸llung in Massenstrom" UWORD m_uw_q0p0005 1 100 0 32.7675 FORMAT "%8.5" ECU_ADDRESS 0x7FDBC0 /end MEASUREMENT
/begin MEASUREMENT vfzggang_w "Berechnete Fahrzeuggeschwindigkeit aus Uebersetzungverh. und nmot" UWORD vfzg_uw_b512 1 100 0 511.992 FORMAT "%8.4" ECU_ADDRESS 0x7FE122 /end MEASUREMENT
/begin MEASUREMENT wdaacpat_l "" ULONG dez 1 100 0 4.29497e+009 FORMAT "%13.2" ECU_ADDRESS 0x7F9C70 /end MEASUREMENT
/begin MEASUREMENT wdaoffdeb_u16 "" UWORD dez 1 100 0 65535 FORMAT "%8.2" ECU_ADDRESS 0x7FE1E4 /end MEASUREMENT
/begin MEASUREMENT wdaondeb_u16 "" UWORD dez 1 100 0 65535 FORMAT "%8.2" ECU_ADDRESS 0x7FE1E6 /end MEASUREMENT
/begin MEASUREMENT wdaovpat_l "" ULONG dez 1 100 0 4.29497e+009 FORMAT "%13.2" ECU_ADDRESS 0x7F9C74 /end MEASUREMENT
/begin MEASUREMENT wdastate_l "" ULONG dez 1 100 0 4.29497e+009 FORMAT "%13.2" ECU_ADDRESS 0x7FE57C /end MEASUREMENT
/begin MEASUREMENT wdkbab_w "wdkba_w begrenzt (Minimalauswahl zwischen wdkba_w und wdkugd_w)" UWORD rel_uw_b100 1 100 0 99.9985 FORMAT "%8.5" ECU_ADDRESS 0x7FDBC2 /end MEASUREMENT
/begin MEASUREMENT wped_w_alt "Altwert Winkel Fahrpedal" UWORD relPED_uw_b100 1 100 0 100 FORMAT "%8.4" ECU_ADDRESS 0x7FDC6C /end MEASUREMENT
/begin MEASUREMENT zaehler "" UBYTE dez 1 100 0 255 FORMAT "%5.1" ECU_ADDRESS 0x7FD8F7 /end MEASUREMENT
/begin MEASUREMENT znostend "Anzahl Z¸ndung=ein ohne Erreichen von Startende" UBYTE dez 1 100 0 255 FORMAT "%5.1" ECU_ADDRESS 0x7F9C7F /end MEASUREMENT
/begin MEASUREMENT zwmatm "Z‰hler f¸r ATM-Wiederholstart und Faktor f¸r W‰rmemengen-Schwellen" UBYTE dez 1 100 0 255 FORMAT "%5.1" ECU_ADDRESS 0x7F9B23 /end MEASUREMENT
/begin MEASUREMENT zwmatm2 "Z‰hler f¸r ATM-Wiederholstart und Faktor f¸r W‰rmemengen-Schwellen Bank2" UBYTE dez 1 100 0 255 FORMAT "%5.1" ECU_ADDRESS 0x7F9B24 /end MEASUREMENT
/begin MEASUREMENT zwmatmf "Z‰hler f¸r ATM-Wiederholstart und Faktor f¸r W‰rmemengen-Schwellwert upstream" UBYTE dez 1 100 0 255 FORMAT "%5.1" ECU_ADDRESS 0x7F9B25 /end MEASUREMENT
/begin MEASUREMENT zwmatmf2 "Z‰hler f¸r ATM-Wiederholst.und Faktor f¸r W‰rmemengen-Schwellw. upstream Bank2" UBYTE dez 1 100 0 255 FORMAT "%5.1" ECU_ADDRESS 0x7F9B26 /end MEASUREMENT
/begin FUNCTION ABIC ""
 /begin DEF_CHARACTERISTIC EWS_ABIC_COM_TIME_SND EWS_ABIC_COM_TIME_SND_RCV EWS_DATA_PERIOD EWS_PAGE0_GSS EWS_PAGE1_ANT_OFF EWS_PAGE1_ANT_ON EWS_PAGE2_FSS1 EWS_PAGE2_FSS2 EWS_PAGE2_FSS3 EWS_PAGE2_FSS4 EWS_PAGE2_GSS EWS_PAGE3_GSS EWS_T_DIN_EXT EWS_T_OFFSET EWS_T_SAMPLE_DELAY EWS_T_SETUP /end DEF_CHARACTERISTIC
 /begin REF_CHARACTERISTIC /end REF_CHARACTERISTIC
 /begin IN_MEASUREMENT EWS_TimeOutFlags /end IN_MEASUREMENT
 /begin OUT_MEASUREMENT EWS_ABICPage0 EWS_ABICPage1 EWS_ABICPage2 EWS_ABICPage3 /end OUT_MEASUREMENT
 /begin LOC_MEASUREMENT /end LOC_MEASUREMENT
 /begin SUB_FUNCTION /end SUB_FUNCTION
/end FUNCTION
/begin FUNCTION AEKP "Ausgabe EKP-Ansteuerung" /begin DEF_CHARACTERISTIC TAPVLTM TNLEKPVL TPVL TZMIN UBSTS ZNOSTMX /end DEF_CHARACTERISTIC /begin REF_CHARACTERISTIC /end REF_CHARACTERISTIC
 /begin IN_MEASUREMENT B_airbag B_ekp B_nachlend B_nmin B_st B_stend B_uhrrsec swOffDlBits tabst_w tmotab tnachl_w ub /end IN_MEASUREMENT
 /begin OUT_MEASUREMENT /end OUT_MEASUREMENT
 /begin LOC_MEASUREMENT AEKPintbits B_ekpd B_ekpn B_ekpubn B_ekpvl B_pvl1 B_pvl2 B_pvlnl B_tpvl dekpub lokBits_Aekp znostend /end LOC_MEASUREMENT
 /begin SUB_FUNCTION /end SUB_FUNCTION
/end FUNCTION
/begin FUNCTION AEVAB "Ausgabe Einspritzung Ev-Ausblendung" /begin DEF_CHARACTERISTIC CWEVAB Fwemx REDANZ RED_FKT_M RED_SET_M Zweab Zweauf /end DEF_CHARACTERISTIC /begin REF_CHARACTERISTIC /end REF_CHARACTERISTIC /begin IN_MEASUREMENT B_faevz devoff evzabm flgtiab redsol /end IN_MEASUREMENT
 /begin OUT_MEASUREMENT abmf B_EZA B_EZZW B_MDEE B_NREDGD B_REDGD B_REDPREL B_TABS B_TKAT eevx evz_aus fevab Fweza redsolr Redst Red_cnt Red_fkt Red_set St_eza St_ezaseg /end OUT_MEASUREMENT
 /begin LOC_MEASUREMENT fevabe /end LOC_MEASUREMENT
 /begin SUB_FUNCTION /end SUB_FUNCTION
/end FUNCTION
/begin FUNCTION AEVABZK "Ausgabe Ev-Abschaltung %MDRED + Komplettabschaltung durch ‹berwachungsfunktionen" /begin DEF_CHARACTERISTIC /end DEF_CHARACTERISTIC /begin REF_CHARACTERISTIC /end REF_CHARACTERISTIC /begin IN_MEASUREMENT B_ausc_act B_A_schutz B_MotorStp B_nlph evz_aus Ews_auth /end IN_MEASUREMENT /begin OUT_MEASUREMENT B_evabsecu evz_austot /end OUT_MEASUREMENT /begin LOC_MEASUREMENT /end LOC_MEASUREMENT /begin SUB_FUNCTION /end SUB_FUNCTION /end FUNCTION
/begin FUNCTION AKUSTIK ""
 /begin DEF_CHARACTERISTIC CW_AKL K_akl_nmot K_btrh_noi k_B_akBetr k_B_akkl15 k_B_akusti K_noisen2m K_noisen3m K_noisen4m K_noiset3m K_noiset3x K_noisevm1 K_noisevm3 K_noisevx1 K_noisevx3 K_noise_dw K_noise_t4 K_noise_t5 WP_G2_TRH WP_G3_TRH WP_G4_TRH WP_TRH_HYS /end DEF_CHARACTERISTIC
 /begin REF_CHARACTERISTIC /end REF_CHARACTERISTIC
 /begin IN_MEASUREMENT B_ll B_stend E_akle gangi Nmot nmot_w r1000msCtr top_w vfzg_w wped_w /end IN_MEASUREMENT
 /begin OUT_MEASUREMENT B_akl B_noise_er B_vl_a dwped_w noise_t2 noise_t3 noise_t4 st_noise wped_w_alt /end OUT_MEASUREMENT
 /begin LOC_MEASUREMENT /end LOC_MEASUREMENT
 /begin SUB_FUNCTION /end SUB_FUNCTION
/end FUNCTION
/begin FUNCTION AMUENE "Abspeicherung von Motor¸berdrehzahlereignissen" /begin DEF_CHARACTERISTIC NUEMAX /end DEF_CHARACTERISTIC /begin REF_CHARACTERISTIC /end REF_CHARACTERISTIC /begin IN_MEASUREMENT B_adpini kmstand nmot_w /end IN_MEASUREMENT /begin OUT_MEASUREMENT anznmax kmstnmax nmaxvk_w /end OUT_MEASUREMENT /begin LOC_MEASUREMENT /end LOC_MEASUREMENT /begin SUB_FUNCTION /end SUB_FUNCTION /end FUNCTION
/begin FUNCTION ANLASSER "" /begin DEF_CHARACTERISTIC LOWBATCOU nmax_Anl nmin_Anl TDSTART1 TDSTART2 /end DEF_CHARACTERISTIC /begin REF_CHARACTERISTIC CW_secufkt /end REF_CHARACTERISTIC /begin IN_MEASUREMENT B_frgAnl B_kl15 B_stend ES_start nmot_w ub /end IN_MEASUREMENT
 /begin OUT_MEASUREMENT A_anlasser B_Anlabr B_anlasser B_anlschu B_A_schutz B_lowbat B_stendAnl /end OUT_MEASUREMENT
 /begin LOC_MEASUREMENT /end LOC_MEASUREMENT
 /begin SUB_FUNCTION /end SUB_FUNCTION
/end FUNCTION
/begin FUNCTION ARMD "Antiruckelfunktion momentenbasiert"
 /begin DEF_CHARACTERISTIC A0 A1 A2 B1 B2 DMDAROG DMDARUG DNARAO DNFILO DNIARNG DVFZAR FLRAG FLRAWG FLRHG FRARAG FRARAWG FRARHG KIFZGAG KIFZGAWG KIFZGHG NARA NARASTG NARLL NTAREIN TAREIN TMAR TMARSTM TZSPINI VARAU ZNGAR /end DEF_CHARACTERISTIC
 /begin REF_CHARACTERISTIC SGA07MDUB /end REF_CHARACTERISTIC
 /begin IN_MEASUREMENT B_asrext B_autget B_kuppl B_kurn B_kurp B_ll B_mdein B_miext B_msrext B_sa B_stend B_wk B_wkr esst_sga07mdub gangi mdverl_w mifa_w misolv_w ngas_w nmot nmot_w tmot tmst vfzg /end IN_MEASUREMENT
 /begin OUT_MEASUREMENT B_ar B_ar_help dmar_w ngfar_w /end OUT_MEASUREMENT
 /begin LOC_MEASUREMENT B_iniar B_tzarni dniar_w fdar flrar kifz_w mdbes_w mkar_w mlast_w ndar_w ndfdif_w ndfil_w ndiff_w nmod_w tzarni /end LOC_MEASUREMENT
 /begin SUB_FUNCTION /end SUB_FUNCTION
/end FUNCTION
/begin FUNCTION ASC_STATUS "" /begin DEF_CHARACTERISTIC TASCBLINK TASCHOLD TASCREL TFASCBLINK /end DEF_CHARACTERISTIC /begin REF_CHARACTERISTIC /end REF_CHARACTERISTIC /begin IN_MEASUREMENT B_ascFreig B_asr E_radv /end IN_MEASUREMENT /begin OUT_MEASUREMENT ascModus ascStatus B_ascLampe ES_asc /end OUT_MEASUREMENT /begin LOC_MEASUREMENT /end LOC_MEASUREMENT /begin SUB_FUNCTION /end SUB_FUNCTION /end FUNCTION
/begin FUNCTION ATD "Ansteuerung TD-Signal (segmentsynchron)" /begin DEF_CHARACTERISTIC /end DEF_CHARACTERISTIC /begin REF_CHARACTERISTIC /end REF_CHARACTERISTIC /begin IN_MEASUREMENT /end IN_MEASUREMENT /begin OUT_MEASUREMENT /end OUT_MEASUREMENT /begin LOC_MEASUREMENT /end LOC_MEASUREMENT /begin SUB_FUNCTION /end SUB_FUNCTION /end FUNCTION
/begin FUNCTION ATEV "Ansteuerung Tankentl¸ftungsventil (Periodendauer)"
 /begin DEF_CHARACTERISTIC KFTEVP KFTVTEV KLTEVTANS TATEGRDO TATEGRDU TEVDTAUF TEVPMN1 TEVPMN2 TMNTEVZU /end DEF_CHARACTERISTIC
 /begin REF_CHARACTERISTIC CWTEVPOS FMTEVEIN KFINDFMS /end REF_CHARACTERISTIC
 /begin IN_MEASUREMENT B_dtes B_evloc B_tevtini dpssol_w dps_uw dps_w msteo_w mstesoll_w nmot pu rl tadtea tans tatemax tefreq ub ub_w /end IN_MEASUREMENT
 /begin OUT_MEASUREMENT B_tevtstp tateist tateout tateovzz tateroh tatesoll tevper ttevein /end OUT_MEASUREMENT
 /begin LOC_MEASUREMENT kftevp tatemxfq tteveroh tvtevptu /end LOC_MEASUREMENT
 /begin SUB_FUNCTION /end SUB_FUNCTION
/end FUNCTION
/begin FUNCTION ATM "Abgastemperaturmodell"
 /begin DEF_CHARACTERISTIC ATMTANS DTUMTAT FATMAHK FATMLSRML FATMLSRML2 FATMLSVM FATMRML FATMRML2 FATMTWHK FATMVHK FATMVM FTMOTKHK FWMABGW FWMABGW2 FWMKATW FWMKATW2 IMTUMTAT KATMCPHK KATMEXML KATMEXML2 KATMIEXML KATMIEXML2 KATMVEXML2 KFATMABKA KFATMABKA2 KFATMABKK KFATMABKK2 KFATMLA KFATMLA2 KFATMLSABKA KFATMLSABKA2 KFATMLSLA KFATMLSLA2 KFATMLSZW KFATMLSZW2 KFATMZW KFATMZW2 KFTATM KFTATM2 KFTATMLS KFTATMLS2 KFWMABG KFWMABG2 KFWMKAT KFWMKAT2 KLATMILAE KLATMILAE2 KLATMIZWE KLATMIZWE2 KLATMLAE KLATMLAE2 KLATMVLAE2 KLATMVZWE2 KLATMZWE KLATMZWE2 KTMOTW NTUMTAT STS06TMUW STU05TMUB TABGMEX TASTBFA TATMKH TATMKH2 TATMKW TATMSA TATMSAE TATMSAE2 TATMSTI TATMTMOT TATMTP TATMTRKH TATMTRKH2 TATMWMK TIKATMOE TIKATMOE2 TKATMOE TKATMOE2 TKATMVOE2 TKSTBFA TNLATM TNLATMTM TNLATMTU TUMTAIT VTUMTAT WMABGKH WMABGKH2 WMKATKH WMKATKH2 ZATMAML ZATMAML2 ZATMIKML ZATMIKML2 ZATMKML ZATMKML2 ZATMLSAML ZATMLSAML2 ZATMLSRML ZATMLSRML2 ZATMRML ZATMRML2 ZATMVKML2 /end DEF_CHARACTERISTIC
 /begin REF_CHARACTERISTIC SEZ06TMUB SLX06TMUW SLY06TMUW SML06TMUW SML07TMUW ST107TMUB ST207TMUB ST307TMUB ST407TMUB STM05TMUB1 STM05TMUB2 /end REF_CHARACTERISTIC
 /begin IN_MEASUREMENT B_adpini B_faatm B_kh B_kw B_nachlend B_nlatm B_nmot B_sa B_st B_stend B_trkh B_uhrrmin B_uhrrsec esst_sez06tmub esst_slx06tmuw esst_sly06tmuw esst_sml06tmuw esst_sml07tmuw esst_st107tmub esst_st207tmub esst_st307tmub esst_st407tmub esst_stm05tmub1 esst_stm05tmub2 etazwist lamsbg2_w lamsbg_w lamsons_w ml ml_w msabg2_w msabg_w nmot rl tabst_w tans tatuk_w tmot tmotk_w tmotzyl1_w tmotzyl2_w tmst tmstzyl1_w tmstzyl2_w vfzg /end IN_MEASUREMENT
 /begin OUT_MEASUREMENT B_atmtpa B_atmtpa2 B_atmtpk B_atmtpk2 B_atmtpl B_atmtpl2 esst_sts06tmuw esst_stu05tmub etazwimt imlatm imlatm_w iwmatm2_w iwmatm_w tabgm tabgm2 tabgm2_w tabgmab tabgmab2 tabgmls tabgmls2 tabgmls2_w tabgmlsab tabgmlsst tabgmlsst2 tabgmls_w tabgmst tabgmst2 tabgm_w tanym_w tatu tavhkm_w tikatm tikatm2 tikatm2_w tikatm_w tkatm tkatm2 tkatm2_w tkatmab tkatmab2 tkatmst tkatmst2 tkatm_w tnhkatm_w tnvkatm2_w tnvkatm_w tvhkatm_w twvhkm_w zwmatm zwmatm2 zwmatmf zwmatmf2 /end OUT_MEASUREMENT
 /begin LOC_MEASUREMENT ATMbits ATMbits1 B_atmst B_atmst2 B_atmtpf B_atmtpf2 B_stndnl dqatmhk_w dtatwhk_w ftkhk_w msabvhk_w quatmhk_w qwatmhk_w tabgmlsab2 tabstatm_w tabstmx_w tatmaml tatmaml2 tatmkf tatmkf2 tatmlsaml tatmlsaml2 tatmlskf tatmlskf2 tatmlsrml tatmlsrml2 tatmlssta tatmlssta2 tatmrml tatmrml2 tatmsta tatmsta2 texkor texkor2 texml texml2 texoikm2_w texoikm_w texom2_w texom_w tiexkor tiexkor2 tiexml tiexml2 tvexkor2 tvexml2 tvexom2_w twatmhk_w /end LOC_MEASUREMENT
 /begin SUB_FUNCTION /end SUB_FUNCTION
/end FUNCTION
/begin FUNCTION BBACC "BBACC.    Ein.- und Ausschaltbedingungen ACC (Adaptiv Cruise Control)" /begin DEF_CHARACTERISTIC /end DEF_CHARACTERISTIC /begin REF_CHARACTERISTIC /end REF_CHARACTERISTIC /begin IN_MEASUREMENT /end IN_MEASUREMENT /begin OUT_MEASUREMENT B_mflai B_mflal B_mflar B_mflas B_mflen fgr_stat /end OUT_MEASUREMENT /begin LOC_MEASUREMENT /end LOC_MEASUREMENT /begin SUB_FUNCTION /end SUB_FUNCTION /end FUNCTION
/begin FUNCTION BBBO "Betriebsbereich Erkennung Benzin im ÷l" /begin DEF_CHARACTERISTIC ABOLRAR ABOMX IMLKS TMSKS /end DEF_CHARACTERISTIC /begin REF_CHARACTERISTIC /end REF_CHARACTERISTIC /begin IN_MEASUREMENT B_adpini B_clradbbo B_stend ml_w tmst /end IN_MEASUREMENT /begin OUT_MEASUREMENT abo B_abor imlbbo imlbbo_w /end OUT_MEASUREMENT /begin LOC_MEASUREMENT /end LOC_MEASUREMENT /begin SUB_FUNCTION /end SUB_FUNCTION /end FUNCTION
/begin FUNCTION BBGANG "Betriebsbereich Gang"
 /begin DEF_CHARACTERISTIC CAN2GANG GANG2V IGESGA NGANGMIN NVQUOT1O NVQUOT1U NVQUOT2O NVQUOT2U NVQUOT3O NVQUOT3U NVQUOT4O NVQUOT4U NVQUOT5O NVQUOT5U NVQUOT6O NVQUOT6U /end DEF_CHARACTERISTIC
 /begin REF_CHARACTERISTIC IGANG MAXGANG /end REF_CHARACTERISTIC
 /begin IN_MEASUREMENT B_neutral B_vnull ES_kupp gang nmot_w vfzg_w /end IN_MEASUREMENT
 /begin OUT_MEASUREMENT B_gwhs gangi gangi_bb gangi_poti gang_bcan nvquot_w uevges vfzggang_w zaehler /end OUT_MEASUREMENT
 /begin LOC_MEASUREMENT /end LOC_MEASUREMENT
 /begin SUB_FUNCTION /end SUB_FUNCTION
/end FUNCTION
/begin FUNCTION BBHWONOF "Betriebsbereich SG HW Startup und abschalten" /begin DEF_CHARACTERISTIC /end DEF_CHARACTERISTIC /begin REF_CHARACTERISTIC /end REF_CHARACTERISTIC /begin IN_MEASUREMENT B_wdapwf nmot /end IN_MEASUREMENT /begin OUT_MEASUREMENT B_adpini B_hwpwf B_pwf /end OUT_MEASUREMENT /begin LOC_MEASUREMENT /end LOC_MEASUREMENT /begin SUB_FUNCTION /end SUB_FUNCTION /end FUNCTION
/begin FUNCTION BBKHZ "Betriebsbereich motorisches Katheizen"
 /begin DEF_CHARACTERISTIC BTRKHTMS CWKHZ DTKATMN DTKH DTMABKH FHOKH FKHABMN FKHLA FKHMD FNSKHLL FTMLAKH IMLATWS IMLKHMX IMLKHTMS KFNFSKHM KFNLLKHM KTNDMRKH MLKHMX MLSUS NLLKT TABSTKH TABSTKHX TKATMN TKATW TKHABB TKHFSAB TKHLL TKHLLAB TKHLLMX TKHMX TKHNAB TMSLOF TNSDMRKH ZKHABB ZKLAMKH /end DEF_CHARACTERISTIC
 /begin REF_CHARACTERISTIC SFR04BBUW STMZYL08BBUW /end REF_CHARACTERISTIC
 /begin IN_MEASUREMENT B_adpini B_bkvleer B_dsla B_fa B_fasla B_fs B_hag B_katfz B_ll B_lmsslof B_msloff B_nmot B_slkhof B_slpoff B_slsfz B_st B_stend B_wst esst_sfr04bbuw esst_stmzyl08bbuw fho_w frhol_w imlatm_w ml tabst_w tabzyl_w tans tkatm tmotzyl_w tmstzyl_w tnst_w /end IN_MEASUREMENT
 /begin OUT_MEASUREMENT B_kh B_kha B_khab B_khn B_khno B_kw B_trkh fhost_w fkhab fkhnab flakh flamkh fmdkh imlpr imlpr_w lws_w nfskh nllkh /end OUT_MEASUREMENT
 /begin LOC_MEASUREMENT BBKHZlokBits B_imlprini B_khares B_khaset B_kherr B_khll B_khlle B_khllmx B_khres B_khset B_khstc B_mlsu fmdkhtns_w imlatmw_w mlsu tanskhst tkhnab_ctr /end LOC_MEASUREMENT
 /begin SUB_FUNCTION /end SUB_FUNCTION
/end FUNCTION
/begin FUNCTION BBKURU "Betriebsbereich Erkennung Kupplung rutscht" /begin DEF_CHARACTERISTIC IKURUN IKURUP TVKURU ZKURU /end DEF_CHARACTERISTIC /begin REF_CHARACTERISTIC SGA07MDUB /end REF_CHARACTERISTIC /begin IN_MEASUREMENT B_kuppl esst_sga07mdub gangi nvquot_w /end IN_MEASUREMENT /begin OUT_MEASUREMENT B_kurn B_kurp dnvquotf_w dnvquot_w /end OUT_MEASUREMENT /begin LOC_MEASUREMENT /end LOC_MEASUREMENT /begin SUB_FUNCTION /end SUB_FUNCTION /end FUNCTION
/begin FUNCTION BBLOWBAT "Betriebsbereich Spannungseinbruch unter 5V" /begin DEF_CHARACTERISTIC /end DEF_CHARACTERISTIC /begin REF_CHARACTERISTIC /end REF_CHARACTERISTIC /begin IN_MEASUREMENT /end IN_MEASUREMENT /begin OUT_MEASUREMENT res5vsta_l res5vsts_l tirq1ofd_w /end OUT_MEASUREMENT /begin LOC_MEASUREMENT /end LOC_MEASUREMENT /begin SUB_FUNCTION /end SUB_FUNCTION /end FUNCTION
/begin FUNCTION BBPEDBR "Plausibilisierung Fahrpedalwert/Bremspedal; Dokumentation" /begin DEF_CHARACTERISTIC TWPEDBR WPEDFMX /end DEF_CHARACTERISTIC /begin REF_CHARACTERISTIC /end REF_CHARACTERISTIC /begin IN_MEASUREMENT B_adpini B_bl B_br B_nmot kmstand wped_w /end IN_MEASUREMENT /begin OUT_MEASUREMENT anzpbr_w kmstpbr_w /end OUT_MEASUREMENT /begin LOC_MEASUREMENT /end LOC_MEASUREMENT /begin SUB_FUNCTION /end SUB_FUNCTION /end FUNCTION
/begin FUNCTION BBRCVRY "System Recovery nach Reset" /begin DEF_CHARACTERISTIC /end DEF_CHARACTERISTIC /begin REF_CHARACTERISTIC /end REF_CHARACTERISTIC /begin IN_MEASUREMENT /end IN_MEASUREMENT /begin OUT_MEASUREMENT B_wdapwf recRes5vSt recWDASt /end OUT_MEASUREMENT /begin LOC_MEASUREMENT /end LOC_MEASUREMENT /begin SUB_FUNCTION /end SUB_FUNCTION /end FUNCTION
/begin FUNCTION BBSAWE "Betriebsbereich Schubabschalten/Wiedereinsetzen"
 /begin DEF_CHARACTERISTIC DNSAH DNSAL DNSLL DNVSA DNWEK DVSA ENASAG KFTVSA KFTVSAM NGDNSA NWDKSA NWEM NWENG TKATSAN TVSATM VSAA /end DEF_CHARACTERISTIC
 /begin REF_CHARACTERISTIC SNM08__UB STM05SAUB /end REF_CHARACTERISTIC
 /begin IN_MEASUREMENT B_cvt B_dash B_dsls B_falls B_kh B_koe B_kuppl B_ll B_llrein B_sacvt B_savfgr B_stend esst_snm08__ub esst_stm05saub gangi ngfil nmot nmot_w tkatm tmot tmst vfzg wdkba_w /end IN_MEASUREMENT
 /begin OUT_MEASUREMENT B_sab nsa nwe nwem_out /end OUT_MEASUREMENT
 /begin LOC_MEASUREMENT BBSAWElokbits B_dnsll B_sabt dnsa /end LOC_MEASUREMENT
 /begin SUB_FUNCTION /end SUB_FUNCTION
/end FUNCTION
/begin FUNCTION BBSTT "Betriebsbereich: Start" /begin DEF_CHARACTERISTIC NNSTA NSTNM /end DEF_CHARACTERISTIC /begin REF_CHARACTERISTIC /end REF_CHARACTERISTIC /begin IN_MEASUREMENT B_nmot nmot tans tmot /end IN_MEASUREMENT /begin OUT_MEASUREMENT B_st B_stend tnse_w tnst_w /end OUT_MEASUREMENT /begin LOC_MEASUREMENT /end LOC_MEASUREMENT /begin SUB_FUNCTION /end SUB_FUNCTION /end FUNCTION
/begin FUNCTION BBSYSCON "Betriebsbereich Systemzustandssteuerung" /begin DEF_CHARACTERISTIC /end DEF_CHARACTERISTIC /begin REF_CHARACTERISTIC /end REF_CHARACTERISTIC /begin IN_MEASUREMENT B_kl15 B_nachl B_nlbyp S_kl15 /end IN_MEASUREMENT
 /begin OUT_MEASUREMENT B_k15_nab B_nachlauf B_nl B_nloff B_nl_rst B_norm B_psoff B_wakeup resetCounter /end OUT_MEASUREMENT
 /begin LOC_MEASUREMENT /end LOC_MEASUREMENT
 /begin SUB_FUNCTION /end SUB_FUNCTION
/end FUNCTION
/begin FUNCTION BBTEGA "Phasensteuerung f¸r Tankentl¸ftung und Gemischadaption"
 /begin DEF_CHARACTERISTIC DFTEDS DMRFATE FMRFAZTE FTEADZU FTEDS MRFABNTE TATELL TMSKLH TMSNOGA TTE TTEAE TTEBSTP TTEGA TTEGAI TTEGAIH TTEGAZO TTEGAZU TTEINI TTEMN TTEPRIO TTEZAO TTEZAU ZMRFABN /end DEF_CHARACTERISTIC
 /begin REF_CHARACTERISTIC CWTEVPOS /end REF_CHARACTERISTIC
 /begin IN_MEASUREMENT B_dldpte B_dmmtev B_dmtltz B_dslste B_dslva B_dtes B_edkvs B_edkvs2 B_frao B_gae B_gaefra B_gaefra2 B_gasp B_grdst B_ll B_lr B_lr2 B_nmot B_te B_teabb B_tehbx B_teza ftead_w mrfa_w nmot tans tmstzyl_w tnse_w /end IN_MEASUREMENT
 /begin OUT_MEASUREMENT B_fraoan B_gap B_nftev B_tep /end OUT_MEASUREMENT
 /begin LOC_MEASUREMENT B_tedtev B_tehbxf B_tepi B_tepzhl B_tepzus B_tesstp B_testop B_tezstp B_tteae B_ttegais dmrfabn_w mrfabn mrfabnf tephc /end LOC_MEASUREMENT
 /begin SUB_FUNCTION /end SUB_FUNCTION
/end FUNCTION
/begin FUNCTION BBVL "Betriebsbereich Vollast" /begin DEF_CHARACTERISTIC MRFAVLN RLFAVLN WDKVLN /end DEF_CHARACTERISTIC /begin REF_CHARACTERISTIC /end REF_CHARACTERISTIC /begin IN_MEASUREMENT B_ll B_mrfavl mrfa_w nmot_w rlvugd rlvw_w sfpu5vg3 wdkba_w /end IN_MEASUREMENT /begin OUT_MEASUREMENT B_vl rlvwvugd_w /end OUT_MEASUREMENT /begin LOC_MEASUREMENT B_vlb B_vlrl /end LOC_MEASUREMENT /begin SUB_FUNCTION /end SUB_FUNCTION /end FUNCTION
/begin FUNCTION BBWDA "Betriebsbereich WDA-Abschaltung" /begin DEF_CHARACTERISTIC /end DEF_CHARACTERISTIC /begin REF_CHARACTERISTIC /end REF_CHARACTERISTIC /begin IN_MEASUREMENT B_ausc_act umerr_c_um /end IN_MEASUREMENT
 /begin OUT_MEASUREMENT wdaacpat_l wdaoffdeb_u16 wdaondeb_u16 wdaovpat_l wdastate_l /end OUT_MEASUREMENT
 /begin LOC_MEASUREMENT /end LOC_MEASUREMENT
 /begin SUB_FUNCTION /end SUB_FUNCTION
/end FUNCTION
/begin FUNCTION BGBN "Berechnete Grˆﬂe Bordnetzversorgung" /begin DEF_CHARACTERISTIC /end DEF_CHARACTERISTIC /begin REF_CHARACTERISTIC /end REF_CHARACTERISTIC /begin IN_MEASUREMENT B_airbag /end IN_MEASUREMENT /begin OUT_MEASUREMENT BGBNausbits0 B_bvhfm B_bvhls /end OUT_MEASUREMENT /begin LOC_MEASUREMENT /end LOC_MEASUREMENT /begin SUB_FUNCTION /end SUB_FUNCTION /end FUNCTION
/begin FUNCTION BGBYP "" /begin DEF_CHARACTERISTIC MSNBYP /end DEF_CHARACTERISTIC /begin REF_CHARACTERISTIC /end REF_CHARACTERISTIC /begin IN_MEASUREMENT bypist_a mlbypcor_w /end IN_MEASUREMENT /begin OUT_MEASUREMENT mbyp_ary mbyp_w_ary /end OUT_MEASUREMENT /begin LOC_MEASUREMENT msnbyp_kge msntebyp /end LOC_MEASUREMENT /begin SUB_FUNCTION /end SUB_FUNCTION /end FUNCTION
/begin FUNCTION BGCVN "" /begin DEF_CHARACTERISTIC /end DEF_CHARACTERISTIC /begin REF_CHARACTERISTIC /end REF_CHARACTERISTIC /begin IN_MEASUREMENT B_m9cvn /end IN_MEASUREMENT
 /begin OUT_MEASUREMENT B_cksbrdy B_cksbrdy2 CALIBID1 CALIBID2 cvn cvn2 kryptoCounter /end OUT_MEASUREMENT
 /begin LOC_MEASUREMENT /end LOC_MEASUREMENT
 /begin SUB_FUNCTION /end SUB_FUNCTION
/end FUNCTION
/begin FUNCTION BGDETX "Kundenspez. Fehlerart-Erweiterungs-Byte (Status Diagnosefunktion)" /begin DEF_CHARACTERISTIC /end DEF_CHARACTERISTIC /begin REF_CHARACTERISTIC UBDLS UBDLSMX /end REF_CHARACTERISTIC
 /begin IN_MEASUREMENT B_cdhsv B_cdhsvsa B_cdkatsp B_cdkvs B_cdlash B_cdlatp B_cdlatv B_cdlsv B_cdsls B_cdtes B_cwdslt B_dkvsf B_dsl2e B_dslerr B_dslo B_dsloab B_dsls B_dtebel B_dtebn B_fakat B_fasla B_fates B_frao B_frau B_lra B_lra2 B_lsastp B_nmot B_nofra B_norkat B_norkaz B_rkat B_rkaz B_slsfz B_stend ub /end IN_MEASUREMENT
 /begin OUT_MEASUREMENT etxfrao etxfrao2 etxfrau etxfrau2 etxhsv etxhsv2 etxhsvsa etxhsvsa2 etxkatsp etxlatp etxlatp2 etxlatv etxlatv2 etxlsv etxlsv2 etxrkat etxrkat2 etxrkaz etxrkaz2 etxsls etxsls2 etxslv etxslv2 etxtes /end OUT_MEASUREMENT
 /begin LOC_MEASUREMENT /end LOC_MEASUREMENT
 /begin SUB_FUNCTION /end SUB_FUNCTION
/end FUNCTION
/begin FUNCTION BGEVAB "Berechnung der tats‰chlichen Reduzierstufe durch EV-Abschaltung" /begin DEF_CHARACTERISTIC /end DEF_CHARACTERISTIC /begin REF_CHARACTERISTIC /end REF_CHARACTERISTIC /begin IN_MEASUREMENT abmf evz_austot redsolr zzbank /end IN_MEASUREMENT
 /begin OUT_MEASUREMENT B_bevab B_bevab2 B_evloc evzabm redbas redist redistb1 redistb2 /end OUT_MEASUREMENT
 /begin LOC_MEASUREMENT /end LOC_MEASUREMENT
 /begin SUB_FUNCTION /end SUB_FUNCTION
/end FUNCTION
/begin FUNCTION BGFDCAN "Berechnete Grˆsse Freigabe CAN-Diagnose" /begin DEF_CHARACTERISTIC TNKL15DC UBDCAN /end DEF_CHARACTERISTIC /begin REF_CHARACTERISTIC /end REF_CHARACTERISTIC /begin IN_MEASUREMENT B_cdiagoff B_kl15 ub /end IN_MEASUREMENT /begin OUT_MEASUREMENT B_fgdcan /end OUT_MEASUREMENT /begin LOC_MEASUREMENT /end LOC_MEASUREMENT /begin SUB_FUNCTION /end SUB_FUNCTION /end FUNCTION
/begin FUNCTION BGFKEZ "Berechnete Grˆﬂe zylinderidividuelle Faktoren zur Kraftstoffkorrektur"
 /begin DEF_CHARACTERISTIC FKEEV0N FKEEV1N FKEEV2N FKEEV3N FKEEV4N FKEEV5N FKEEV6N FKEEV7N /end DEF_CHARACTERISTIC
 /begin REF_CHARACTERISTIC SNM08GKUB /end REF_CHARACTERISTIC
 /begin IN_MEASUREMENT esst_snm08gkub nmot /end IN_MEASUREMENT
 /begin OUT_MEASUREMENT fkez /end OUT_MEASUREMENT
 /begin LOC_MEASUREMENT /end LOC_MEASUREMENT
 /begin SUB_FUNCTION /end SUB_FUNCTION
/end FUNCTION
/begin FUNCTION BGKMST "Berechnete Grˆﬂe: Kilometerstand" /begin DEF_CHARACTERISTIC /end DEF_CHARACTERISTIC /begin REF_CHARACTERISTIC /end REF_CHARACTERISTIC /begin IN_MEASUREMENT B_adpini B_ins2cok B_kmmil fcmEnd FCMTab kmstand vfzg_u /end IN_MEASUREMENT /begin OUT_MEASUREMENT kmstmil_w kmst_w /end OUT_MEASUREMENT /begin LOC_MEASUREMENT /end LOC_MEASUREMENT /begin SUB_FUNCTION /end SUB_FUNCTION /end FUNCTION
/begin FUNCTION BGMDLM "Berechnete Grˆﬂe Motormoment mit Momenteneingriffen" /begin DEF_CHARACTERISTIC /end DEF_CHARACTERISTIC /begin REF_CHARACTERISTIC CWZWVMX REDANZ /end REF_CHARACTERISTIC
 /begin IN_MEASUREMENT B_allzwe B_dash B_fil B_msr dmar_w dmllr_w dmrkt_w miasrs_w mibas_w mibgr_w miext_w mifa_w miist_w mims_w minmx_w miszul_w mivmx_w mizsol_w mizwmn_w redbas synchroCtr /end IN_MEASUREMENT
 /begin OUT_MEASUREMENT B_intzwv B_miext mdindegs_w mdindlm_w miint1_w miint2_w miint3_w miintegs_w miintv_w miint_w /end OUT_MEASUREMENT
 /begin LOC_MEASUREMENT etazabas /end LOC_MEASUREMENT
 /begin SUB_FUNCTION /end SUB_FUNCTION
/end FUNCTION
/begin FUNCTION BGMSABG "Berechnung Abgasmassenstrom - bankabh‰ngig" /begin DEF_CHARACTERISTIC /end DEF_CHARACTERISTIC /begin REF_CHARACTERISTIC /end REF_CHARACTERISTIC /begin IN_MEASUREMENT ml ml_w msl msl2 /end IN_MEASUREMENT /begin OUT_MEASUREMENT mlbb mlbb2 mlbb2_w mlbb_w msabg msabg2 msabg2_w msabg_w /end OUT_MEASUREMENT /begin LOC_MEASUREMENT /end LOC_MEASUREMENT /begin SUB_FUNCTION /end SUB_FUNCTION /end FUNCTION
/begin FUNCTION BGMSZS "Berechnungsgrˆﬂe Massenstrˆme zum Saugrohr"
 /begin DEF_CHARACTERISTIC CW_RAMAIR DFKMSMN DFKMSMX DFKPVMN DFKPVMX FKMSDKMN FKMSDKMX FKPVDKE FKPVDKMN FKPVDKMX KFMSNWDK KFRAMAIREF KIMSA KIMSALL KLAF KUMSRL KVLAD LADFIL MLFKMSDK MSALLMN MSALLMX MSLG NMSNDKO PSPVDKUGN RLNOT TIMSA TIMSALL TMFKMSDKA WDKFMAON WDKFMAUN WDKMSON ZKMSDK /end DEF_CHARACTERISTIC
 /begin REF_CHARACTERISTIC /end REF_CHARACTERISTIC
 /begin IN_MEASUREMENT B_adpini B_ffuerf B_hfm B_ll B_nmot fpvdkds_w ftvdk mbyp_ary mbyp_w_ary ml_w mshfm_w mste nmot nmot_w ps_w pu_w pvdkds_w tmotzyl_w vfzg_w wdkba wdkba_w wdkugd_w /end IN_MEASUREMENT
 /begin OUT_MEASUREMENT B_dslvh B_dssv B_fkmsmn B_fkmsmx B_fkpvmn B_fkpvmx B_hfmv B_timsa B_timsall fkmsdka_w fkmsdks_w fkmsdk_w fpvdk fpvdk_w frhodk_w klaf_kge msdif_w msdkalm_w msdk_w msndko_w msndk_w mss_w mstebyp pspvdb_w pspvdk_w pvdk pvdk_w rldvs_w rlroh_w rlwped_w umsrln_w /end OUT_MEASUREMENT
 /begin LOC_MEASUREMENT drllad_w msdkue_w wdkbab_w /end LOC_MEASUREMENT
 /begin SUB_FUNCTION /end SUB_FUNCTION
/end FUNCTION
/begin FUNCTION BGNG "Berechnete Grˆﬂe Drehzahlgradient" /begin DEF_CHARACTERISTIC ZNGFIL /end DEF_CHARACTERISTIC /begin REF_CHARACTERISTIC /end REF_CHARACTERISTIC /begin IN_MEASUREMENT inisynmon nmot_w tseg_l /end IN_MEASUREMENT
 /begin OUT_MEASUREMENT B_ngasok dnmotas_w dnmot_w irspsyn ngas_w ngfil ngfil_w tsegrsp_l /end OUT_MEASUREMENT
 /begin LOC_MEASUREMENT irspsynold nmotarr_w nmotas_w tsast_l tsas_w /end LOC_MEASUREMENT
 /begin SUB_FUNCTION /end SUB_FUNCTION
/end FUNCTION
/begin COMPU_METHOD AscModus "" TAB_VERB "%6.3" "" COMPU_TAB_REF AscModus /end COMPU_METHOD
/begin COMPU_VTAB AscModus "" TAB_VERB 3 0 "aus" 1 "komfort" 2 "GS" /end COMPU_VTAB
/begin COMPU_METHOD AscStatus "" TAB_VERB "%6.3" "" COMPU_TAB_REF AscStatus /end COMPU_METHOD
/begin COMPU_VTAB AscStatus "" TAB_VERB 8 0 "aus" 1 "komfort" 2 "GS" 3 "keine Freigabe" 4 "reserved" 5 "komfort Eingriff" 6 "GS Eingriff" 7 "Signal Fehler" /end COMPU_VTAB
/begin COMPU_METHOD B_TRUE "" TAB_VERB "%6.3" "" COMPU_TAB_REF B_TRUE /end COMPU_METHOD
/begin COMPU_VTAB B_TRUE "" TAB_VERB 2 0 "false" 1 "TRUE" /end COMPU_VTAB
/begin COMPU_METHOD Def_n4 "" RAT_FUNC "%6.3" "Upm" COEFFS 0 4 0 0 0 1 /end COMPU_METHOD
/begin COMPU_METHOD dez "" RAT_FUNC "%6.2" "" COEFFS 0 1 0 0 0 1 /end COMPU_METHOD
/begin COMPU_METHOD fak_q0p00174_JsK "" RAT_FUNC "%6.4" "J/sK" COEFFS 0 576 0 0 0 1 /end COMPU_METHOD
/begin COMPU_METHOD fak_q0p00347_JsK "" RAT_FUNC "%6.4" "J/sK" COEFFS 0 288 0 0 0 1 /end COMPU_METHOD
/begin COMPU_METHOD fak_q0p00926_JsKK "" RAT_FUNC "%6.4" "J/sK^2" COEFFS 0 108 0 0 0 1 /end COMPU_METHOD
/begin COMPU_METHOD fak_q0p1 "" RAT_FUNC "%6.3" "-" COEFFS 0 1 0 0 0 0.1 /end COMPU_METHOD
/begin COMPU_METHOD fak_q0p2222_JK "" RAT_FUNC "%6.3" "J/K" COEFFS 0 9 0 0 0 2 /end COMPU_METHOD
/begin COMPU_METHOD fak_sw_b0p0625 "" RAT_FUNC "%8.7" "-" COEFFS 0 65536 0 0 0 0.125 /end COMPU_METHOD
/begin COMPU_METHOD fak_sw_b2 "" RAT_FUNC "%7.6" "-" COEFFS 0 65536 0 0 0 4 /end COMPU_METHOD
/begin COMPU_METHOD fak_sw_b64 "" RAT_FUNC "%6.4" "-" COEFFS 0 65536 0 0 0 128 /end COMPU_METHOD
/begin COMPU_METHOD fak_ub_b1 "" RAT_FUNC "%6.4" "-" COEFFS 0 256 0 0 0 1 /end COMPU_METHOD
/begin COMPU_METHOD fak_ub_b16 "" RAT_FUNC "%6.4" "-" COEFFS 0 256 0 0 0 16 /end COMPU_METHOD
/begin COMPU_METHOD fak_ub_b2 "" RAT_FUNC "%6.4" "-" COEFFS 0 256 0 0 0 2 /end COMPU_METHOD
/begin COMPU_METHOD fak_ub_b318p75 "" RAT_FUNC "%6.2" "-" COEFFS 0 256 0 0 0 318.75 /end COMPU_METHOD
/begin COMPU_METHOD fak_ub_b3p125 "" RAT_FUNC "%6.4" "%/1/min" COEFFS 0 2048 0 0 0 25 /end COMPU_METHOD
/begin COMPU_METHOD fak_ub_b4 "" RAT_FUNC "%6.4" "-" COEFFS 0 256 0 0 0 4 /end COMPU_METHOD
/begin COMPU_METHOD fak_uw_b1 "" RAT_FUNC "%7.6" "-" COEFFS 0 65536 0 0 0 1 /end COMPU_METHOD
/begin COMPU_METHOD fak_uw_b16 "" RAT_FUNC "%6.5" "-" COEFFS 0 65536 0 0 0 16 /end COMPU_METHOD
/begin COMPU_METHOD fak_uw_b2 "" RAT_FUNC "%7.6" "-" COEFFS 0 65536 0 0 0 2 /end COMPU_METHOD
/begin COMPU_METHOD fak_uw_b4 "" RAT_FUNC "%7.6" "-" COEFFS 0 65536 0 0 0 4 /end COMPU_METHOD
/begin COMPU_METHOD fak_uw_b4864 "" RAT_FUNC "%6.4" "-" COEFFS 0 65536 0 0 0 4864 /end COMPU_METHOD
/begin COMPU_METHOD fak_uw_q0p001 "" RAT_FUNC "%6.5" "-" COEFFS 0 65536 0 0 0 65.536 /end COMPU_METHOD
/begin COMPU_METHOD GrelPED_sw_b100 "" RAT_FUNC "%6.4" "%PED" COEFFS 0 65535 0 0 0 100 /end COMPU_METHOD
/begin COMPU_METHOD km_uw_q10 "" RAT_FUNC "%6.1" "km" COEFFS 0 1 0 0 0 10 /end COMPU_METHOD
/begin COMPU_METHOD kumsrl_ub_b0p002 "" RAT_FUNC "%8.7" "(kg/h)/((1/min)*%)" COEFFS 0 128000 0 0 0 1 /end COMPU_METHOD
/begin COMPU_METHOD lws_q0p04375 "" RAT_FUNC "%6.4" "Grad" COEFFS 0 1 0 0 0 0.04375 /end COMPU_METHOD
/begin COMPU_METHOD mk10ms_uw_q2p384e5n "" RAT_FUNC "%6.5" "h(kg*s)" COEFFS 0 41943 0 0 0 10 /end COMPU_METHOD
/begin COMPU_METHOD m_sw_q0p1 "" RAT_FUNC "%6.3" "kg/h" COEFFS 0 1 0 0 0 0.1 /end COMPU_METHOD
/begin COMPU_METHOD m_ub_b0p166 "" RAT_FUNC "%6.5" "1/s" COEFFS 0 255 0 0 0 0.166 /end COMPU_METHOD
/begin COMPU_METHOD m_ub_b1020 "" RAT_FUNC "%6.2" "kg/h" COEFFS 0 1 0 0 0 4 /end COMPU_METHOD
/begin COMPU_METHOD m_ub_b23p3 "" RAT_FUNC "%6.3" "kg" COEFFS 0 2812.5 0 0 0 256 /end COMPU_METHOD
/begin COMPU_METHOD m_ub_b5p8 "" RAT_FUNC "%6.4" "kg" COEFFS 0 5625 0 0 0 128 /end COMPU_METHOD
/begin COMPU_METHOD m_ub_q0p0415 "" RAT_FUNC "%6.4" "kg/(h*s)" COEFFS 0 1 0 0 0 0.0415 /end COMPU_METHOD
/begin COMPU_METHOD m_ub_q0p1 "" RAT_FUNC "%6.3" "kg/h" COEFFS 0 256 0 0 0 25.6 /end COMPU_METHOD
/begin COMPU_METHOD m_uw_b23p3 "" RAT_FUNC "%6.5" "kg" COEFFS 0 2812.5 0 0 0 1 /end COMPU_METHOD
/begin COMPU_METHOD m_uw_b25p6 "" RAT_FUNC "%6.5" "kg/h" COEFFS 0 65536 0 0 0 25.6 /end COMPU_METHOD
/begin COMPU_METHOD m_uw_b6553p5 "" RAT_FUNC "%6.3" "kg/h" COEFFS 0 1 0 0 0 0.1 /end COMPU_METHOD
/begin COMPU_METHOD m_uw_q0p0005 "" RAT_FUNC "%6.5" "kg/h" COEFFS 0 1 0 0 0 0.0005 /end COMPU_METHOD
/begin COMPU_METHOD nmot2vfzg_uw "" RAT_FUNC "%6.5" "km/(60*1000)" COEFFS 0 5242.88 0 0 0 1 /end COMPU_METHOD
/begin COMPU_METHOD nmotg_sb_q100 "" RAT_FUNC "%6.0" "1/min/s" COEFFS 0 1 0 0 0 100 /end COMPU_METHOD
/begin COMPU_METHOD nmotg_sw_q0p15625 "" RAT_FUNC "%6.3" "1/min/s" COEFFS 0 1 0 0 0 0.15625 /end COMPU_METHOD
/begin COMPU_METHOD nmotg_sw_q0p39 "" RAT_FUNC "%6.3" "1/min/s" COEFFS 0 1 0 0 0 0.39063 /end COMPU_METHOD
/begin COMPU_METHOD nmot_sw_q0p25 "" RAT_FUNC "%6.3" "1/min" COEFFS 0 1 0 0 0 0.25 /end COMPU_METHOD
/begin COMPU_METHOD nmot_ub_q10 "" RAT_FUNC "%6.1" "1/min" COEFFS 0 1 0 0 0 10 /end COMPU_METHOD
/begin COMPU_METHOD nmot_ub_q40 "" RAT_FUNC "%6.1" "1/min" COEFFS 0 1 0 0 0 40 /end COMPU_METHOD
/begin COMPU_METHOD nmot_uw_q0p15625 "" RAT_FUNC "%6.3" "1/min" COEFFS 0 6.4 0 0 0 1 /end COMPU_METHOD
/begin COMPU_METHOD nmot_uw_q0p25 "" RAT_FUNC "%6.3" "1/min" COEFFS 0 1 0 0 0 0.25 /end COMPU_METHOD
/begin COMPU_METHOD p_q0p039s32768 "" RAT_FUNC "%7.1" "hPa" COEFFS 0 256 327680 0 0 10 /end COMPU_METHOD
/begin COMPU_METHOD p_ub_q10 "" RAT_FUNC "%6.1" "hPa" COEFFS 0 1 0 0 0 10 /end COMPU_METHOD
/begin COMPU_METHOD p_uw_q0p039 "" RAT_FUNC "%6.4" "hPa" COEFFS 0 256 0 0 0 10 /end COMPU_METHOD
/begin COMPU_METHOD qg_q5p333 "" RAT_FUNC "%6.2" "J/s" COEFFS 0 3 0 0 0 16 /end COMPU_METHOD
/begin COMPU_METHOD qnv_sw_q0p0078 "" RAT_FUNC "%6.4" "(1/min) / (km/h)" COEFFS 0 65536 0 0 0 512 /end COMPU_METHOD
/begin COMPU_METHOD qnv_uw_b512 "" RAT_FUNC "%6.4" "(1/min) / (km/h)" COEFFS 0 65536 0 0 0 512 /end COMPU_METHOD
/begin COMPU_METHOD q_q0p4551 "" RAT_FUNC "%6.3" "kJ" COEFFS 0 36000 0 0 0 16384 /end COMPU_METHOD
/begin COMPU_METHOD relDK_q0p02441 "" RAT_FUNC "%6.4" "%DK" COEFFS 0 65536 0 0 0 1600 /end COMPU_METHOD
/begin COMPU_METHOD relDK_ub_b100 "" RAT_FUNC "%6.3" "%DK" COEFFS 0 255 0 0 0 100 /end COMPU_METHOD
/begin COMPU_METHOD relPED_uw_b100 "" RAT_FUNC "%6.4" "%PED" COEFFS 0 65535 0 0 0 100 /end COMPU_METHOD
/begin COMPU_METHOD rel_sw_b100 "" RAT_FUNC "%6.4" "%" COEFFS 0 32768 0 0 0 100 /end COMPU_METHOD
/begin COMPU_METHOD rel_sw_q0p0234 "" RAT_FUNC "%6.4" "%/seg" COEFFS 0 32 0 0 0 0.75 /end COMPU_METHOD
/begin COMPU_METHOD rel_ub_b100 "" RAT_FUNC "%6.3" "%" COEFFS 0 255 0 0 0 100 /end COMPU_METHOD
/begin COMPU_METHOD rel_ub_b127p5 "" RAT_FUNC "%6.3" "%" COEFFS 0 2 0 0 0 1 /end COMPU_METHOD
/begin COMPU_METHOD rel_ub_b2p0 "" RAT_FUNC "%6.4" "%" COEFFS 0 256 0 0 0 2 /end COMPU_METHOD
/begin COMPU_METHOD rel_ub_b99p6 "" RAT_FUNC "%6.3" "%" COEFFS 0 256 0 0 0 100 /end COMPU_METHOD
/begin COMPU_METHOD rel_ub_q0p75 "" RAT_FUNC "%6.3" "%" COEFFS 0 1 0 0 0 0.75 /end COMPU_METHOD
/begin COMPU_METHOD rel_uw_b100 "" RAT_FUNC "%6.4" "%" COEFFS 0 65536 0 0 0 100 /end COMPU_METHOD
/begin COMPU_METHOD rel_uw_b200 "" RAT_FUNC "%6.4" "%" COEFFS 0 65536 0 0 0 200 /end COMPU_METHOD
/begin COMPU_METHOD rel_uw_q0p0234 "" RAT_FUNC "%6.4" "%" COEFFS 0 32 0 0 0 0.75 /end COMPU_METHOD
/begin COMPU_METHOD Sekunden "" RAT_FUNC "%6.2" "s" COEFFS 0 1 0 0 0 1 /end COMPU_METHOD
/begin COMPU_METHOD spg_ubatt "" RAT_FUNC "%6.3" "V" COEFFS 0 1 0 0 0 0.0942 /end COMPU_METHOD
/begin COMPU_METHOD Stunden "" RAT_FUNC "%6.2" "h" COEFFS 0 1 0 0 0 1 /end COMPU_METHOD
/begin COMPU_METHOD st_akust "" TAB_VERB "%6.3" "" COMPU_TAB_REF st_akust /end COMPU_METHOD
/begin COMPU_VTAB st_akust "" TAB_VERB 5 0 "NOT_AKTIV" 1 "B_noise_A" 2 "B_noise_T" 4 "B_noise_D" 8 "B_noise_V" /end COMPU_VTAB
/begin COMPU_METHOD s_q1_km "" RAT_FUNC "%6.2" "km" COEFFS 0 1 0 0 0 1 /end COMPU_METHOD
/begin COMPU_METHOD s_q6_km "" RAT_FUNC "%6.2" "km" COEFFS 0 1 0 0 0 6 /end COMPU_METHOD
/begin COMPU_METHOD t100msxs_ub_b25p5 "" RAT_FUNC "%6.3" "s" COEFFS 0 1 0 0 0 0.1 /end COMPU_METHOD
/begin COMPU_METHOD t100msxs_uw_b6553p5 "" RAT_FUNC "%6.3" "s" COEFFS 0 1 0 0 0 0.1 /end COMPU_METHOD
/begin COMPU_METHOD t100msxs_uw_b6553p6 "" RAT_FUNC "%6.3" "s" COEFFS 0 10 0 0 0 1 /end COMPU_METHOD
/begin COMPU_METHOD t10msxs_sb_q0p01 "" RAT_FUNC "%6.4" "s" COEFFS 0 1 0 0 0 0.01 /end COMPU_METHOD
/begin COMPU_METHOD t10msxs_ub_b2p55 "" RAT_FUNC "%6.4" "s" COEFFS 0 1 0 0 0 0.01 /end COMPU_METHOD
/begin COMPU_METHOD t10msxs_uw_b655p35 "" RAT_FUNC "%6.4" "s" COEFFS 0 1 0 0 0 0.01 /end COMPU_METHOD
/begin COMPU_METHOD t128ms_uw "" RAT_FUNC "%5.4" "s" COEFFS 0 512 0 0 0 1 /end COMPU_METHOD
/begin COMPU_METHOD t1sxs_ub_b255 "" RAT_FUNC "%6.2" "s" COEFFS 0 1 0 0 0 1 /end COMPU_METHOD
/begin COMPU_METHOD t1sxs_uw_b65535 "" RAT_FUNC "%6.2" "s" COEFFS 0 1 0 0 0 1 /end COMPU_METHOD
/begin COMPU_METHOD t1sxs_uw_q1 "" RAT_FUNC "%6.2" "s" COEFFS 0 1 0 0 0 1 /end COMPU_METHOD
/begin COMPU_METHOD t200msxs_ub_b51 "" RAT_FUNC "%6.3" "s" COEFFS 0 1 0 0 0 0.2 /end COMPU_METHOD
/begin COMPU_METHOD t20msxs_ub_b5p1 "" RAT_FUNC "%6.4" "s" COEFFS 0 1 0 0 0 0.02 /end COMPU_METHOD
/begin COMPU_METHOD t20msxs_uw_b1310 "" RAT_FUNC "%7.4" "s" COEFFS 0 1 0 0 0 0.02 /end COMPU_METHOD
/begin COMPU_METHOD t500usxms_ub_q0p5 "" RAT_FUNC "%6.3" "ms" COEFFS 0 1 0 0 0 0.5 /end COMPU_METHOD
/begin COMPU_METHOD tempg_q0p0234 "" RAT_FUNC "%6.4" "Grad C/s" COEFFS 0 256 0 0 0 6 /end COMPU_METHOD
/begin COMPU_METHOD temp_q0p0195 "" RAT_FUNC "%6.4" "Grad C" COEFFS 0 256 0 0 0 5 /end COMPU_METHOD
/begin COMPU_METHOD temp_q0p0234_o273 "" RAT_FUNC "%6.1" "Grad C" COEFFS 0 1 273.15 0 0 0.0234375 /end COMPU_METHOD
/begin COMPU_METHOD temp_q0p0468 "" RAT_FUNC "%6.4" "Grad C" COEFFS 0 256 0 0 0 12 /end COMPU_METHOD
/begin COMPU_METHOD temp_q5 "" RAT_FUNC "%6.2" "Grad C" COEFFS 0 1 0 0 0 5 /end COMPU_METHOD
/begin COMPU_METHOD temp_ub_b191p25 "" RAT_FUNC "%6.3" "Grad C" COEFFS 0 1 0 0 0 0.75 /end COMPU_METHOD
/begin COMPU_METHOD temp_ub_q0p75_o48 "" RAT_FUNC "%6.2" "Grad C" COEFFS 0 1 48 0 0 0.75 /end COMPU_METHOD
/begin COMPU_METHOD temp_ub_q5_o50 "" RAT_FUNC "%6.2" "Grad C" COEFFS 0 1 50 0 0 5 /end COMPU_METHOD
/begin COMPU_METHOD temp_uw_q0p0195_o50 "" RAT_FUNC "%6.2" "Grad C" COEFFS 0 256 12800 0 0 5 /end COMPU_METHOD
/begin COMPU_METHOD txms_ub_q0p1 "" RAT_FUNC "%6.3" "ms" COEFFS 0 10 0 0 0 1 /end COMPU_METHOD
/begin COMPU_METHOD txms_uw_q0p1 "" RAT_FUNC "%6.3" "ms" COEFFS 0 10 0 0 0 1 /end COMPU_METHOD
/begin COMPU_METHOD t_q0p0001_ms "" RAT_FUNC "%7.6" "ms" COEFFS 0 1 0 0 0 0.0001 /end COMPU_METHOD
/begin COMPU_METHOD t_q0p04_ms "" RAT_FUNC "%6.4" "ms" COEFFS 0 1 0 0 0 0.04 /end COMPU_METHOD
/begin COMPU_METHOD t_tev0p0005 "" RAT_FUNC "%6.5" "s" COEFFS 0 2048 0 0 0 1 /end COMPU_METHOD
/begin COMPU_METHOD vfzg_ub_q1p25 "" RAT_FUNC "%6.2" "km/h" COEFFS 0 1 0 0 0 1.25 /end COMPU_METHOD
/begin COMPU_METHOD vfzg_uw_b512 "" RAT_FUNC "%6.4" "km/h" COEFFS 0 65536 0 0 0 512 /end COMPU_METHOD
/begin COMPU_METHOD zk100msxs_ub_b25p5 "" RAT_FUNC "%6.3" "s" COEFFS 0 0 256 0 10 0 /end COMPU_METHOD
/begin COMPU_METHOD zk100msxs_uw_b6553 "" RAT_FUNC "%10.3" "s" COEFFS 0 0 65536 0 10 0 /end COMPU_METHOD
/begin COMPU_METHOD zk10msxs_uw_b655 "" RAT_FUNC "%10.4" "s" COEFFS 0 0 65536 0 100 0 /end COMPU_METHOD
/begin COMPU_METHOD zk200msxs_uw_b13107 "" RAT_FUNC "%6.0" "s" COEFFS 0 0 13107 0 1 0 /end COMPU_METHOD
/begin COMPU_METHOD zk20msxs_uw_b1310 "" RAT_FUNC "%6.1" "s" COEFFS 0 0 1310 0 1 0 /end COMPU_METHOD
/begin COMPU_METHOD default "" RAT_FUNC "%6.2" "" COEFFS 0 1 0 0 0 1 /end COMPU_METHOD
/begin RECORD_LAYOUT FklWUb FNC_VALUES 1 UBYTE COLUMN_DIR DIRECT /end RECORD_LAYOUT
/begin RECORD_LAYOUT FklWUw FNC_VALUES 1 UWORD COLUMN_DIR DIRECT /end RECORD_LAYOUT
/begin RECORD_LAYOUT GkfWSb FNC_VALUES 1 SBYTE COLUMN_DIR DIRECT /end RECORD_LAYOUT
/begin RECORD_LAYOUT GkfWU8 FNC_VALUES 1 UBYTE COLUMN_DIR DIRECT /end RECORD_LAYOUT
/begin RECORD_LAYOUT GkfWUb FNC_VALUES 1 UBYTE COLUMN_DIR DIRECT /end RECORD_LAYOUT
/begin RECORD_LAYOUT GkfWUw FNC_VALUES 1 UWORD COLUMN_DIR DIRECT /end RECORD_LAYOUT
/begin RECORD_LAYOUT GklWSb FNC_VALUES 1 SBYTE COLUMN_DIR DIRECT /end RECORD_LAYOUT
/begin RECORD_LAYOUT GklWSw FNC_VALUES 1 SWORD COLUMN_DIR DIRECT /end RECORD_LAYOUT
/begin RECORD_LAYOUT GklWU8 FNC_VALUES 1 UBYTE COLUMN_DIR DIRECT /end RECORD_LAYOUT
/begin RECORD_LAYOUT GklWUb FNC_VALUES 1 UBYTE COLUMN_DIR DIRECT /end RECORD_LAYOUT
/begin RECORD_LAYOUT GklWUw FNC_VALUES 1 UWORD COLUMN_DIR DIRECT /end RECORD_LAYOUT
/begin RECORD_LAYOUT KfAxUbAyUbSstxUbSstyUbWUb NO_AXIS_PTS_X 1 UBYTE NO_AXIS_PTS_Y 2 UBYTE AXIS_PTS_X 3 UBYTE INDEX_INCR DIRECT AXIS_PTS_Y 4 UBYTE INDEX_INCR DIRECT FNC_VALUES 5 UBYTE COLUMN_DIR DIRECT /end RECORD_LAYOUT
/begin RECORD_LAYOUT KfAxUwAyUwSstxUwSstyUwWUw NO_AXIS_PTS_X 1 UWORD NO_AXIS_PTS_Y 2 UWORD AXIS_PTS_X 3 UWORD INDEX_INCR DIRECT AXIS_PTS_Y 4 UWORD INDEX_INCR DIRECT FNC_VALUES 5 UWORD COLUMN_DIR DIRECT /end RECORD_LAYOUT
/begin RECORD_LAYOUT KlASwSstSwWSw NO_AXIS_PTS_X 1 SWORD AXIS_PTS_X 2 SWORD INDEX_INCR DIRECT FNC_VALUES 3 SWORD COLUMN_DIR DIRECT /end RECORD_LAYOUT
/begin RECORD_LAYOUT KlAUbSstSbWUb NO_AXIS_PTS_X 1 UBYTE AXIS_PTS_X 2 SBYTE INDEX_INCR DIRECT FNC_VALUES 3 UBYTE COLUMN_DIR DIRECT /end RECORD_LAYOUT
/begin RECORD_LAYOUT KlAUbSstUbWSb NO_AXIS_PTS_X 1 UBYTE AXIS_PTS_X 2 UBYTE INDEX_INCR DIRECT FNC_VALUES 3 SBYTE COLUMN_DIR DIRECT /end RECORD_LAYOUT
/begin RECORD_LAYOUT KlAUbSstUbWUb NO_AXIS_PTS_X 1 UBYTE AXIS_PTS_X 2 UBYTE INDEX_INCR DIRECT FNC_VALUES 3 UBYTE COLUMN_DIR DIRECT /end RECORD_LAYOUT
/begin RECORD_LAYOUT KlAUbSstUbWUw NO_AXIS_PTS_X 1 UBYTE AXIS_PTS_X 2 UBYTE INDEX_INCR DIRECT FNC_VALUES 3 UWORD COLUMN_DIR DIRECT /end RECORD_LAYOUT
/begin RECORD_LAYOUT KlAUbSstUwWUw NO_AXIS_PTS_X 1 UWORD AXIS_PTS_X 2 UWORD INDEX_INCR DIRECT FNC_VALUES 3 UWORD COLUMN_DIR DIRECT /end RECORD_LAYOUT
/begin RECORD_LAYOUT KlAUwSstSwWUw NO_AXIS_PTS_X 1 UWORD AXIS_PTS_X 2 SWORD INDEX_INCR DIRECT FNC_VALUES 3 UWORD COLUMN_DIR DIRECT /end RECORD_LAYOUT
/begin RECORD_LAYOUT KlAUwSstUwWUw NO_AXIS_PTS_X 1 UWORD AXIS_PTS_X 2 UWORD INDEX_INCR DIRECT FNC_VALUES 3 UWORD COLUMN_DIR DIRECT /end RECORD_LAYOUT
/begin RECORD_LAYOUT KlAxU8SstxU8WU8 NO_AXIS_PTS_X 1 UBYTE AXIS_PTS_X 2 UBYTE INDEX_INCR DIRECT FNC_VALUES 3 UBYTE COLUMN_DIR DIRECT /end RECORD_LAYOUT
/begin RECORD_LAYOUT KwbUw FNC_VALUES 1 UWORD COLUMN_DIR DIRECT /end RECORD_LAYOUT
/begin RECORD_LAYOUT KwSb FNC_VALUES 1 SBYTE COLUMN_DIR DIRECT /end RECORD_LAYOUT
/begin RECORD_LAYOUT KwSw FNC_VALUES 1 SWORD COLUMN_DIR DIRECT /end RECORD_LAYOUT
/begin RECORD_LAYOUT KwUb FNC_VALUES 1 UBYTE COLUMN_DIR DIRECT /end RECORD_LAYOUT
/begin RECORD_LAYOUT KwUw FNC_VALUES 1 UWORD COLUMN_DIR DIRECT /end RECORD_LAYOUT
/begin RECORD_LAYOUT KwWU16 FNC_VALUES 1 UWORD COLUMN_DIR DIRECT /end RECORD_LAYOUT
/begin RECORD_LAYOUT KwWU8 FNC_VALUES 1 UBYTE COLUMN_DIR DIRECT /end RECORD_LAYOUT
/begin RECORD_LAYOUT SstAU8SstU16 NO_AXIS_PTS_X 1 UWORD AXIS_PTS_X 2 UWORD INDEX_INCR DIRECT /end RECORD_LAYOUT
/begin RECORD_LAYOUT SstAU8SstU8 NO_AXIS_PTS_X 1 UBYTE AXIS_PTS_X 2 UBYTE INDEX_INCR DIRECT /end RECORD_LAYOUT
/begin RECORD_LAYOUT SstAUbSstUb NO_AXIS_PTS_X 1 UBYTE AXIS_PTS_X 2 UBYTE INDEX_INCR DIRECT /end RECORD_LAYOUT
/begin RECORD_LAYOUT SstAUwSstUw NO_AXIS_PTS_X 1 UWORD AXIS_PTS_X 2 UWORD INDEX_INCR DIRECT /end RECORD_LAYOUT
/end MODULE
/end PROJECT
