ASAP2_VERSION 1 3
/begin PROJECT basisme9 ""
/begin HEADER "" VERSION "basisme9" PROJECT_NO basisme9 /end HEADER
/begin MODULE DIM ""
/begin MOD_COMMON "" BYTE_ORDER MSB_FIRST ALIGNMENT_BYTE 1 ALIGNMENT_WORD 2 ALIGNMENT_LONG 2 ALIGNMENT_FLOAT32_IEEE 4 /end MOD_COMMON
/begin CHARACTERISTIC Abschaltpfadtest_in_init "" VALUE 0x4E9C9E KwUb 255.0 dez 0.00 255.0 FORMAT "%5.1" /end CHARACTERISTIC
/begin CHARACTERISTIC ANWFOZA "Anzahl NW-Umdr. f¸r Z¸ndausblendung bei fuel-off Adaption" VALUE 0x4E8A9C KwUb 255.0 dez 0.00 255.0 FORMAT "%5.1" /end CHARACTERISTIC
/begin CHARACTERISTIC AUSCH_T_UM "Maximale Anzahl von Antworten an das UM zur Heilung des FZ im Abschaltpfadtest" VALUE 0x4E9C9F KwUb 255.0 dez 0.00 255.0 FORMAT "%5.1" /end CHARACTERISTIC
/begin CHARACTERISTIC AUSC_T_UM "zul‰ssige Anzahl von Pr¸fungen auf nicht angezogenes Hauptrelais in %UMAUSC" VALUE 0x4E9CA0 KwUb 255.0 dez 0.00 255.0 FORMAT "%5.1" /end CHARACTERISTIC
/begin CHARACTERISTIC AUSGH_T_UM "Heilungszeit f¸r Fehler in der zyklischen RAM-Pr¸fung der Funktions¸berwachung" VALUE 0x4E9CAC KwUb 10200.0 t40ms_ub_b10200 0.00 10200.0 FORMAT "%7.1" /end CHARACTERISTIC
/begin CHARACTERISTIC AUSG_T_UM "Fehlertoleranzschwelle f¸r zyklische RAM-Pr¸fung in der Funktions¸berwachung" VALUE 0x4E9CAD KwUb 255.0 dezsub1 1.000 256.0 FORMAT "%5.1" /end CHARACTERISTIC
/begin CHARACTERISTIC AUSZH_T_UM "Heilungszeit f¸r Fehler in der zyklischen ROM-Pr¸fung der Funktions¸berwachung" VALUE 0x4E9CAE KwUb 10200.0 t40ms_ub_b10200 0.00 10200.0 FORMAT "%7.1" /end CHARACTERISTIC
/begin CHARACTERISTIC AUSZ_T_UM "Fehlertoleranzschwelle f¸r zyklische ROM-Pr¸fung in der Funktions¸berwachung" VALUE 0x4E9CAF KwUb 255.0 dezsub1 1.000 256.0 FORMAT "%5.1" /end CHARACTERISTIC
/begin CHARACTERISTIC BZ_MSR_M "MSR-Botschaftsz‰hler-Maske (0Fh f¸r 4-Bit-Botschaftsz‰hler)" VALUE 0x4E9C90 KwUb 255.0 dez 0.00 255.0 FORMAT "%5.1" /end CHARACTERISTIC
/begin CHARACTERISTIC CWDVMX "Codewort SW-Schalter f¸r Integratorinit. bei VMAX-Regelung" VALUE 0x4E8588 KwUb 255.0 dez 0.00 255.0 FORMAT "%5.1" /end CHARACTERISTIC
/begin CHARACTERISTIC CWNOMSRU "Codewort MSR-‹berwachung nicht aktiv" VALUE 0x4E9C91 KwUb 255.0 dez 0.00 255.0 FORMAT "%5.1" /end CHARACTERISTIC
/begin CHARACTERISTIC CWTEACFG "ausserordentliche Konfiguration der Tankentl¸ftung" VALUE 0x4EE784 KwUb 255.0 dez 0.00 255.0 FORMAT "%5.1" /end CHARACTERISTIC
/begin CHARACTERISTIC CW_NOROMCHKRESET "" VALUE 0x4E29B0 KwUb 255.0 dez 0.00 255.0 FORMAT "%5.1" /end CHARACTERISTIC
/begin CHARACTERISTIC CW_NWFLANKE "" VALUE 0x4EA0BA KwUw 65535.00 dez 0.00 65535.00 FORMAT "%8.2" /end CHARACTERISTIC
/begin CHARACTERISTIC CW_VSI "" VALUE 0x4EF382 KwUb 255.0 dez 0.00 255.0 FORMAT "%5.1" /end CHARACTERISTIC
/begin CHARACTERISTIC DFTEAHB "Schwelle Gemischanteil Tankentl¸ftung zum Setzen Bit ""Hohe Beladung""" VALUE 0x4EE4C4 KwSb 1.992 fak_sb_b1 -1.000 0.9922 FORMAT "%5.3" /end CHARACTERISTIC
/begin CHARACTERISTIC DSTEMIN "Minimalwert f¸r Weitertransport in Totzeitglied Gemischtransport" VALUE 0x4E8908 KwUw 0.9999695 fak_uw_b2 0.00 0.9999695 FORMAT "%9.7" /end CHARACTERISTIC
/begin CHARACTERISTIC DUETMOT "Delta Motor¸bertemperatur-Schwelle" VALUE 0x4E2D32 KwUb 191.3 temp_ub_b191p25 0.00 191.3 FORMAT "%5.1" /end CHARACTERISTIC
/begin CHARACTERISTIC DZWAML "Auf/Abregelgeschwindigkeit zwischen den Begrenzungskennfeldern" CURVE 0x4EEE1A KlAUbSstUbWSb 191.3 zw_sb_q0p75 -96.00 95.25 FORMAT "%5.2"
 /begin AXIS_DESCR STD_AXIS ml m_ub_b1020 12 0.00 1020. FORMAT "%5.0" DEPOSIT ABSOLUTE /end AXIS_DESCR
/end CHARACTERISTIC
/begin CHARACTERISTIC DZWSPM "Delta sp‰tester Z¸ndwinkel abh‰ngig von Motortemperatur" CURVE 0x4EEE14 GklWSb 191.3 zw_sb_q0p75 -96.00 95.25 FORMAT "%5.2"
 /begin AXIS_DESCR COM_AXIS tmotzyl_w temp_ub_q0p75_o48 6 -48.00000 49103.25 AXIS_PTS_REF STMZYL06__UW /end AXIS_DESCR
/end CHARACTERISTIC
/begin CHARACTERISTIC DZWSTTA "Delta Z¸ndwinkel im Start" CURVE 0x4EEE33 KlAUbSstUbWSb 191.3 zw_sb_q0p75 -96.00 95.25 FORMAT "%5.2"
 /begin AXIS_DESCR STD_AXIS tans temp_ub_q0p75_o48 6 -48.00 143.3 FORMAT "%5.1" DEPOSIT ABSOLUTE /end AXIS_DESCR
/end CHARACTERISTIC
/begin CHARACTERISTIC DZWTANSPU "ZW-Korrektur f¸r pu/tans-ƒnderung" MAP 0x4E8D24 KfAxU8AyU8SstxU8SstyU8WS8 191.3 zw_sb_q0p75 -96.00 95.25 FORMAT "%5.2"
 /begin AXIS_DESCR STD_AXIS tans temp_ub_q0p75_o48 12 -48.00 143.3 FORMAT "%5.1" DEPOSIT ABSOLUTE /end AXIS_DESCR
 /begin AXIS_DESCR STD_AXIS pu p_ub_q5 8 0.00 1275. FORMAT "%5.0" DEPOSIT ABSOLUTE /end AXIS_DESCR
/end CHARACTERISTIC
/begin CHARACTERISTIC EWS_BIT_CHK_VAL_1 "" VALUE 0x4E5474 KwUw 65535.00 dez 0.00 65535.00 FORMAT "%8.2" /end CHARACTERISTIC
/begin CHARACTERISTIC EWS_BIT_CHK_VAL_2 "" VALUE 0x4E5476 KwUw 65535.00 dez 0.00 65535.00 FORMAT "%8.2" /end CHARACTERISTIC
/begin CHARACTERISTIC EWS_START_DELAY "" VALUE 0x4E5478 KwUw 65535.00 dez 0.00 65535.00 FORMAT "%8.2" /end CHARACTERISTIC
/begin CHARACTERISTIC EWS_T_HIGH_0 "" VALUE 0x4E547A KwUw 65535.00 dez 0.00 65535.00 FORMAT "%8.2" /end CHARACTERISTIC
/begin CHARACTERISTIC EWS_T_HIGH_1 "" VALUE 0x4E547C KwUw 65535.00 dez 0.00 65535.00 FORMAT "%8.2" /end CHARACTERISTIC
/begin CHARACTERISTIC EWS_T_HIGH_STOP "" VALUE 0x4E547E KwUw 65535.00 dez 0.00 65535.00 FORMAT "%8.2" /end CHARACTERISTIC
/begin CHARACTERISTIC EWS_T_LOW "" VALUE 0x4E5480 KwUw 65535.00 dez 0.00 65535.00 FORMAT "%8.2" /end CHARACTERISTIC
/begin CHARACTERISTIC FAKNZ_NSEG "" CURVE 0x4EE7C0 KlAUbSstUbWUb 1.000 fak_ub_b2 0.00 1.000 FORMAT "%5.3"
 /begin AXIS_DESCR STD_AXIS nmot nmot_ub_q40 6 0.00 10200. FORMAT "%5.0" DEPOSIT ABSOLUTE /end AXIS_DESCR
/end CHARACTERISTIC
/begin CHARACTERISTIC FBTEB "Faktor Begrenzung Lerngeschwindigkeit f¸r Beladung" CURVE 0x4EE4C8 KlAUbSstUbWUb 0.9961 fak_ub_b1 0.00 0.9961
 /begin AXIS_DESCR STD_AXIS ftefvab fak_ub_b0p03125 6 0.00 0.03113 FORMAT "%7.5" DEPOSIT ABSOLUTE /end AXIS_DESCR
/end CHARACTERISTIC
/begin CHARACTERISTIC FBTEVA "Faktor ftefva-abh‰ngige Lerngeschwindigkeit der Beladung" CURVE 0x4EE4D8 KlAUbSstUbWUb 0.9961 fak_ub_b1 0.00 0.9961 /begin AXIS_DESCR STD_AXIS ftefva fak_ub_b0p5 6 0.00 0.4980 DEPOSIT ABSOLUTE /end AXIS_DESCR /end CHARACTERISTIC
/begin CHARACTERISTIC FETATEBN "Kennlinie f¸r drehzahlabh‰ngigen Sollwert des Motorwirkungsgrades" CURVE 0x4EE4E8 KlAUbSstUbWUb 0.9961 fak_ub_b1 0.00 0.9961
 /begin AXIS_DESCR STD_AXIS nmot nmot_ub_q40 5 0.00 10200. FORMAT "%5.0" DEPOSIT ABSOLUTE /end AXIS_DESCR
/end CHARACTERISTIC
/begin CHARACTERISTIC FKATEB "Kennlinie Kraftstoffanteil Tankentl¸ftung abh. von te / TEMIN" CURVE 0x4EE4F4 KlAUbSstUbWUb 0.9961 fak_ub_b1 0.00 0.9961
 /begin AXIS_DESCR STD_AXIS qtetemin fak_ub_b4 5 0.00 3.984 FORMAT "%5.3" DEPOSIT ABSOLUTE /end AXIS_DESCR
/end CHARACTERISTIC
/begin CHARACTERISTIC FQTEDL "Kennlinie Faktor f¸r exponentielle Absteuerung Sp¸lrate" CURVE 0x4EE500 KlAUbSstUbWUb 1.992 fak_ub_b2 0.00 1.992 FORMAT "%5.3"
 /begin AXIS_DESCR STD_AXIS dmlftef fak_ub_b0p5 5 0.00 0.4980 DEPOSIT ABSOLUTE /end AXIS_DESCR
/end CHARACTERISTIC
/begin CHARACTERISTIC FQTEPT "Kennlinie Tankunterdruckbegrenzung (pte)" CURVE 0x4EE64B KlAUbSstUbWSb 0.006056 perio_ub_b0p012207 0.00 0.006056 FORMAT "%8.6"
 /begin AXIS_DESCR STD_AXIS pte p_sb_q32 6 0.00 63.75 FORMAT "%5.2" DEPOSIT ABSOLUTE /end AXIS_DESCR
/end CHARACTERISTIC
/begin CHARACTERISTIC FQTEVA "Progression bei Sp¸lratenaufsteuerung" CURVE 0x4EE50C KlAUbSstUbWUb 15.94 fak_ub_b16 0.00 15.94 FORMAT "%5.2" /begin AXIS_DESCR STD_AXIS ftefva fak_ub_b0p5 6 0.00 0.4980 DEPOSIT ABSOLUTE /end AXIS_DESCR /end CHARACTERISTIC
/begin CHARACTERISTIC FRERR_T_UM "" VALUE 0x4E9C9C KwUb 10200.0 t40ms_ub_b10200 0.00 10200.0 FORMAT "%7.1" /end CHARACTERISTIC
/begin CHARACTERISTIC FRHB "fr-Schwelle f¸r mˆgliches R¸cksetzten Flip-Flop ""Hohe Beladung""" VALUE 0x4EE519 KwUb 1.992 fak_ub_b2 0.00 1.992 FORMAT "%5.3" /end CHARACTERISTIC
/begin CHARACTERISTIC FTEADAB "Schwelle Beladung f¸r Abbruch TE-Phase" VALUE 0x4EE51A KwSb 127.5 fak_sb_b64 -64.00 63.50 FORMAT "%5.2" /end CHARACTERISTIC
/begin CHARACTERISTIC FTEADMX "Maximalwert der Beladung des AKF's" VALUE 0x4EE51B KwSb 127.5 fak_sb_b64 -64.00 63.50 FORMAT "%5.2" /end CHARACTERISTIC
/begin CHARACTERISTIC FTEFHB "Schwelle f¸r Sp¸lrate Tankentl¸ftung f¸r Erkennung hohe Beladung" VALUE 0x4EE51C KwUb 0.4980 fak_ub_b0p5 0.00 0.4980 /end CHARACTERISTIC
/begin CHARACTERISTIC FTEHB "Schwelle f¸r Faktor Tankentl¸ftung f¸r Erkennung hohe Beladung" VALUE 0x4EE51D KwSb 127.5 fak_sb_b64 -64.00 63.50 FORMAT "%5.2" /end CHARACTERISTIC
/begin CHARACTERISTIC FTEINIX "Kennlinie Max. Sp¸lrate abh‰ngig vom Integral Massenstrom TE nach TE Stop" CURVE 0x4EE520 KlAUbSstUbWUb 0.1992 fak_ub_b0p5 0.00 0.1992
 /begin AXIS_DESCR STD_AXIS imsteini m_ub_q0p0444 5 0.00 11.32 FORMAT "%5.2" DEPOSIT ABSOLUTE /end AXIS_DESCR
/end CHARACTERISTIC
/begin CHARACTERISTIC FUMRBRK "Faktor Umrechnung HC-Konzentration in Beladung ftead" VALUE 0x4EE52B KwUb 31.88 fak_ub_b32 0.00 31.88 FORMAT "%5.2" /end CHARACTERISTIC
/begin CHARACTERISTIC FVERMN "Kennlinie Faktor Vermischung Regeneriergas Tankentl¸ftung mit Frischluft" CURVE 0x4E88F0 KlAUbSstUbWUb 0.9961 fak_ub_b1 0.00 0.9961
 /begin AXIS_DESCR STD_AXIS nmot nmot_ub_q40 6 0.00 10200. FORMAT "%5.0" DEPOSIT ABSOLUTE /end AXIS_DESCR
/end CHARACTERISTIC
/begin CHARACTERISTIC FVERZDYN "Dynamischer Faktor Verzˆgerung Regeneriergas zw. Drosselklappe, Einspritzventil" CURVE 0x4E890A GklWUw 0.003905886 t_min_q5p96em8 0.00 0.003905886 FORMAT "%11.9"
 /begin AXIS_DESCR COM_AXIS qmsdyn fak_ub_b16 5 0.00 15.94 AXIS_PTS_REF SQM05TEUB /end AXIS_DESCR
/end CHARACTERISTIC
/begin CHARACTERISTIC FVRMDYN "dynamischer Faktor Vermischung Regeneriergas Tankentl¸ftung mit Frischluft" CURVE 0x4E8900 GklWUb 7.969 fak_ub_b8 0.00 7.969 FORMAT "%5.3"
 /begin AXIS_DESCR COM_AXIS qmsdyn fak_ub_b16 5 0.00 15.94 AXIS_PTS_REF SQM05TEUB /end AXIS_DESCR
/end CHARACTERISTIC
/begin CHARACTERISTIC FZWKHMX "Normierung f¸r Faktor Momentenreserve Katheizen" VALUE 0x4E9214 KwUb 0.9961 fak_ub_b1 0.00 0.9961 /end CHARACTERISTIC
/begin CHARACTERISTIC ini_wda_resptime "" VALUE 0x4E9CA2 KwUw 65535.00 dez 0.00 65535.00 FORMAT "%8.2" /end CHARACTERISTIC
/begin CHARACTERISTIC KFDZWEKR "ZW-Korrektur bei Bedingung Sicherheitsz¸ndwinkel" MAP 0x4E8D9A KfAxU8AyU8SstxU8SstyU8WS8 191.3 zw_sb_q0p75 -96.00 95.25 FORMAT "%5.2"
 /begin AXIS_DESCR STD_AXIS nzwgru nmot_ub_q40 12 0.00 10200. FORMAT "%5.0" DEPOSIT ABSOLUTE /end AXIS_DESCR
 /begin AXIS_DESCR STD_AXIS rl rel_ub_q0p75 8 0.00 191.3 FORMAT "%5.1" DEPOSIT ABSOLUTE /end AXIS_DESCR
/end CHARACTERISTIC
/begin CHARACTERISTIC KFDZWFF "Gewichtung der ZW-Korrektur bei Fr¸hverstellung" MAP 0x4EE7CE KfAxUwAyUwSstxUwSstyUwWSw 31.99951 fak_sw_b16 -16.00000 15.99951 FORMAT "%8.5"
 /begin AXIS_DESCR STD_AXIS nzwgru_w nmot_uw_q0p25 16 0.00 16383.75 FORMAT "%8.2" DEPOSIT ABSOLUTE /end AXIS_DESCR
 /begin AXIS_DESCR STD_AXIS rl_w rel_uw_q0p0234 16 0.00 1535.977 FORMAT "%8.3" DEPOSIT ABSOLUTE /end AXIS_DESCR
/end CHARACTERISTIC
/begin CHARACTERISTIC KFDZWFS "Gewichtung der ZW-Korrektur bei Sp‰tverstellung" MAP 0x4EEA12 KfAxUwAyUwSstxUwSstyUwWSw 31.99951 fak_sw_b16 -16.00000 15.99951 FORMAT "%8.5"
 /begin AXIS_DESCR STD_AXIS nzwgru_w nmot_uw_q0p25 16 0.00 16383.75 FORMAT "%8.2" DEPOSIT ABSOLUTE /end AXIS_DESCR
 /begin AXIS_DESCR STD_AXIS rl_w rel_uw_q0p0234 16 0.00 1535.977 FORMAT "%8.3" DEPOSIT ABSOLUTE /end AXIS_DESCR
/end CHARACTERISTIC
/begin CHARACTERISTIC KFDZWTM "ZW-Korrektur f¸r tmotzyl-ƒnderung" MAP 0x4EEC56 KfAxUwAyUwSstxUwSstyUwWSw 192.0000 zw_sb_q0p75 -96.00000 96.00000 FORMAT "%8.5"
 /begin AXIS_DESCR STD_AXIS nzwgru_w nmot_uw_q0p25 16 0.00 16383.75 FORMAT "%8.2" DEPOSIT ABSOLUTE /end AXIS_DESCR
 /begin AXIS_DESCR STD_AXIS tmotzyl_w temp_ub_q0p75_o48 12 -48.00000 49103.25 FORMAT "%8.2" DEPOSIT ABSOLUTE /end AXIS_DESCR
/end CHARACTERISTIC
/begin CHARACTERISTIC KFETATE "Kennfeld gew¸nscher Wirkungsgrad bei Tankentl¸ftung bei Erreichen te = TEMIN" MAP 0x4EE658 KfAxUwAyUwSstxSwSstyUwWUw 50.00000 rel_q0p00195 50.00000 100.0000 FORMAT "%8.4"
 /begin AXIS_DESCR STD_AXIS fteadf_w fak_q0p00195 3 -64.00000 63.99805 FORMAT "%8.5" DEPOSIT ABSOLUTE /end AXIS_DESCR
 /begin AXIS_DESCR STD_AXIS mifa_w rel_uw_b100 5 0.00 99.99847 FORMAT "%8.5" DEPOSIT ABSOLUTE /end AXIS_DESCR
/end CHARACTERISTIC
/begin CHARACTERISTIC KFFQTEFR "KF stetige Grenzwertregelung" MAP 0x4EE52C KfAxUbAyUbSstxUbSstyUbWSb 0.006056 perio_ub_b0p012207 0.00 0.006056 FORMAT "%8.6"
 /begin AXIS_DESCR STD_AXIS ml m_ub_b1020 8 0.00 1020. FORMAT "%5.0" DEPOSIT ABSOLUTE /end AXIS_DESCR
 /begin AXIS_DESCR STD_AXIS frmxa fak_ub_b2 8 0.00 1.992 FORMAT "%5.3" DEPOSIT ABSOLUTE /end AXIS_DESCR
/end CHARACTERISTIC
/begin CHARACTERISTIC KFFTEAN "Kennfeld Maximale Sp¸lrate bei Notlauftankentl¸ftung" MAP 0x4EE68A KfAxUwAyUwSstxUwSstyUwWUw 0.1992188 fak_ub_b0p5 0.00 0.1992188 FORMAT "%9.7"
 /begin AXIS_DESCR STD_AXIS nmot_w nmot_uw_q0p25 10 0.00 16383.75 FORMAT "%8.2" DEPOSIT ABSOLUTE /end AXIS_DESCR
 /begin AXIS_DESCR STD_AXIS rlsol_w rel_uw_q0p0234 10 0.00 1535.977 FORMAT "%8.3" DEPOSIT ABSOLUTE /end AXIS_DESCR
/end CHARACTERISTIC
/begin CHARACTERISTIC KFFTEAX "Kennfeld maximale Sp¸lrate" MAP 0x4EE580 KfAxUbAyUbSstxUbSstyUbWUb 0.1992 fak_ub_b0p5 0.00 0.1992
 /begin AXIS_DESCR STD_AXIS ml m_ub_b1020 5 0.00 1020. FORMAT "%5.0" DEPOSIT ABSOLUTE /end AXIS_DESCR
 /begin AXIS_DESCR STD_AXIS tans temp_ub_q0p75_o48 4 -48.00 143.3 FORMAT "%5.1" DEPOSIT ABSOLUTE /end AXIS_DESCR
/end CHARACTERISTIC
/begin CHARACTERISTIC KFMIRED "Kennfeld Abregelungsmoment f¸r VMAX-Regelung" MAP 0x4E858C GkfWUb 99.61 rel_ub_b99p6 0.00 99.61 FORMAT "%5.2"
 /begin AXIS_DESCR COM_AXIS bfzglf bfzg_sb_q0p217 4 -27.78 27.56 AXIS_PTS_REF SBF02MFSB /end AXIS_DESCR
 /begin AXIS_DESCR COM_AXIS rl_w rel_uw_q0p0234 4 0.00 1535.977 AXIS_PTS_REF SRL03MFUW /end AXIS_DESCR
/end CHARACTERISTIC
/begin CHARACTERISTIC KFQTE "Kennfeld Auf-/Absteuergeschwindigkeit der Sollsp¸lrate Tankentl¸ftung" MAP 0x4EE59F KfAxUbAyUbSstxUbSstyUbWSb 0.01216 perio_ub_b0p012207 -0.006104 0.006056 FORMAT "%8.6"
 /begin AXIS_DESCR STD_AXIS ml m_ub_b1020 8 0.00 1020. FORMAT "%5.0" DEPOSIT ABSOLUTE /end AXIS_DESCR
 /begin AXIS_DESCR STD_AXIS frmit fak_ub_b2 8 0.00 1.992 FORMAT "%5.3" DEPOSIT ABSOLUTE /end AXIS_DESCR
/end CHARACTERISTIC
/begin CHARACTERISTIC KFTADMS "dynamischer Bewertungsfaktor f¸r das Absteuern des TEV" MAP 0x4E8890 GkfWU8 1.992 fak_ub_b2 0.00 1.992 FORMAT "%5.3"
 /begin AXIS_DESCR COM_AXIS dmssginr fak_sb_b1 5 -1.000 0.9922 AXIS_PTS_REF SDM05TESB /end AXIS_DESCR
 /begin AXIS_DESCR COM_AXIS nmot nmot_ub_q40 4 0.00 10200. AXIS_PTS_REF SNM04TEUB /end AXIS_DESCR
/end CHARACTERISTIC
/begin CHARACTERISTIC KFTATX "Kennfeld f¸r maximales Tastverh‰ltnis" MAP 0x4EE5F4 KfAxUbAyUbSstxUbSstyUbWUb 99.61 rel_ub_b99p6 0.00 99.61 FORMAT "%5.2"
 /begin AXIS_DESCR STD_AXIS nmot nmot_ub_q40 6 0.00 10200. FORMAT "%5.0" DEPOSIT ABSOLUTE /end AXIS_DESCR
 /begin AXIS_DESCR STD_AXIS rl rel_ub_q0p75 10 0.00 191.3 FORMAT "%5.1" DEPOSIT ABSOLUTE /end AXIS_DESCR
/end CHARACTERISTIC
/begin CHARACTERISTIC KFTEKA "Kennfeld Sollkraftstoffanteil bei Regenerierung" MAP 0x4E88A4 KfAxU8AyU8SstxU16SstyU16WU16 3071.953 rel_uw_b3072 0.00 3071.953 FORMAT "%8.3"
 /begin AXIS_DESCR STD_AXIS nmot_w nmot_uw_q0p25 5 0.00 16383.75 FORMAT "%8.2" DEPOSIT ABSOLUTE /end AXIS_DESCR
 /begin AXIS_DESCR STD_AXIS rl_w rel_uw_q0p0234 5 0.00 1535.977 FORMAT "%8.3" DEPOSIT ABSOLUTE /end AXIS_DESCR
/end CHARACTERISTIC
/begin CHARACTERISTIC KFWZWWLDI "" MAP 0x4E9598 KfAxU8AyU8SstxU8SstyU8WU8 0.9961 fak_ub_b1 0.00 0.9961
 /begin AXIS_DESCR STD_AXIS nmot nmot_ub_q40 8 0.00 10200. FORMAT "%5.0" DEPOSIT ABSOLUTE /end AXIS_DESCR
 /begin AXIS_DESCR STD_AXIS rl rel_ub_q0p75 8 0.00 191.3 FORMAT "%5.1" DEPOSIT ABSOLUTE /end AXIS_DESCR
/end CHARACTERISTIC
/begin CHARACTERISTIC KFWZWWLLL "" MAP 0x4E95EC KfAxU8AyU8SstxU8SstyU8WU8 0.9961 fak_ub_b1 0.00 0.9961
 /begin AXIS_DESCR STD_AXIS nmot nmot_ub_q40 8 0.00 10200. FORMAT "%5.0" DEPOSIT ABSOLUTE /end AXIS_DESCR
 /begin AXIS_DESCR STD_AXIS rl rel_ub_q0p75 8 0.00 191.3 FORMAT "%5.1" DEPOSIT ABSOLUTE /end AXIS_DESCR
/end CHARACTERISTIC
/begin CHARACTERISTIC KFWZWWLVL "" MAP 0x4E9640 KfAxU8AyU8SstxU8SstyU8WU8 0.9961 fak_ub_b1 0.00 0.9961
 /begin AXIS_DESCR STD_AXIS nmot nmot_ub_q40 8 0.00 10200. FORMAT "%5.0" DEPOSIT ABSOLUTE /end AXIS_DESCR
 /begin AXIS_DESCR STD_AXIS rl rel_ub_q0p75 8 0.00 191.3 FORMAT "%5.1" DEPOSIT ABSOLUTE /end AXIS_DESCR
/end CHARACTERISTIC
/begin CHARACTERISTIC KFZWDI1 "Z¸ndwinkelkennfeld Teillast" MAP 0x4E8E80 GkfWSb 191.3 zw_sb_q0p75 -96.00 95.25 FORMAT "%5.2"
 /begin AXIS_DESCR COM_AXIS nzwgru nmot_ub_q40 24 0.00 10200. AXIS_PTS_REF SNM24ZUUB1 /end AXIS_DESCR
 /begin AXIS_DESCR COM_AXIS rl rel_ub_q0p75 16 0.00 191.3 AXIS_PTS_REF SRL16ZUUB /end AXIS_DESCR
/end CHARACTERISTIC
/begin CHARACTERISTIC KFZWDI1EPH "ZW-Kennfeld bei Teillast und Phasengeberfehler" MAP 0x4E9000 GkfWSb 191.3 zw_sb_q0p75 -96.00 95.25 FORMAT "%5.2"
 /begin AXIS_DESCR COM_AXIS nzwgru nmot_ub_q40 24 0.00 10200. AXIS_PTS_REF SNM24ZUUB1 /end AXIS_DESCR
 /begin AXIS_DESCR COM_AXIS rl rel_ub_q0p75 16 0.00 191.3 AXIS_PTS_REF SRL16ZUUB /end AXIS_DESCR
/end CHARACTERISTIC
/begin CHARACTERISTIC KFZWDI1OFS "Offsetz¸ndwinkelkennfeld Teillast fuer Nebenkerze" MAP 0x4E8ADC GkfWSb 191.3 zw_sb_q0p75 -96.00 95.25 FORMAT "%5.2"
 /begin AXIS_DESCR COM_AXIS nzwgru nmot_ub_q40 24 0.00 10200. AXIS_PTS_REF SNM24ZUUB1 /end AXIS_DESCR
 /begin AXIS_DESCR COM_AXIS rl rel_ub_q0p75 16 0.00 191.3 AXIS_PTS_REF SRL16ZUUB /end AXIS_DESCR
/end CHARACTERISTIC
/begin CHARACTERISTIC KFZWLL "Z¸ndwinkelkennfeld im Leerlauf" MAP 0x4E8E10 KfAxU8AyU8SstxU8SstyU8WS8 191.3 zw_sb_q0p75 -96.00 95.25 FORMAT "%5.2"
 /begin AXIS_DESCR STD_AXIS nzwgru nmot_ub_q40 8 0.00 10200. FORMAT "%5.0" DEPOSIT ABSOLUTE /end AXIS_DESCR
 /begin AXIS_DESCR STD_AXIS rl rel_ub_q0p75 5 0.00 191.3 FORMAT "%5.1" DEPOSIT ABSOLUTE /end AXIS_DESCR
/end CHARACTERISTIC
/begin CHARACTERISTIC KFZWLLEPH "ZW-Kennfeld bei Leerlauf und Phasengeberfehler" MAP 0x4E8E47 KfAxU8AyU8SstxU8SstyU8WS8 191.3 zw_sb_q0p75 -96.00 95.25 FORMAT "%5.2"
 /begin AXIS_DESCR STD_AXIS nzwgru nmot_ub_q40 8 0.00 10200. FORMAT "%5.0" DEPOSIT ABSOLUTE /end AXIS_DESCR
 /begin AXIS_DESCR STD_AXIS rl rel_ub_q0p75 5 0.00 191.3 FORMAT "%5.1" DEPOSIT ABSOLUTE /end AXIS_DESCR
/end CHARACTERISTIC
/begin CHARACTERISTIC KFZWLLOFS "Offsetz¸ndwinkelkennfeld im Leerlauf fuer Nebenkerze" MAP 0x4E8AA4 KfAxU8AyU8SstxU8SstyU8WS8 191.3 zw_sb_q0p75 -96.00 95.25 FORMAT "%5.2"
 /begin AXIS_DESCR STD_AXIS nmot nmot_ub_q40 8 0.00 10200. FORMAT "%5.0" DEPOSIT ABSOLUTE /end AXIS_DESCR
 /begin AXIS_DESCR STD_AXIS rl rel_ub_q0p75 5 0.00 191.3 FORMAT "%5.1" DEPOSIT ABSOLUTE /end AXIS_DESCR
/end CHARACTERISTIC
/begin CHARACTERISTIC KFZWMN "Min-Z¸ndwinkel" MAP 0x4E92D8 KfAxUbAyUbSstxUbSstyUbWSb 191.3 zw_sb_q0p75 -96.00 95.25 FORMAT "%5.2"
 /begin AXIS_DESCR STD_AXIS nmot nmot_ub_q40 16 0.00 10200. FORMAT "%5.0" DEPOSIT ABSOLUTE /end AXIS_DESCR
 /begin AXIS_DESCR STD_AXIS rl rel_ub_q0p75 12 0.00 191.3 FORMAT "%5.1" DEPOSIT ABSOLUTE /end AXIS_DESCR
/end CHARACTERISTIC
/begin CHARACTERISTIC KFZWMNKH "Min-Z¸ndwinkel Katheizen" MAP 0x4E93B6 KfAxUbAyUbSstxUbSstyUbWSb 191.3 zw_sb_q0p75 -96.00 95.25 FORMAT "%5.2"
 /begin AXIS_DESCR STD_AXIS nmot nmot_ub_q40 16 0.00 10200. FORMAT "%5.0" DEPOSIT ABSOLUTE /end AXIS_DESCR
 /begin AXIS_DESCR STD_AXIS rl rel_ub_q0p75 12 0.00 191.3 FORMAT "%5.1" DEPOSIT ABSOLUTE /end AXIS_DESCR
/end CHARACTERISTIC
/begin CHARACTERISTIC KFZWMNST "Min-Z¸ndwinkel f¸r Start und Nachstart" MAP 0x4E9494 KfAxUbAyUbSstxUbSstyUbWSb 191.3 zw_sb_q0p75 -96.00 95.25 FORMAT "%5.2"
 /begin AXIS_DESCR STD_AXIS nmot nmot_ub_q40 16 0.00 10200. FORMAT "%5.0" DEPOSIT ABSOLUTE /end AXIS_DESCR
 /begin AXIS_DESCR STD_AXIS rl rel_ub_q0p75 12 0.00 191.3 FORMAT "%5.1" DEPOSIT ABSOLUTE /end AXIS_DESCR
/end CHARACTERISTIC
/begin CHARACTERISTIC KFZWMS "Kennfeld mit dauerhaft sp‰test mˆglichem Z¸ndwinkel" MAP 0x4E9218 GkfWSb 191.3 zw_sb_q0p75 -96.00 95.25 FORMAT "%5.2"
 /begin AXIS_DESCR COM_AXIS nmot nmot_ub_q40 16 0.00 10200. AXIS_PTS_REF SNM16ZUUB /end AXIS_DESCR
 /begin AXIS_DESCR COM_AXIS rl rel_ub_q0p75 12 0.00 191.3 AXIS_PTS_REF SRL12ZUUB /end AXIS_DESCR
/end CHARACTERISTIC
/begin CHARACTERISTIC KFZWSTNMTM "Z¸ndwinkel im Start" MAP 0x4EEE40 KfAxUbAyUbSstxUbSstyUbWSb 191.3 zw_sb_q0p75 -96.00 95.25 FORMAT "%5.2"
 /begin AXIS_DESCR STD_AXIS nzwgru nmot_ub_q40 6 0.00 10200. FORMAT "%5.0" DEPOSIT ABSOLUTE /end AXIS_DESCR
 /begin AXIS_DESCR STD_AXIS tmst temp_ub_q0p75_o48 6 -48.00 143.3 FORMAT "%5.1" DEPOSIT ABSOLUTE /end AXIS_DESCR
/end CHARACTERISTIC
/begin CHARACTERISTIC KFZWVL1 "Z¸ndwinkelkennfeld Volllast" MAP 0x4E9180 GkfWSb 191.3 zw_sb_q0p75 -96.00 95.25 FORMAT "%5.2"
 /begin AXIS_DESCR COM_AXIS nzwgru nmot_ub_q40 24 0.00 10200. AXIS_PTS_REF SNM24ZUUB1 /end AXIS_DESCR
 /begin AXIS_DESCR COM_AXIS rl rel_ub_q0p75 3 0.00 191.3 AXIS_PTS_REF SRL03ZUUB /end AXIS_DESCR
/end CHARACTERISTIC
/begin CHARACTERISTIC KFZWVL1EPH "ZW-Kennfeld bei Vollast und Phasengeberfehler" MAP 0x4E91C8 GkfWSb 191.3 zw_sb_q0p75 -96.00 95.25 FORMAT "%5.2"
 /begin AXIS_DESCR COM_AXIS nzwgru nmot_ub_q40 24 0.00 10200. AXIS_PTS_REF SNM24ZUUB1 /end AXIS_DESCR
 /begin AXIS_DESCR COM_AXIS rl rel_ub_q0p75 3 0.00 191.3 AXIS_PTS_REF SRL03ZUUB /end AXIS_DESCR
/end CHARACTERISTIC
/begin CHARACTERISTIC KFZWVL1OFS "Offsetz¸ndwinkelkennfeld Volllast fuer Nebenkerze" MAP 0x4E8C5C GkfWSb 191.3 zw_sb_q0p75 -96.00 95.25 FORMAT "%5.2"
 /begin AXIS_DESCR COM_AXIS nzwgru nmot_ub_q40 24 0.00 10200. AXIS_PTS_REF SNM24ZUUB1 /end AXIS_DESCR
 /begin AXIS_DESCR COM_AXIS rl rel_ub_q0p75 3 0.00 191.3 AXIS_PTS_REF SRL03ZUUB /end AXIS_DESCR
/end CHARACTERISTIC
/begin CHARACTERISTIC KFZWWLTM "Delta Z¸ndwinkel im Warmlauf" MAP 0x4EEE72 KfAxUwAyUwSstxUwSstyUwWSw 190.5000 zw_sb_q0p75 -95.25000 95.25000 FORMAT "%8.5"
 /begin AXIS_DESCR STD_AXIS tmotzyl_w temp_ub_q0p75_o48 12 -48.00000 49103.25 FORMAT "%8.2" DEPOSIT ABSOLUTE /end AXIS_DESCR
 /begin AXIS_DESCR STD_AXIS tmstzyl_w temp_ub_q0p75_o48 12 -48.00000 49103.25 FORMAT "%8.2" DEPOSIT ABSOLUTE /end AXIS_DESCR
/end CHARACTERISTIC
/begin CHARACTERISTIC KHCTEMN "Minimalwert HC-Konzentration Regeneriergas Tankentl¸ftung" VALUE 0x4EE642 KwSb 3.984 fak_sb_b2 -2.000 1.984 FORMAT "%5.3" /end CHARACTERISTIC
/begin CHARACTERISTIC KHCTEMX "Maximalwert HC-Konzentration Regeneriergas Tankentl¸ftung" VALUE 0x4EE643 KwSb 3.984 fak_sb_b2 -2.000 1.984 FORMAT "%5.3" /end CHARACTERISTIC
/begin CHARACTERISTIC KLZZWMNST "KL Zeitkonstante f¸r Abregelung ZW-Begrenzung im Nachstart" CURVE 0x4E9572 KlAUbSstUwWUw 655.350000 zk10msxs_uw_b655 0.0100001526 655.360000 FORMAT "%10.6"
 /begin AXIS_DESCR STD_AXIS tmstzyl_w temp_ub_q0p75_o48 8 -48.00000 49103.25 FORMAT "%8.2" DEPOSIT ABSOLUTE /end AXIS_DESCR
/end CHARACTERISTIC
/begin CHARACTERISTIC KSDZWE "ZW-Korrektur bei Error Sensor tmot oder tans" VALUE 0x4E9210 KwSb 191.3 zw_sb_q0p75 -96.00 95.25 FORMAT "%5.2" /end CHARACTERISTIC
/begin CHARACTERISTIC K_ALEN "" VALUE 0x4EA0C8 KwSw 65535.00 Def_n -32768.00 32767.00 FORMAT "%8.2" /end CHARACTERISTIC
/begin CHARACTERISTIC K_KVA "" VALUE 0x4EA0F4 KwWU16 65535.00 dez 0.00 65535.00 FORMAT "%8.2" /end CHARACTERISTIC
/begin CHARACTERISTIC K_LURENDE "" VALUE 0x4EA0CB KwUb 1530. Def_kw_ub_q6p0 0.00 1530. FORMAT "%5.0" /end CHARACTERISTIC
/begin CHARACTERISTIC K_LURSTART "" VALUE 0x4EA0CA KwUb 1530. Def_kw_ub_q6p0 0.00 1530. FORMAT "%5.0" /end CHARACTERISTIC
/begin CHARACTERISTIC K_NLIMIT "" VALUE 0x4EA0D0 KwSw 98.00000 Def_n 2.000000 100.0000 FORMAT "%8.4" /end CHARACTERISTIC
/begin CHARACTERISTIC K_NMAX "" VALUE 0x4EA0D2 KwSw 65535.00 Def_n -32768.00 32767.00 FORMAT "%8.2" /end CHARACTERISTIC
/begin CHARACTERISTIC K_NWE1_MAX "" VALUE 0x4EA0B6 KwUw 6554. sprzi_q0p1 0.00 6554. FORMAT "%2.0" /end CHARACTERISTIC
/begin CHARACTERISTIC K_NWE1_MIN "" VALUE 0x4EA0B4 KwUw 6554. sprzi_q0p1 0.00 6554. FORMAT "%2.0" /end CHARACTERISTIC
/begin CHARACTERISTIC K_NWPOSMN "" VALUE 0x4EA0C4 KwUw 6554. sprzi_q0p1 0.00 6554. FORMAT "%2.0" /end CHARACTERISTIC
/begin CHARACTERISTIC K_NWPOSMX "" VALUE 0x4EA0C2 KwUw 6554. sprzi_q0p1 0.00 6554. FORMAT "%2.0" /end CHARACTERISTIC
/begin CHARACTERISTIC K_NW_SYNC_IRQ "" VALUE 0x4EA0C0 KwUb 255.0 dez 0.00 255.0 FORMAT "%5.1" /end CHARACTERISTIC
/begin CHARACTERISTIC K_PEGEL_TPO_ZAHN "" VALUE 0x4EA0BF KwUb 255.0 dez 0.00 255.0 FORMAT "%5.1" /end CHARACTERISTIC
/begin CHARACTERISTIC K_TEMIN "" VALUE 0x4EA0D6 KwWU16 65.53520 Def_ti_uw_q0p0008 0.00 65.53520 FORMAT "%8.5" /end CHARACTERISTIC
/begin CHARACTERISTIC K_TEMINOFF "" VALUE 0x4EA0F2 KwWU16 52.42800 Def_ti_uw_q0p0008 0.00 52.42800 FORMAT "%8.5" /end CHARACTERISTIC
/begin CHARACTERISTIC K_TPO_ZAHN1 "" VALUE 0x4EA0BC KwUb 255.0 dez 0.00 255.0 FORMAT "%5.1" /end CHARACTERISTIC
/begin CHARACTERISTIC K_TPO_ZAHN2 "" VALUE 0x4EA0BD KwUb 255.0 dez 0.00 255.0 FORMAT "%5.1" /end CHARACTERISTIC
/begin CHARACTERISTIC K_TPO_ZAHN3 "" VALUE 0x4EA0BE KwUb 255.0 dez 0.00 255.0 FORMAT "%5.1" /end CHARACTERISTIC
/begin CHARACTERISTIC K_TPRELL "" VALUE 0x4EA0CC KwUb 1671. Def_td_ub_q6p5536 0.00 1671. FORMAT "%5.0" /end CHARACTERISTIC
/begin CHARACTERISTIC K_TRESYNC "" VALUE 0x4EA0B0 KwUb 255.0 dez 0.00 255.0 FORMAT "%5.1" /end CHARACTERISTIC
/begin CHARACTERISTIC K_ZPERUNSYNC "" VALUE 0x4EA0CF KwUb 1671. Def_td_ub_q6p5536 0.00 1671. FORMAT "%5.0" /end CHARACTERISTIC
/begin CHARACTERISTIC K_ZPRELL "" VALUE 0x4EA0CD KwUb 255.0 dez 0.00 255.0 FORMAT "%5.1" /end CHARACTERISTIC
/begin CHARACTERISTIC K_ZUEWMAXST "" VALUE 0x4EA0B2 KwSw 6554. sprzi_q0p1 -3277. 3277. FORMAT "%2.0" /end CHARACTERISTIC
/begin CHARACTERISTIC K_ZUNSYNC "" VALUE 0x4EA0CE KwUb 255.0 dez 0.00 255.0 FORMAT "%5.1" /end CHARACTERISTIC
/begin CHARACTERISTIC LAMTEMN "minimale Lambda-Schwelle, bei der die Tankentl¸ftung aktiv sein kann" VALUE 0x4EE786 KwUw 15.99976 fak_uw_b16 0.00 15.99976 FORMAT "%8.5" /end CHARACTERISTIC
/begin CHARACTERISTIC LAMTEMX "maximale Lambda-Schwelle, bei der die Tankentl¸ftung aktiv sein kann" VALUE 0x4EE788 KwUw 15.99976 fak_uw_b16 0.00 15.99976 FORMAT "%8.5" /end CHARACTERISTIC
/begin CHARACTERISTIC LPFACDECV "" CURVE 0x4E991A KlAUwSstUwWUw 0.9999847 fak_uw_b1 0.00 0.9999847 FORMAT "%9.7"
 /begin AXIS_DESCR STD_AXIS v_vradabs vfzg_uw_q0p00781 3 0.00 511.9922 FORMAT "%8.4" DEPOSIT ABSOLUTE /end AXIS_DESCR
/end CHARACTERISTIC
/begin CHARACTERISTIC LPFACHRAD "" CURVE 0x4E9928 KlAUwSstUwWUw 0.9999847 fak_uw_b1 0.00 0.9999847 FORMAT "%9.7"
 /begin AXIS_DESCR STD_AXIS v_hradabs vfzg_uw_q0p00781 3 0.00 511.9922 FORMAT "%8.4" DEPOSIT ABSOLUTE /end AXIS_DESCR
/end CHARACTERISTIC
/begin CHARACTERISTIC LPFACINCV "" CURVE 0x4E9936 KlAUwSstUwWUw 0.9999847 fak_uw_b1 0.00 0.9999847 FORMAT "%9.7"
 /begin AXIS_DESCR STD_AXIS v_vradabs vfzg_uw_q0p00781 3 0.00 511.9922 FORMAT "%8.4" DEPOSIT ABSOLUTE /end AXIS_DESCR
/end CHARACTERISTIC
/begin CHARACTERISTIC MAX_Abschaltpfadtest "" VALUE 0x4E9CA1 KwUb 239.0 dez 16.00 255.0 FORMAT "%5.1" /end CHARACTERISTIC
/begin CHARACTERISTIC MSDKLMMN "minimaler Massenstrom ¸ber Drosselklappe in TE" VALUE 0x4E8914 KwUw 6553.500 m_uw_b6553p5 0.00 6553.500 FORMAT "%8.3" /end CHARACTERISTIC
/begin CHARACTERISTIC MSRC_T_UM "Fehlerzeit f¸r MSR-Eingriff-‹berwachung der Funktions¸berwachung" VALUE 0x4E9C92 KwUb 10200.0 t40ms_ub_b10200 0.00 10200.0 FORMAT "%7.1" /end CHARACTERISTIC
/begin CHARACTERISTIC NACHANZ "" VALUE 0x4E8A9D KwUb 255.0 dez 0.00 255.0 FORMAT "%5.1" /end CHARACTERISTIC
/begin CHARACTERISTIC NKLO "Drehzahl - Klopfschutzschwelle" VALUE 0x4E9211 KwUb 10200. nmot_ub_q40 0.00 10200. FORMAT "%5.0" /end CHARACTERISTIC
/begin CHARACTERISTIC NMIN "" VALUE 0x4ECA9C KwUw 16383.75 Def_n4 0.00 16383.75 FORMAT "%8.2" /end CHARACTERISTIC
/begin CHARACTERISTIC NMINVMX "Minimale Drehzahlschwelle zur VMAX-Regelung" VALUE 0x4E859C KwUb 10200. nmot_ub_q40 0.00 10200. FORMAT "%5.0" /end CHARACTERISTIC
/begin CHARACTERISTIC NMOTNK "" VALUE 0x4EE7BC KwUb 10200. nmot_ub_q40 0.00 10200. FORMAT "%5.0" /end CHARACTERISTIC
/begin CHARACTERISTIC NMOTSYNC "" VALUE 0x4EA0C6 KwUw 16383.75 Def_n4 0.00 16383.75 FORMAT "%8.2" /end CHARACTERISTIC
/begin CHARACTERISTIC NSC_T_UM "Nachstart¸berwachungszeit f¸r die Funktions¸berwachung" VALUE 0x4E9C9A KwUw 2621.400 t40msxs_uw_q0p04 0.00 2621.400 FORMAT "%8.3" /end CHARACTERISTIC
/begin CHARACTERISTIC NSOF_T_UM "Entprellzeit f¸r Abschaltung der Nachstartaufweitung" VALUE 0x4E9C94 KwUb 10200.0 t40ms_ub_b10200 0.00 10200.0 FORMAT "%7.1" /end CHARACTERISTIC
/begin CHARACTERISTIC NVERZMN "minimale Drehzahl f¸r Verzˆgerung" VALUE 0x4E8916 KwUw 16383.75 nmot_uw_q0p25 0.00 16383.75 FORMAT "%8.2" /end CHARACTERISTIC
/begin CHARACTERISTIC N_START_UM "Motordrehzahlschwelle f¸r Unterdrehzahl-Ausstieg f¸r die Fkt.-‹berwachung" VALUE 0x4E9C95 KwUb 10200. nmot_ub_q40 0.00 10200. FORMAT "%5.0" /end CHARACTERISTIC
/begin CHARACTERISTIC N_STEND_UM "Motordrehzahlschwelle f¸r Startende in der Fkt.-‹berwachung" VALUE 0x4E9C96 KwUb 10200. nmot_ub_q40 0.00 10200. FORMAT "%5.0" /end CHARACTERISTIC
/begin CHARACTERISTIC PHYSPDLIMH "" VALUE 0x4EFE74 KwUw 511.9922 vfzg_uw_q0p00781 0.00 511.9922 FORMAT "%8.4" /end CHARACTERISTIC
/begin CHARACTERISTIC PHYSPDLIMV "" VALUE 0x4EFE76 KwUw 511.9922 vfzg_uw_q0p00781 0.00 511.9922 FORMAT "%8.4" /end CHARACTERISTIC
/begin CHARACTERISTIC RLKL "Lastsignal rl - Schwelle f¸r Klopfschutz" VALUE 0x4E9212 KwUb 191.3 rel_ub_q0p75 0.00 191.3 FORMAT "%5.1" /end CHARACTERISTIC
/begin CHARACTERISTIC ROMRSTA_UM "maximale Anzahl Resets bei Fehlererkennung im ROM-Check in der Initialisierung" VALUE 0x4E9D08 KwUb 255.0 dez 0.00 255.0 FORMAT "%5.1" /end CHARACTERISTIC
/begin AXIS_PTS SBF02MFSB "" 0x4E85A0 bfzglf SstAUbSstSb 55.34 bfzg_sb_q0p217 4 -27.78 27.56 FORMAT "%5.2" DEPOSIT ABSOLUTE /end AXIS_PTS
/begin AXIS_PTS SDM05TESB "dmssginr abh‰ngige St¸tzstellen (Anzahl 5)" 0x4E2A0C dmssginr SstAU8SstS8 1.992 fak_sb_b1 5 -1.000 0.9922 FORMAT "%5.3" DEPOSIT ABSOLUTE /end AXIS_PTS
/begin AXIS_PTS SML06TEUB "ml abh‰ngige St¸tzstellen (Anzahl 6)" 0x4EA104 ml SstAUbSstUb 1020. m_ub_b1020 6 0.00 1020. FORMAT "%5.0" DEPOSIT ABSOLUTE /end AXIS_PTS
/begin AXIS_PTS SNM04TEUB "Motordrehzahl-abh‰ngige St¸tzstellen (Anzahl =4)" 0x4E2A3C nmot SstAU8SstU8 10200. nmot_ub_q40 4 0.00 10200. FORMAT "%5.0" DEPOSIT ABSOLUTE /end AXIS_PTS
/begin AXIS_PTS SNM08__UB "St¸tzstellenverteilung Drehzahl, 8 Sst." 0x4E2AD4 nmot SstAUbSstUb 10200. nmot_ub_q40 8 0.00 10200. FORMAT "%5.0" DEPOSIT ABSOLUTE /end AXIS_PTS
/begin AXIS_PTS SNM16ZUUB "St¸tzstellenverteilung Drehzahl, 16 Sst." 0x4E2B00 nmot SstAUbSstUb 10200. nmot_ub_q40 16 0.00 10200. FORMAT "%5.0" DEPOSIT ABSOLUTE /end AXIS_PTS
/begin AXIS_PTS SNM24ZUUB1 "" 0x4E2B14 nzwgru SstAUbSstUb 10200. nmot_ub_q40 24 0.00 10200. FORMAT "%5.0" DEPOSIT ABSOLUTE /end AXIS_PTS
/begin AXIS_PTS SQM05TEUB "Luftmassenquotient-abh‰ngige St¸tzstellen (Anzahl =5)" 0x4E2B30 qmsdyn SstAUbSstUb 15.94 fak_ub_b16 5 0.00 15.94 FORMAT "%5.2" DEPOSIT ABSOLUTE /end AXIS_PTS
/begin AXIS_PTS SRL03MFUW "" 0x4E85AA rl_w SstAUwSstUw 1535.977 rel_uw_q0p0234 4 0.00 1535.977 FORMAT "%8.3" DEPOSIT ABSOLUTE /end AXIS_PTS
/begin AXIS_PTS SRL03ZUUB "" 0x4E2B38 rl SstAUbSstUb 191.3 rel_ub_q0p75 3 0.00 191.3 FORMAT "%5.1" DEPOSIT ABSOLUTE /end AXIS_PTS
/begin AXIS_PTS SRL12ZUUB "St¸tzstellenverteilung relative Luftf¸llung, 12 St." 0x4E2B5C rl SstAUbSstUb 191.3 rel_ub_q0p75 12 0.00 191.3 FORMAT "%5.1" DEPOSIT ABSOLUTE /end AXIS_PTS
/begin AXIS_PTS SRL16ZUUB "St¸tzstellenverteilung relative F¸llung, 16 Sst." 0x4E2B6C rl SstAUbSstUb 191.3 rel_ub_q0p75 16 0.00 191.3 FORMAT "%5.1" DEPOSIT ABSOLUTE /end AXIS_PTS
/begin AXIS_PTS STMZYL06__UW "" 0x4EA25A tmotzyl_w SstAUwSstUw 49151.25 temp_ub_q0p75_o48 6 -48.00000 49103.25 FORMAT "%8.2" DEPOSIT ABSOLUTE /end AXIS_PTS
/begin CHARACTERISTIC S_KRZWSOL "" VALUE 0x4E8A9E KwUb 255.0 dez 0.00 255.0 FORMAT "%5.1" /end CHARACTERISTIC
/begin CHARACTERISTIC S_NWNOSYNC "" VALUE 0x4EA0B8 KwUb 255.0 dez 0.00 255.0 FORMAT "%5.1" /end CHARACTERISTIC
/begin CHARACTERISTIC S_SEGCLRNW "" VALUE 0x4EA0D4 KwUb 1671. Def_td_ub_q6p5536 0.00 1671. FORMAT "%5.0" /end CHARACTERISTIC
/begin CHARACTERISTIC S_TIUNSYNC "" VALUE 0x4EA0B9 KwUb 255.0 dez 0.00 255.0 FORMAT "%5.1" /end CHARACTERISTIC
/begin CHARACTERISTIC TANSMN_UM "Ansauglufttemperaturschwelle zur Nachstartaufweitung in der Fkt.-‹berwachung" VALUE 0x4E9C97 KwUb 191.3 temp_ub_q0p75_o48 -48.00 143.3 FORMAT "%5.1" /end CHARACTERISTIC
/begin CHARACTERISTIC TFTEINI "Zeit f¸r Erkennung TE Stop" VALUE 0x4E8918 KwUw 6553.500 t100msxs_uw_b6553p5 0.00 6553.500 FORMAT "%8.3" /end CHARACTERISTIC
/begin CHARACTERISTIC TMNSMN_UM "Motortemperaturschwelle f¸r die Nachstartaufweitung in der FKT.-‹berwachung" VALUE 0x4E9C98 KwUb 191.3 temp_ub_q0p75_o48 -48.00 143.3 FORMAT "%5.1" /end CHARACTERISTIC
/begin CHARACTERISTIC TMSTTE "Starttemperaturschwelle, bei der die TE sofort aktiv werden kann" VALUE 0x4EE78A KwUw 49151.25 temp_ub_q0p75_o48 -48.00000 49103.25 FORMAT "%8.2" /end CHARACTERISTIC
/begin CHARACTERISTIC TMTE "TMOT - Schwelle f¸r Tankentl¸ftung" VALUE 0x4EE78C KwUw 49151.25 temp_ub_q0p75_o48 -48.00000 49103.25 FORMAT "%8.2" /end CHARACTERISTIC
/begin CHARACTERISTIC TPUCR_T_UM "Fehlerzeit des TPU-Code-RAM-Tests in der Funktions¸berwachung" VALUE 0x4E9D09 KwUb 255.0 dez 0.00 255.0 FORMAT "%5.1" /end CHARACTERISTIC
/begin CHARACTERISTIC TPURA_T_UM "Zeitlicher Abstand der zyklischen Aktivierung des TPU-Code-RAM-Tests in der FU" VALUE 0x4E9D0A KwUb 2550.00 t10ms_ub_b2550 0.00 2550.00 /end CHARACTERISTIC
/begin CHARACTERISTIC TPUWWMAX "" VALUE 0x4E29B2 KwUw 1535.977 kw_q0p02566 0.00 1535.977 FORMAT "%8.3" /end CHARACTERISTIC
/begin CHARACTERISTIC TPUWWSEG "" VALUE 0x4E29B4 KwUw 1535.977 kw_q0p02566 0.00 1535.977 FORMAT "%8.3" /end CHARACTERISTIC
/begin CHARACTERISTIC TQTEAB "Zeit f¸r Absteuerung Sp¸lrate Tankentl¸ftung" VALUE 0x4E8905 KwUb 81.28 t20msxs_ub_q0p32 0.3200 81.60 FORMAT "%5.2" /end CHARACTERISTIC
/begin CHARACTERISTIC TQTEDAB "Zeit f¸r schnelle Absteuerung Sp¸lrate Tankentl¸ftung" VALUE 0x4E8906 KwUb 81.28 t20msxs_ub_q0p32 0.3200 81.60 FORMAT "%5.2" /end CHARACTERISTIC
/begin CHARACTERISTIC TSUB "Schliesszeit" CURVE 0x4E8CA4 FklWU16 65.53500 txms_uw_q0p001 0.00 65.53500 FORMAT "%8.5"
 /begin AXIS_DESCR FIX_AXIS ub spg_ubatt 64 0.00 24.02 FORMAT "%5.2" FIX_AXIS_PAR 0 2 64 /end AXIS_DESCR
/end CHARACTERISTIC
/begin CHARACTERISTIC TTEAUS "Zeit nach Start bis TEB aktiv wird" VALUE 0x4EE78E KwUw 195.0000 t100msxs_uw_q100 5.000000 200.0000 FORMAT "%8.4" /end CHARACTERISTIC
/begin CHARACTERISTIC TUETM "Zeit¸bertemperatur nach Start" VALUE 0x4E2D34 KwUw 655.3500 t_q0p01 0.00 655.3500 FORMAT "%8.4" /end CHARACTERISTIC
/begin CHARACTERISTIC TVMXPR "Geschwindigkeit-Pr‰diktionshorizont f¸r VMAX-Regelung" VALUE 0x4E85A5 KwUb 2.550 t10msxs_ub_b2p55 0.00 2.550 FORMAT "%5.3" /end CHARACTERISTIC
/begin CHARACTERISTIC TVSATEM "Verzˆgerungszeit f¸r TEV zu nach SA-Bereitschaft" CURVE 0x4E891A KlAUwSstUwWUw 5.100000 t20msxs_ub_b5p1 0.00 5.100000 FORMAT "%8.6"
 /begin AXIS_DESCR STD_AXIS tmotzyl_w temp_ub_q0p75_o48 6 -48.00000 49103.25 FORMAT "%8.2" DEPOSIT ABSOLUTE /end AXIS_DESCR
/end CHARACTERISTIC
/begin CHARACTERISTIC TVZWMSA "Zeit bis zum ‹bergehen auf Dauersp‰tbegrenzung" VALUE 0x4E9594 KwUw 655.3500 t10msxs_uw_b655p35 0.00 655.3500 FORMAT "%8.4" /end CHARACTERISTIC
/begin CHARACTERISTIC TVZWMSE "Zeit bis zum ‹bergehen auf Dynamiksp‰tbegrenzung" VALUE 0x4E9596 KwUw 655.3500 t10msxs_uw_b655p35 0.00 655.3500 FORMAT "%8.4" /end CHARACTERISTIC
/begin CHARACTERISTIC UETMOT "Motor¸bertemperatur-Schwelle" VALUE 0x4E2D33 KwUb 191.3 temp_ub_q0p75_o48 -48.00 143.3 FORMAT "%5.1" /end CHARACTERISTIC
/begin CHARACTERISTIC VABSCH "Vmax-Regler-Abschaltschwelle, variantenkodiert" VALUE 0x4E85B4 KwUw 511.9922 vfzg_uw_q0p00781 0.00 511.9922 FORMAT "%8.4" /end CHARACTERISTIC
/begin CHARACTERISTIC VHYST "Vmax-Hystereseschwelle, variantenkodiert" VALUE 0x4E85B6 KwUw 511.9922 vfzg_uw_q0p00781 0.00 511.9922 FORMAT "%8.4" /end CHARACTERISTIC
/begin CHARACTERISTIC VMAXO "Vmax-Begrenzungswert (Linie mit 16 Varianten)" VALUE 0x4E85B8 KwUw 511.9922 vfzg_uw_q0p00781 0.00 511.9922 FORMAT "%8.4" /end CHARACTERISTIC
/begin CHARACTERISTIC VMAXP "P-Glied bei VMAX-Regelung" VALUE 0x4E85A6 KwUb 99.70 rel_ub_q0p391 0.00 99.70 FORMAT "%5.2" /end CHARACTERISTIC
/begin CHARACTERISTIC VSIKVBASIS "" VALUE 0x4EF384 KwUw 34359.21 fuel_q0p524288 0.00 34359.21 FORMAT "%8.2" /end CHARACTERISTIC
/begin CHARACTERISTIC VSIW "" VALUE 0x4EF386 KwUw 327670.0 km_uw_q10 0.00 327670.0 FORMAT "%8.1" /end CHARACTERISTIC
/begin CHARACTERISTIC VVORH "Vmax-Vorhaltschwelle, variantenkodiert" VALUE 0x4E85BA KwUw 511.9922 vfzg_uw_q0p00781 0.00 511.9922 FORMAT "%8.4" /end CHARACTERISTIC
/begin CHARACTERISTIC WESNESPR "Kennlinie f¸r ƒnderung des Einlassventil-÷ffnungswinkels" CURVE 0x4E4FE6 KlAUwSstUwWUw 65535.00 kw_q1 0.00 65535.00 FORMAT "%8.2"
 /begin AXIS_DESCR STD_AXIS evhubs_w hub_uw_q0p001 8 0.00 65.53500 FORMAT "%8.5" DEPOSIT ABSOLUTE /end AXIS_DESCR
/end CHARACTERISTIC
/begin CHARACTERISTIC WMNDOPZ "Sp‰tester Z¸ndwinkel im DZA Betrieb (Phasengebernotlauf)" VALUE 0x4E8A9F KwSb 191.3 zw_sb_q0p75 -96.00 95.25 FORMAT "%5.2" /end CHARACTERISTIC
/begin CHARACTERISTIC WPHN "Phasengang" CURVE 0x4EE7B4 GklWSb 191.3 zw_sb_q0p75 -96.00 95.25 FORMAT "%5.2"
 /begin AXIS_DESCR COM_AXIS nmot nmot_ub_q40 8 0.00 10200. AXIS_PTS_REF SNM08__UB /end AXIS_DESCR
/end CHARACTERISTIC
/begin CHARACTERISTIC ZBFIL "Zeitkonstante f¸r Beschleunigungsfilter" VALUE 0x4E85A7 KwUb 2.54000 zk10msxs_ub_b2p55 0.0100000 2.55000 FORMAT "%7.5" /end CHARACTERISTIC
/begin CHARACTERISTIC ZBTEML "Integrationsgeschwindigkeit Beladungsfaktor" CURVE 0x4EE644 GklWUb 6.101 perio_ub_b6p125 0.00 6.101 FORMAT "%5.3" /begin AXIS_DESCR COM_AXIS ml m_ub_b1020 6 0.00 1020. AXIS_PTS_REF SML06TEUB /end AXIS_DESCR /end CHARACTERISTIC
/begin CHARACTERISTIC ZETATE "Rampensteilheit f¸r Ver‰nderung Motorwirkungsgrad durch Tankentl¸ftung" VALUE 0x4EE77E KwUw 1279.590 rgrad_uw_b1280 0.3906250 1279.980 FORMAT "%8.3" /end CHARACTERISTIC
/begin CHARACTERISTIC ZIVMAX "I-Steigung f¸r VMAX-Regelung" VALUE 0x4E85A8 KwUb 25.4996 zk100msxs_ub_b25p5 0.100392 25.6000 FORMAT "%7.4" /end CHARACTERISTIC
/begin CHARACTERISTIC ZKFTEAD "Zeitkonstante gefilteter Faktor Beladung Sp¸lstrom bei Tankentl¸ftung" VALUE 0x4EE780 KwUw 6553.50000 zk100msxs_uw_b6553 0.100001526 6553.60000 FORMAT "%10.5" /end CHARACTERISTIC
/begin CHARACTERISTIC ZMLTE "Zeitkonstante f¸r ml-Filter in beladungsabh. Tankentl¸ftung" VALUE 0x4EE782 KwUw 6553.4999985 zk100msxs_uw_b655 0.10000152590 6553.6000000 FORMAT "%12.7" /end CHARACTERISTIC
/begin CHARACTERISTIC ZMSSGIN "Filterzeitkonstante f¸r Berechnung der relativen ƒnderung von mssgin_w" VALUE 0x4EE64A KwUb 25.4996 zk100msxs_ub_b25p5 0.100392 25.6000 FORMAT "%7.4" /end CHARACTERISTIC
/begin CHARACTERISTIC ZWAPPL "Applikationsschnittstelle Z¸ndwinkelverstellung" VALUE 0x4E8AA0 KwSb 191.3 zw_sb_q0p75 -96.00 95.25 FORMAT "%5.2" /end CHARACTERISTIC
/begin CHARACTERISTIC ZWOUTNK "Abschaltzuendwinkel fuer Nebenzuendkerze" VALUE 0x4EE7BD KwSb 190.5 zw_sb_q0p75 -95.25 95.25 FORMAT "%5.2" /end CHARACTERISTIC
/begin MEASUREMENT alv_old_um "" UBYTE dez 1 100 0 255 FORMAT "%5.1" ECU_ADDRESS 0x7F8032 /end MEASUREMENT
/begin MEASUREMENT auscf_c_um "Fehlerz‰hler im DauerRAM f¸r nicht angezogenes Hauptrelais (Diagnose) in %UMAUSC" UBYTE dez 1 100 0 255 FORMAT "%5.1" ECU_ADDRESS 0x7F9AAE /end MEASUREMENT
/begin MEASUREMENT ausch_c_um "Heilungsz‰hler f¸r Anzahl von Antworten an das UM im Abschaltpfadtest" UBYTE dez 1 100 0 255 FORMAT "%5.1" ECU_ADDRESS 0x7FD87C /end MEASUREMENT
/begin MEASUREMENT ausc_c_um "Pr¸fungsz‰hler im DauerRAM f¸r nicht angezogenes Hauptrelais im Abschaltpfadtest" UBYTE dez 1 100 0 255 FORMAT "%5.1" ECU_ADDRESS 0x7F9AAF /end MEASUREMENT
/begin MEASUREMENT ausgh_c_um "Heilungsz‰hler f¸r Fehler in der zyklischen RAM-Pr¸fung der Funktions¸berwachung" UBYTE t40ms_ub_b10200 1 100 0 10200 FORMAT "%7.1" ECU_ADDRESS 0x7F8076 /end MEASUREMENT
/begin MEASUREMENT ausg_c_um "Fehlerz‰hler f¸r zyklische RAM-Pr¸fung in der Funktions¸berwachung" UBYTE dezsub1 1 100 1 256 FORMAT "%5.1" ECU_ADDRESS 0x7F8077 /end MEASUREMENT
/begin MEASUREMENT auszh_c_um "Heilungsz‰hler f¸r Fehler in der zyklischen ROM-Pr¸fung der Funktions¸berwachung" UBYTE t40ms_ub_b10200 1 100 0 10200 FORMAT "%7.1" ECU_ADDRESS 0x7F8078 /end MEASUREMENT
/begin MEASUREMENT ausz_c_um "Fehlerz‰hler f¸r zyklische ROM-Pr¸fung in der Funktions¸berwachung" UBYTE dezsub1 1 100 1 256 FORMAT "%5.1" ECU_ADDRESS 0x7F8079 /end MEASUREMENT
/begin MEASUREMENT bfzglf "Fahrzeugl‰ngsbeschleunigung gefiltert" SBYTE bfzg_sb_q0p217 1 100 -27.776 27.559 FORMAT "%5.2" ECU_ADDRESS 0x7FDA78 /end MEASUREMENT
/begin MEASUREMENT btduty_ekp "" UBYTE dez 1 100 0 255 FORMAT "%5.1" ECU_ADDRESS 0x7FD6CE /end MEASUREMENT
/begin MEASUREMENT B_aklet "" UBYTE B_TRUE 1 100 0 1 BIT_MASK 0x1 FORMAT "%13.11" ECU_ADDRESS 0x7FBAF2 /end MEASUREMENT
/begin MEASUREMENT B_anw1irq "" UBYTE B_TRUE 1 100 0 1 BIT_MASK 0x2 FORMAT "%13.11" ECU_ADDRESS 0x7FD45C /end MEASUREMENT
/begin MEASUREMENT B_anw2irq "" UBYTE B_TRUE 1 100 0 1 BIT_MASK 0x8 FORMAT "%13.11" ECU_ADDRESS 0x7FD45C /end MEASUREMENT
/begin MEASUREMENT B_ausc_act "Bedingung f¸r Abschaltpfadtest aktiv" UBYTE B_TRUE 1 100 0 1 BIT_MASK 0x1 FORMAT "%13.11" ECU_ADDRESS 0x7FB909 /end MEASUREMENT
/begin MEASUREMENT B_ausc_um "Bedingung f¸r Abschaltpfadtest abgeschlossen in der Funktions¸berwachung" UBYTE B_TRUE 1 100 0 1 BIT_MASK 0x1 FORMAT "%13.11" ECU_ADDRESS 0x7FB90A /end MEASUREMENT
/begin MEASUREMENT B_brems_um "Bedingung Bremse getreten f¸r die Funktions¸berwachung" UBYTE B_TRUE 1 100 0 1 BIT_MASK 0x1 FORMAT "%13.11" ECU_ADDRESS 0x7F803F /end MEASUREMENT
/begin MEASUREMENT B_brfgr_um "Bedingung Bremse getreten f¸r die Funktions¸berwachung" UBYTE B_TRUE 1 100 0 1 BIT_MASK 0x2 FORMAT "%13.11" ECU_ADDRESS 0x7F803F /end MEASUREMENT
/begin MEASUREMENT B_bsl_um "erkannter Low-Pegel am FGR-Bedienhebelschalter Beschleunigen in Funktions¸berw." UBYTE B_TRUE 1 100 0 1 BIT_MASK 0x2 FORMAT "%13.11" ECU_ADDRESS 0x7F8040 /end MEASUREMENT
/begin MEASUREMENT B_bt "Bedingung Bauteileansteuerung  allgemein" UBYTE B_TRUE 1 100 0 1 BIT_MASK 0x1 FORMAT "%13.11" ECU_ADDRESS 0x7FBAF3 /end MEASUREMENT
/begin MEASUREMENT B_btakl "" UBYTE B_TRUE 1 100 0 1 BIT_MASK 0x1 FORMAT "%13.11" ECU_ADDRESS 0x7FBAF4 /end MEASUREMENT
/begin MEASUREMENT B_btelue "Bedingung der Bauteileansteuerung des E-Luefters" UBYTE B_TRUE 1 100 0 1 BIT_MASK 0x1 FORMAT "%13.11" ECU_ADDRESS 0x7FBAF5 /end MEASUREMENT
/begin MEASUREMENT B_btev1 "" UBYTE B_TRUE 1 100 0 1 BIT_MASK 0x1 FORMAT "%13.11" ECU_ADDRESS 0x7FBAF6 /end MEASUREMENT
/begin MEASUREMENT B_btev2 "" UBYTE B_TRUE 1 100 0 1 BIT_MASK 0x1 FORMAT "%13.11" ECU_ADDRESS 0x7FBAF7 /end MEASUREMENT
/begin MEASUREMENT B_bthsv "Bedingung Bauteileansteuerung; LS-Heizung vor Kat." UBYTE B_TRUE 1 100 0 1 BIT_MASK 0x1 FORMAT "%13.11" ECU_ADDRESS 0x7FBAF8 /end MEASUREMENT
/begin MEASUREMENT B_bthsv2 "Bedingung Bauteileansteuerung; LS-Heizung vor Kat. Bank 2" UBYTE B_TRUE 1 100 0 1 BIT_MASK 0x1 FORMAT "%13.11" ECU_ADDRESS 0x7FBAF9 /end MEASUREMENT
/begin MEASUREMENT B_btmil "Bedingung Bauteileansteuerung;  Fehlerlampe (MIL)" UBYTE B_TRUE 1 100 0 1 BIT_MASK 0x1 FORMAT "%13.11" ECU_ADDRESS 0x7FBAFA /end MEASUREMENT
/begin MEASUREMENT B_btslv "Bedingung Bauteileansteuerung; Sekund‰rluftventil" UBYTE B_TRUE 1 100 0 1 BIT_MASK 0x1 FORMAT "%13.11" ECU_ADDRESS 0x7FBAFB /end MEASUREMENT
/begin MEASUREMENT B_btstpabg "" UBYTE B_TRUE 1 100 0 1 BIT_MASK 0x1 FORMAT "%13.11" ECU_ADDRESS 0x7FBAFC /end MEASUREMENT
/begin MEASUREMENT B_btstpll1 "" UBYTE B_TRUE 1 100 0 1 BIT_MASK 0x1 FORMAT "%13.11" ECU_ADDRESS 0x7FBAFD /end MEASUREMENT
/begin MEASUREMENT B_btstpll2 "" UBYTE B_TRUE 1 100 0 1 BIT_MASK 0x1 FORMAT "%13.11" ECU_ADDRESS 0x7FBAFE /end MEASUREMENT
/begin MEASUREMENT B_bttev "Bedingung Bauteileansteuerung; Tankentl¸ftungsventil" UBYTE B_TRUE 1 100 0 1 BIT_MASK 0x1 FORMAT "%13.11" ECU_ADDRESS 0x7FBAFF /end MEASUREMENT
/begin MEASUREMENT B_btuetmc "" UBYTE B_TRUE 1 100 0 1 BIT_MASK 0x1 FORMAT "%13.11" ECU_ADDRESS 0x7FBB00 /end MEASUREMENT
/begin MEASUREMENT B_clvar "Bedingung Variante Lˆschen ¸ber KWP 2000* Service" UBYTE B_TRUE 1 100 0 1 BIT_MASK 0x1 FORMAT "%13.11" ECU_ADDRESS 0x7F9C35 /end MEASUREMENT
/begin MEASUREMENT B_dcdis_um "Fehlerreaktions-Info der Funktions¸berwachung (Abschaltung der DK-Steller-ES)" UBYTE B_TRUE 1 100 0 1 BIT_MASK 0x1 FORMAT "%13.11" ECU_ADDRESS 0x7F803E /end MEASUREMENT
/begin MEASUREMENT B_ekpet "Stellglieddiagnose EKP: Eingriff Tester" UBYTE B_TRUE 1 100 0 1 BIT_MASK 0x1 FORMAT "%13.11" ECU_ADDRESS 0x7FBB01 /end MEASUREMENT
/begin MEASUREMENT B_elueet "" UBYTE B_TRUE 1 100 0 1 BIT_MASK 0x1 FORMAT "%13.11" ECU_ADDRESS 0x7FBB02 /end MEASUREMENT
/begin MEASUREMENT B_enw1irq "" UBYTE B_TRUE 1 100 0 1 BIT_MASK 0x1 FORMAT "%13.11" ECU_ADDRESS 0x7FD45C /end MEASUREMENT
/begin MEASUREMENT B_enw2irq "" UBYTE B_TRUE 1 100 0 1 BIT_MASK 0x4 FORMAT "%13.11" ECU_ADDRESS 0x7FD45C /end MEASUREMENT
/begin MEASUREMENT B_fa "Bedingung Funktionsanforderung allgemein" UBYTE B_TRUE 1 100 0 1 BIT_MASK 0x1 FORMAT "%13.11" ECU_ADDRESS 0x7FBB03 /end MEASUREMENT
/begin MEASUREMENT B_faavr "" UBYTE B_TRUE 1 100 0 1 BIT_MASK 0x1 FORMAT "%13.11" ECU_ADDRESS 0x7FBB04 /end MEASUREMENT
/begin MEASUREMENT B_fadisa "" UBYTE B_TRUE 1 100 0 1 BIT_MASK 0x1 FORMAT "%13.11" ECU_ADDRESS 0x7FBB05 /end MEASUREMENT
/begin MEASUREMENT B_fadk "" UBYTE B_TRUE 1 100 0 1 BIT_MASK 0x1 FORMAT "%13.11" ECU_ADDRESS 0x7FBB06 /end MEASUREMENT
/begin MEASUREMENT B_fadka "" UBYTE B_TRUE 1 100 0 1 BIT_MASK 0x1 FORMAT "%13.11" ECU_ADDRESS 0x7FBB07 /end MEASUREMENT
/begin MEASUREMENT B_faevz "Bedingung Zylinderausblendung durch Tester" UBYTE B_TRUE 1 100 0 1 BIT_MASK 0x1 FORMAT "%13.11" ECU_ADDRESS 0x7FBB08 /end MEASUREMENT
/begin MEASUREMENT B_fallas "" UBYTE B_TRUE 1 100 0 1 BIT_MASK 0x1 FORMAT "%13.11" ECU_ADDRESS 0x7FBB09 /end MEASUREMENT
/begin MEASUREMENT B_falls "Bedingung: Funktionsanforderung Drehzahl‰nderung durch Tester" UBYTE B_TRUE 1 100 0 1 BIT_MASK 0x1 FORMAT "%13.11" ECU_ADDRESS 0x7FBB0A /end MEASUREMENT
/begin MEASUREMENT B_falr "Bedingung: Funktionsanforderung Lambdaregelung aus" UBYTE B_TRUE 1 100 0 1 BIT_MASK 0x1 FORMAT "%13.11" ECU_ADDRESS 0x7FBB0B /end MEASUREMENT
/begin MEASUREMENT B_falra "Bedingung: Funktionsanforderung Lambdaregelung-Adaption aus" UBYTE B_TRUE 1 100 0 1 BIT_MASK 0x1 FORMAT "%13.11" ECU_ADDRESS 0x7FBB0C /end MEASUREMENT
/begin MEASUREMENT B_falsv "Bedingung Funktionsanforderung Lambda-Sonde vor KAT" UBYTE B_TRUE 1 100 0 1 BIT_MASK 0x1 FORMAT "%13.11" ECU_ADDRESS 0x7FBB0D /end MEASUREMENT
/begin MEASUREMENT B_falsv2 "Bedingung Funktionsanforderung Lambda-Sonde vor KAT Bank2" UBYTE B_TRUE 1 100 0 1 BIT_MASK 0x1 FORMAT "%13.11" ECU_ADDRESS 0x7FBB0E /end MEASUREMENT
/begin MEASUREMENT B_fanws "Bedingung Funktionsanforderung Diagnose Nockenwellensteuerung" UBYTE B_TRUE 1 100 0 1 BIT_MASK 0x1 FORMAT "%13.11" ECU_ADDRESS 0x7FBB0F /end MEASUREMENT
/begin MEASUREMENT B_fanwsd "Bedingung Funktionsanforderung Nockenwellenregelung Dichtheit" UBYTE B_TRUE 1 100 0 1 BIT_MASK 0x1 FORMAT "%13.11" ECU_ADDRESS 0x7FBB10 /end MEASUREMENT
/begin MEASUREMENT B_fasls "Bedingung Funktionsanforderung Sekund‰rluftsystem" UBYTE B_TRUE 1 100 0 1 BIT_MASK 0x1 FORMAT "%13.11" ECU_ADDRESS 0x7FBB11 /end MEASUREMENT
/begin MEASUREMENT B_fates "Bedingung Funktionsanforderung Tankentl¸ftungssystem" UBYTE B_TRUE 1 100 0 1 BIT_MASK 0x1 FORMAT "%13.11" ECU_ADDRESS 0x7FBB12 /end MEASUREMENT
/begin MEASUREMENT B_fgrea_um "" UBYTE B_TRUE 1 100 0 1 BIT_MASK 0x80 FORMAT "%13.11" ECU_ADDRESS 0x7F8040 /end MEASUREMENT
/begin MEASUREMENT b_flags_um "Flag f¸r Bitinformationen in der Funktions¸berwachung" UBYTE dez 1 100 0 255 FORMAT "%5.1" ECU_ADDRESS 0x7F803C /end MEASUREMENT
/begin MEASUREMENT B_gangat "Getriebepotiadaption ¸ber Testereingriff" UBYTE B_TRUE 1 100 0 1 BIT_MASK 0x1 FORMAT "%13.11" ECU_ADDRESS 0x7FBB13 /end MEASUREMENT
/begin MEASUREMENT B_grdst "Bedingung Grundeinstellung" UBYTE B_TRUE 1 100 0 1 BIT_MASK 0x1 FORMAT "%13.11" ECU_ADDRESS 0x7FBB14 /end MEASUREMENT
/begin MEASUREMENT B_gwrte "Bedingung fr-Grenzwertregelung Tankentl¸ftung aktiv" UBYTE B_TRUE 1 100 0 1 BIT_MASK 0x1 FORMAT "%13.11" ECU_ADDRESS 0x7FBC40 /end MEASUREMENT
/begin MEASUREMENT B_hsv2et "" UBYTE B_TRUE 1 100 0 1 BIT_MASK 0x1 FORMAT "%13.11" ECU_ADDRESS 0x7FBB15 /end MEASUREMENT
/begin MEASUREMENT B_hsvet "" UBYTE B_TRUE 1 100 0 1 BIT_MASK 0x1 FORMAT "%13.11" ECU_ADDRESS 0x7FBB16 /end MEASUREMENT
/begin MEASUREMENT B_i_ska "Funktions-Fehlerreaktion irreversible SKA (Sicherheits-Kraftstoffabschaltung)" UBYTE B_TRUE 1 100 0 1 BIT_MASK 0x4 FORMAT "%13.11" ECU_ADDRESS 0x7F803E /end MEASUREMENT
/begin MEASUREMENT B_kkl_um "erkannter Low-Pegel am FGR-Bedienhebelschalter Kontrollkontakt in Funktions¸berw" UBYTE B_TRUE 1 100 0 1 BIT_MASK 0x8 FORMAT "%13.11" ECU_ADDRESS 0x7F8040 /end MEASUREMENT
/begin MEASUREMENT B_krzwsol "" UBYTE B_TRUE 1 100 0 1 BIT_MASK 0x1 FORMAT "%13.11" ECU_ADDRESS 0x7FBC50 /end MEASUREMENT
/begin MEASUREMENT B_kwdreht "" UBYTE B_TRUE 1 100 0 1 BIT_MASK 0x20 FORMAT "%13.11" ECU_ADDRESS 0x7FD47A /end MEASUREMENT
/begin MEASUREMENT B_kwluecke "" UBYTE B_TRUE 1 100 0 1 BIT_MASK 0x8 FORMAT "%13.11" ECU_ADDRESS 0x7FD47A /end MEASUREMENT
/begin MEASUREMENT B_llzwe "" UBYTE B_TRUE 1 100 0 1 BIT_MASK 0x1 FORMAT "%13.11" ECU_ADDRESS 0x7FBC51 /end MEASUREMENT
/begin MEASUREMENT B_lrar "Bedingung reduzierte Korrekturbereiche in der LRA" UBYTE B_TRUE 1 100 0 1 BIT_MASK 0x1 FORMAT "%13.11" ECU_ADDRESS 0x7FBC41 /end MEASUREMENT
/begin MEASUREMENT B_m9cvn "Bedingung zur Berechnung der Checksumme (CVN) nach SAE/ISO Mode/Service $09" UBYTE B_TRUE 1 100 0 1 BIT_MASK 0x1 FORMAT "%13.11" ECU_ADDRESS 0x7FBB1E /end MEASUREMENT
/begin MEASUREMENT B_m9cvnTmp "" UBYTE B_TRUE 1 100 0 1 BIT_MASK 0x1 FORMAT "%13.11" ECU_ADDRESS 0x7FBB1F /end MEASUREMENT
/begin MEASUREMENT B_milet "" UBYTE B_TRUE 1 100 0 1 BIT_MASK 0x1 FORMAT "%13.11" ECU_ADDRESS 0x7FBB17 /end MEASUREMENT
/begin MEASUREMENT B_mzns_um "Nachstartaufweitung des zul. Moments aktiv f¸r die Fkt.-‹berwachung" UBYTE B_TRUE 1 100 0 1 BIT_MASK 0x1 FORMAT "%13.11" ECU_ADDRESS 0x7F8036 /end MEASUREMENT
/begin MEASUREMENT B_naccf_um "" UBYTE B_TRUE 1 100 0 1 BIT_MASK 0x40 FORMAT "%13.11" ECU_ADDRESS 0x7F8040 /end MEASUREMENT
/begin MEASUREMENT B_neusync "" UBYTE B_TRUE 1 100 0 1 BIT_MASK 0x1 FORMAT "%13.11" ECU_ADDRESS 0x7FD47A /end MEASUREMENT
/begin MEASUREMENT B_nkoff "Bedinung wenn Nebenkerze nicht gezuendet wird" UBYTE B_TRUE 1 100 0 1 BIT_MASK 0x1 FORMAT "%13.11" ECU_ADDRESS 0x7FBC54 /end MEASUREMENT
/begin MEASUREMENT B_nlh_um "Anforderung Notlauf  mit Lambda 1 aus Funktions¸berwachung" UBYTE B_TRUE 1 100 0 1 BIT_MASK 0x1 FORMAT "%13.11" ECU_ADDRESS 0x7F803C /end MEASUREMENT
/begin MEASUREMENT B_nlimit "" UBYTE B_TRUE 1 100 0 1 BIT_MASK 0x10 FORMAT "%13.11" ECU_ADDRESS 0x7FD47A /end MEASUREMENT
/begin MEASUREMENT B_nlph "Bedingung kein Phasensignal von den Phasengebern" UBYTE B_TRUE 1 100 0 1 BIT_MASK 0x1 FORMAT "%13.11" ECU_ADDRESS 0x7FB90C /end MEASUREMENT
/begin MEASUREMENT B_nmaxsyn "" UBYTE B_TRUE 1 100 0 1 BIT_MASK 0x80 FORMAT "%13.11" ECU_ADDRESS 0x7FD45D /end MEASUREMENT
/begin MEASUREMENT B_nmin "Bedingung Unterdrehzahl: n < NMIN" UBYTE B_TRUE 1 100 0 1 BIT_MASK 0x1 FORMAT "%13.11" ECU_ADDRESS 0x7FBAAA /end MEASUREMENT
/begin MEASUREMENT B_nmot "Bedingung Motordrehzahl: n > NMIN" UBYTE B_TRUE 1 100 0 1 BIT_MASK 0x1 FORMAT "%13.11" ECU_ADDRESS 0x7FBAAB /end MEASUREMENT
/begin MEASUREMENT B_nomsr_um "MSR-Momentenvorgabe in der Funktions¸berwachung nicht ¸bernommen" UBYTE B_TRUE 1 100 0 1 BIT_MASK 0x1 FORMAT "%13.11" ECU_ADDRESS 0x7F8030 /end MEASUREMENT
/begin MEASUREMENT B_notlu "Anforderung Notluftfahren aus der Funktion" UBYTE B_TRUE 1 100 0 1 BIT_MASK 0x8 FORMAT "%13.11" ECU_ADDRESS 0x7F803E /end MEASUREMENT
/begin MEASUREMENT B_nouetm "Bedingung keine ‹bertemperatur im Nachlauf" UBYTE B_TRUE 1 100 0 1 BIT_MASK 0x1 FORMAT "%13.11" ECU_ADDRESS 0x7F9B51 /end MEASUREMENT
/begin MEASUREMENT B_nsakt_um "Nachstart aktiv f¸r die Fkt.-‹berwachung" UBYTE B_TRUE 1 100 0 1 BIT_MASK 0x4 FORMAT "%13.11" ECU_ADDRESS 0x7F803D /end MEASUREMENT
/begin MEASUREMENT B_nsegment "" UBYTE B_TRUE 1 100 0 1 BIT_MASK 0x80 FORMAT "%13.11" ECU_ADDRESS 0x7FD47A /end MEASUREMENT
/begin MEASUREMENT B_nsend_um "Nachstart¸berwachungszeit abgelaufen f¸r die Fkt.-‹berwachung" UBYTE B_TRUE 1 100 0 1 BIT_MASK 0x1 FORMAT "%13.11" ECU_ADDRESS 0x7F803D /end MEASUREMENT
/begin MEASUREMENT B_nwcheck1 "" UBYTE B_TRUE 1 100 0 1 BIT_MASK 0x1 FORMAT "%13.11" ECU_ADDRESS 0x7FD45D /end MEASUREMENT
/begin MEASUREMENT B_nwcheck2 "" UBYTE B_TRUE 1 100 0 1 BIT_MASK 0x2 FORMAT "%13.11" ECU_ADDRESS 0x7FD45D /end MEASUREMENT
/begin MEASUREMENT B_nwcheck3 "Synchronisation abgeschlissen Test erfolgreich" UBYTE B_TRUE 1 100 0 1 BIT_MASK 0x4 FORMAT "%13.11" ECU_ADDRESS 0x7FD45D /end MEASUREMENT
/begin MEASUREMENT B_nwfehler "NW-Fehler, Synchronisationstest nicht erfolgreich" UBYTE B_TRUE 1 100 0 1 BIT_MASK 0x8 FORMAT "%13.11" ECU_ADDRESS 0x7FD45D /end MEASUREMENT
/begin MEASUREMENT B_nwsyn "" UBYTE B_TRUE 1 100 0 1 BIT_MASK 0x40 FORMAT "%13.11" ECU_ADDRESS 0x7FD45D /end MEASUREMENT
/begin MEASUREMENT B_nwtest "" UBYTE B_TRUE 1 100 0 1 BIT_MASK 0x1 FORMAT "%13.11" ECU_ADDRESS 0x7FBB20 /end MEASUREMENT
/begin MEASUREMENT B_nwturn "" UBYTE B_TRUE 1 100 0 1 BIT_MASK 0x20 FORMAT "%13.11" ECU_ADDRESS 0x7FD45D /end MEASUREMENT
/begin MEASUREMENT B_nxptr_um "" UBYTE B_TRUE 1 100 0 1 BIT_MASK 0x1 FORMAT "%13.11" ECU_ADDRESS 0x7FB90B /end MEASUREMENT
/begin MEASUREMENT B_nxtrp_um "Bedingung f¸r n‰chste Antwort korrekt an das UM ausgeben in der F‹" UBYTE B_TRUE 1 100 0 1 BIT_MASK 0x1 FORMAT "%13.11" ECU_ADDRESS 0x7FB908 /end MEASUREMENT
/begin MEASUREMENT B_qtedab "Bedingung schnelle Absteuerung der Sp¸lrate" UBYTE B_TRUE 1 100 0 1 BIT_MASK 0x1 FORMAT "%13.11" ECU_ADDRESS 0x7FBC46 /end MEASUREMENT
/begin MEASUREMENT B_reaci_um "" UBYTE B_TRUE 1 100 0 1 BIT_MASK 0x10 FORMAT "%13.11" ECU_ADDRESS 0x7F803E /end MEASUREMENT
/begin MEASUREMENT B_rlini_um "" UBYTE B_TRUE 1 100 0 1 BIT_MASK 0x2 FORMAT "%13.11" ECU_ADDRESS 0x7F803C /end MEASUREMENT
/begin MEASUREMENT B_rluf_um "" UBYTE B_TRUE 1 100 0 1 BIT_MASK 0x4 FORMAT "%13.11" ECU_ADDRESS 0x7F803C /end MEASUREMENT
/begin MEASUREMENT B_slvet "Stellglieddiagnose SLV: Eingriff Tester" UBYTE B_TRUE 1 100 0 1 BIT_MASK 0x1 FORMAT "%13.11" ECU_ADDRESS 0x7FBB18 /end MEASUREMENT
/begin MEASUREMENT B_sperrEKP "" UBYTE B_TRUE 1 100 0 1 BIT_MASK 0x1 FORMAT "%13.11" ECU_ADDRESS 0x7F9C36 /end MEASUREMENT
/begin MEASUREMENT B_srstz_um "Software-Reset-Anforderung aus der zyklischen ROM-Absicherung der Fkt-‹berwach." UBYTE B_TRUE 1 100 0 1 BIT_MASK 0x80 FORMAT "%13.11" ECU_ADDRESS 0x7F803E /end MEASUREMENT
/begin MEASUREMENT B_srst_um "Software-Reset-Anforderung aus der zyklischen RAM-Absicherung der Fkt-‹berwach." UBYTE B_TRUE 1 100 0 1 BIT_MASK 0x40 FORMAT "%13.11" ECU_ADDRESS 0x7F803E /end MEASUREMENT
/begin MEASUREMENT B_synph "Bedingung Synchronisation Phase" UBYTE B_TRUE 1 100 0 1 BIT_MASK 0x2 FORMAT "%13.11" ECU_ADDRESS 0x7FD3D8 /end MEASUREMENT
/begin MEASUREMENT B_te "Bedingung Tankentl¸ftung" UBYTE B_TRUE 1 100 0 1 BIT_MASK 0x1 FORMAT "%13.11" ECU_ADDRESS 0x7FBC47 /end MEASUREMENT
/begin MEASUREMENT B_teabb "Bedingung Tankentl¸ftung abbruchbereit" UBYTE B_TRUE 1 100 0 1 BIT_MASK 0x1 FORMAT "%13.11" ECU_ADDRESS 0x7FBC42 /end MEASUREMENT
/begin MEASUREMENT B_teakt "Bedingung Tankentl¸ftung aktiv (normaler Betrieb oder Notlauf)" UBYTE B_TRUE 1 100 0 1 BIT_MASK 0x1 FORMAT "%13.11" ECU_ADDRESS 0x7FBC43 /end MEASUREMENT
/begin MEASUREMENT B_tef "Bedingung Tankentl¸ftung prinzipiell freigegeben" UBYTE B_TRUE 1 100 0 1 BIT_MASK 0x1 FORMAT "%13.11" ECU_ADDRESS 0x7FBC48 /end MEASUREMENT
/begin MEASUREMENT B_tehb "Bedingung Tankentl¸ftung mit hoher Beladung" UBYTE B_TRUE 1 100 0 1 BIT_MASK 0x1 FORMAT "%13.11" ECU_ADDRESS 0x7FBC44 /end MEASUREMENT
/begin MEASUREMENT B_tehbx "Bedingung Beladungsintegrator ftead am Maximalanschlag" UBYTE B_TRUE 1 100 0 1 BIT_MASK 0x1 FORMAT "%13.11" ECU_ADDRESS 0x7FBC45 /end MEASUREMENT
/begin MEASUREMENT B_tei "Bedingung Tankentl¸ftung funktionsintern" UBYTE B_TRUE 1 100 0 1 BIT_MASK 0x1 FORMAT "%13.11" ECU_ADDRESS 0x7FBC49 /end MEASUREMENT
/begin MEASUREMENT B_ten "Bedingung Tankentl¸ftung im Notlaufbetrieb (ohne Lambdaregelung)" UBYTE B_TRUE 1 100 0 1 BIT_MASK 0x1 FORMAT "%13.11" ECU_ADDRESS 0x7FBC4A /end MEASUREMENT
/begin MEASUREMENT B_tenmda "Notlauf TE beim Aussetzer" UBYTE B_TRUE 1 100 0 1 BIT_MASK 0x1 FORMAT "%13.11" ECU_ADDRESS 0x7FD7A4 /end MEASUREMENT
/begin MEASUREMENT B_tevet "Condition purge valve on by tester" UBYTE B_TRUE 1 100 0 1 BIT_MASK 0x1 FORMAT "%13.11" ECU_ADDRESS 0x7FBB19 /end MEASUREMENT
/begin MEASUREMENT B_tevqoff "" UBYTE B_TRUE 1 100 0 1 BIT_MASK 0x1 FORMAT "%13.11" ECU_ADDRESS 0x7FBC4B /end MEASUREMENT
/begin MEASUREMENT B_tprell "" UBYTE B_TRUE 1 100 0 1 BIT_MASK 0x2 FORMAT "%13.11" ECU_ADDRESS 0x7FD47A /end MEASUREMENT
/begin MEASUREMENT B_tpuaktiv "" UBYTE B_TRUE 1 100 0 1 BIT_MASK 0x40 FORMAT "%13.11" ECU_ADDRESS 0x7FD47A /end MEASUREMENT
/begin MEASUREMENT B_tpu_um "" UBYTE B_TRUE 1 100 0 1 BIT_MASK 0x20 FORMAT "%13.11" ECU_ADDRESS 0x7F803E /end MEASUREMENT
/begin MEASUREMENT B_ub_ska "Batteriespannung nicht o.k., Unterspannungsabschaltung aktiv" UBYTE B_TRUE 1 100 0 1 BIT_MASK 0x2 FORMAT "%13.11" ECU_ADDRESS 0x7F803E /end MEASUREMENT
/begin MEASUREMENT B_uetm "Bedingung ‹bertemperatur" UBYTE B_TRUE 1 100 0 1 BIT_MASK 0x1 FORMAT "%13.11" ECU_ADDRESS 0x7FB9A4 /end MEASUREMENT
/begin MEASUREMENT B_uetmc "Bedingung ‹bertemperatur; CAN-Sende-Botschaft" UBYTE B_TRUE 1 100 0 1 BIT_MASK 0x1 FORMAT "%13.11" ECU_ADDRESS 0x7FB9A5 /end MEASUREMENT
/begin MEASUREMENT B_uetmcet "" UBYTE B_TRUE 1 100 0 1 BIT_MASK 0x1 FORMAT "%13.11" ECU_ADDRESS 0x7FBB1A /end MEASUREMENT
/begin MEASUREMENT B_vmax "Bedingung VMAX-Regelung aktiv" UBYTE B_TRUE 1 100 0 1 BIT_MASK 0x1 FORMAT "%13.11" ECU_ADDRESS 0x7FBB6A /end MEASUREMENT
/begin MEASUREMENT B_vsiReset "" UBYTE B_TRUE 1 100 0 1 BIT_MASK 0x1 FORMAT "%13.11" ECU_ADDRESS 0x7FBB1B /end MEASUREMENT
/begin MEASUREMENT B_vzl_um "erkannter Low-Pegel am FGR-Bedienhebelschalter Verzˆgern in der Funktions¸berw." UBYTE B_TRUE 1 100 0 1 BIT_MASK 0x1 FORMAT "%13.11" ECU_ADDRESS 0x7F8040 /end MEASUREMENT
/begin MEASUREMENT B_waittpo "" UBYTE B_TRUE 1 100 0 1 BIT_MASK 0x10 FORMAT "%13.11" ECU_ADDRESS 0x7FD45D /end MEASUREMENT
/begin MEASUREMENT B_wal_um "erkannter Low-Pegel am FGR-Bedienhebelschalter Wiederaufnahme in Funktions¸berw." UBYTE B_TRUE 1 100 0 1 BIT_MASK 0x4 FORMAT "%13.11" ECU_ADDRESS 0x7F8040 /end MEASUREMENT
/begin MEASUREMENT B_wkora "" UBYTE B_TRUE 1 100 0 1 BIT_MASK 0x1 FORMAT "%13.11" ECU_ADDRESS 0x7FBC55 /end MEASUREMENT
/begin MEASUREMENT B_zndaus "Bedingung Z¸ndungsausblendung aktiv" UBYTE B_TRUE 1 100 0 1 BIT_MASK 0x1 FORMAT "%13.11" ECU_ADDRESS 0x7FBC4F /end MEASUREMENT
/begin MEASUREMENT B_zprell "" UBYTE B_TRUE 1 100 0 1 BIT_MASK 0x4 FORMAT "%13.11" ECU_ADDRESS 0x7FD47A /end MEASUREMENT
/begin MEASUREMENT B_zwkra "Bedingung: Z¸ndwinkel der KR wird ausgegeben" UBYTE B_TRUE 1 100 0 1 BIT_MASK 0x1 FORMAT "%13.11" ECU_ADDRESS 0x7FBC52 /end MEASUREMENT
/begin MEASUREMENT B_zwmnste "Bedingung Abregelung der Z¸ndwinkelsp‰tbegrenzung erf¸llt" UBYTE B_TRUE 1 100 0 1 BIT_MASK 0x1 FORMAT "%13.11" ECU_ADDRESS 0x7FBC56 /end MEASUREMENT
/begin MEASUREMENT B_zwms "Bedingung Motorschutz-Z¸ndwinkelbegrenzung" UBYTE B_TRUE 1 100 0 1 BIT_MASK 0x1 FORMAT "%13.11" ECU_ADDRESS 0x7FBC57 /end MEASUREMENT
/begin MEASUREMENT B_zwspae "Bedingung: Z¸ndwinkel zwspae bei Schubabschaltung wird ausgegeben" UBYTE B_TRUE 1 100 0 1 BIT_MASK 0x1 FORMAT "%13.11" ECU_ADDRESS 0x7FBC53 /end MEASUREMENT
/begin MEASUREMENT devoff "EV-Ausblendmaske bei Testeranforderung" UBYTE dez 1 100 0 255 FORMAT "%5.1" ECU_ADDRESS 0x7FC0BD /end MEASUREMENT
/begin MEASUREMENT dftef_w "Eingang Integrator Sp¸lrate" SWORD perio_sw_b1p562 1 100 -1.562 1.56195 FORMAT "%8.6" ECU_ADDRESS 0x7FE068 /end MEASUREMENT
/begin MEASUREMENT dkhc_w "Eingang Integrator HC-Konzentration" SWORD perio_sw_b6p125 1 100 -6.125 6.12481 FORMAT "%8.6" ECU_ADDRESS 0x7FD79C /end MEASUREMENT
/begin MEASUREMENT dmlftef "Produkt Sp¸lrate mal prozentuale Luftmassen‰nderung" UBYTE fak_ub_b0p5 1 100 0 0.498047 ECU_ADDRESS 0x7FDAD8 /end MEASUREMENT
/begin MEASUREMENT dmssginr "relative ƒnderung des Massenstromes mssgin_w" SBYTE fak_sb_b1 1 100 -1 0.992188 FORMAT "%5.3" ECU_ADDRESS 0x7FDAD9 /end MEASUREMENT
/begin MEASUREMENT dmvmxi_w "Drehmoment I-Anteil bei VMAX-Regelung" SWORD rel_sw_b100 1 100 -100 99.9969 FORMAT "%8.4" ECU_ADDRESS 0x7FDF7A /end MEASUREMENT
/begin MEASUREMENT dmvmxp_w "Drehmoment P-Anteil bei VMAX-Regelung" SWORD rel_sw_b100 1 100 -100 99.9969 FORMAT "%8.4" ECU_ADDRESS 0x7FDF7C /end MEASUREMENT
/begin MEASUREMENT dphBits2_200ms "" UBYTE dez 1 100 0 255 FORMAT "%5.1" ECU_ADDRESS 0x7FD3D8 /end MEASUREMENT
/begin MEASUREMENT drrev_sta "" UBYTE dez 1 100 0 255 FORMAT "%5.1" ECU_ADDRESS 0x7FD830 /end MEASUREMENT
/begin MEASUREMENT dstert20_w "Normierte Weitertransportstrecke Regeneriergas im Saugrohr im 20ms-Raster" UWORD fak_uw_b2 1 100 0 1.99997 FORMAT "%8.6" ECU_ADDRESS 0x7FE06A /end MEASUREMENT
/begin MEASUREMENT dvprae_w "Pr‰dizierter Geschwindigkeitsanteil" UWORD vfzg_uw_q0p00781 1 100 0 511.992 FORMAT "%8.4" ECU_ADDRESS 0x7FDF7E /end MEASUREMENT
/begin MEASUREMENT dvsi_w "Abweichung zwischen Soll- und Istgeschwindigkeit der VMAX-Regelung" SWORD vfzg_sw_q0p00781 1 100 -256 255.992 FORMAT "%8.4" ECU_ADDRESS 0x7FDF80 /end MEASUREMENT
/begin MEASUREMENT Dzw "" SWORD Def_kw_sw_q0p0234 1 100 -768 767.977 FORMAT "%8.4" ARRAY_SIZE 4 ECU_ADDRESS 0x7FD436 /end MEASUREMENT
/begin MEASUREMENT dzwekr "ZW-Korrektur bei Bedingung Klopfregelung Sicherheitsz¸ndwinkel" SBYTE zw_sb_q0p75 1 100 -96 95.25 FORMAT "%5.2" ECU_ADDRESS 0x7FDB07 /end MEASUREMENT
/begin MEASUREMENT dzwkg "ZW-Korrektur bei Klopfgrenzenverschiebung" SWORD zw_sb_q0p75 1 100 -24576 24575.3 FORMAT "%8.2" ECU_ADDRESS 0x7FE09C /end MEASUREMENT
/begin MEASUREMENT dzwmna "Delta-Z¸ndwinkel Minimum" SBYTE zw_sb_q0p75 1 100 -96 95.25 FORMAT "%5.2" ECU_ADDRESS 0x7FDB0C /end MEASUREMENT
/begin MEASUREMENT dzwspae "Korrektur-Z¸ndwinkel f¸r den sp‰test erlaubten Z¸ndwinkel" SBYTE zw_sb_q0p75 1 100 -96 95.25 FORMAT "%5.2" ECU_ADDRESS 0x7FDB0D /end MEASUREMENT
/begin MEASUREMENT dzwtans "Rover" SBYTE zw_sb_q0p75 1 100 -96 95.25 FORMAT "%5.2" ECU_ADDRESS 0x7FDB08 /end MEASUREMENT
/begin MEASUREMENT dzwtantmot "" SWORD zw_sb_q0p75 1 100 -24576 24575.3 FORMAT "%8.2" ECU_ADDRESS 0x7FE09E /end MEASUREMENT
/begin MEASUREMENT dzwtgew "Drehzahl-Last gewichtete ZW-Korrektur nach fr¸h/sp‰t" SBYTE zw_sb_q0p75 1 100 -96 95.25 FORMAT "%5.2" ECU_ADDRESS 0x7FDB09 /end MEASUREMENT
/begin MEASUREMENT dzwtmot "Rover" SBYTE zw_sb_q0p75 1 100 -96 95.25 FORMAT "%5.2" ECU_ADDRESS 0x7FDB0A /end MEASUREMENT
/begin MEASUREMENT dzwwl "Delta Zuendwinkel aus Warmlauf" SBYTE zw_sb_q0p75 1 100 -96 95.25 FORMAT "%5.2" ECU_ADDRESS 0x7FDB16 /end MEASUREMENT
/begin MEASUREMENT ei_msrc_um "irreversibles Fehlerbit bei der MSR-‹berwachung der Funktions¸berwachung" UBYTE B_TRUE 1 100 0 1 BIT_MASK 0x1 FORMAT "%13.11" ECU_ADDRESS 0x7F8031 /end MEASUREMENT
/begin MEASUREMENT ei_tpu_um "Irreversibles Fehlerbit der TPU-‹berwachung in der Funktions¸berwachung" UBYTE B_TRUE 1 100 0 1 BIT_MASK 0x1 FORMAT "%13.11" ECU_ADDRESS 0x7F8080 /end MEASUREMENT
/begin MEASUREMENT ei_ubr_um "irrev. Fehlerbit zur Anforderung Fehlereintrag Hauptrelais-Diagnose aus %UMAUSC" UBYTE B_TRUE 1 100 0 1 BIT_MASK 0x1 FORMAT "%13.11" ECU_ADDRESS 0x7F8075 /end MEASUREMENT
/begin MEASUREMENT Eoi "" SWORD Def_kw_sw_q0p0234 1 100 -768 767.977 FORMAT "%8.4" ARRAY_SIZE 2 ECU_ADDRESS 0x7FD49C /end MEASUREMENT
/begin MEASUREMENT esst_sbf02mfsb "" ULONG dez 1 100 0 4.29497e+009 FORMAT "%13.2" ECU_ADDRESS 0x7FE4B0 /end MEASUREMENT
/begin MEASUREMENT esst_srl03mfuw "" ULONG dez 1 100 0 4.29497e+009 FORMAT "%13.2" ECU_ADDRESS 0x7FE4B4 /end MEASUREMENT
/begin MEASUREMENT etate "Motorwirkungsgrad bei Tankentl¸ftung mit hoher Beladung" UBYTE rel_ub_b127p5 1 100 0 127.5 FORMAT "%5.1" ECU_ADDRESS 0x7FD792 /end MEASUREMENT
/begin MEASUREMENT etateint "Integrator Motrwirkungsgrad bei Tankentl¸ftung" UBYTE rel_ub_b127p5 1 100 0 127.5 FORMAT "%5.1" ECU_ADDRESS 0x7FD793 /end MEASUREMENT
/begin MEASUREMENT etatesol "beladungsabh‰ngiger Soll-Motorwirkungsgrad bei Betrieb mit Tankentl¸ftung" UBYTE rel_ub_b127p5 1 100 0 127.5 FORMAT "%5.1" ECU_ADDRESS 0x7FD794 /end MEASUREMENT
/begin MEASUREMENT etazwmn "Minimum-Z¸ndwinkelwirkungsgrad" UBYTE rel_ub_b127p5 1 100 0 127.5 FORMAT "%5.1" ECU_ADDRESS 0x7FBCE1 /end MEASUREMENT
/begin MEASUREMENT e_mem_um "Errorflag im DauerRAM f¸r Fehler im zyklischen Speichertest in der FU" UBYTE B_TRUE 1 100 0 1 BIT_MASK 0x1 FORMAT "%13.11" ECU_ADDRESS 0x7F9AB0 /end MEASUREMENT
/begin MEASUREMENT e_ram_um "Errorflag im DauerRAM f¸r RAM-Fehler in der Funktions¸berwachung" UBYTE B_TRUE 1 100 0 1 BIT_MASK 0x1 FORMAT "%13.11" ECU_ADDRESS 0x7F9ABA /end MEASUREMENT
/begin MEASUREMENT e_rom1_um "Errorflag im DauerRAM f¸r Fehler nur in einer ROM-Page in der Fkt.¸berwachung" UBYTE B_TRUE 1 100 0 1 BIT_MASK 0x1 FORMAT "%13.11" ECU_ADDRESS 0x7F9ABB /end MEASUREMENT
/begin MEASUREMENT e_romx_um "Errorflag im DauerRAM f¸r Fehler in mehreren ROM-Pages in der Fkt.¸berwachung" UBYTE B_TRUE 1 100 0 1 BIT_MASK 0x1 FORMAT "%13.11" ECU_ADDRESS 0x7F9ABC /end MEASUREMENT
/begin MEASUREMENT fakdzw "Faktor Gewwichtung frueh/spaet Verstellung Z¸ndwinkel" SWORD fak_sw_b16 1 100 -16 15.9995 FORMAT "%8.5" ECU_ADDRESS 0x7FD7A8 /end MEASUREMENT
/begin MEASUREMENT fakdzwwl "" UBYTE fak_ub_b1 1 100 0 0.996094 ECU_ADDRESS 0x7FDB17 /end MEASUREMENT
/begin MEASUREMENT faknznseg "" UBYTE fak_ub_b2 1 100 0 1.99219 FORMAT "%5.3" ECU_ADDRESS 0x7FD866 /end MEASUREMENT
/begin MEASUREMENT fbetate "gew¸nschter Motorwirkungsgrad als f(nmot) bei TE zur Vermeidung von te <= TEMIN" UBYTE fak_ub_b1 1 100 0 0.996094 ECU_ADDRESS 0x7FD795 /end MEASUREMENT
/begin MEASUREMENT fbkate "Faktor Kraftstoffanteil Tankentl¸ftung abh‰ngig von te / TEMIN" UBYTE fak_ub_b1 1 100 0 0.996094 ECU_ADDRESS 0x7FDADA /end MEASUREMENT
/begin MEASUREMENT Fenster "" UBYTE dez 1 100 0 255 FORMAT "%5.1" ECU_ADDRESS 0x7FA471 /end MEASUREMENT
/begin MEASUREMENT fgwrte "Eingriff Grenzwertregelung Tankentl¸ftung" SBYTE perio_ub_b0p012207 1 100 -0.0061035 0.00605582 FORMAT "%8.6" ECU_ADDRESS 0x7FD796 /end MEASUREMENT
/begin MEASUREMENT fkateapp "Faktor applizierter Krafstoffanteil Tankentl¸ftung" UWORD rel_uw_b3072 1 100 0 3071.95 FORMAT "%8.3" ECU_ADDRESS 0x7FE06C /end MEASUREMENT
/begin MEASUREMENT fkatei "Faktor Kraftstoffanteil Tankentl¸ftung (aktueller Istwert)" SBYTE fak_sb_b1 1 100 -1 0.992188 FORMAT "%5.3" ECU_ADDRESS 0x7FDADB /end MEASUREMENT
/begin MEASUREMENT fkates "Faktor Kraftstoffanteil Tankentl¸ftung (Sollwert)" UWORD rel_uw_b3072 1 100 0 3071.95 FORMAT "%8.3" ECU_ADDRESS 0x7FE06E /end MEASUREMENT
/begin MEASUREMENT frerr_c_um "FR-Fehlerz‰hler f¸r Differenz FZ-R¸ckmeldung/FZ-Erwartungswert in der Fkt.¸berw." UBYTE dez 1 100 0 255 FORMAT "%5.1" ECU_ADDRESS 0x7F8074 /end MEASUREMENT
/begin MEASUREMENT frmit "Bei Stereo-LR: Mittelwert des fr,fr2 oder bei Ausfall einer Bank: fr der i.O. Bk" UBYTE fak_ub_b2 1 100 0 1.99219 FORMAT "%5.3" ECU_ADDRESS 0x7FDADC /end MEASUREMENT
/begin MEASUREMENT frmit_w "Mittelwert aus fr und fr2 (16 bit)" UWORD fak_uw_b2 1 100 0 1.99997 FORMAT "%8.6" ECU_ADDRESS 0x7FE070 /end MEASUREMENT
/begin MEASUREMENT frmxa "fr-Max-Auschlag: Bei Stereo-LR: der fr, der am weitesten von 1.0 entfernt" UBYTE fak_ub_b2 1 100 0 1.99219 FORMAT "%5.3" ECU_ADDRESS 0x7FDADD /end MEASUREMENT
/begin MEASUREMENT frmxaold_w "Mittelwert Lambdaregler - alter Wert (16 bit)" UWORD fak_uw_b2 1 100 0 1.99997 FORMAT "%8.6" ECU_ADDRESS 0x7FE072 /end MEASUREMENT
/begin MEASUREMENT frmxa_w "fr-Max-Ausschlag: Bei Stereo LR der fr, der am weitesten von 1.0 weg (16 bit)" UWORD fak_uw_b2 1 100 0 1.99997 FORMAT "%8.6" ECU_ADDRESS 0x7FE074 /end MEASUREMENT
/begin MEASUREMENT frtar_c_um "Funktionsrechner Fehlerz‰hler-Erwartungswert der Funktions¸berwachung" UBYTE dez 1 100 0 255 FORMAT "%5.1" ECU_ADDRESS 0x7FD878 /end MEASUREMENT
/begin MEASUREMENT ftadmste "Bewrtungsfaktor f¸r Absteuern des TEV bei dynamischer Vorg‰nge" UBYTE fak_ub_b2 1 100 0 1.99219 FORMAT "%5.3" ECU_ADDRESS 0x7FDADE /end MEASUREMENT
/begin MEASUREMENT fteadf "gefilteter Faktor Beladung Sp¸lstrom bei Tankentl¸ftung" SBYTE fak_sb_q0p5 1 100 -64 63.5 FORMAT "%5.2" ECU_ADDRESS 0x7FD797 /end MEASUREMENT
/begin MEASUREMENT fteadf_w "gefilteter Faktor Beladung Sp¸lstrom bei Tankentl¸ftung (16 Bit)" SWORD fak_q0p00195 1 100 -64 63.998 FORMAT "%8.5" ECU_ADDRESS 0x7FD79E /end MEASUREMENT
/begin MEASUREMENT ftead_w "Beladung des Aktivkohlefilters" SWORD fak_sw_b64 1 100 -64 63.998 FORMAT "%8.5" ECU_ADDRESS 0x7FD7A0 /end MEASUREMENT
/begin MEASUREMENT ftefsold_w "Letzter Sollwert der Sp¸lrate Tankentl¸ftung vor Absteuerung" UWORD fak_uw_b0p5 1 100 0 0.499992 FORMAT "%9.7" ECU_ADDRESS 0x7FE076 /end MEASUREMENT
/begin MEASUREMENT ftefsoll_w "Sollwert der Sp¸lrate Tankentl¸ftung" UWORD fak_uw_b0p5 1 100 0 0.499992 FORMAT "%9.7" ECU_ADDRESS 0x7FE078 /end MEASUREMENT
/begin MEASUREMENT ftefva "Sp¸lrate der Tankentl¸ftung" UBYTE fak_ub_b0p5 1 100 0 0.498047 ECU_ADDRESS 0x7FDADF /end MEASUREMENT
/begin MEASUREMENT ftefvab "Begrenzungswert der Sp¸lrate Tankentl¸ftung" UBYTE fak_ub_b0p03125 1 100 0 0.0311279 FORMAT "%7.5" ECU_ADDRESS 0x7FD798 /end MEASUREMENT
/begin MEASUREMENT ftefvamx_w "max. Sp¸lrate (Begrenzung absolut, 16 bit)" UWORD fak_uw_b0p5 1 100 0 0.499992 FORMAT "%9.7" ECU_ADDRESS 0x7FE07A /end MEASUREMENT
/begin MEASUREMENT ftefva_w "Sp¸lrate Tankentl¸ftung" UWORD fak_uw_b0p5 1 100 0 0.499992 FORMAT "%9.7" ECU_ADDRESS 0x7FE07C /end MEASUREMENT
/begin MEASUREMENT fteml "Aufsteuergeschwindigkeit der Sp¸lrate und des Massenstroms TEV" SBYTE perio_ub_b0p012207 1 100 -0.0061035 0.00605582 FORMAT "%8.6" ECU_ADDRESS 0x7FD799 /end MEASUREMENT
/begin MEASUREMENT fvermte_w "Faktor Vermischung Regeneriergas im Saugrohr" UWORD fak_uw_b1 1 100 0 0.999985 FORMAT "%9.7" ECU_ADDRESS 0x7FE07E /end MEASUREMENT
/begin MEASUREMENT hsv2tim "" UBYTE dez 1 100 0 255 FORMAT "%5.1" ECU_ADDRESS 0x7FC0BE /end MEASUREMENT
/begin MEASUREMENT hsvtim "" UBYTE dez 1 100 0 255 FORMAT "%5.1" ECU_ADDRESS 0x7FC0BF /end MEASUREMENT
/begin MEASUREMENT imsteini "Integral Massenstrom TEV nach l‰ngerem TE-Stop" UBYTE m_ub_q0p0444 1 100 0 11.322 FORMAT "%5.2" ECU_ADDRESS 0x7FD79A /end MEASUREMENT
/begin MEASUREMENT inisynmon "Monitor-Array mit Gr¸nden der letzten Anforderung einer Neusynchronisation" UWORD dez 1 100 0 65535 FORMAT "%8.2" ARRAY_SIZE 2 ECU_ADDRESS 0x7FE158 /end MEASUREMENT
/begin MEASUREMENT Intdrift "" SWORD dez 1 100 -32768 32767 FORMAT "%8.2" ECU_ADDRESS 0x7FA474 /end MEASUREMENT
/begin MEASUREMENT ivmax "Initialisierungswert Integrator f¸r VMAX-Regelung" SBYTE rel_sb_q0p78 1 100 -99.84 99.06 FORMAT "%5.2" ECU_ADDRESS 0x7FDA79 /end MEASUREMENT
/begin MEASUREMENT Kbstest_cnt "" UBYTE dez 1 100 0 255 FORMAT "%5.1" ECU_ADDRESS 0x7FA472 /end MEASUREMENT
/begin MEASUREMENT khc_w "Adaptierte HC-Konzentration Regenerierstrom" SWORD fak_sw_b2 1 100 -2 1.99994 FORMAT "%8.6" ECU_ADDRESS 0x7FD7A2 /end MEASUREMENT
/begin MEASUREMENT kteev_w "Konzentration Regeneriergas im Saugrohr auf Hˆhe der Einspritzventile" UWORD fak_uw_b1 1 100 0 0.999985 FORMAT "%9.7" ECU_ADDRESS 0x7FE080 /end MEASUREMENT
/begin MEASUREMENT ktetevvz_w "Konzentration Regeneriergas im Saugrohr verzˆgert" UWORD fak_uw_b1 1 100 0 0.999985 FORMAT "%9.7" ECU_ADDRESS 0x7FE082 /end MEASUREMENT
/begin MEASUREMENT ktetev_w "Konzentration Regeneriergas im Saugrohr auf Hˆhe vom TEV" UWORD fak_uw_b1 1 100 0 0.999985 FORMAT "%9.7" ECU_ADDRESS 0x7FE084 /end MEASUREMENT
/begin MEASUREMENT Kva_summe "" UWORD dez 1 100 0 65535 FORMAT "%8.2" ECU_ADDRESS 0x7FD488 /end MEASUREMENT
/begin MEASUREMENT Kwerror "Fehlerz‰hler: unkritischer KWG-Fehler" UBYTE dez 1 100 0 255 FORMAT "%5.1" ECU_ADDRESS 0x7FD47B /end MEASUREMENT
/begin MEASUREMENT Kwirq "" UWORD dez 1 100 0 65535 FORMAT "%8.2" ECU_ADDRESS 0x7FD480 /end MEASUREMENT
/begin MEASUREMENT Kwkriterr "Fehlerz‰hler: kritischer KWG-Fehler" UBYTE dez 1 100 0 255 FORMAT "%5.1" ECU_ADDRESS 0x7FD47C /end MEASUREMENT
/begin MEASUREMENT Kwkriterrm "" UBYTE dez 1 100 0 255 FORMAT "%5.1" ECU_ADDRESS 0x7FD47D /end MEASUREMENT
/begin MEASUREMENT Kwkriterrs "" UBYTE dez 1 100 0 255 FORMAT "%5.1" ECU_ADDRESS 0x7FD47E /end MEASUREMENT
/begin MEASUREMENT lokBits_Tebeb "" UBYTE dez 1 100 0 255 FORMAT "%5.1" ECU_ADDRESS 0x7FD7A4 /end MEASUREMENT
/begin MEASUREMENT lpfach_w "" UWORD fak_uw_b1 1 100 0 0.999985 FORMAT "%9.7" ECU_ADDRESS 0x7FE0DE /end MEASUREMENT
/begin MEASUREMENT lpfacv_w "" UWORD fak_uw_b1 1 100 0 0.999985 FORMAT "%9.7" ECU_ADDRESS 0x7FE0E0 /end MEASUREMENT
/begin MEASUREMENT Mfende "" UWORD dez 1 100 0 65535 FORMAT "%8.2" ECU_ADDRESS 0x7FA484 /end MEASUREMENT
/begin MEASUREMENT mired "indiziertes Reduktionsmoment zur VMAX-Regelung" UBYTE rel_ub_b99p6 1 100 0 99.6094 FORMAT "%5.2" ECU_ADDRESS 0x7FDA7A /end MEASUREMENT
/begin MEASUREMENT mitebg_w "Momentvorgabe f¸r Mindestf¸llung Tankentl¸ftung" UWORD rel_uw_b100 1 100 0 99.9985 FORMAT "%8.5" ECU_ADDRESS 0x7FE086 /end MEASUREMENT
/begin MEASUREMENT mivmxs "ind. Soll-Motormoment zur Integratorinitialisierung VMAX-Regelung" SBYTE rel_sb_q0p78 1 100 -99.84 99.06 FORMAT "%5.2" ECU_ADDRESS 0x7FDA7B /end MEASUREMENT
/begin MEASUREMENT mivmx_w "Indiziertes Sollmoment der VMAX-Regelung" UWORD rel_uw_b100 1 100 0 99.9985 FORMAT "%8.5" ECU_ADDRESS 0x7FDF82 /end MEASUREMENT
/begin MEASUREMENT mmsr_um "zul‰ssiger MSR-Momentenwunsch f¸r die Funktions¸berwachung" UBYTE rel_ub_q0p3906 1 100 0 99.6094 FORMAT "%5.2" ECU_ADDRESS 0x7F8033 /end MEASUREMENT
/begin MEASUREMENT msrc_c_um "Fehlerz‰hler f¸r MSR-Eingriff-‹berwachung der Funktions¸berwachung" UBYTE t40ms_ub_b10200 1 100 0 10200 FORMAT "%7.1" ECU_ADDRESS 0x7F8034 /end MEASUREMENT
/begin MEASUREMENT mssginmn_w "Minmaler ins Saugrohr strˆmender Massenstrom (Drosselklappe + TEV)" UWORD m_uw_b6553p5 1 100 0 6553.5 FORMAT "%8.3" ECU_ADDRESS 0x7FE088 /end MEASUREMENT
/begin MEASUREMENT mssgin_w "Ins Saugrohr strˆmender Massenstrom (Drosselklappe + TEV)" UWORD m_uw_b6553p5 1 100 0 6553.5 FORMAT "%8.3" ECU_ADDRESS 0x7FE08A /end MEASUREMENT
/begin MEASUREMENT msteev_w "Massenstrom Regeneriergas auf Hˆhe Einspritzventil" UWORD m_uw_b25p6 1 100 0 25.5996 FORMAT "%8.5" ECU_ADDRESS 0x7FE08C /end MEASUREMENT
/begin MEASUREMENT mstesmx_w "Maximal mˆglicher Sollmassenstrom Tankentl¸ftung" UWORD m_uw_b25p6 1 100 0 25.5996 FORMAT "%8.5" ECU_ADDRESS 0x7FE08E /end MEASUREMENT
/begin MEASUREMENT mstesoll_w "Massenstrom Tankentl¸ftung ins Saugrohr, Sollwert" UWORD m_uw_b25p6 1 100 0 25.5996 FORMAT "%8.5" ECU_ADDRESS 0x7FE090 /end MEASUREMENT
/begin MEASUREMENT N "" SWORD Def_n 1 100 -32768 32767 FORMAT "%8.2" ECU_ADDRESS 0x7FD458 /end MEASUREMENT
/begin MEASUREMENT newansw_um "Neue Antwort an das UM in der Funktions¸berwachung" ULONG dez 1 100 0 4.29497e+009 FORMAT "%13.2" ECU_ADDRESS 0x7FE284 /end MEASUREMENT
/begin MEASUREMENT newqu_um "Neue Frage vom UM in der Funktions¸berwachung" UBYTE dez 1 100 0 255 FORMAT "%5.1" ECU_ADDRESS 0x7FD879 /end MEASUREMENT
/begin MEASUREMENT Ngrad "Drehzahlgradient" SWORD Def_n 1 100 -32768 32767 FORMAT "%8.2" ECU_ADDRESS 0x7FD454 /end MEASUREMENT
/begin MEASUREMENT Ngradsig "" SBYTE Def_n 1 100 -128 127 FORMAT "%5.1" ECU_ADDRESS 0x7FD456 /end MEASUREMENT
/begin MEASUREMENT Nkw "" SWORD Def_n 1 100 -32768 32767 FORMAT "%8.2" ECU_ADDRESS 0x7FD45A /end MEASUREMENT
/begin MEASUREMENT Nkw_grad "" SBYTE dez 1 100 -128 127 FORMAT "%5.1" ECU_ADDRESS 0x7FD460 /end MEASUREMENT
/begin MEASUREMENT Nmot "" UWORD Def_n4 1 100 0 16383.8 FORMAT "%8.2" ECU_ADDRESS 0x7FD478 /end MEASUREMENT
/begin MEASUREMENT nsc_c_um "Nachstart-Zeitz‰hler Nachstartaufweitung der FU" UWORD t40msxs_uw_q0p04 1 100 0 2621.4 FORMAT "%8.3" ECU_ADDRESS 0x7F8038 /end MEASUREMENT
/begin MEASUREMENT nsof_c_um "Z‰ller Entprellzeit f¸r Abschaltung der Nachstartaufweitung" UBYTE t40ms_ub_b10200 1 100 0 10200 FORMAT "%7.1" ECU_ADDRESS 0x7F8037 /end MEASUREMENT
/begin MEASUREMENT nsolfa "Leerlaufsolldrehzahl, Funktionsanforderung Tester" UBYTE nmot_ub_q10 1 100 0 2550 FORMAT "%5.0" ECU_ADDRESS 0x7FC0C0 /end MEASUREMENT
/begin MEASUREMENT Nwe1poserr "NW Flanke ausserhalb des g¸ltigen Fensters" UBYTE dez 1 100 0 255 FORMAT "%5.1" ECU_ADDRESS 0x7FD444 /end MEASUREMENT
/begin MEASUREMENT Nwe1_irq "IRQ counter Einlassnockenwelle" UWORD dez 1 100 0 65535 FORMAT "%8.2" ECU_ADDRESS 0x7FD442 /end MEASUREMENT
/begin MEASUREMENT Nwe1_pos "Position neg Flanke ENWG1" UWORD sprzi_q0p1 1 100 0 6553.5 FORMAT "%2.0" ECU_ADDRESS 0x7FD440 /end MEASUREMENT
/begin MEASUREMENT Nwe1_time "" ULONG dez 1 100 0 4.29497e+009 FORMAT "%13.2" ECU_ADDRESS 0x7FD448 /end MEASUREMENT
/begin MEASUREMENT nwg_sw1 "" UBYTE B_TRUE 1 100 0 1 BIT_MASK 0x1 FORMAT "%13.11" ECU_ADDRESS 0x7FB90D /end MEASUREMENT
/begin MEASUREMENT nwg_sw2 "" UBYTE B_TRUE 1 100 0 1 BIT_MASK 0x1 FORMAT "%13.11" ECU_ADDRESS 0x7FB90E /end MEASUREMENT
/begin MEASUREMENT nzahn_w "" UWORD Def_n4 1 100 0 16383.8 FORMAT "%8.2" ECU_ADDRESS 0x7FDB20 /end MEASUREMENT
/begin MEASUREMENT nzwgru "" UBYTE nmot_ub_q40 1 100 0 10200 FORMAT "%5.0" ECU_ADDRESS 0x7FD867 /end MEASUREMENT
/begin MEASUREMENT nzwgru_w "" UWORD nmot_uw_q0p25 1 100 0 16383.8 FORMAT "%8.2" ECU_ADDRESS 0x7FE0A0 /end MEASUREMENT
/begin MEASUREMENT n_flags_um "Byte f¸r Nachstart-Bits der Funktions¸berwachung" UBYTE dez 1 100 0 255 FORMAT "%5.1" ECU_ADDRESS 0x7F803D /end MEASUREMENT
/begin MEASUREMENT plstate_um "Zustand zur Plausibilisierung des UM in der Funktions¸berwachung" UBYTE dez 1 100 0 255 FORMAT "%5.1" ECU_ADDRESS 0x7FD87A /end MEASUREMENT
/begin MEASUREMENT qmsdyn "Quotient aus ml_w und mssgin_w" UBYTE fak_ub_b16 1 100 0 15.9375 FORMAT "%5.2" ECU_ADDRESS 0x7FDAE0 /end MEASUREMENT
/begin MEASUREMENT qtetemin "Quotient: te / TEMIN f¸r BDE teh_w/teminh_w bzw. tes_w/temins" UBYTE fak_ub_b4 1 100 0 3.98438 FORMAT "%5.3" ECU_ADDRESS 0x7FDAE1 /end MEASUREMENT
/begin MEASUREMENT raster_um "Allgemeiner Z‰hler des 10ms Raster der Funktions¸berwachung" ULONG dez 1 100 0 4.29497e+009 FORMAT "%13.2" ECU_ADDRESS 0x7FE280 /end MEASUREMENT
/begin MEASUREMENT reset_indication_um "" UWORD dez 1 100 0 65535 FORMAT "%8.2" ECU_ADDRESS 0x7F9AAC /end MEASUREMENT
/begin MEASUREMENT rkte_w "Relativer Gemischanteil Tankentl¸ftung" SWORD rel_sw_q0p0468 1 100 -1536 1535.95 FORMAT "%8.3" ECU_ADDRESS 0x7FE092 /end MEASUREMENT
/begin MEASUREMENT rlteev_w "Relative F¸llung verursacht durch Regeneriergas Tankentl¸ftung" UWORD rel_uw_b192 1 100 0 191.997 FORMAT "%8.4" ECU_ADDRESS 0x7FE094 /end MEASUREMENT
/begin MEASUREMENT rompage_um "Adresse im DauerRAM der einzelnen fehlerhaften ROM-Page  in der Fkt.¸berw." UBYTE dez 1 100 0 255 FORMAT "%5.1" ECU_ADDRESS 0x7F9ABD /end MEASUREMENT
/begin MEASUREMENT romrstc_um "Z‰hler im DauerRAM f¸r Resets bei ROM-Check-Fehler in der Init. in der FU" UBYTE dez 1 100 0 255 FORMAT "%5.1" ECU_ADDRESS 0x7F9ABE /end MEASUREMENT
/begin MEASUREMENT romz_c_um "Fehlerz‰hler im Dauer-RAM f¸r ROM-Pr¸fung (Diagnose) in der Funktions¸berwachung" UBYTE dez 1 100 0 255 FORMAT "%5.1" ECU_ADDRESS 0x7F9AA8 /end MEASUREMENT
/begin MEASUREMENT r_flags_um "Byte f¸r Fehlerreaktions-Bits der Funktions¸berwachung" UBYTE dez 1 100 0 255 FORMAT "%5.1" ECU_ADDRESS 0x7F803E /end MEASUREMENT
/begin MEASUREMENT Segakt "Aktuelle Segmentnummer" UBYTE dez 1 100 0 255 FORMAT "%5.1" ECU_ADDRESS 0x7FD44E /end MEASUREMENT
/begin MEASUREMENT Segment_aktuell "" UBYTE dez 1 100 0 255 FORMAT "%5.1" ECU_ADDRESS 0x7FD44D /end MEASUREMENT
/begin MEASUREMENT Soi "" SWORD Def_kw_sw_q0p0234 1 100 -768 767.977 FORMAT "%8.4" ARRAY_SIZE 2 ECU_ADDRESS 0x7FD498 /end MEASUREMENT
/begin MEASUREMENT srst_c_um "Z‰hler im Dauer-RAM f¸r Software-Reset (Diagnose) aus der Funktions¸berwachung" UBYTE dez 1 100 0 255 FORMAT "%5.1" ECU_ADDRESS 0x7F9AA9 /end MEASUREMENT
/begin MEASUREMENT stacktest_rel "" UBYTE rel_q0p392 1 100 0 100 FORMAT "%5.1" ECU_ADDRESS 0x7FD87D /end MEASUREMENT
/begin MEASUREMENT stacktest_words "" UWORD dez 1 100 0 65535 FORMAT "%8.2" ECU_ADDRESS 0x7FDB1E /end MEASUREMENT
/begin MEASUREMENT Status_kwnot "" UBYTE dez 1 100 0 255 FORMAT "%5.1" ECU_ADDRESS 0x7FD44C /end MEASUREMENT
/begin MEASUREMENT St_injesb "" UWORD dez 1 100 0 65535 FORMAT "%8.2" ECU_ADDRESS 0x7FD4A0 /end MEASUREMENT
/begin MEASUREMENT St_kbsdiag "" UBYTE dez 1 100 0 255 FORMAT "%5.1" ECU_ADDRESS 0x7FA470 /end MEASUREMENT
/begin MEASUREMENT St_mkwchn "" UBYTE dez 1 100 0 255 FORMAT "%5.1" ECU_ADDRESS 0x7FD47A /end MEASUREMENT
/begin MEASUREMENT St_nwirq "" UBYTE dez 1 100 0 255 FORMAT "%5.1" ECU_ADDRESS 0x7FD45C /end MEASUREMENT
/begin MEASUREMENT St_nwsync "" UBYTE dez 1 100 0 255 FORMAT "%5.1" ECU_ADDRESS 0x7FD45D /end MEASUREMENT
/begin MEASUREMENT St_tpu "" UWORD dez 1 100 0 65535 FORMAT "%8.2" ARRAY_SIZE 32 ECU_ADDRESS 0x7FD3DA /end MEASUREMENT
/begin MEASUREMENT Synclevel "" SBYTE dez 1 100 -128 127 FORMAT "%5.1" ECU_ADDRESS 0x7FD482 /end MEASUREMENT
/begin MEASUREMENT Szout "" UWORD sprzi_q0p1 1 100 0 6553.5 FORMAT "%2.0" ECU_ADDRESS 0x7FD424 /end MEASUREMENT
/begin MEASUREMENT szout_w "Schlieﬂzeitausgabe" UWORD txms_uw_q0p001 1 100 0 65.535 FORMAT "%8.5" ECU_ADDRESS 0x7FE09A /end MEASUREMENT
/begin MEASUREMENT s_flags_um "Byte f¸r Status-Bits der Funktions¸berwachung" UBYTE dez 1 100 0 255 FORMAT "%5.1" ECU_ADDRESS 0x7F803F /end MEASUREMENT
/begin MEASUREMENT tahsom_w "Abgastemperatur an Sonde hinter Kat aus Modell" UWORD temp_q0p0234_o273 1 100 -273.15 1262.83 FORMAT "%8.3" ECU_ADDRESS 0x7FD52E /end MEASUREMENT
/begin MEASUREMENT taikrm2_w "Abgastemperatur im Kr¸mmer (Zusammenf¸hrung aller Zylinder) aus Modell, Bank 2" UWORD temp_q0p0234_o273 1 100 -273.15 1262.83 FORMAT "%8.3" ECU_ADDRESS 0x7FD530 /end MEASUREMENT
/begin MEASUREMENT taikrm_w "Abgastemperatur im Kr¸mmer (Zusammenf¸hrung aller Zylinder) aus Modell" UWORD temp_q0p0234_o273 1 100 -273.15 1262.83 FORMAT "%8.3" ECU_ADDRESS 0x7FD532 /end MEASUREMENT
/begin MEASUREMENT tanhkm_w "Abgastemperatur hinter Hauptkat aus Modell" UWORD temp_q0p0234_o273 1 100 -273.15 1262.83 FORMAT "%8.3" ECU_ADDRESS 0x7FD534 /end MEASUREMENT
/begin MEASUREMENT tanvk2_w "Abgastemperatur nach dem Vorkat aus Sensor, Bank 2" UWORD temp_q0p0234_o273 1 100 -273.15 1262.83 FORMAT "%8.3" ECU_ADDRESS 0x7FD536 /end MEASUREMENT
/begin MEASUREMENT tanvk_w "Abgastemperatur nach dem Vorkat aus Sensor" UWORD temp_q0p0234_o273 1 100 -273.15 1262.83 FORMAT "%8.3" ECU_ADDRESS 0x7FD538 /end MEASUREMENT
/begin MEASUREMENT tatuk "Ansaugluft- oder Umgebungstemperatur, Ausgabe in Grad C, intern in Kelvin" UBYTE temp_q6_o273 1 100 -273.15 1256.85 FORMAT "%5.0" ECU_ADDRESS 0x7FD54C /end MEASUREMENT
/begin MEASUREMENT tatuk_w "Ansaugluft- oder Umgebungstemperatur, Ausgabe in Grad C, intern in Kelvin" UWORD temp_q0p0234_o273 1 100 -273.15 1262.83 FORMAT "%8.3" ECU_ADDRESS 0x7FD53A /end MEASUREMENT
/begin MEASUREMENT tavrom2_w "Abgastemperatur im Rohrst¸ck vor Vorkat modelliert (Bank2)" UWORD temp_q0p0234_o273 1 100 -273.15 1262.83 FORMAT "%8.3" ECU_ADDRESS 0x7FD53C /end MEASUREMENT
/begin MEASUREMENT tavrom_w "Abgastemperatur im Rohrstuck nach Kr¸mmer modelliert" UWORD temp_q0p0234_o273 1 100 -273.15 1262.83 FORMAT "%8.3" ECU_ADDRESS 0x7FD53E /end MEASUREMENT
/begin MEASUREMENT tavsom2_w "Abgastemperatur an Sonde vor Kat aus Modell, Bank 2" UWORD temp_q0p0234_o273 1 100 -273.15 1262.83 FORMAT "%8.3" ECU_ADDRESS 0x7FD540 /end MEASUREMENT
/begin MEASUREMENT tavsom_w "Abgastemperatur an Sonde vor Kat aus Modell" UWORD temp_q0p0234_o273 1 100 -273.15 1262.83 FORMAT "%8.3" ECU_ADDRESS 0x7FD542 /end MEASUREMENT
/begin MEASUREMENT tavvkm2_w "Abgastemperatur vor Vorkat aus Modell, Bank2" UWORD temp_q0p0234_o273 1 100 -273.15 1262.83 FORMAT "%8.3" ECU_ADDRESS 0x7FD544 /end MEASUREMENT
/begin MEASUREMENT tavvkm_w "Abgastemperatur vor Vorkat aus Modell" UWORD temp_q0p0234_o273 1 100 -273.15 1262.83 FORMAT "%8.3" ECU_ADDRESS 0x7FD546 /end MEASUREMENT
/begin MEASUREMENT tevtim "" UBYTE dez 1 100 0 255 FORMAT "%5.1" ECU_ADDRESS 0x7FC0C1 /end MEASUREMENT
/begin MEASUREMENT Tianz "" UWORD dez 1 100 0 65535 FORMAT "%8.2" ECU_ADDRESS 0x7FD484 /end MEASUREMENT
/begin MEASUREMENT Tiout "" ULONG Def_ti_uw_q0p0008 1 100 0 3.43597e+006 FORMAT "%13.5" ARRAY_SIZE 2 ECU_ADDRESS 0x7FD490 /end MEASUREMENT
/begin MEASUREMENT Ti_summe "" ULONG Def_ti_uw_q0p0008 1 100 0 3.43597e+006 FORMAT "%13.5" ECU_ADDRESS 0x7FD48C /end MEASUREMENT
/begin MEASUREMENT tkihkm_w "Temperatur Katalysator im Hauptkat aus Modell" UWORD temp_q0p0234_o273 1 100 -273.15 1262.83 FORMAT "%8.3" ECU_ADDRESS 0x7FD548 /end MEASUREMENT
/begin MEASUREMENT Tkwlur "" ULONG Def_tkw_ul_q0p0001 1 100 0 429497 FORMAT "%13.6" ARRAY_SIZE 2 ECU_ADDRESS 0x7FD46C /end MEASUREMENT
/begin MEASUREMENT Tkwseg "" ULONG Def_tkw_ul_q0p0001 1 100 0 429497 FORMAT "%13.6" ARRAY_SIZE 2 ECU_ADDRESS 0x7FD464 /end MEASUREMENT
/begin MEASUREMENT Tkwzale "" ULONG Def_tkw_ul_q0p0001 1 100 0 429497 FORMAT "%13.6" ARRAY_SIZE 2 ECU_ADDRESS 0x7FD474 /end MEASUREMENT
/begin MEASUREMENT tmotk "Motor-Temperatur, Ausgabe in Grad C, intern in Kelvin" UBYTE temp_q6_o273 1 100 -273.15 1256.85 FORMAT "%5.0" ECU_ADDRESS 0x7FD54D /end MEASUREMENT
/begin MEASUREMENT tmotk_w "Motor-Temperatur, Ausgabe in Grad C, intern in Kelvin" UWORD temp_q0p0234_o273 1 100 -273.15 1262.83 FORMAT "%8.3" ECU_ADDRESS 0x7FD54A /end MEASUREMENT
/begin MEASUREMENT Tpoz "" UBYTE dez 1 100 0 255 FORMAT "%5.1" ECU_ADDRESS 0x7FD461 /end MEASUREMENT
/begin MEASUREMENT tpucr_c_um "Fehlerz‰hler des TPU-Code-RAM-Tests in der Funktions¸berwachung" UBYTE dez 1 100 0 255 FORMAT "%5.1" ECU_ADDRESS 0x7F8081 /end MEASUREMENT
/begin MEASUREMENT tpura_c_um "Z‰hler f¸r TPU-Code-RAM-Test aktiv in der Funktions¸berwachung" UBYTE t10ms_ub_b2550 1 100 0 2550 ECU_ADDRESS 0x7F8082 /end MEASUREMENT
/begin MEASUREMENT tpuwwdauer "" UWORD kw_q0p02566 1 100 0 1535.98 FORMAT "%8.3" ECU_ADDRESS 0x7FDB22 /end MEASUREMENT
/begin MEASUREMENT tpuwwstart "" UWORD kw_q0p02566 1 100 0 1535.98 FORMAT "%8.3" ECU_ADDRESS 0x7FDB24 /end MEASUREMENT
/begin MEASUREMENT Tresync "" UBYTE dez 1 100 0 255 FORMAT "%5.1" ECU_ADDRESS 0x7FD41A /end MEASUREMENT
/begin MEASUREMENT tseg_l "Winkel-Segmentzeit" ULONG t_q0p0001_ms 1 100 0 429497 FORMAT "%13.6" ECU_ADDRESS 0x7FE288 /end MEASUREMENT
/begin MEASUREMENT t_bthsv "" UBYTE dez 1 100 0 255 FORMAT "%5.1" ECU_ADDRESS 0x7FC0C2 /end MEASUREMENT
/begin MEASUREMENT t_bthsv2 "" UBYTE dez 1 100 0 255 FORMAT "%5.1" ECU_ADDRESS 0x7FC0C3 /end MEASUREMENT
/begin MEASUREMENT t_btstpll1 "" UBYTE dez 1 100 0 255 FORMAT "%5.1" ECU_ADDRESS 0x7FC0C4 /end MEASUREMENT
/begin MEASUREMENT t_btstpll2 "" UBYTE dez 1 100 0 255 FORMAT "%5.1" ECU_ADDRESS 0x7FC0C5 /end MEASUREMENT
/begin MEASUREMENT t_bttev "" UBYTE dez 1 100 0 255 FORMAT "%5.1" ECU_ADDRESS 0x7FC0C6 /end MEASUREMENT
/begin MEASUREMENT t_bttim "" UBYTE dez 1 100 0 255 FORMAT "%5.1" ECU_ADDRESS 0x7FC0C7 /end MEASUREMENT
/begin MEASUREMENT t_flags_um "Byte f¸r Tempomat-Bits der Funktions¸berwachung" UBYTE dez 1 100 0 255 FORMAT "%5.1" ECU_ADDRESS 0x7F8040 /end MEASUREMENT
/begin MEASUREMENT T_kwseg "" UWORD dez 1 100 0 65535 FORMAT "%8.2" ARRAY_SIZE 2 ECU_ADDRESS 0x7FD450 /end MEASUREMENT
/begin MEASUREMENT U0 "" UBYTE dez 1 100 0 255 FORMAT "%5.1" ECU_ADDRESS 0x7FA481 /end MEASUREMENT
/begin MEASUREMENT U01 "" UBYTE dez 1 100 0 255 FORMAT "%5.1" ECU_ADDRESS 0x7FA482 /end MEASUREMENT
/begin MEASUREMENT UetmNvBits "" UBYTE dez 1 100 0 255 FORMAT "%5.1" ECU_ADDRESS 0x7F9B51 /end MEASUREMENT
/begin MEASUREMENT Uint "" UBYTE dez 1 100 0 255 FORMAT "%5.1" ECU_ADDRESS 0x7FA480 /end MEASUREMENT
/begin MEASUREMENT Uklopf "" UBYTE dez 1 100 0 255 FORMAT "%5.1" ARRAY_SIZE 4 ECU_ADDRESS 0x7FA47C /end MEASUREMENT
/begin MEASUREMENT Ukti "" UBYTE dez 1 100 0 255 FORMAT "%5.1" ECU_ADDRESS 0x7FA473 /end MEASUREMENT
/begin MEASUREMENT umerr_c_um "Fehlerz‰hler-R¸ckmeldung des UM in der Funktions¸berwachung" UBYTE dez 1 100 0 255 FORMAT "%5.1" ECU_ADDRESS 0x7FD87B /end MEASUREMENT
/begin MEASUREMENT Ureset "" UBYTE dez 1 100 0 255 FORMAT "%5.1" ECU_ADDRESS 0x7FA478 /end MEASUREMENT
/begin MEASUREMENT urmcksco "Checksumme ¸ber Code der Funktions¸berwachung im zyklischen ROM-Test" UWORD dez 1 100 0 65535 FORMAT "%8.2" ARRAY_SIZE 2 ECU_ADDRESS 0x7F9AB2 /end MEASUREMENT
/begin MEASUREMENT urmcksda "Checksumme ¸ber Daten der Funktions¸berwachung im zyklischen ROM-Test" UWORD dez 1 100 0 65535 FORMAT "%8.2" ARRAY_SIZE 2 ECU_ADDRESS 0x7F9AB6 /end MEASUREMENT
/begin MEASUREMENT urmpatco "Patch-Adresse im Code der Funktions¸berwachung f¸r ‹berpr¸fung zykl. ROM-Test" UWORD dez 1 100 0 65535 FORMAT "%8.2" ARRAY_SIZE 2 ECU_ADDRESS 0x7F807A /end MEASUREMENT
/begin MEASUREMENT uzkw_w "Kurbelwellen-Umdrehungsz‰hler" UWORD dez 1 100 0 65535 FORMAT "%8.2" ECU_ADDRESS 0x7FE10A /end MEASUREMENT
/begin MEASUREMENT vfzgpr_w "Pr‰dizierte Fahrzeuggeschwindigkeit f¸r VMAX-Regelung" UWORD vfzg_uw_q0p00781 1 100 0 511.992 FORMAT "%8.4" ECU_ADDRESS 0x7FDF84 /end MEASUREMENT
/begin MEASUREMENT vhradchk "" UWORD vfzg_uw_q0p00781 1 100 0 511.992 FORMAT "%8.4" ECU_ADDRESS 0x7FE0E2 /end MEASUREMENT
/begin MEASUREMENT vhradunchk "" UWORD vfzg_uw_q0p00781 1 100 0 511.992 FORMAT "%8.4" ECU_ADDRESS 0x7FE0E4 /end MEASUREMENT
/begin MEASUREMENT Vl_winkel "" SWORD kw_q3 1 100 -98304 98301 FORMAT "%8.2" ARRAY_SIZE 2 ECU_ADDRESS 0x7FD4A2 /end MEASUREMENT
/begin MEASUREMENT vsidelete "" UBYTE dez 1 100 0 255 FORMAT "%5.1" ECU_ADDRESS 0x7F9CA8 /end MEASUREMENT
/begin MEASUREMENT vsikvsum "" ULONG fuel_q0p000008 1 100 0 34359.7 FORMAT "%13.7" ECU_ADDRESS 0x7F9CAC /end MEASUREMENT
/begin MEASUREMENT vsirw "" SWORD km_uw_q10 1 100 -327680 327670 FORMAT "%8.1" ECU_ADDRESS 0x7FD7E6 /end MEASUREMENT
/begin MEASUREMENT vvradchk "" UWORD vfzg_uw_q0p00781 1 100 0 511.992 FORMAT "%8.4" ECU_ADDRESS 0x7FE0E6 /end MEASUREMENT
/begin MEASUREMENT vvradunchk "" UWORD vfzg_uw_q0p00781 1 100 0 511.992 FORMAT "%8.4" ECU_ADDRESS 0x7FE0E8 /end MEASUREMENT
/begin MEASUREMENT v_hradabs "" UWORD vfzg_uw_q0p00781 1 100 0 511.992 FORMAT "%8.4" ECU_ADDRESS 0x7FE0EA /end MEASUREMENT
/begin MEASUREMENT v_vradabs "" UWORD vfzg_uw_q0p00781 1 100 0 511.992 FORMAT "%8.4" ECU_ADDRESS 0x7FE0EC /end MEASUREMENT
/begin MEASUREMENT wes "Winkelmarke Einlass schliesst bezogen auf Z¸nd-OT Zylinder 1" UBYTE kw_q3 1 100 0 765 FORMAT "%5.1" ECU_ADDRESS 0x7FD82C /end MEASUREMENT
/begin MEASUREMENT wesnesprau "Ausgang aus Kennlinie WESNESPR" UWORD kw_q1 1 100 0 65535 FORMAT "%8.2" ECU_ADDRESS 0x7FE13E /end MEASUREMENT
/begin MEASUREMENT wphg "Z¸ndwinkel DG-Phasenkorrektur" SBYTE zw_sb_q0p75 1 100 -96 95.25 FORMAT "%5.2" ECU_ADDRESS 0x7FDAEC /end MEASUREMENT
/begin MEASUREMENT wri_c_um "Fehlerz‰hler im Dauer-RAM f¸r RAM-Beschreibbarkeits-Pr¸fung (Diagnose) in der FU" UBYTE dez 1 100 0 255 FORMAT "%5.1" ECU_ADDRESS 0x7F9AAA /end MEASUREMENT
/begin MEASUREMENT znachanz "Anzahl der Z¸ndungen im Nachlauf" UBYTE dez 1 100 0 255 FORMAT "%5.1" ECU_ADDRESS 0x7FBCDD /end MEASUREMENT
/begin MEASUREMENT zwbas "Basisz¸ndwinkel" SBYTE zw_sb_q0p75 1 100 -96 95.25 FORMAT "%5.2" ECU_ADDRESS 0x7FBCDE /end MEASUREMENT
/begin MEASUREMENT zwbasar "Basisz¸ndwinkelarray" SBYTE zw_sb_q0p75 1 100 -96 95.25 FORMAT "%5.2" ARRAY_SIZE 4 ECU_ADDRESS 0x7FDAF0 /end MEASUREMENT
/begin MEASUREMENT zwbaskrkor "" SBYTE zw_sb_q0p75 1 100 -96 95.25 FORMAT "%5.2" ARRAY_SIZE 4 ECU_ADDRESS 0x7FDAF4 /end MEASUREMENT
/begin MEASUREMENT zwgru "Grundz¸ndwinkel" SBYTE zw_sb_q0p75 1 100 -96 95.25 FORMAT "%5.2" ECU_ADDRESS 0x7FDB0B /end MEASUREMENT
/begin MEASUREMENT Zwist "" SWORD Def_kw_sw_q0p0234 1 100 -768 767.977 FORMAT "%8.4" ARRAY_SIZE 4 ECU_ADDRESS 0x7FD41C /end MEASUREMENT
/begin MEASUREMENT zwist "Ist-Z¸ndwinkel" SBYTE zw_sb_q0p75 1 100 -96 95.25 FORMAT "%5.2" ECU_ADDRESS 0x7FBCDF /end MEASUREMENT
/begin MEASUREMENT zwkrafld "Bitmuster des zyl.ind. abgelegten B_zwkra" UBYTE dez 1 100 0 255 FORMAT "%5.1" ECU_ADDRESS 0x7FBCE0 /end MEASUREMENT
/begin MEASUREMENT zwmn "Sp‰tester Z¸ndwinkel" SBYTE zw_sb_q0p75 1 100 -96 95.25 FORMAT "%5.2" ECU_ADDRESS 0x7FDB0E /end MEASUREMENT
/begin MEASUREMENT zwmnd "dynamisch sp‰test zul‰ssiger Z¸ndwinkel" SBYTE zw_sb_q0p75 1 100 -96 95.25 FORMAT "%5.2" ECU_ADDRESS 0x7FDB0F /end MEASUREMENT
/begin MEASUREMENT zwmnms "dauerhaft sp‰test mˆglicher Z¸ndwinkel" SBYTE zw_sb_q0p75 1 100 -96 95.25 FORMAT "%5.2" ECU_ADDRESS 0x7FDB10 /end MEASUREMENT
/begin MEASUREMENT zwnst "" SBYTE zw_sb_q0p75 1 100 -96 95.25 FORMAT "%5.2" ECU_ADDRESS 0x7FDB11 /end MEASUREMENT
/begin MEASUREMENT zwofsnk "Offset zum Zuendwinkel fuer Nebenkerze" SBYTE zw_sb_q0p75 1 100 -96 95.25 FORMAT "%5.2" ECU_ADDRESS 0x7FDB05 /end MEASUREMENT
/begin MEASUREMENT zwofubph "" SBYTE zw_sb_q0p75 1 100 -96 95.25 FORMAT "%5.2" ECU_ADDRESS 0x7FDB06 /end MEASUREMENT
/begin MEASUREMENT Zwout "" SWORD Def_kw_sw_q0p0234 1 100 -768 767.977 FORMAT "%8.4" ARRAY_SIZE 4 ECU_ADDRESS 0x7FD42E /end MEASUREMENT
/begin MEASUREMENT zwoutar "Z¸ndwinkel-Ausgabe Array" SBYTE zw_sb_q0p75 1 100 -96 95.25 FORMAT "%5.2" ARRAY_SIZE 4 ECU_ADDRESS 0x7FDAF8 /end MEASUREMENT
/begin MEASUREMENT zwoutzyl "" SBYTE zw_sb_q0p75 1 100 -96 95.25 FORMAT "%5.2" ARRAY_SIZE 8 ECU_ADDRESS 0x7FDAFC /end MEASUREMENT
/begin MEASUREMENT zwout_nk "" UWORD krmf_to_zw 1 100 0 1535.98 FORMAT "%8.3" ECU_ADDRESS 0x7FE098 /end MEASUREMENT
/begin MEASUREMENT Zwsoll "" SWORD Def_kw_sw_q0p0234 1 100 -768 767.977 FORMAT "%8.4" ARRAY_SIZE 4 ECU_ADDRESS 0x7FD426 /end MEASUREMENT
/begin MEASUREMENT zwspae "Sp‰tester Z¸ndwinkel" SBYTE zw_sb_q0p75 1 100 -96 95.25 FORMAT "%5.2" ECU_ADDRESS 0x7FDB12 /end MEASUREMENT
/begin MEASUREMENT zwstnmtm "Startz¸ndwinkel nmot/tmst abh‰ngiger Anteil" SBYTE zw_sb_q0p75 1 100 -96 95.25 FORMAT "%5.2" ECU_ADDRESS 0x7FDB13 /end MEASUREMENT
/begin MEASUREMENT zwstt "Z¸ndwinkel im Start" SBYTE zw_sb_q0p75 1 100 -96 95.25 FORMAT "%5.2" ECU_ADDRESS 0x7FDB14 /end MEASUREMENT
/begin MEASUREMENT zwstta "Startz¸ndwinkel tans-abh‰ngiger Anteil" SBYTE zw_sb_q0p75 1 100 -96 95.25 FORMAT "%5.2" ECU_ADDRESS 0x7FDB15 /end MEASUREMENT
/begin MEASUREMENT zwzyl1 "Z¸ndwinkel Zylinder 1" SBYTE zw_sb_q0p75 1 100 -96 95.25 FORMAT "%5.2" ECU_ADDRESS 0x7FDB04 /end MEASUREMENT
/begin MEASUREMENT Zylinder "" UBYTE dez 1 100 0 255 FORMAT "%5.1" ECU_ADDRESS 0x7FA483 /end MEASUREMENT
/begin MEASUREMENT zzyl "SW-Zylinderz‰hler" UBYTE dez 1 100 0 255 FORMAT "%5.1" ECU_ADDRESS 0x7FD809 /end MEASUREMENT
/begin FUNCTION T2DFA "KWP2000; Diagnosefunktion aktivieren" /begin DEF_CHARACTERISTIC /end DEF_CHARACTERISTIC /begin REF_CHARACTERISTIC /end REF_CHARACTERISTIC /begin IN_MEASUREMENT B_btekp devoff nmot_w /end IN_MEASUREMENT
 /begin OUT_MEASUREMENT B_aklet B_bt B_btakl B_btelue B_btev1 B_btev2 B_bthsv B_bthsv2 B_btmil B_btslv B_btstpabg B_btstpll1 B_btstpll2 B_bttev B_btuetmc B_ekpet B_elueet B_fa B_faavr B_fadisa B_fadk B_fadka B_faevz B_fallas B_falls B_falr B_falra B_falsv B_falsv2 B_fanws B_fanwsd B_fasls B_fates B_gangat B_grdst B_hsv2et B_hsvet B_milet B_slvet B_tevet B_uetmcet B_vsiReset hsv2tim hsvtim nsolfa tevtim t_bthsv t_bthsv2 t_btstpll1 t_btstpll2 t_bttev t_bttim /end OUT_MEASUREMENT
 /begin LOC_MEASUREMENT /end LOC_MEASUREMENT
 /begin SUB_FUNCTION /end SUB_FUNCTION
/end FUNCTION
/begin FUNCTION TEB "Tankentl¸ftung beladungsabh‰ngig"
 /begin DEF_CHARACTERISTIC DFTEAHB DSTEMIN FBTEB FBTEVA FETATEBN FKATEB FQTEDL FQTEPT FQTEVA FRHB FTEADAB FTEADMX FTEFHB FTEHB FTEINIX FUMRBRK FVERMN FVERZDYN FVRMDYN KFETATE KFFQTEFR KFFTEAN KFFTEAX KFQTE KFTADMS KFTATX KFTEKA KHCTEMN KHCTEMX MSDKLMMN NVERZMN TFTEINI TQTEAB TQTEDAB TVSATEM ZBTEML ZETATE ZKFTEAD ZMLTE ZMSSGIN /end DEF_CHARACTERISTIC
 /begin REF_CHARACTERISTIC CWTEVPOS KUMSRL SDM05TESB SML06TEUB SNM04TEUB SQM05TEUB TEMIN /end REF_CHARACTERISTIC
 /begin IN_MEASUREMENT B_evloc B_frmax B_frmax2 B_frmin B_frmin2 B_lr B_lr2 B_nmot B_nswo1 B_qtedab B_sab B_te B_tef B_tei B_ten B_tep dpssol_w dps_uw dps_w esst_sdm05tesb esst_sml06teub esst_snm04teub esst_sqm05teub frm2_w frm_w mbyp_ary mifa_w miopt_w ml mlsol_w ml_w msdkalm_w msdk_w mste mstedte_w msteo_w mste_w nmot nmot_w ps_w pte rl rlsol_w rl_w tans te2_w te_w tmotzyl_w wdkba /end IN_MEASUREMENT
 /begin OUT_MEASUREMENT B_lrar B_teabb B_teakt B_tehb B_tehbx dmssginr etate fkatei frmit frmit_w frmxa fteadf ftead_w ftefva_w mitebg_w mstesoll_w qmsdyn rkte_w /end OUT_MEASUREMENT
 /begin LOC_MEASUREMENT B_gwrte dftef_w dkhc_w dmlftef dstert20_w etateint etatesol fbetate fbkate fgwrte fkateapp fkates frmxaold_w frmxa_w ftadmste fteadf_w ftefsold_w ftefsoll_w ftefva ftefvab ftefvamx_w fteml fvermte_w imsteini khc_w kteev_w ktetevvz_w ktetev_w mssginmn_w mssgin_w msteev_w mstesmx_w qtetemin rlteev_w /end LOC_MEASUREMENT
 /begin SUB_FUNCTION /end SUB_FUNCTION
/end FUNCTION
/begin FUNCTION TEBEB "Einschaltbedingungen Tankentl¸ftung" /begin DEF_CHARACTERISTIC CWTEACFG LAMTEMN LAMTEMX TMSTTE TMTE TTEAUS /end DEF_CHARACTERISTIC /begin REF_CHARACTERISTIC CWTEV CWTEVPOS /end REF_CHARACTERISTIC
 /begin IN_MEASUREMENT B_atmtpa B_dldpte B_dllra B_dsls B_dslste B_dteaa B_eobdlr B_ffuest B_fkvs B_fosb B_fraoan B_ftedab B_lamka B_lamka2 B_lamsdef B_lr B_lr2 B_lrssa B_m8te B_mdarv B_mlrsa B_nwfehler B_sbbvk B_sbbvk2 B_sls B_slste B_tep E_akle E_frao E_frao2 E_frau E_frau2 E_frst E_frst2 E_llr E_lsv E_lsv2 E_ph E_rkat E_rkat2 E_rkaz E_rkaz2 E_sld E_slv E_slv1e lamsons_w tateist tatesoll tmotzyl_w tmstzyl_w /end IN_MEASUREMENT
 /begin OUT_MEASUREMENT B_qtedab B_te B_tef B_tei B_ten B_tevqoff /end OUT_MEASUREMENT
 /begin LOC_MEASUREMENT B_tenmda lokBits_Tebeb /end LOC_MEASUREMENT
 /begin SUB_FUNCTION /end SUB_FUNCTION
/end FUNCTION
/begin FUNCTION TEMPKON "TEMPKON.  Temperatur-Konvertermodul" /begin DEF_CHARACTERISTIC /end DEF_CHARACTERISTIC /begin REF_CHARACTERISTIC /end REF_CHARACTERISTIC /begin IN_MEASUREMENT tabgm2_w tabgm_w tatu tikatm_w tkatm_w tmot /end IN_MEASUREMENT
 /begin OUT_MEASUREMENT tahsom_w taikrm2_w taikrm_w tanhkm_w tanvk2_w tanvk_w tatuk tatuk_w tavrom2_w tavrom_w tavsom2_w tavsom_w tavvkm2_w tavvkm_w tkihkm_w tmotk tmotk_w /end OUT_MEASUREMENT
 /begin LOC_MEASUREMENT /end LOC_MEASUREMENT
 /begin SUB_FUNCTION /end SUB_FUNCTION
/end FUNCTION
/begin FUNCTION TI_CB_CERDD "" /begin DEF_CHARACTERISTIC /end DEF_CHARACTERISTIC /begin REF_CHARACTERISTIC /end REF_CHARACTERISTIC /begin IN_MEASUREMENT /end IN_MEASUREMENT /begin OUT_MEASUREMENT /end OUT_MEASUREMENT /begin LOC_MEASUREMENT /end LOC_MEASUREMENT /begin SUB_FUNCTION /end SUB_FUNCTION /end FUNCTION
/begin FUNCTION TI_CB_NS "" /begin DEF_CHARACTERISTIC /end DEF_CHARACTERISTIC /begin REF_CHARACTERISTIC /end REF_CHARACTERISTIC /begin IN_MEASUREMENT /end IN_MEASUREMENT /begin OUT_MEASUREMENT /end OUT_MEASUREMENT /begin LOC_MEASUREMENT /end LOC_MEASUREMENT /begin SUB_FUNCTION /end SUB_FUNCTION /end FUNCTION
/begin FUNCTION TI_CB_RCOOBC "" /begin DEF_CHARACTERISTIC /end DEF_CHARACTERISTIC /begin REF_CHARACTERISTIC /end REF_CHARACTERISTIC /begin IN_MEASUREMENT /end IN_MEASUREMENT /begin OUT_MEASUREMENT /end OUT_MEASUREMENT /begin LOC_MEASUREMENT /end LOC_MEASUREMENT /begin SUB_FUNCTION /end SUB_FUNCTION /end FUNCTION
/begin FUNCTION TI_CB_RERDTC "" /begin DEF_CHARACTERISTIC /end DEF_CHARACTERISTIC /begin REF_CHARACTERISTIC /end REF_CHARACTERISTIC /begin IN_MEASUREMENT fcmEnd /end IN_MEASUREMENT /begin OUT_MEASUREMENT /end OUT_MEASUREMENT /begin LOC_MEASUREMENT /end LOC_MEASUREMENT /begin SUB_FUNCTION /end SUB_FUNCTION /end FUNCTION
/begin FUNCTION TI_CB_RFCMS "" /begin DEF_CHARACTERISTIC /end DEF_CHARACTERISTIC /begin REF_CHARACTERISTIC /end REF_CHARACTERISTIC /begin IN_MEASUREMENT fcmEnd /end IN_MEASUREMENT /begin OUT_MEASUREMENT /end OUT_MEASUREMENT /begin LOC_MEASUREMENT /end LOC_MEASUREMENT /begin SUB_FUNCTION /end SUB_FUNCTION /end FUNCTION
/begin FUNCTION TI_CB_RFNCM "" /begin DEF_CHARACTERISTIC /end DEF_CHARACTERISTIC /begin REF_CHARACTERISTIC /end REF_CHARACTERISTIC
 /begin IN_MEASUREMENT B_cdsls B_cdtes B_cwdslt m6cmsl m6cmsl2 m6cmslv m6cmslv2 m6smsl2_w m6smslv2_w m6smslv_w m6smsl_w m6wmsl2_w m6wmslv2_w m6wmslv_w m6wmsl_w tc6tesc tc6tess tc6tesw /end IN_MEASUREMENT
 /begin OUT_MEASUREMENT /end OUT_MEASUREMENT
 /begin LOC_MEASUREMENT /end LOC_MEASUREMENT
 /begin SUB_FUNCTION /end SUB_FUNCTION
/end FUNCTION
/begin FUNCTION TI_CB_ROSMR "" /begin DEF_CHARACTERISTIC /end DEF_CHARACTERISTIC
 /begin REF_CHARACTERISTIC ATVFETTO ATVFETTU ATVMAGO ATVMAGU TPSVKMN TPSVKMX TUSPNMN TUSPNMX USMNSAMN USMNSAMX USMXSAMN USMXSAMX /end REF_CHARACTERISTIC
 /begin IN_MEASUREMENT atvfett atvfett2 atvmager atvmager2 B_lsh B_lsh2 B_lsv B_lsv2 tpsvlssa tpsvlssa2 tuspnf tuspnf2 usmnsan usmnsan2 usmxsan usmxsan2 usrj /end IN_MEASUREMENT
 /begin OUT_MEASUREMENT /end OUT_MEASUREMENT
 /begin LOC_MEASUREMENT /end LOC_MEASUREMENT
 /begin SUB_FUNCTION /end SUB_FUNCTION
/end FUNCTION
/begin FUNCTION TI_CB_RPTDD "" /begin DEF_CHARACTERISTIC /end DEF_CHARACTERISTIC /begin REF_CHARACTERISTIC CWKONFLS CWOBD /end REF_CHARACTERISTIC
 /begin IN_MEASUREMENT B_cdkvs B_cdmd B_kmmilsct B_lsh B_lsh2 B_lsv B_lsv2 B_milstat B_sls B_slsfz evsup1 flglrs flglrs2 fr2_w fra_w fr_w kmstmil_w mshfm_w nmot_w ready rml tanslin tmotlin usvkj usvkj2 vfzg wdkba zwzyl1 /end IN_MEASUREMENT
 /begin OUT_MEASUREMENT /end OUT_MEASUREMENT
 /begin LOC_MEASUREMENT /end LOC_MEASUREMENT
 /begin SUB_FUNCTION /end SUB_FUNCTION
/end FUNCTION
/begin FUNCTION TI_CB_RPTFF "" /begin DEF_CHARACTERISTIC /end DEF_CHARACTERISTIC /begin REF_CHARACTERISTIC /end REF_CHARACTERISTIC /begin IN_MEASUREMENT B_xff ffzdfp /end IN_MEASUREMENT /begin OUT_MEASUREMENT /end OUT_MEASUREMENT /begin LOC_MEASUREMENT /end LOC_MEASUREMENT /begin SUB_FUNCTION /end SUB_FUNCTION /end FUNCTION
/begin FUNCTION TI_CB_RVI "" /begin DEF_CHARACTERISTIC /end DEF_CHARACTERISTIC /begin REF_CHARACTERISTIC /end REF_CHARACTERISTIC /begin IN_MEASUREMENT B_cksbrdy B_cksbrdy2 CALIBID1 CALIBID2 cvn cvn2 nmot_w /end IN_MEASUREMENT /begin OUT_MEASUREMENT B_m9cvn /end OUT_MEASUREMENT /begin LOC_MEASUREMENT B_m9cvnTmp /end LOC_MEASUREMENT /begin SUB_FUNCTION /end SUB_FUNCTION /end FUNCTION
/begin FUNCTION TI_CB_UTILITIES "" /begin DEF_CHARACTERISTIC /end DEF_CHARACTERISTIC /begin REF_CHARACTERISTIC /end REF_CHARACTERISTIC /begin IN_MEASUREMENT fcmEnd /end IN_MEASUREMENT /begin OUT_MEASUREMENT /end OUT_MEASUREMENT /begin LOC_MEASUREMENT /end LOC_MEASUREMENT /begin SUB_FUNCTION /end SUB_FUNCTION /end FUNCTION
/begin FUNCTION TI_K2_CDI_B "" /begin DEF_CHARACTERISTIC /end DEF_CHARACTERISTIC /begin REF_CHARACTERISTIC /end REF_CHARACTERISTIC /begin IN_MEASUREMENT fcmEnd /end IN_MEASUREMENT /begin OUT_MEASUREMENT /end OUT_MEASUREMENT /begin LOC_MEASUREMENT /end LOC_MEASUREMENT /begin SUB_FUNCTION /end SUB_FUNCTION /end FUNCTION
/begin FUNCTION ti_k2_er_b "" /begin DEF_CHARACTERISTIC /end DEF_CHARACTERISTIC /begin REF_CHARACTERISTIC /end REF_CHARACTERISTIC /begin IN_MEASUREMENT nmot_w /end IN_MEASUREMENT /begin OUT_MEASUREMENT /end OUT_MEASUREMENT /begin LOC_MEASUREMENT /end LOC_MEASUREMENT /begin SUB_FUNCTION /end SUB_FUNCTION /end FUNCTION
/begin FUNCTION TI_K2_IOCBLI_B "" /begin DEF_CHARACTERISTIC /end DEF_CHARACTERISTIC
 /begin REF_CHARACTERISTIC NFSACVMN NFSACVMX NFSMVMN NFSMVMX NLLMVMN NLLMVMX NSACMVMN NSACMVMX NSLBVMN NSLBVMX TMNV TMNVFS /end REF_CHARACTERISTIC
 /begin IN_MEASUREMENT anznmax anzpbr_w B_aklet B_bt B_btakl B_btekp B_btelue B_btev1 B_btev2 B_bthsv B_bthsv2 B_btmil B_btslv B_btstpabg B_btstpll1 B_btstpll2 B_bttev B_btuetmc B_cotrim B_ekpet B_elueet B_gangat B_hsv2et B_hsvet B_milet B_nsabg B_tevet B_uetmcet B_vsiReset co_pot dnfsacmv dnfsmv dnllmv dnsacmv dnslbv hsv2tim hsvtim ikr kmstnmax kmstpbr_w nmaxvk_w nmot spi_max_transmission_time tevtim tmot t_bthsv t_bthsv2 t_btstpll1 t_btstpll2 t_bttev t_bttim udkp1_w udsk ugetrg uiekp_w uielue_w uisys_w uizdg_w ulsvk1 ulsvk2 utzyl1 utzyl2 uuekp uuelue uusys uuzdg wtans wtmot wub /end IN_MEASUREMENT
 /begin OUT_MEASUREMENT btduty_ekp B_clvar B_nwtest B_sperrEKP /end OUT_MEASUREMENT
 /begin LOC_MEASUREMENT /end LOC_MEASUREMENT
 /begin SUB_FUNCTION /end SUB_FUNCTION
/end FUNCTION
/begin FUNCTION TI_K2_RDBCI_B "" /begin DEF_CHARACTERISTIC /end DEF_CHARACTERISTIC /begin REF_CHARACTERISTIC STP_MAX_POSITION /end REF_CHARACTERISTIC
 /begin IN_MEASUREMENT A_anlasser B_atmtpa B_A_schutz B_bl B_br B_btekp B_btelue B_bthsv B_bthsv2 B_btslv B_ebl B_ekp B_ekpbts B_ekpet B_elue B_etr B_frgAnl B_hsv2et B_hsve B_hsve2 B_hsvet B_kh B_kl15 B_kl15_zfe B_krdws B_kuppl B_kwluecke B_ll B_lr B_mil B_MotorStp B_nwsyn B_sa B_sbbvk B_sbbvk2 B_slp B_slv B_slvet B_sysbts B_te B_teakt B_tehb B_uetmc B_vl co_pot_w dmllri_w dmrllr_w dmvadfk_w dmvadfs_w dmvadko_w dmvadll_w dmvad_w dwkr dzws ES_kill ES_oelniv ES_poel ES_sst ES_sst1 ES_sst2 ES_start fcmEnd fho_w fkmsdka_w fkmsdk_w fmsla fmsla2 fmslva fmslva2 fr2_w fra2_w frao2_w frao_w frau2_w frau_w fra_w fr_w ftvdk gangi kmstand kmst_w Kwirq Lut_f mdgen mdko mdwan_w mimin_w msdif_w mshfm_w msndko_w Nc_cnt_nv nmot_w nsol nsol_w Nwe1_irq pu_w rka2_w rkat2_w rkats_w rkat_w rkaz2_w rkaz_w rka_w rkrn_w rlsol_w rl_w st_cur_pos szout_w S_kl15 S_kupp tabgm tans tateist tateout te2_w tev_btduty te_w tmot tmotzyl1_w tmotzyl2_w tnse_w trsec tsg ub udkp1mx_w usvk2_w usvk_w uulsuv2_w uulsuv_w vfzg vsidelete vsirw v_hrad v_vrad wdkba wdkba_w wdks_w wped_w zwist zwout Z_nwfehler /end IN_MEASUREMENT
 /begin OUT_MEASUREMENT /end OUT_MEASUREMENT
 /begin LOC_MEASUREMENT /end LOC_MEASUREMENT
 /begin SUB_FUNCTION /end SUB_FUNCTION
/end FUNCTION
/begin FUNCTION ti_k2_rdbli_b "" /begin DEF_CHARACTERISTIC /end DEF_CHARACTERISTIC /begin REF_CHARACTERISTIC NUEMAX /end REF_CHARACTERISTIC
 /begin IN_MEASUREMENT anznmax anzpbr_w B_abs B_agrrdy B_cdagr B_cdhsv B_cdlsv B_cdsls B_cdtes B_gap B_hsrdy B_katfz B_katrdy B_lowbat B_lowvoltage B_lsrdy B_slsrdy B_sperrEKP B_sysbts B_tesrdy B_zdgbts EE_bdm_init ES_kill evz_austot Ews_active Ews_auth Ews_default_auth Ews_Diag_Auth_done Ews_Diag_check_activ Ews_Diag_check_State Ews_Diag_FGNR_equal Ews_Diag_mSC_equal Ews_Diag_no_FGNR_ECU Ews_Diag_no_mSC_ECU Ews_D_Page4 Ews_D_Page5 Ews_D_Page6 EWS_GetID_activ EWS_GetID_State Ews_ID_found EWS_Init_activ EWS_Init_State EWS_KeyNo EWS_mechSC_A EWS_mechSC_B Ews_NS_auth Ews_Prog_Day Ews_Prog_Mon Ews_Prog_Ort Ews_Prog_Year EWS_Retry_Counter EWS_Retry_Counter_max EWS_status Ews_Trsp_fz_cnt Ews_trsp_init fcmEnd Fgstnummer flglrs flglrs2 kmstmil_w kmstnmax kmstpbr_w kva_korr KWP2000_Diag_Info llsstat nmaxvk_w Nmot slsstat tesstat uganga /end IN_MEASUREMENT
 /begin OUT_MEASUREMENT /end OUT_MEASUREMENT
 /begin LOC_MEASUREMENT /end LOC_MEASUREMENT
 /begin SUB_FUNCTION /end SUB_FUNCTION
/end FUNCTION
/begin FUNCTION TI_K2_RDTCBS_B "" /begin DEF_CHARACTERISTIC /end DEF_CHARACTERISTIC /begin REF_CHARACTERISTIC /end REF_CHARACTERISTIC /begin IN_MEASUREMENT fcmEnd /end IN_MEASUREMENT /begin OUT_MEASUREMENT /end OUT_MEASUREMENT /begin LOC_MEASUREMENT /end LOC_MEASUREMENT /begin SUB_FUNCTION /end SUB_FUNCTION /end FUNCTION
/begin FUNCTION TI_K2_SPC_B "" /begin DEF_CHARACTERISTIC /end DEF_CHARACTERISTIC /begin REF_CHARACTERISTIC /end REF_CHARACTERISTIC /begin IN_MEASUREMENT B_bt B_fa nmot /end IN_MEASUREMENT /begin OUT_MEASUREMENT /end OUT_MEASUREMENT /begin LOC_MEASUREMENT /end LOC_MEASUREMENT /begin SUB_FUNCTION /end SUB_FUNCTION /end FUNCTION
/begin FUNCTION ti_k2_sprbli_b "" /begin DEF_CHARACTERISTIC /end DEF_CHARACTERISTIC /begin REF_CHARACTERISTIC /end REF_CHARACTERISTIC
 /begin IN_MEASUREMENT B_faavr B_fadisa B_fadk B_fadka B_faevz B_fallas B_falls B_falr B_falra B_falsv B_falsv2 B_fanws B_fanwsd B_fasls B_fates B_grdst B_wdksap /end IN_MEASUREMENT
 /begin OUT_MEASUREMENT /end OUT_MEASUREMENT
 /begin LOC_MEASUREMENT /end LOC_MEASUREMENT
 /begin SUB_FUNCTION /end SUB_FUNCTION
/end FUNCTION
/begin FUNCTION TI_K2_STDS_B "" /begin DEF_CHARACTERISTIC /end DEF_CHARACTERISTIC /begin REF_CHARACTERISTIC /end REF_CHARACTERISTIC /begin IN_MEASUREMENT nmot_w /end IN_MEASUREMENT /begin OUT_MEASUREMENT /end OUT_MEASUREMENT /begin LOC_MEASUREMENT /end LOC_MEASUREMENT /begin SUB_FUNCTION /end SUB_FUNCTION /end FUNCTION
/begin FUNCTION ti_k2_strbli_b "" /begin DEF_CHARACTERISTIC /end DEF_CHARACTERISTIC /begin REF_CHARACTERISTIC /end REF_CHARACTERISTIC
 /begin IN_MEASUREMENT B_abs B_clradllr B_fa B_faavr B_fadisa B_fadka B_faevz B_fallas B_falls B_falr B_falra B_fasls B_fates B_gap B_grdst B_hwpwf B_wdksap evz_austot flglrs flglrs2 llsstat nmot_w pm_fre pm_mod pm_ta pm_td slsstat tesstat tmot top_w /end IN_MEASUREMENT
 /begin OUT_MEASUREMENT devoff /end OUT_MEASUREMENT
 /begin LOC_MEASUREMENT /end LOC_MEASUREMENT
 /begin SUB_FUNCTION /end SUB_FUNCTION
/end FUNCTION
/begin FUNCTION ti_k2_wdbci_b "" /begin DEF_CHARACTERISTIC /end DEF_CHARACTERISTIC /begin REF_CHARACTERISTIC /end REF_CHARACTERISTIC /begin IN_MEASUREMENT nmot_w top_w /end IN_MEASUREMENT /begin OUT_MEASUREMENT /end OUT_MEASUREMENT /begin LOC_MEASUREMENT /end LOC_MEASUREMENT /begin SUB_FUNCTION /end SUB_FUNCTION /end FUNCTION
/begin FUNCTION ti_k2_wdbli_b "" /begin DEF_CHARACTERISTIC /end DEF_CHARACTERISTIC /begin REF_CHARACTERISTIC /end REF_CHARACTERISTIC
 /begin IN_MEASUREMENT EE_bdm_init Ews_active Ews_Diag_check_activ Ews_Diag_check_State Ews_D_Page4 Ews_D_Page5 Ews_D_Page6 Ews_D_Page7 EWS_GetID_activ EWS_GetID_State EWS_Init_activ EWS_Init_State EWS_KeyNo EWS_mechSC_A EWS_mechSC_B Ews_Prog_Day Ews_Prog_Mon Ews_Prog_Ort Ews_Prog_Year EWS_SendToTRSP_Counter Ews_Trsp_fz_cnt Ews_trsp_init Fgstnummer kva_korr Nmot /end IN_MEASUREMENT
 /begin OUT_MEASUREMENT /end OUT_MEASUREMENT
 /begin LOC_MEASUREMENT /end LOC_MEASUREMENT
 /begin SUB_FUNCTION /end SUB_FUNCTION
/end FUNCTION
/begin FUNCTION TI_UTILIT "" /begin DEF_CHARACTERISTIC /end DEF_CHARACTERISTIC /begin REF_CHARACTERISTIC /end REF_CHARACTERISTIC /begin IN_MEASUREMENT fcmEnd /end IN_MEASUREMENT /begin OUT_MEASUREMENT /end OUT_MEASUREMENT /begin LOC_MEASUREMENT /end LOC_MEASUREMENT /begin SUB_FUNCTION /end SUB_FUNCTION /end FUNCTION
/begin FUNCTION ti_vm_dnmt_b "" /begin DEF_CHARACTERISTIC /end DEF_CHARACTERISTIC /begin REF_CHARACTERISTIC /end REF_CHARACTERISTIC /begin IN_MEASUREMENT nmot_w /end IN_MEASUREMENT /begin OUT_MEASUREMENT /end OUT_MEASUREMENT /begin LOC_MEASUREMENT /end LOC_MEASUREMENT /begin SUB_FUNCTION /end SUB_FUNCTION /end FUNCTION
/begin FUNCTION TI_VM_RDS2TCF_B "" /begin DEF_CHARACTERISTIC /end DEF_CHARACTERISTIC /begin REF_CHARACTERISTIC /end REF_CHARACTERISTIC /begin IN_MEASUREMENT fcmEnd /end IN_MEASUREMENT /begin OUT_MEASUREMENT /end OUT_MEASUREMENT /begin LOC_MEASUREMENT /end LOC_MEASUREMENT /begin SUB_FUNCTION /end SUB_FUNCTION /end FUNCTION
/begin FUNCTION TI_VM_RDS2TCM_B "" /begin DEF_CHARACTERISTIC /end DEF_CHARACTERISTIC /begin REF_CHARACTERISTIC /end REF_CHARACTERISTIC /begin IN_MEASUREMENT fcmEnd FCMTab kmstand /end IN_MEASUREMENT /begin OUT_MEASUREMENT /end OUT_MEASUREMENT /begin LOC_MEASUREMENT /end LOC_MEASUREMENT /begin SUB_FUNCTION /end SUB_FUNCTION /end FUNCTION
/begin FUNCTION TPU_BMS "" /begin DEF_CHARACTERISTIC /end DEF_CHARACTERISTIC /begin REF_CHARACTERISTIC /end REF_CHARACTERISTIC /begin IN_MEASUREMENT Ews_active Nmot /end IN_MEASUREMENT
 /begin OUT_MEASUREMENT B_nlph B_synph dphBits2_200ms nwg_sw1 nwg_sw2 nzahn_w tseg_l uzkw_w zzyl /end OUT_MEASUREMENT
 /begin LOC_MEASUREMENT /end LOC_MEASUREMENT
 /begin SUB_FUNCTION /end SUB_FUNCTION
/end FUNCTION
/begin FUNCTION TPU_BMS_DAT "" /begin DEF_CHARACTERISTIC K_TRESYNC /end DEF_CHARACTERISTIC /begin REF_CHARACTERISTIC /end REF_CHARACTERISTIC /begin IN_MEASUREMENT /end IN_MEASUREMENT
 /begin OUT_MEASUREMENT Fenster Intdrift Kbstest_cnt Mfende St_kbsdiag St_tpu Tresync U0 U01 Uint Uklopf Ukti Ureset Zylinder /end OUT_MEASUREMENT
 /begin LOC_MEASUREMENT /end LOC_MEASUREMENT
 /begin SUB_FUNCTION /end SUB_FUNCTION
/end FUNCTION
/begin FUNCTION TPU_INJEC "" /begin DEF_CHARACTERISTIC K_KVA K_TEMIN K_TEMINOFF /end DEF_CHARACTERISTIC /begin REF_CHARACTERISTIC /end REF_CHARACTERISTIC /begin IN_MEASUREMENT /end IN_MEASUREMENT /begin OUT_MEASUREMENT Eoi Kva_summe Soi St_injesb Tianz Tiout Ti_summe Vl_winkel /end OUT_MEASUREMENT /begin LOC_MEASUREMENT /end LOC_MEASUREMENT /begin SUB_FUNCTION /end SUB_FUNCTION /end FUNCTION
/begin FUNCTION TPU_IO "" /begin DEF_CHARACTERISTIC TPUWWMAX TPUWWSEG /end DEF_CHARACTERISTIC /begin REF_CHARACTERISTIC /end REF_CHARACTERISTIC /begin IN_MEASUREMENT Segakt /end IN_MEASUREMENT /begin OUT_MEASUREMENT tpuwwdauer tpuwwstart /end OUT_MEASUREMENT /begin LOC_MEASUREMENT /end LOC_MEASUREMENT /begin SUB_FUNCTION /end SUB_FUNCTION /end FUNCTION
/begin FUNCTION TPU_KWCHN ""
 /begin DEF_CHARACTERISTIC K_ALEN K_LURENDE K_LURSTART K_NLIMIT K_NMAX K_TPRELL K_ZPERUNSYNC K_ZPRELL K_ZUNSYNC S_SEGCLRNW /end DEF_CHARACTERISTIC
 /begin REF_CHARACTERISTIC /end REF_CHARACTERISTIC
 /begin IN_MEASUREMENT /end IN_MEASUREMENT
 /begin OUT_MEASUREMENT B_kwdreht B_kwluecke B_neusync B_nlimit B_nsegment B_tprell B_tpuaktiv B_zprell Kwerror Kwirq Kwkriterr Kwkriterrm Kwkriterrs Nkw_grad Nmot St_mkwchn Synclevel Tkwlur Tkwseg Tkwzale Tpoz /end OUT_MEASUREMENT
 /begin LOC_MEASUREMENT /end LOC_MEASUREMENT
 /begin SUB_FUNCTION /end SUB_FUNCTION
/end FUNCTION
/begin FUNCTION TPU_NWCHN ""
 /begin DEF_CHARACTERISTIC CW_NWFLANKE K_NWE1_MAX K_NWE1_MIN K_NWPOSMN K_NWPOSMX K_NW_SYNC_IRQ K_PEGEL_TPO_ZAHN K_TPO_ZAHN1 K_TPO_ZAHN2 K_TPO_ZAHN3 NMOTSYNC S_NWNOSYNC S_TIUNSYNC /end DEF_CHARACTERISTIC
 /begin REF_CHARACTERISTIC /end REF_CHARACTERISTIC
 /begin IN_MEASUREMENT /end IN_MEASUREMENT
 /begin OUT_MEASUREMENT B_anw1irq B_anw2irq B_enw1irq B_enw2irq B_nmaxsyn B_nwcheck1 B_nwcheck2 B_nwcheck3 B_nwfehler B_nwsyn B_nwturn B_waittpo N Ngrad Ngradsig Nkw Nwe1poserr Nwe1_irq Nwe1_pos Nwe1_time Segakt Segment_aktuell Status_kwnot St_nwirq St_nwsync T_kwseg /end OUT_MEASUREMENT
 /begin LOC_MEASUREMENT /end LOC_MEASUREMENT
 /begin SUB_FUNCTION /end SUB_FUNCTION
/end FUNCTION
/begin FUNCTION TPU_ZUECHN "" /begin DEF_CHARACTERISTIC K_ZUEWMAXST /end DEF_CHARACTERISTIC /begin REF_CHARACTERISTIC /end REF_CHARACTERISTIC /begin IN_MEASUREMENT /end IN_MEASUREMENT /begin OUT_MEASUREMENT Dzw Szout Zwist Zwout Zwsoll /end OUT_MEASUREMENT /begin LOC_MEASUREMENT /end LOC_MEASUREMENT /begin SUB_FUNCTION /end SUB_FUNCTION /end FUNCTION
/begin FUNCTION TRSP ""
 /begin DEF_CHARACTERISTIC EWS_BIT_CHK_VAL_1 EWS_BIT_CHK_VAL_2 EWS_START_DELAY EWS_T_HIGH_0 EWS_T_HIGH_1 EWS_T_HIGH_STOP EWS_T_LOW /end DEF_CHARACTERISTIC
 /begin REF_CHARACTERISTIC /end REF_CHARACTERISTIC
 /begin IN_MEASUREMENT /end IN_MEASUREMENT
 /begin OUT_MEASUREMENT /end OUT_MEASUREMENT
 /begin LOC_MEASUREMENT /end LOC_MEASUREMENT
 /begin SUB_FUNCTION /end SUB_FUNCTION
/end FUNCTION
/begin FUNCTION UETM "Motor¸bertemperatur-Anzeige" /begin DEF_CHARACTERISTIC DUETMOT TUETM UETMOT /end DEF_CHARACTERISTIC /begin REF_CHARACTERISTIC /end REF_CHARACTERISTIC
 /begin IN_MEASUREMENT B_adpini B_btuetmc B_kl15 B_stend B_uetmcet nmot tmot tnst_w /end IN_MEASUREMENT
 /begin OUT_MEASUREMENT B_uetm B_uetmc UetmNvBits /end OUT_MEASUREMENT
 /begin LOC_MEASUREMENT B_nouetm /end LOC_MEASUREMENT
 /begin SUB_FUNCTION /end SUB_FUNCTION
/end FUNCTION
/begin FUNCTION UFMSRC "EGAS ‹berwachungskonzept: MSR-Eingriff-‹berwachung f¸r die Funktions¸berwachung" /begin DEF_CHARACTERISTIC BZ_MSR_M CWNOMSRU MSRC_T_UM /end DEF_CHARACTERISTIC /begin REF_CHARACTERISTIC /end REF_CHARACTERISTIC /begin IN_MEASUREMENT raster_um /end IN_MEASUREMENT /begin OUT_MEASUREMENT B_nomsr_um ei_msrc_um mmsr_um /end OUT_MEASUREMENT /begin LOC_MEASUREMENT alv_old_um msrc_c_um /end LOC_MEASUREMENT /begin SUB_FUNCTION /end SUB_FUNCTION /end FUNCTION
/begin FUNCTION UFNSC "EGAS ‹berwachungskonzept: Nachstart¸berwachung f¸r die Funktions¸berwachung"
 /begin DEF_CHARACTERISTIC NSC_T_UM NSOF_T_UM N_START_UM N_STEND_UM TANSMN_UM TMNSMN_UM /end DEF_CHARACTERISTIC
 /begin REF_CHARACTERISTIC /end REF_CHARACTERISTIC
 /begin IN_MEASUREMENT nmot raster_um tans tmot /end IN_MEASUREMENT
 /begin OUT_MEASUREMENT B_mzns_um /end OUT_MEASUREMENT
 /begin LOC_MEASUREMENT nsc_c_um nsof_c_um /end LOC_MEASUREMENT
 /begin SUB_FUNCTION /end SUB_FUNCTION
/end FUNCTION
/begin FUNCTION UFURAM "" /begin DEF_CHARACTERISTIC /end DEF_CHARACTERISTIC /begin REF_CHARACTERISTIC /end REF_CHARACTERISTIC /begin IN_MEASUREMENT /end IN_MEASUREMENT
 /begin OUT_MEASUREMENT b_flags_um n_flags_um raster_um romz_c_um r_flags_um srst_c_um s_flags_um t_flags_um wri_c_um /end OUT_MEASUREMENT
 /begin LOC_MEASUREMENT B_brems_um B_brfgr_um B_bsl_um B_dcdis_um B_fgrea_um B_i_ska B_kkl_um B_naccf_um B_nlh_um B_notlu B_nsakt_um B_nsend_um B_reaci_um B_rlini_um B_rluf_um B_srstz_um B_srst_um B_tpu_um B_ub_ska B_vzl_um B_wal_um reset_indication_um /end LOC_MEASUREMENT
 /begin SUB_FUNCTION /end SUB_FUNCTION
/end FUNCTION
/begin FUNCTION UK2LNK "" /begin DEF_CHARACTERISTIC /end DEF_CHARACTERISTIC /begin REF_CHARACTERISTIC /end REF_CHARACTERISTIC /begin IN_MEASUREMENT /end IN_MEASUREMENT /begin OUT_MEASUREMENT /end OUT_MEASUREMENT /begin LOC_MEASUREMENT /end LOC_MEASUREMENT /begin SUB_FUNCTION /end SUB_FUNCTION /end FUNCTION
/begin FUNCTION UMAUSC "EGAS ‹berwachungskonzept: Abschaltpfadtest ‹berwachungsmodul"
 /begin DEF_CHARACTERISTIC Abschaltpfadtest_in_init AUSCH_T_UM AUSC_T_UM ini_wda_resptime MAX_Abschaltpfadtest /end DEF_CHARACTERISTIC
 /begin REF_CHARACTERISTIC /end REF_CHARACTERISTIC
 /begin IN_MEASUREMENT B_ubdve newqu_um umerr_c_um /end IN_MEASUREMENT
 /begin OUT_MEASUREMENT auscf_c_um ausch_c_um ausc_c_um B_ausc_act B_ausc_um B_nxptr_um ei_ubr_um /end OUT_MEASUREMENT
 /begin LOC_MEASUREMENT /end LOC_MEASUREMENT
 /begin SUB_FUNCTION /end SUB_FUNCTION
/end FUNCTION
/begin FUNCTION UMKOM "EGAS ‹berwachungskonzept: Frage/Antwort-Kommunikation zw. UM und FR" /begin DEF_CHARACTERISTIC FRERR_T_UM /end DEF_CHARACTERISTIC /begin REF_CHARACTERISTIC AUSCH_T_UM /end REF_CHARACTERISTIC /begin IN_MEASUREMENT B_ausc_act B_ausc_um e_mem_um /end IN_MEASUREMENT
 /begin OUT_MEASUREMENT B_nxtrp_um frerr_c_um frtar_c_um newansw_um newqu_um umerr_c_um /end OUT_MEASUREMENT
 /begin LOC_MEASUREMENT plstate_um /end LOC_MEASUREMENT
 /begin SUB_FUNCTION /end SUB_FUNCTION
/end FUNCTION
/begin FUNCTION URMEM "EGAS ‹berwachungskonzept: Zyklischer Speichertest" /begin DEF_CHARACTERISTIC AUSGH_T_UM AUSG_T_UM AUSZH_T_UM AUSZ_T_UM /end DEF_CHARACTERISTIC /begin REF_CHARACTERISTIC /end REF_CHARACTERISTIC /begin IN_MEASUREMENT raster_um /end IN_MEASUREMENT /begin OUT_MEASUREMENT e_mem_um urmcksco urmcksda urmpatco /end OUT_MEASUREMENT /begin LOC_MEASUREMENT ausgh_c_um ausg_c_um auszh_c_um ausz_c_um /end LOC_MEASUREMENT /begin SUB_FUNCTION /end SUB_FUNCTION /end FUNCTION
/begin FUNCTION URRAM "EGAS ‹berwachungskonzept: RAM-Test" /begin DEF_CHARACTERISTIC /end DEF_CHARACTERISTIC /begin REF_CHARACTERISTIC /end REF_CHARACTERISTIC /begin IN_MEASUREMENT B_pwf e_mem_um e_rom1_um e_romx_um rompage_um wri_c_um /end IN_MEASUREMENT /begin OUT_MEASUREMENT e_ram_um stacktest_rel stacktest_words /end OUT_MEASUREMENT /begin LOC_MEASUREMENT /end LOC_MEASUREMENT /begin SUB_FUNCTION /end SUB_FUNCTION /end FUNCTION
/begin FUNCTION URROM "EGAS ‹berwachungskonzept: ROM-Test" /begin DEF_CHARACTERISTIC CW_NOROMCHKRESET ROMRSTA_UM /end DEF_CHARACTERISTIC /begin REF_CHARACTERISTIC /end REF_CHARACTERISTIC /begin IN_MEASUREMENT B_nlsiko B_pwf e_mem_um e_ram_um swOffDlBits /end IN_MEASUREMENT /begin OUT_MEASUREMENT e_rom1_um e_romx_um rompage_um romrstc_um /end OUT_MEASUREMENT /begin LOC_MEASUREMENT /end LOC_MEASUREMENT /begin SUB_FUNCTION /end SUB_FUNCTION /end FUNCTION
/begin FUNCTION URTPU "TPU-‹berwachung" /begin DEF_CHARACTERISTIC TPUCR_T_UM TPURA_T_UM /end DEF_CHARACTERISTIC /begin REF_CHARACTERISTIC /end REF_CHARACTERISTIC /begin IN_MEASUREMENT e_mem_um raster_um /end IN_MEASUREMENT /begin OUT_MEASUREMENT ei_tpu_um /end OUT_MEASUREMENT /begin LOC_MEASUREMENT tpucr_c_um tpura_c_um /end LOC_MEASUREMENT /begin SUB_FUNCTION /end SUB_FUNCTION /end FUNCTION
/begin FUNCTION UTIL "" /begin DEF_CHARACTERISTIC NMIN /end DEF_CHARACTERISTIC /begin REF_CHARACTERISTIC /end REF_CHARACTERISTIC /begin IN_MEASUREMENT B_nachl B_wakeup B_zprell Nmot /end IN_MEASUREMENT /begin OUT_MEASUREMENT B_nmin B_nmot drrev_sta inisynmon /end OUT_MEASUREMENT /begin LOC_MEASUREMENT /end LOC_MEASUREMENT /begin SUB_FUNCTION /end SUB_FUNCTION /end FUNCTION
/begin FUNCTION VMAXMD "Drehmomentanforderung von VMAX-Regelung"
 /begin DEF_CHARACTERISTIC CWDVMX KFMIRED NMINVMX SBF02MFSB SRL03MFUW TVMXPR VABSCH VHYST VMAXO VMAXP VVORH ZBFIL ZIVMAX /end DEF_CHARACTERISTIC
 /begin REF_CHARACTERISTIC MDIMX /end REF_CHARACTERISTIC
 /begin IN_MEASUREMENT bfzgl_b mifab_w miist_w nmot rl_w vfgr_w /end IN_MEASUREMENT
 /begin OUT_MEASUREMENT bfzglf B_vmax esst_sbf02mfsb esst_srl03mfuw mivmx_w /end OUT_MEASUREMENT
 /begin LOC_MEASUREMENT dmvmxi_w dmvmxp_w dvprae_w dvsi_w ivmax mired mivmxs vfzgpr_w /end LOC_MEASUREMENT
 /begin SUB_FUNCTION /end SUB_FUNCTION
/end FUNCTION
/begin FUNCTION VSI "" /begin DEF_CHARACTERISTIC CW_VSI VSIKVBASIS VSIW /end DEF_CHARACTERISTIC /begin REF_CHARACTERISTIC /end REF_CHARACTERISTIC /begin IN_MEASUREMENT B_vsiReset kvaverbr /end IN_MEASUREMENT /begin OUT_MEASUREMENT vsidelete vsikvsum vsirw /end OUT_MEASUREMENT /begin LOC_MEASUREMENT /end LOC_MEASUREMENT /begin SUB_FUNCTION /end SUB_FUNCTION /end FUNCTION
/begin FUNCTION WES "Winkel Einlass Schliesst (BMW-Funktion)" /begin DEF_CHARACTERISTIC WESNESPR /end DEF_CHARACTERISTIC /begin REF_CHARACTERISTIC /end REF_CHARACTERISTIC /begin IN_MEASUREMENT evhubs_w Vse_spri /end IN_MEASUREMENT /begin OUT_MEASUREMENT wes wesnesprau /end OUT_MEASUREMENT /begin LOC_MEASUREMENT /end LOC_MEASUREMENT /begin SUB_FUNCTION /end SUB_FUNCTION /end FUNCTION
/begin FUNCTION WHEELSPEED "" /begin DEF_CHARACTERISTIC LPFACDECV LPFACHRAD LPFACINCV PHYSPDLIMH PHYSPDLIMV /end DEF_CHARACTERISTIC /begin REF_CHARACTERISTIC /end REF_CHARACTERISTIC /begin IN_MEASUREMENT hr_v_w vr_v_w /end IN_MEASUREMENT
 /begin OUT_MEASUREMENT lpfach_w lpfacv_w vhradchk vhradunchk vvradchk vvradunchk v_hradabs v_vradabs /end OUT_MEASUREMENT
 /begin LOC_MEASUREMENT /end LOC_MEASUREMENT
 /begin SUB_FUNCTION /end SUB_FUNCTION
/end FUNCTION
/begin FUNCTION ZNDAUS "Z¸ndung: Anforderungen f¸r Ausblendung" /begin DEF_CHARACTERISTIC ANWFOZA /end DEF_CHARACTERISTIC /begin REF_CHARACTERISTIC /end REF_CHARACTERISTIC /begin IN_MEASUREMENT B_fofrun B_sa zzyl /end IN_MEASUREMENT /begin OUT_MEASUREMENT B_zndaus /end OUT_MEASUREMENT /begin LOC_MEASUREMENT /end LOC_MEASUREMENT /begin SUB_FUNCTION /end SUB_FUNCTION /end FUNCTION
/begin FUNCTION ZUE "Grundfunktion - Z¸ndung" /begin DEF_CHARACTERISTIC NACHANZ S_KRZWSOL WMNDOPZ WPHN ZWAPPL /end DEF_CHARACTERISTIC /begin REF_CHARACTERISTIC REDANZ SNM08__UB /end REF_CHARACTERISTIC
 /begin IN_MEASUREMENT B_allzwe B_ll B_llrein B_nkoff B_nozwe B_sa B_zwappl dwkrkorll dwkrz dzwwl esst_snm08__ub krmf_start nmot redist vszw wkrdy zwgru zwofsnk zwout zwsol zwspae zwstt zzylzue /end IN_MEASUREMENT
 /begin OUT_MEASUREMENT B_krzwsol B_llzwe B_zwkra B_zwspae znachanz zwbas zwbasar zwbaskrkor zwist zwkrafld zwoutar zwoutzyl zwout_nk zwzyl1 /end OUT_MEASUREMENT
 /begin LOC_MEASUREMENT wphg /end LOC_MEASUREMENT
 /begin SUB_FUNCTION /end SUB_FUNCTION
/end FUNCTION
/begin FUNCTION ZUESZ "Z¸ndung, Berechnung Schlieﬂzeit" /begin DEF_CHARACTERISTIC TSUB /end DEF_CHARACTERISTIC /begin REF_CHARACTERISTIC /end REF_CHARACTERISTIC /begin IN_MEASUREMENT B_stend ub /end IN_MEASUREMENT /begin OUT_MEASUREMENT szout_w /end OUT_MEASUREMENT /begin LOC_MEASUREMENT /end LOC_MEASUREMENT /begin SUB_FUNCTION /end SUB_FUNCTION /end FUNCTION
/begin FUNCTION ZWGRU "Grundz¸ndwinkel"
 /begin DEF_CHARACTERISTIC DZWTANSPU FAKNZ_NSEG KFDZWEKR KFDZWFF KFDZWFS KFDZWTM KFZWDI1 KFZWDI1EPH KFZWLL KFZWLLEPH KFZWVL1 KFZWVL1EPH KSDZWE NKLO RLKL /end DEF_CHARACTERISTIC
 /begin REF_CHARACTERISTIC CW_TZYL SNM24ZUUB1 SRL03ZUUB SRL16ZUUB /end REF_CHARACTERISTIC
 /begin IN_MEASUREMENT B_kr B_krdws B_ll B_nwfehler B_stend B_vl dzwoag dzwol esst_snm24zuub1 esst_srl03zuub esst_srl16zuub nmot nmot_w nzahn_w pu rl rl_w tans tmotzyl_w zwmnms /end IN_MEASUREMENT
 /begin OUT_MEASUREMENT dzwekr dzwkg dzwtans dzwtantmot dzwtgew dzwtmot fakdzw faknznseg nzwgru nzwgru_w zwgru /end OUT_MEASUREMENT
 /begin LOC_MEASUREMENT B_wkora /end LOC_MEASUREMENT
 /begin SUB_FUNCTION /end SUB_FUNCTION
/end FUNCTION
/begin FUNCTION ZWMIN "Berechnung des sp‰test erlaubten Z¸ndwinkels"
 /begin DEF_CHARACTERISTIC DZWAML DZWSPM FZWKHMX KFZWMN KFZWMNKH KFZWMNST KFZWMS KLZZWMNST TVZWMSA TVZWMSE /end DEF_CHARACTERISTIC
 /begin REF_CHARACTERISTIC ETADZW SNM16ZUUB SRL12ZUUB STMZYL06__UW /end REF_CHARACTERISTIC
 /begin IN_MEASUREMENT B_kh B_kw B_sa B_st esst_snm16zuub esst_srl12zuub esst_stmzyl06__uw fmdkh migs_w misolv_w misol_w ml nmot rl tmotzyl_w tmstzyl_w zwist zwopt /end IN_MEASUREMENT
 /begin OUT_MEASUREMENT B_zwms dzwspae etazwmn zwmnms zwspae /end OUT_MEASUREMENT
 /begin LOC_MEASUREMENT B_zwmnste dzwmna zwmn zwmnd zwnst /end LOC_MEASUREMENT
 /begin SUB_FUNCTION /end SUB_FUNCTION
/end FUNCTION
/begin FUNCTION ZWNK "" /begin DEF_CHARACTERISTIC KFZWDI1OFS KFZWLLOFS KFZWVL1OFS NMOTNK ZWOUTNK /end DEF_CHARACTERISTIC /begin REF_CHARACTERISTIC SNM24ZUUB1 SRL03ZUUB SRL16ZUUB /end REF_CHARACTERISTIC
 /begin IN_MEASUREMENT B_ll B_synph B_vl esst_snm24zuub1 esst_srl03zuub esst_srl16zuub nmot nzwgru rl /end IN_MEASUREMENT
 /begin OUT_MEASUREMENT B_nkoff zwofsnk zwofubph /end OUT_MEASUREMENT
 /begin LOC_MEASUREMENT /end LOC_MEASUREMENT
 /begin SUB_FUNCTION /end SUB_FUNCTION
/end FUNCTION
/begin FUNCTION ZWSTT "Z¸ndung im Start" /begin DEF_CHARACTERISTIC DZWSTTA KFZWSTNMTM /end DEF_CHARACTERISTIC /begin REF_CHARACTERISTIC /end REF_CHARACTERISTIC /begin IN_MEASUREMENT B_stend nzwgru tans tmst /end IN_MEASUREMENT /begin OUT_MEASUREMENT zwstnmtm zwstt zwstta /end OUT_MEASUREMENT /begin LOC_MEASUREMENT /end LOC_MEASUREMENT /begin SUB_FUNCTION /end SUB_FUNCTION /end FUNCTION
/begin FUNCTION ZWWL "Warmlauf Z¸ndwinkel" /begin DEF_CHARACTERISTIC KFWZWWLDI KFWZWWLLL KFWZWWLVL KFZWWLTM /end DEF_CHARACTERISTIC /begin REF_CHARACTERISTIC /end REF_CHARACTERISTIC /begin IN_MEASUREMENT B_ll B_vl nmot rl tmotzyl_w tmstzyl_w /end IN_MEASUREMENT /begin OUT_MEASUREMENT dzwwl fakdzwwl /end OUT_MEASUREMENT /begin LOC_MEASUREMENT /end LOC_MEASUREMENT /begin SUB_FUNCTION /end SUB_FUNCTION /end FUNCTION
/begin COMPU_METHOD bfzg_sb_q0p217 "" RAT_FUNC "%6.3" "m/s^2" COEFFS 0 1 0 0 0 0.217 /end COMPU_METHOD
/begin COMPU_METHOD B_TRUE "" TAB_VERB "%6.3" "" COMPU_TAB_REF B_TRUE /end COMPU_METHOD
/begin COMPU_VTAB B_TRUE "" TAB_VERB 2 0 "false" 1 "TRUE" /end COMPU_VTAB
/begin COMPU_METHOD Def_kw_sw_q0p0234 "" RAT_FUNC "%6.4" "Grad KW" COEFFS 0 256 0 0 0 6 /end COMPU_METHOD
/begin COMPU_METHOD Def_kw_ub_q6p0 "" RAT_FUNC "%6.2" "Grad Kw" COEFFS 0 1 0 0 0 6 /end COMPU_METHOD
/begin COMPU_METHOD Def_n "" RAT_FUNC "%6.2" "Upm" COEFFS 0 1 0 0 0 1 /end COMPU_METHOD
/begin COMPU_METHOD Def_n4 "" RAT_FUNC "%6.3" "Upm" COEFFS 0 4 0 0 0 1 /end COMPU_METHOD
/begin COMPU_METHOD Def_td_ub_q6p5536 "" RAT_FUNC "%6.2" "ms" COEFFS 0 10000 0 0 0 65536 /end COMPU_METHOD
/begin COMPU_METHOD Def_ti_uw_q0p0008 "" RAT_FUNC "%6.5" "ms" COEFFS 0 1250 0 0 0 1 /end COMPU_METHOD
/begin COMPU_METHOD Def_tkw_ul_q0p0001 "" RAT_FUNC "%7.6" "ms" COEFFS 0 10000 0 0 0 1 /end COMPU_METHOD
/begin COMPU_METHOD dez "" RAT_FUNC "%6.2" "" COEFFS 0 1 0 0 0 1 /end COMPU_METHOD
/begin COMPU_METHOD dezsub1 "" RAT_FUNC "%6.2" "-" COEFFS 0 1 -1 0 0 1 /end COMPU_METHOD
/begin COMPU_METHOD fak_q0p00195 "" RAT_FUNC "%6.4" "-" COEFFS 0 65536 0 0 0 128 /end COMPU_METHOD
/begin COMPU_METHOD fak_sb_b1 "" RAT_FUNC "%6.4" "-" COEFFS 0 256 0 0 0 2 /end COMPU_METHOD
/begin COMPU_METHOD fak_sb_b2 "" RAT_FUNC "%6.4" "-" COEFFS 0 256 0 0 0 4 /end COMPU_METHOD
/begin COMPU_METHOD fak_sb_b64 "" RAT_FUNC "%6.3" "-" COEFFS 0 256 0 0 0 128 /end COMPU_METHOD
/begin COMPU_METHOD fak_sb_q0p5 "" RAT_FUNC "%6.3" "-" COEFFS 0 256 0 0 0 128 /end COMPU_METHOD
/begin COMPU_METHOD fak_sw_b16 "" RAT_FUNC "%6.5" "-" COEFFS 0 65536 0 0 0 32 /end COMPU_METHOD
/begin COMPU_METHOD fak_sw_b2 "" RAT_FUNC "%7.6" "-" COEFFS 0 65536 0 0 0 4 /end COMPU_METHOD
/begin COMPU_METHOD fak_sw_b64 "" RAT_FUNC "%6.4" "-" COEFFS 0 65536 0 0 0 128 /end COMPU_METHOD
/begin COMPU_METHOD fak_ub_b0p03125 "" RAT_FUNC "%6.5" "-" COEFFS 0 256 0 0 0 0.03125 /end COMPU_METHOD
/begin COMPU_METHOD fak_ub_b0p5 "" RAT_FUNC "%6.4" "-" COEFFS 0 256 0 0 0 0.5 /end COMPU_METHOD
/begin COMPU_METHOD fak_ub_b1 "" RAT_FUNC "%6.4" "-" COEFFS 0 256 0 0 0 1 /end COMPU_METHOD
/begin COMPU_METHOD fak_ub_b16 "" RAT_FUNC "%6.4" "-" COEFFS 0 256 0 0 0 16 /end COMPU_METHOD
/begin COMPU_METHOD fak_ub_b2 "" RAT_FUNC "%6.4" "-" COEFFS 0 256 0 0 0 2 /end COMPU_METHOD
/begin COMPU_METHOD fak_ub_b32 "" RAT_FUNC "%6.3" "-" COEFFS 0 256 0 0 0 32 /end COMPU_METHOD
/begin COMPU_METHOD fak_ub_b4 "" RAT_FUNC "%6.4" "-" COEFFS 0 256 0 0 0 4 /end COMPU_METHOD
/begin COMPU_METHOD fak_ub_b8 "" RAT_FUNC "%6.4" "-" COEFFS 0 256 0 0 0 8 /end COMPU_METHOD
/begin COMPU_METHOD fak_uw_b0p5 "" RAT_FUNC "%8.7" "-" COEFFS 0 65536 0 0 0 0.5 /end COMPU_METHOD
/begin COMPU_METHOD fak_uw_b1 "" RAT_FUNC "%7.6" "-" COEFFS 0 65536 0 0 0 1 /end COMPU_METHOD
/begin COMPU_METHOD fak_uw_b16 "" RAT_FUNC "%6.5" "-" COEFFS 0 65536 0 0 0 16 /end COMPU_METHOD
/begin COMPU_METHOD fak_uw_b2 "" RAT_FUNC "%7.6" "-" COEFFS 0 65536 0 0 0 2 /end COMPU_METHOD
/begin COMPU_METHOD fuel_q0p000008 "" RAT_FUNC "%8.7" "l" COEFFS 0 1e+006 0 0 0 8 /end COMPU_METHOD
/begin COMPU_METHOD fuel_q0p524288 "" RAT_FUNC "%6.3" "l" COEFFS 0 1e+006 0 0 0 524288 /end COMPU_METHOD
/begin COMPU_METHOD hub_uw_q0p001 "" RAT_FUNC "%6.5" "mm" COEFFS 0 1000 0 0 0 1 /end COMPU_METHOD
/begin COMPU_METHOD km_uw_q10 "" RAT_FUNC "%6.1" "km" COEFFS 0 1 0 0 0 10 /end COMPU_METHOD
/begin COMPU_METHOD krmf_to_zw "" RAT_FUNC "%6.4" "Grad KW" COEFFS 0 8160 0 0 0 191.25 /end COMPU_METHOD
/begin COMPU_METHOD kw_q0p02566 "" RAT_FUNC "%6.4" "∞KW" COEFFS 0 256 0 0 0 6 /end COMPU_METHOD
/begin COMPU_METHOD kw_q1 "" RAT_FUNC "%6.2" "Grad KW" COEFFS 0 1 0 0 0 1 /end COMPU_METHOD
/begin COMPU_METHOD kw_q3 "" RAT_FUNC "%6.2" "Grad KW" COEFFS 0 1 0 0 0 3 /end COMPU_METHOD
/begin COMPU_METHOD m_ub_b1020 "" RAT_FUNC "%6.2" "kg/h" COEFFS 0 1 0 0 0 4 /end COMPU_METHOD
/begin COMPU_METHOD m_ub_q0p0444 "" RAT_FUNC "%6.4" "g" COEFFS 0 1 0 0 0 0.0444 /end COMPU_METHOD
/begin COMPU_METHOD m_uw_b25p6 "" RAT_FUNC "%6.5" "kg/h" COEFFS 0 65536 0 0 0 25.6 /end COMPU_METHOD
/begin COMPU_METHOD m_uw_b6553p5 "" RAT_FUNC "%6.3" "kg/h" COEFFS 0 1 0 0 0 0.1 /end COMPU_METHOD
/begin COMPU_METHOD nmot_ub_q10 "" RAT_FUNC "%6.1" "1/min" COEFFS 0 1 0 0 0 10 /end COMPU_METHOD
/begin COMPU_METHOD nmot_ub_q40 "" RAT_FUNC "%6.1" "1/min" COEFFS 0 1 0 0 0 40 /end COMPU_METHOD
/begin COMPU_METHOD nmot_uw_q0p25 "" RAT_FUNC "%6.3" "1/min" COEFFS 0 1 0 0 0 0.25 /end COMPU_METHOD
/begin COMPU_METHOD perio_sw_b1p562 "" RAT_FUNC "%7.6" "1/s" COEFFS 0 65536 0 0 0 3.124 /end COMPU_METHOD
/begin COMPU_METHOD perio_sw_b6p125 "" RAT_FUNC "%6.5" "1/s" COEFFS 0 65536 0 0 0 12.25 /end COMPU_METHOD
/begin COMPU_METHOD perio_ub_b0p012207 "" RAT_FUNC "%7.6" "1/s" COEFFS 0 256 0 0 0 0.012207 /end COMPU_METHOD
/begin COMPU_METHOD perio_ub_b6p125 "" RAT_FUNC "%6.4" "1/s" COEFFS 0 256 0 0 0 6.125 /end COMPU_METHOD
/begin COMPU_METHOD p_sb_q32 "" RAT_FUNC "%6.3" "hPa" COEFFS 0 256 0 0 0 64 /end COMPU_METHOD
/begin COMPU_METHOD p_ub_q5 "" RAT_FUNC "%6.2" "hPa" COEFFS 0 1 0 0 0 5 /end COMPU_METHOD
/begin COMPU_METHOD rel_q0p00195 "" RAT_FUNC "%6.4" "%" COEFFS 0 65536 0 0 0 128 /end COMPU_METHOD
/begin COMPU_METHOD rel_q0p392 "" RAT_FUNC "%6.3" "%" COEFFS 0 255 0 0 0 100 /end COMPU_METHOD
/begin COMPU_METHOD rel_sb_q0p78 "" RAT_FUNC "%6.3" "%" COEFFS 0 1 0 0 0 0.78 /end COMPU_METHOD
/begin COMPU_METHOD rel_sw_b100 "" RAT_FUNC "%6.4" "%" COEFFS 0 32768 0 0 0 100 /end COMPU_METHOD
/begin COMPU_METHOD rel_sw_q0p0468 "" RAT_FUNC "%6.4" "%" COEFFS 0 65536 0 0 0 3072 /end COMPU_METHOD
/begin COMPU_METHOD rel_ub_b127p5 "" RAT_FUNC "%6.3" "%" COEFFS 0 2 0 0 0 1 /end COMPU_METHOD
/begin COMPU_METHOD rel_ub_b99p6 "" RAT_FUNC "%6.3" "%" COEFFS 0 256 0 0 0 100 /end COMPU_METHOD
/begin COMPU_METHOD rel_ub_q0p3906 "" RAT_FUNC "%6.3" "%" COEFFS 0 256 0 0 0 100 /end COMPU_METHOD
/begin COMPU_METHOD rel_ub_q0p391 "" RAT_FUNC "%6.3" "%/km/h" COEFFS 0 1 0 0 0 0.391 /end COMPU_METHOD
/begin COMPU_METHOD rel_ub_q0p75 "" RAT_FUNC "%6.3" "%" COEFFS 0 1 0 0 0 0.75 /end COMPU_METHOD
/begin COMPU_METHOD rel_uw_b100 "" RAT_FUNC "%6.4" "%" COEFFS 0 65536 0 0 0 100 /end COMPU_METHOD
/begin COMPU_METHOD rel_uw_b192 "" RAT_FUNC "%6.4" "%" COEFFS 0 65536 0 0 0 192 /end COMPU_METHOD
/begin COMPU_METHOD rel_uw_b3072 "" RAT_FUNC "%6.4" "%" COEFFS 0 65536 0 0 0 3072 /end COMPU_METHOD
/begin COMPU_METHOD rel_uw_q0p0234 "" RAT_FUNC "%6.4" "%" COEFFS 0 32 0 0 0 0.75 /end COMPU_METHOD
/begin COMPU_METHOD rgrad_uw_b1280 "" RAT_FUNC "%6.4" "%/s" COEFFS 0 65536 0 0 0 1280 /end COMPU_METHOD
/begin COMPU_METHOD spg_ubatt "" RAT_FUNC "%6.3" "V" COEFFS 0 1 0 0 0 0.0942 /end COMPU_METHOD
/begin COMPU_METHOD sprzi_q0p1 "" RAT_FUNC "%3.2" "Grad KW" COEFFS 0 10 0 0 0 1 /end COMPU_METHOD
/begin COMPU_METHOD t100msxs_uw_b6553p5 "" RAT_FUNC "%6.3" "s" COEFFS 0 1 0 0 0 0.1 /end COMPU_METHOD
/begin COMPU_METHOD t100msxs_uw_q100 "" RAT_FUNC "%6.3" "s" COEFFS 0 1 0 0 0 0.1 /end COMPU_METHOD
/begin COMPU_METHOD t10msxs_ub_b2p55 "" RAT_FUNC "%6.4" "s" COEFFS 0 1 0 0 0 0.01 /end COMPU_METHOD
/begin COMPU_METHOD t10msxs_uw_b655p35 "" RAT_FUNC "%6.4" "s" COEFFS 0 1 0 0 0 0.01 /end COMPU_METHOD
/begin COMPU_METHOD t10ms_ub_b2550 "" RAT_FUNC "%7.2" "ms" COEFFS 0 1 0 0 0 10 /end COMPU_METHOD
/begin COMPU_METHOD t20msxs_ub_b5p1 "" RAT_FUNC "%6.4" "s" COEFFS 0 1 0 0 0 0.02 /end COMPU_METHOD
/begin COMPU_METHOD t20msxs_ub_q0p32 "" RAT_FUNC "%6.3" "s" COEFFS 0 256 0 0 0 81.92 /end COMPU_METHOD
/begin COMPU_METHOD t40msxs_uw_q0p04 "" RAT_FUNC "%6.4" "s" COEFFS 0 1 0 0 0 0.04 /end COMPU_METHOD
/begin COMPU_METHOD t40ms_ub_b10200 "" RAT_FUNC "%7.2" "ms" COEFFS 0 1 0 0 0 40 /end COMPU_METHOD
/begin COMPU_METHOD temp_q0p0234_o273 "" RAT_FUNC "%6.1" "Grad C" COEFFS 0 1 273.15 0 0 0.0234375 /end COMPU_METHOD
/begin COMPU_METHOD temp_q6_o273 "" RAT_FUNC "%6.1" "Grad C" COEFFS 0 1 273.15 0 0 6 /end COMPU_METHOD
/begin COMPU_METHOD temp_ub_b191p25 "" RAT_FUNC "%6.3" "Grad C" COEFFS 0 1 0 0 0 0.75 /end COMPU_METHOD
/begin COMPU_METHOD temp_ub_q0p75_o48 "" RAT_FUNC "%6.2" "Grad C" COEFFS 0 1 48 0 0 0.75 /end COMPU_METHOD
/begin COMPU_METHOD txms_uw_q0p001 "" RAT_FUNC "%6.5" "ms" COEFFS 0 1000 0 0 0 1 /end COMPU_METHOD
/begin COMPU_METHOD t_min_q5p96em8 "" RAT_FUNC "%10.9" "min" COEFFS 0 1 0 0 0 5.96e-008 /end COMPU_METHOD
/begin COMPU_METHOD t_q0p0001_ms "" RAT_FUNC "%7.6" "ms" COEFFS 0 1 0 0 0 0.0001 /end COMPU_METHOD
/begin COMPU_METHOD t_q0p01 "" RAT_FUNC "%6.4" "s" COEFFS 0 100 0 0 0 1 /end COMPU_METHOD
/begin COMPU_METHOD vfzg_sw_q0p00781 "" RAT_FUNC "%6.4" "km/h" COEFFS 0 1 0 0 0 0.0078125 /end COMPU_METHOD
/begin COMPU_METHOD vfzg_uw_q0p00781 "" RAT_FUNC "%6.4" "km/h" COEFFS 0 1 0 0 0 0.0078125 /end COMPU_METHOD
/begin COMPU_METHOD zk100msxs_ub_b25p5 "" RAT_FUNC "%6.3" "s" COEFFS 0 0 256 0 10 0 /end COMPU_METHOD
/begin COMPU_METHOD zk100msxs_uw_b655 "" RAT_FUNC "%6.1" "s" COEFFS 0 0 65536 0 10 0 /end COMPU_METHOD
/begin COMPU_METHOD zk100msxs_uw_b6553 "" RAT_FUNC "%10.3" "s" COEFFS 0 0 65536 0 10 0 /end COMPU_METHOD
/begin COMPU_METHOD zk10msxs_ub_b2p55 "" RAT_FUNC "%6.4" "s" COEFFS 0 0 255 0 100 0 /end COMPU_METHOD
/begin COMPU_METHOD zk10msxs_uw_b655 "" RAT_FUNC "%10.4" "s" COEFFS 0 0 65536 0 100 0 /end COMPU_METHOD
/begin COMPU_METHOD zw_sb_q0p75 "" RAT_FUNC "%6.3" "Grad KW" COEFFS 0 255 0 0 0 191.25 /end COMPU_METHOD
/begin COMPU_METHOD defaultAscii "" RAT_FUNC "%6.2" "" COEFFS 0 1 0 0 0 1 /end COMPU_METHOD
/begin RECORD_LAYOUT FklWU16 FNC_VALUES 1 UWORD COLUMN_DIR DIRECT /end RECORD_LAYOUT
/begin RECORD_LAYOUT GkfWSb FNC_VALUES 1 SBYTE COLUMN_DIR DIRECT /end RECORD_LAYOUT
/begin RECORD_LAYOUT GkfWU8 FNC_VALUES 1 UBYTE COLUMN_DIR DIRECT /end RECORD_LAYOUT
/begin RECORD_LAYOUT GkfWUb FNC_VALUES 1 UBYTE COLUMN_DIR DIRECT /end RECORD_LAYOUT
/begin RECORD_LAYOUT GklWSb FNC_VALUES 1 SBYTE COLUMN_DIR DIRECT /end RECORD_LAYOUT
/begin RECORD_LAYOUT GklWUb FNC_VALUES 1 UBYTE COLUMN_DIR DIRECT /end RECORD_LAYOUT
/begin RECORD_LAYOUT GklWUw FNC_VALUES 1 UWORD COLUMN_DIR DIRECT /end RECORD_LAYOUT
/begin RECORD_LAYOUT KfAxU8AyU8SstxU16SstyU16WU16 NO_AXIS_PTS_X 1 UWORD NO_AXIS_PTS_Y 2 UWORD AXIS_PTS_X 3 UWORD INDEX_INCR DIRECT AXIS_PTS_Y 4 UWORD INDEX_INCR DIRECT FNC_VALUES 5 UWORD COLUMN_DIR DIRECT /end RECORD_LAYOUT
/begin RECORD_LAYOUT KfAxU8AyU8SstxU8SstyU8WS8 NO_AXIS_PTS_X 1 UBYTE NO_AXIS_PTS_Y 2 UBYTE AXIS_PTS_X 3 UBYTE INDEX_INCR DIRECT AXIS_PTS_Y 4 UBYTE INDEX_INCR DIRECT FNC_VALUES 5 SBYTE COLUMN_DIR DIRECT /end RECORD_LAYOUT
/begin RECORD_LAYOUT KfAxU8AyU8SstxU8SstyU8WU8 NO_AXIS_PTS_X 1 UBYTE NO_AXIS_PTS_Y 2 UBYTE AXIS_PTS_X 3 UBYTE INDEX_INCR DIRECT AXIS_PTS_Y 4 UBYTE INDEX_INCR DIRECT FNC_VALUES 5 UBYTE COLUMN_DIR DIRECT /end RECORD_LAYOUT
/begin RECORD_LAYOUT KfAxUbAyUbSstxUbSstyUbWSb NO_AXIS_PTS_X 1 UBYTE NO_AXIS_PTS_Y 2 UBYTE AXIS_PTS_X 3 UBYTE INDEX_INCR DIRECT AXIS_PTS_Y 4 UBYTE INDEX_INCR DIRECT FNC_VALUES 5 SBYTE COLUMN_DIR DIRECT /end RECORD_LAYOUT
/begin RECORD_LAYOUT KfAxUbAyUbSstxUbSstyUbWUb NO_AXIS_PTS_X 1 UBYTE NO_AXIS_PTS_Y 2 UBYTE AXIS_PTS_X 3 UBYTE INDEX_INCR DIRECT AXIS_PTS_Y 4 UBYTE INDEX_INCR DIRECT FNC_VALUES 5 UBYTE COLUMN_DIR DIRECT /end RECORD_LAYOUT
/begin RECORD_LAYOUT KfAxUwAyUwSstxSwSstyUwWUw NO_AXIS_PTS_X 1 UWORD NO_AXIS_PTS_Y 2 UWORD AXIS_PTS_X 3 SWORD INDEX_INCR DIRECT AXIS_PTS_Y 4 UWORD INDEX_INCR DIRECT FNC_VALUES 5 UWORD COLUMN_DIR DIRECT /end RECORD_LAYOUT
/begin RECORD_LAYOUT KfAxUwAyUwSstxUwSstyUwWSw NO_AXIS_PTS_X 1 UWORD NO_AXIS_PTS_Y 2 UWORD AXIS_PTS_X 3 UWORD INDEX_INCR DIRECT AXIS_PTS_Y 4 UWORD INDEX_INCR DIRECT FNC_VALUES 5 SWORD COLUMN_DIR DIRECT /end RECORD_LAYOUT
/begin RECORD_LAYOUT KfAxUwAyUwSstxUwSstyUwWUw NO_AXIS_PTS_X 1 UWORD NO_AXIS_PTS_Y 2 UWORD AXIS_PTS_X 3 UWORD INDEX_INCR DIRECT AXIS_PTS_Y 4 UWORD INDEX_INCR DIRECT FNC_VALUES 5 UWORD COLUMN_DIR DIRECT /end RECORD_LAYOUT
/begin RECORD_LAYOUT KlAUbSstUbWSb NO_AXIS_PTS_X 1 UBYTE AXIS_PTS_X 2 UBYTE INDEX_INCR DIRECT FNC_VALUES 3 SBYTE COLUMN_DIR DIRECT /end RECORD_LAYOUT
/begin RECORD_LAYOUT KlAUbSstUbWUb NO_AXIS_PTS_X 1 UBYTE AXIS_PTS_X 2 UBYTE INDEX_INCR DIRECT FNC_VALUES 3 UBYTE COLUMN_DIR DIRECT /end RECORD_LAYOUT
/begin RECORD_LAYOUT KlAUbSstUwWUw NO_AXIS_PTS_X 1 UWORD AXIS_PTS_X 2 UWORD INDEX_INCR DIRECT FNC_VALUES 3 UWORD COLUMN_DIR DIRECT /end RECORD_LAYOUT
/begin RECORD_LAYOUT KlAUwSstUwWUw NO_AXIS_PTS_X 1 UWORD AXIS_PTS_X 2 UWORD INDEX_INCR DIRECT FNC_VALUES 3 UWORD COLUMN_DIR DIRECT /end RECORD_LAYOUT
/begin RECORD_LAYOUT KwSb FNC_VALUES 1 SBYTE COLUMN_DIR DIRECT /end RECORD_LAYOUT
/begin RECORD_LAYOUT KwSw FNC_VALUES 1 SWORD COLUMN_DIR DIRECT /end RECORD_LAYOUT
/begin RECORD_LAYOUT KwUb FNC_VALUES 1 UBYTE COLUMN_DIR DIRECT /end RECORD_LAYOUT
/begin RECORD_LAYOUT KwUw FNC_VALUES 1 UWORD COLUMN_DIR DIRECT /end RECORD_LAYOUT
/begin RECORD_LAYOUT KwWU16 FNC_VALUES 1 UWORD COLUMN_DIR DIRECT /end RECORD_LAYOUT
/begin RECORD_LAYOUT SstAU8SstS8 NO_AXIS_PTS_X 1 SBYTE AXIS_PTS_X 2 SBYTE INDEX_INCR DIRECT /end RECORD_LAYOUT
/begin RECORD_LAYOUT SstAU8SstU8 NO_AXIS_PTS_X 1 UBYTE AXIS_PTS_X 2 UBYTE INDEX_INCR DIRECT /end RECORD_LAYOUT
/begin RECORD_LAYOUT SstAUbSstSb NO_AXIS_PTS_X 1 UBYTE AXIS_PTS_X 2 SBYTE INDEX_INCR DIRECT /end RECORD_LAYOUT
/begin RECORD_LAYOUT SstAUbSstUb NO_AXIS_PTS_X 1 UBYTE AXIS_PTS_X 2 UBYTE INDEX_INCR DIRECT /end RECORD_LAYOUT
/begin RECORD_LAYOUT SstAUwSstUw NO_AXIS_PTS_X 1 UWORD AXIS_PTS_X 2 UWORD INDEX_INCR DIRECT /end RECORD_LAYOUT
/end MODULE
/end PROJECT
