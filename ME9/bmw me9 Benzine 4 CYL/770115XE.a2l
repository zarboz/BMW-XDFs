ASAP2_VERSION 1 3
/begin PROJECT basisme9 ""
/begin HEADER "" VERSION "basisme9" PROJECT_NO basisme9 /end HEADER
/begin MODULE DIM ""
/begin MOD_COMMON "" BYTE_ORDER MSB_FIRST ALIGNMENT_BYTE 1 ALIGNMENT_WORD 2 ALIGNMENT_LONG 2 ALIGNMENT_FLOAT32_IEEE 4 /end MOD_COMMON
/begin CHARACTERISTIC ABRABW "" VALUE 0x4E9708 KwUw 65535.00 dez 0.00 65535.00 FORMAT "%8.2" /end CHARACTERISTIC
/begin CHARACTERISTIC ASC_SMPL "" VALUE 0x4EF584 KwUw 59.00000 t1msxms_q1 1.000000 60.00000 FORMAT "%8.5" /end CHARACTERISTIC
/begin CHARACTERISTIC CDAGR "Codewort DAGR abschalten (EURO-Codierung), CD..=0 -> keine Diagnose" VALUE 0x4E85CA KwUb 255.0 dez 0.00 255.0 FORMAT "%5.1" /end CHARACTERISTIC
/begin CHARACTERISTIC CDDMTL "Codewort DMTL-Diagnose einschalten (EURO-Codierung), CD..=0 -> keine Dia" VALUE 0x4E85CB KwUb 255.0 dez 0.00 255.0 FORMAT "%5.1" /end CHARACTERISTIC
/begin CHARACTERISTIC CDHSH "Codewort Heizerdiagnose hinter Kat (CDHSH = 0  => keine Diagnose)" VALUE 0x4E85CC KwUb 255.0 dez 0.00 255.0 FORMAT "%5.1" /end CHARACTERISTIC
/begin CHARACTERISTIC CDHSV "Codewort Heizerdiagnose vor Kat im (CDHSV = 0  => keine Diagnose)" VALUE 0x4E85CD KwUb 255.0 dez 0.00 255.0 FORMAT "%5.1" /end CHARACTERISTIC
/begin CHARACTERISTIC CDHSVSA "Codewort Heizerdiagnose vor Kat im Schub (CDHSVsa = 0  => keine Diagnose)" VALUE 0x4E85BD KwWU8 255.0 dez 0.00 255.0 FORMAT "%5.1" /end CHARACTERISTIC
/begin CHARACTERISTIC CDKAT "Codewort Katalysator-Diagnose im OBDII-Mode (invers: Europa-Mode)" VALUE 0x4E85CE KwUb 255.0 dez 0.00 255.0 FORMAT "%5.1" /end CHARACTERISTIC
/begin CHARACTERISTIC CDKATSP "Codewort Katalysator-Diagnose im OBDII-Mode (invers: Europa-Mode)" VALUE 0x4E85BE KwWU8 255.0 dez 0.00 255.0 FORMAT "%5.1" /end CHARACTERISTIC
/begin CHARACTERISTIC CDKVS "Codeword DKVS aktiv/inaktiv, CD..=0 -> keine Diagnose" VALUE 0x4E85CF KwUb 255.0 dez 0.00 255.0 FORMAT "%5.1" /end CHARACTERISTIC
/begin CHARACTERISTIC CDLASH "Codewort Lambdasondenalterungsdiagnose (SHK) im OBDII-Mode (invers: Europa-Mode)" VALUE 0x4E85D0 KwUb 255.0 dez 0.00 255.0 FORMAT "%5.1" /end CHARACTERISTIC
/begin CHARACTERISTIC CDLATP "Codewort Lambdasondenalterungsdiagnose (TP) im OBDII-Mode (invers: Europa-Mode)" VALUE 0x4E85D1 KwUb 255.0 dez 0.00 255.0 FORMAT "%5.1" /end CHARACTERISTIC
/begin CHARACTERISTIC CDLATV "Codewort Lambdasondenalterungsdiagnose (tv) im OBDII-Mode (invers: Europa-Mode)" VALUE 0x4E85D2 KwUb 255.0 dez 0.00 255.0 FORMAT "%5.1" /end CHARACTERISTIC
/begin CHARACTERISTIC CDLDP "Codewort LDP-Diagnose im OBDII-Modus (invers: Europa-Modus), CD..=0 -> keine Dia" VALUE 0x4E85D3 KwUb 255.0 dez 0.00 255.0 FORMAT "%5.1" /end CHARACTERISTIC
/begin CHARACTERISTIC CDLLR "Codewort DLLR abschalten (EURO-Codierung), CD..=0 -> keine Diagnose" VALUE 0x4E85D4 KwUb 255.0 dez 0.00 255.0 FORMAT "%5.1" /end CHARACTERISTIC
/begin CHARACTERISTIC CDLSH "Codewort Sondendiagnose hinter Kat im OBDII-Mode (invers: Europa-Mode)" VALUE 0x4E85D5 KwUb 255.0 dez 0.00 255.0 FORMAT "%5.1" /end CHARACTERISTIC
/begin CHARACTERISTIC CDLSV "Codewort Sondendiagnose vor KAT im OBDII-Mode" VALUE 0x4E85D6 KwUb 255.0 dez 0.00 255.0 FORMAT "%5.1" /end CHARACTERISTIC
/begin CHARACTERISTIC CDLSVV "Codewort Diagnose vertauschte Sonden vor Kat im OBDII-Mode (invers: Europa-Mode)" VALUE 0x4E85D7 KwUb 255.0 dez 0.00 255.0 FORMAT "%5.1" /end CHARACTERISTIC
/begin CHARACTERISTIC CDMD "Codewort DMD abschalten (EURO-Codierung), CD..=0 -> keine Diagnose" VALUE 0x4E85D8 KwUb 255.0 dez 0.00 255.0 FORMAT "%5.1" /end CHARACTERISTIC
/begin CHARACTERISTIC CDNWS "Codewort DNWS abschalten (EURO-Codierung), CD..=0 -> keine Diagnose" VALUE 0x4E85BF KwWU8 255.0 dez 0.00 255.0 FORMAT "%5.1" /end CHARACTERISTIC
/begin CHARACTERISTIC CDSLS "Euro-Byte f¸r Diagnose Sekund‰rluft-System" VALUE 0x4E85D9 KwUb 255.0 dez 0.00 255.0 FORMAT "%5.1" /end CHARACTERISTIC
/begin CHARACTERISTIC CDSLSFZ "Codewort Fahrzeug mit Sekund‰rluftsystem" VALUE 0x4E881C KwUb 255.0 dez 0.00 255.0 FORMAT "%5.1" /end CHARACTERISTIC
/begin CHARACTERISTIC CDSLV "" VALUE 0x4EF0A8 KwUb 255.0 dez 0.00 255.0 FORMAT "%5.1" /end CHARACTERISTIC
/begin CHARACTERISTIC CDSWE "Codewort DSWE abschalten (EURO-Codierung), CD..=0 -> keine Diagnose" VALUE 0x4E85DA KwUb 255.0 dez 0.00 255.0 FORMAT "%5.1" /end CHARACTERISTIC
/begin CHARACTERISTIC CDTANKL "Codewort DTANKL abschalten (EURO-Codierung), CD..=0 -> keine Diagnose" VALUE 0x4E85DB KwUb 255.0 dez 0.00 255.0 FORMAT "%5.1" /end CHARACTERISTIC
/begin CHARACTERISTIC CDTES "Codewort Tankentl¸ftungsdiagnose abschalten (EURO-Codierung), CD..=0 ->keine Dia" VALUE 0x4E85DC KwUb 255.0 dez 0.00 255.0 FORMAT "%5.1" /end CHARACTERISTIC
/begin CHARACTERISTIC CNFMDWAN "Codewort f¸r die Einberechnung von MDWAN in der LLR" VALUE 0x4E5E18 KwUb 255.0 dez 0.00 255.0 FORMAT "%5.1" /end CHARACTERISTIC
/begin CHARACTERISTIC CURVECOMP "" MAP 0x4E9944 KfAxUwAyUwSstxUwSstyUwWUw 1.999969 fak_uw_b2 0.00 1.999969 FORMAT "%8.6"
 /begin AXIS_DESCR STD_AXIS v_vradabs vfzg_uw_q0p00781 8 0.00 511.9922 FORMAT "%8.4" DEPOSIT ABSOLUTE /end AXIS_DESCR
 /begin AXIS_DESCR STD_AXIS rai_w wink_uw_q0p1 8 0.00 6553.500 FORMAT "%8.3" DEPOSIT ABSOLUTE /end AXIS_DESCR
/end CHARACTERISTIC
/begin CHARACTERISTIC CURVECORR "" MAP 0x4EFE7A KfAxUwAyUwSstxUwSstyUwWSw 511.9922 vfzg_sw_q0p00781 -256.0000 255.9922 FORMAT "%8.4"
 /begin AXIS_DESCR STD_AXIS tirefory_w fak_uw_b4 6 0.00 3.999939 FORMAT "%8.6" DEPOSIT ABSOLUTE /end AXIS_DESCR
 /begin AXIS_DESCR STD_AXIS tireforx_w fak_uw_b4 6 0.00 3.999939 FORMAT "%8.6" DEPOSIT ABSOLUTE /end AXIS_DESCR
/end CHARACTERISTIC
/begin CHARACTERISTIC CWALE "Auslauferkennung aktiv" VALUE 0x4E85C0 KwWU8 255.0 dez 0.00 255.0 FORMAT "%5.1" /end CHARACTERISTIC
/begin CHARACTERISTIC CWDSLVTEST "" VALUE 0x4EF0A9 KwUb 255.0 dez 0.00 255.0 FORMAT "%5.1" /end CHARACTERISTIC
/begin CHARACTERISTIC CWEBSLV "Codeword Einschaltbedingungen SL-Ventil" VALUE 0x4EF19A KwUb 255.0 dez 0.00 255.0 FORMAT "%5.1" /end CHARACTERISTIC
/begin CHARACTERISTIC CWFASL "Codewort: Testereingriff Sekund‰rluftdiagnose" VALUE 0x4EF19B KwUb 255.0 dez 0.00 255.0 FORMAT "%5.1" /end CHARACTERISTIC
/begin CHARACTERISTIC CWGEN "" VALUE 0x4E85C1 KwWU8 255.0 dez 0.00 255.0 FORMAT "%5.1" /end CHARACTERISTIC
/begin CHARACTERISTIC CWGGMFL "Codewort f¸r %GGMFL ( Auswertung Multifunktionslenkrad)" VALUE 0x4E85C2 KwWU8 255.0 dez 0.00 255.0 FORMAT "%5.1" /end CHARACTERISTIC
/begin CHARACTERISTIC CWKONABG "Codewort f¸r Konfiguration Abgasbehandlung" VALUE 0x4EDEB2 KwUb 255.0 dez 0.00 255.0 FORMAT "%5.1" /end CHARACTERISTIC
/begin CHARACTERISTIC CWKONFLS "Beschreibung der Lambdasondenposition hinter Katalysator im Abgasstrang" VALUE 0x4E85C3 KwWU8 255.0 dez 0.00 255.0 FORMAT "%5.1" /end CHARACTERISTIC
/begin CHARACTERISTIC CWKONLS "Codewort f¸r Konfiguration Lambda Sonden" VALUE 0x4E85C4 KwWU8 255.0 dez 0.00 255.0 FORMAT "%5.1" /end CHARACTERISTIC
/begin CHARACTERISTIC CWMDAPP "Codewort Applikation ohne Drehmomentfunktionen" VALUE 0x4E85C5 KwWU8 255.0 dez 0.00 255.0 FORMAT "%5.1" /end CHARACTERISTIC
/begin CHARACTERISTIC CWMDELUE "" VALUE 0x4ED7CC KwUb 255.0 dez 0.00 255.0 FORMAT "%5.1" /end CHARACTERISTIC
/begin CHARACTERISTIC CWMDSL "Codewort f¸r Momentaufnahme Servolenkung" VALUE 0x4ED7CD KwUb 255.0 dez 0.00 255.0 FORMAT "%5.1" /end CHARACTERISTIC
/begin CHARACTERISTIC CWNSABG "Codewort Einstellen Leerlauf-Solldrehzahl mit Diagnosetester" VALUE 0x4EDEB3 KwUb 255.0 dez 0.00 255.0 FORMAT "%5.1" /end CHARACTERISTIC
/begin CHARACTERISTIC CWOBD "Codewort f¸r Konfiguration OBD Zertifikationsnachweis" VALUE 0x4E85DD KwUb 255.0 dez 0.00 255.0 FORMAT "%5.1" /end CHARACTERISTIC
/begin CHARACTERISTIC CWPKAPP "Codewort Applikation Druckreferenz f¸r Kraftstoffdruckregler" VALUE 0x4E4F40 KwWU8 255.0 dez 0.00 255.0 FORMAT "%5.1" /end CHARACTERISTIC
/begin CHARACTERISTIC CWPSGER "Codewort Umschaltung Saugrohrdruck von modelliertem auf gerechneten" VALUE 0x4E85C6 KwWU8 255.0 dez 0.00 255.0 FORMAT "%5.1" /end CHARACTERISTIC
/begin CHARACTERISTIC CWPWF "Codewort Powerfail" VALUE 0x4E85C7 KwWU8 255.0 dez 0.00 255.0 FORMAT "%5.1" /end CHARACTERISTIC
/begin CHARACTERISTIC CWSLS "Codewort f¸r Sekund‰rluftsystem" VALUE 0x4E85DE KwUb 255.0 dez 0.00 255.0 FORMAT "%5.1" /end CHARACTERISTIC
/begin CHARACTERISTIC CWSLSON "Schalter SLS-System mit (0) oder ohne (1) SLS-Pumpe" VALUE 0x4EF19C KwUb 255.0 dez 0.00 255.0 FORMAT "%5.1" /end CHARACTERISTIC
/begin CHARACTERISTIC CWSLSOP "Codeword SL-System ohne Pumpe" VALUE 0x4EF19D KwUb 255.0 dez 0.00 255.0 FORMAT "%5.1" /end CHARACTERISTIC
/begin CHARACTERISTIC CWSLSTE "" VALUE 0x4EF19E KwUb 255.0 dez 0.00 255.0 FORMAT "%5.1" /end CHARACTERISTIC
/begin CHARACTERISTIC CWUHR "Codewort f¸r Uhr" VALUE 0x4E85C8 KwWU8 255.0 dez 0.00 255.0 FORMAT "%5.1" /end CHARACTERISTIC
/begin CHARACTERISTIC CWVL "Erkennung Vollast ¸ber relativen Fahrerwunsch (CWVL=1)" VALUE 0x4E85C9 KwWU8 255.0 dez 0.00 255.0 FORMAT "%5.1" /end CHARACTERISTIC
/begin CHARACTERISTIC CW_NCOLLAKT "" VALUE 0x4E2C17 KwWU8 255.0 default 0.00 255.0 FORMAT "%5.1" /end CHARACTERISTIC
/begin CHARACTERISTIC CW_RUNTIME "" VALUE 0x4E85DF KwWU8 255.0 default 0.00 255.0 FORMAT "%5.1" /end CHARACTERISTIC
/begin CHARACTERISTIC CW_secufkt "Codewort zum deaktivieren der Sicherheitsabschaltung (0=aus)" VALUE 0x4E974F KwUb 1.000 dez 0.00 1.000 FORMAT "%5.3" /end CHARACTERISTIC
/begin CHARACTERISTIC dataID "" ASCII 0x4E2210 KwbWU8 255.0 KennText 0.00 255.0 FORMAT "%5.1" NUMBER 51 /end CHARACTERISTIC
/begin CHARACTERISTIC DISTANCEDT "" VALUE 0x4EFE78 KwUb 255.0 dez 0.00 255.0 FORMAT "%5.1" /end CHARACTERISTIC
/begin CHARACTERISTIC DL_CHECK_DEBUG_MODE "" VALUE 0x4E85BC KwUb 255.0 dez 0.00 255.0 FORMAT "%5.1" /end CHARACTERISTIC
/begin CHARACTERISTIC DMAUFN "Delta-Moment Aufregelung nach Drehmomenteingriff" CURVE 0x4EE790 KlAUwSstUwWUw 99.99847 rel_uw_b100 0.00 99.99847 FORMAT "%8.5"
 /begin AXIS_DESCR STD_AXIS nmot_w nmot_uw_q0p25 8 0.00 16383.75 FORMAT "%8.2" DEPOSIT ABSOLUTE /end AXIS_DESCR
/end CHARACTERISTIC
/begin CHARACTERISTIC DMDKOE "Anfangswert Momentenfilter bei Klimakompressor Einschalten" CURVE 0x4ED7D0 KlAUbSstUbWUb 49.73 rel_ub_b49p725 0.00 49.73 FORMAT "%5.2"
 /begin AXIS_DESCR STD_AXIS nmot nmot_ub_q40 6 0.00 10200. FORMAT "%5.0" DEPOSIT ABSOLUTE /end AXIS_DESCR
/end CHARACTERISTIC
/begin CHARACTERISTIC DMDWHYS "Hysterese f¸r Bildung D-Anteil-Wandlermoment" VALUE 0x4E5E19 KwUb 99.61 rel_ub_b99p6 0.00 99.61 FORMAT "%5.2" /end CHARACTERISTIC
/begin CHARACTERISTIC DMDWM "D-Anteil Wandlermoment bei Einlegen der Fahrstufe" CURVE 0x4ED894 GklWUb 99.61 rel_ub_b99p6 0.00 99.61 FORMAT "%5.2"
 /begin AXIS_DESCR COM_AXIS tmot temp_ub_q0p75_o48 8 -48.00 143.3 AXIS_PTS_REF STM08MDUB /end AXIS_DESCR
/end CHARACTERISTIC
/begin CHARACTERISTIC DNMAXHG "gangabh‰ngige Hystherese f¸r harte Drehzahlbegrenzung" CURVE 0x4E84A8 GklWUw 16383.75 nmot_uw_q0p25 0.00 16383.75 FORMAT "%8.2" /begin AXIS_DESCR COM_AXIS gangi dez 7 0.00 255.0 AXIS_PTS_REF SGA07MDUB /end AXIS_DESCR /end CHARACTERISTIC
/begin CHARACTERISTIC DNMAXLR "Hysterese f¸r harte Drehzahlbegrenzung bei Low Range" VALUE 0x4EDE80 KwUw 16383.75 nmot_uw_q0p25 0.00 16383.75 FORMAT "%8.2" /end CHARACTERISTIC
/begin CHARACTERISTIC DPSLV "minimale Druckdifferenz Sekund‰rluftventi" VALUE 0x4EF19F KwUb 1275. p_ub_q5 0.00 1275. FORMAT "%5.0" /end CHARACTERISTIC
/begin CHARACTERISTIC DSLVTAO "" VALUE 0x4EF0AA KwUb 191.3 temp_ub_q0p75_o48 -48.00 143.3 FORMAT "%5.1" /end CHARACTERISTIC
/begin CHARACTERISTIC DSLVTAU "" VALUE 0x4EF0AB KwUb 191.3 temp_ub_q0p75_o48 -48.00 143.3 FORMAT "%5.1" /end CHARACTERISTIC
/begin CHARACTERISTIC DSLVTMO "" VALUE 0x4EF0AC KwUb 191.3 temp_ub_q0p75_o48 -48.00 143.3 FORMAT "%5.1" /end CHARACTERISTIC
/begin CHARACTERISTIC DSLVTMU "" VALUE 0x4EF0AD KwUb 191.3 temp_ub_q0p75_o48 -48.00 143.3 FORMAT "%5.1" /end CHARACTERISTIC
/begin CHARACTERISTIC DZWQ2DZW "Deltaz¸ndwinkel" CURVE 0x4E8990 FklWSb 191.3 zw_sb_q0p75 -96.00 95.25 FORMAT "%5.2"
 /begin AXIS_DESCR FIX_AXIS dzwssq kwq_ub_q0p35576 201 0.00 71.15 FORMAT "%5.2" FIX_AXIS_PAR 0 0 201 /end AXIS_DESCR
/end CHARACTERISTIC
/begin CHARACTERISTIC DZWQ2DZWL "Deltaz¸ndwinkel unterer Bereich" CURVE 0x4E8A5C FklWSb 191.3 zw_sb_q0p75 -96.00 95.25 FORMAT "%5.2"
 /begin AXIS_DESCR FIX_AXIS dzwssql kwq_ub_q0p04447 64 0.00 2.802 FORMAT "%5.3" FIX_AXIS_PAR 0 0 64 /end AXIS_DESCR
/end CHARACTERISTIC
/begin CHARACTERISTIC FABMDWA "Faktor zur Absteuerung des Wandlermoments abh‰ngig von nturb/nsol" CURVE 0x4E5E1C KlAUbSstUbWUb 0.9961 fak_ub_b1 0.00 0.9961
 /begin AXIS_DESCR STD_AXIS qntns fak_ub_b8 6 0.00 7.969 FORMAT "%5.3" DEPOSIT ABSOLUTE /end AXIS_DESCR
/end CHARACTERISTIC
/begin CHARACTERISTIC FDMDWAN "Wichtungsfaktor f¸r Einrechnung D-Anteil in Wandlermoment" VALUE 0x4E5E29 KwUb 0.9961 fak_ub_b1 0.00 0.9961 /end CHARACTERISTIC
/begin CHARACTERISTIC FKKVS "Korrekturfaktor Kraftstoffversorgungssystem" MAP 0x4E4DB0 KfAxU8AyU8SstxU16SstyU16WU16 2.000000 fak_uw_b16 0.00 2.000000 FORMAT "%8.6"
 /begin AXIS_DESCR STD_AXIS nmot nmot_ub_q40 10 0.00 10200.00 FORMAT "%8.2" DEPOSIT ABSOLUTE /end AXIS_DESCR
 /begin AXIS_DESCR STD_AXIS tevfa2_w t16p0usxms 10 0.00 524.2880 FORMAT "%8.4" DEPOSIT ABSOLUTE /end AXIS_DESCR
/end CHARACTERISTIC
/begin CHARACTERISTIC FMDWAT "Faktor zur Berechnung des Wandlermoments abh. von der ÷ltemperatur des Wandlers" CURVE 0x4ED89C GklWUb 0.0001199 fak_ub_q4p7Em7 0.00 0.0001199 FORMAT "%9.7"
 /begin AXIS_DESCR COM_AXIS tmot temp_ub_q0p75_o48 8 -48.00 143.3 AXIS_PTS_REF STM08MDUB /end AXIS_DESCR
/end CHARACTERISTIC
/begin CHARACTERISTIC FMSL "Faktor Korrektur Sekund‰rluftmasse" VALUE 0x4EF1A0 KwUb 1.992 fak_ub_b2 0.00 1.992 FORMAT "%5.3" /end CHARACTERISTIC
/begin CHARACTERISTIC FMSL2 "Faktor Korrektur Sekund‰rluftmasse, Bank 2" VALUE 0x4EF1A1 KwUb 1.992 fak_ub_b2 0.00 1.992 FORMAT "%5.3" /end CHARACTERISTIC
/begin CHARACTERISTIC FMSLOFF "Schwelle Ausr‰umen der Sekund‰rluft beendet" VALUE 0x4EF1A2 KwUb 0.9961 fak_ub_b1 0.00 0.9961 /end CHARACTERISTIC
/begin CHARACTERISTIC FMSRHOL "Dichtekorrektur der Sekund‰rluftmasse" CURVE 0x4EF2BA KlAUwSstUwWUw 1.999969 fak_uw_b2 0.00 1.999969 FORMAT "%8.6"
 /begin AXIS_DESCR STD_AXIS frhol_w fak_uw_b2 4 0.00 1.999969 FORMAT "%8.6" DEPOSIT ABSOLUTE /end AXIS_DESCR
/end CHARACTERISTIC
/begin CHARACTERISTIC FMSTMOT "tmot- Korrektur der Sekund‰rluftmasse" CURVE 0x4EF2CC KlAUbSstUwWUw 1.992188 fak_ub_b2 0.00 1.992188 FORMAT "%8.6"
 /begin AXIS_DESCR STD_AXIS tmotzyl_w temp_ub_q0p75_o48 8 -48.00000 49103.25 FORMAT "%8.2" DEPOSIT ABSOLUTE /end AXIS_DESCR
/end CHARACTERISTIC
/begin CHARACTERISTIC FNRAD "Faktor zwischen Raddrehzahl und Geschwindigkeit f(Radumfang)" VALUE 0x4E5E2A KwUb 15.94 fak_ub_b16 0.00 15.94 FORMAT "%5.2" /end CHARACTERISTIC
/begin CHARACTERISTIC FRHOKRSTTE "Einspritzkorrekutr bei hoher Kraftstofftemperatur" CURVE 0x4E4EA4 KlAxU8SstxU16WS16 1.999969 fak_sw_b2x 0.00 1.999969 FORMAT "%8.6"
 /begin AXIS_DESCR STD_AXIS tkrst temp_ub_q0p75_o48 6 -48.00000 143.2500 FORMAT "%8.4" DEPOSIT ABSOLUTE /end AXIS_DESCR
/end CHARACTERISTIC
/begin CHARACTERISTIC FRLFSDP "Einspritzkorrektur bei RLFS" CURVE 0x4E4EBE KlAxU8SstxS16WS16 1.999969 fak_sw_b2x 0.00 1.999969 FORMAT "%8.6"
 /begin AXIS_DESCR STD_AXIS dpus_w p_q0p039 11 -1280.000 1279.961 FORMAT "%8.3" DEPOSIT ABSOLUTE /end AXIS_DESCR
/end CHARACTERISTIC
/begin CHARACTERISTIC FVDMDWAN "Verst‰rkungsfaktor zur Bildung D-Ateil-Wandlermomnet" VALUE 0x4E5E2B KwUb 7.969 fak_ub_b8 0.00 7.969 FORMAT "%5.3" /end CHARACTERISTIC
/begin CHARACTERISTIC FZG_ON "Betrieb im Fahrzeug" VALUE 0x4EDEB4 KwUb 255.0 dez 0.00 255.0 FORMAT "%5.1" /end CHARACTERISTIC
/begin CHARACTERISTIC HR_UMFG "" VALUE 0x4EF586 KwUw 3000.000 dez 1000.000 4000.000 FORMAT "%8.3" /end CHARACTERISTIC
/begin CHARACTERISTIC HR_ZAHN "" VALUE 0x4EF588 KwUw 170.0000 dez 30.00000 200.0000 FORMAT "%8.4" /end CHARACTERISTIC
/begin CHARACTERISTIC HYSSLSON "Hysterrese Einschaltschwelle SLS-Ventil" VALUE 0x4EF1A3 KwUb 0.9961 fak_ub_b1 0.00 0.9961 /end CHARACTERISTIC
/begin CHARACTERISTIC IMLSLMN "min. Verh‰ltnisfaktor psum_w/mlsu f¸r Einschaltung SLS" VALUE 0x4EF1A4 KwUb 0.9961 fak_ub_b1 0.00 0.9961 /end CHARACTERISTIC
/begin CHARACTERISTIC IMLSLMX "max. Verh‰ltnisfaktor psum_w/mlsu f¸r Einschaltung SLS" VALUE 0x4EF1A5 KwUb 0.9961 fak_ub_b1 0.00 0.9961 /end CHARACTERISTIC
/begin CHARACTERISTIC IMLSLSA "Schwelle Luftmassenintegral f¸r Anfang Sekund‰rluft im Abgas" VALUE 0x4EF2EE KwUw 4660.267 m_uw_b4660 0.00 4660.267 FORMAT "%8.3" /end CHARACTERISTIC
/begin CHARACTERISTIC IMLSLSE "Schwelle Luftmassenintegral f¸r Ende Sekund‰rluft im Abgas" VALUE 0x4EF2F0 KwUw 4660.267 m_uw_b4660 0.00 4660.267 FORMAT "%8.3" /end CHARACTERISTIC
/begin CHARACTERISTIC KFDSLVEIN "" MAP 0x4EF0AE KfAxUbAyUbSstxUbSstyUwWUw 10000.00 dez 0.00 10000.00 FORMAT "%8.2"
 /begin AXIS_DESCR STD_AXIS nmot nmot_ub_q40 10 0.00 10200. FORMAT "%5.0" DEPOSIT ABSOLUTE /end AXIS_DESCR
 /begin AXIS_DESCR STD_AXIS rl_w rel_uw_q0p0234 10 0.00 1535.977 FORMAT "%8.3" DEPOSIT ABSOLUTE /end AXIS_DESCR
/end CHARACTERISTIC
/begin CHARACTERISTIC KFFMSML "Abgasgegendruckkorrektur der Sekund‰rluftmasse" MAP 0x4EF1A8 KfAxUbAyUbSstxUbSstyUbWUb 1.992 fak_ub_b2 0.00 1.992 FORMAT "%5.3"
 /begin AXIS_DESCR STD_AXIS nmot nmot_ub_q40 8 0.00 10200. FORMAT "%5.0" DEPOSIT ABSOLUTE /end AXIS_DESCR
 /begin AXIS_DESCR STD_AXIS rl rel_ub_q0p75 8 0.00 191.3 FORMAT "%5.1" DEPOSIT ABSOLUTE /end AXIS_DESCR
/end CHARACTERISTIC
/begin CHARACTERISTIC KFMDGEN "Drehmomentenaufnahme Generator" MAP 0x4E5DAE KfAxU8AyU8SstxU16SstyU16WU16 1.999969 fak_uw_b2 0.00 1.999969 FORMAT "%8.6"
 /begin AXIS_DESCR STD_AXIS nmot_w nmot_uw_q0p25 6 0.00 16383.75 FORMAT "%8.2" DEPOSIT ABSOLUTE /end AXIS_DESCR
 /begin AXIS_DESCR STD_AXIS mdgenvf_w rel_uw_b100 6 0.00 99.99847 FORMAT "%8.5" DEPOSIT ABSOLUTE /end AXIS_DESCR
/end CHARACTERISTIC
/begin CHARACTERISTIC KFMDKO "Drehmomentaufnahme Klimakompressor" MAP 0x4ED7E0 KfAxUbAyUbSstxUbSstyUbWUb 49.73 rel_ub_b49p725 0.00 49.73 FORMAT "%5.2"
 /begin AXIS_DESCR STD_AXIS nmot nmot_ub_q40 6 0.00 10200. FORMAT "%5.0" DEPOSIT ABSOLUTE /end AXIS_DESCR
 /begin AXIS_DESCR STD_AXIS kopwm rel_ub_b99p6 6 0.00 99.61 FORMAT "%5.2" DEPOSIT ABSOLUTE /end AXIS_DESCR
/end CHARACTERISTIC
/begin CHARACTERISTIC KFMDKOG "Drehmomentaufnahme geregelter Klimakompressor" MAP 0x4ED814 KfAxUbAyUbSstxUbSstyUbWUb 49.73 rel_ub_b49p725 0.00 49.73 FORMAT "%5.2"
 /begin AXIS_DESCR STD_AXIS nmot nmot_ub_q40 6 0.00 10200. FORMAT "%5.0" DEPOSIT ABSOLUTE /end AXIS_DESCR
 /begin AXIS_DESCR STD_AXIS mdkog md_ub_q1 6 0.00 255.0 FORMAT "%5.1" DEPOSIT ABSOLUTE /end AXIS_DESCR
/end CHARACTERISTIC
/begin CHARACTERISTIC KFMDST "Startmoment" MAP 0x4E5E7E KfAxUbAyUbSstxUbSstyUwWUw 199.9969 rel_uw_b200 0.00 199.9969 FORMAT "%8.4"
 /begin AXIS_DESCR STD_AXIS tmot temp_ub_q0p75_o48 8 -48.00 143.3 FORMAT "%5.1" DEPOSIT ABSOLUTE /end AXIS_DESCR
 /begin AXIS_DESCR STD_AXIS qnst_w fak_uw_b2 8 0.00 1.999969 FORMAT "%8.6" DEPOSIT ABSOLUTE /end AXIS_DESCR
/end CHARACTERISTIC
/begin CHARACTERISTIC KFMDWMX "Max. Begrenzung f¸r Drehmomentaufnahme des Wandlers" MAP 0x4E5E2C KfAxUbAyUbSstxUbSstyUbWUb 99.61 rel_ub_b99p6 0.00 99.61 FORMAT "%5.2"
 /begin AXIS_DESCR STD_AXIS vfzg vfzg_ub_q1p25 6 0.00 318.8 FORMAT "%5.1" DEPOSIT ABSOLUTE /end AXIS_DESCR
 /begin AXIS_DESCR STD_AXIS tmot temp_ub_q0p75_o48 8 -48.00 143.3 FORMAT "%5.1" DEPOSIT ABSOLUTE /end AXIS_DESCR
/end CHARACTERISTIC
/begin CHARACTERISTIC KFMIRED1 "Kennfeld Abregelmoment f¸r NMAX Regelung" MAP 0x4EDE82 KfAxUbAyUbSstxUwSstyUbWUb 99.61 rel_ub_b99p6 0.00 99.61 FORMAT "%5.2"
 /begin AXIS_DESCR STD_AXIS miist_w rel_uw_b100 4 0.00 99.99847 FORMAT "%8.5" DEPOSIT ABSOLUTE /end AXIS_DESCR
 /begin AXIS_DESCR STD_AXIS gangi dez 6 0.00 255.0 FORMAT "%5.1" DEPOSIT ABSOLUTE /end AXIS_DESCR
/end CHARACTERISTIC
/begin CHARACTERISTIC KFMIZUFIL "Zul‰ssiges indiziertes Moment zur Momentenbegrenzung vor Filter" MAP 0x4E83A4 GkfWUb 99.61 rel_ub_b99p6 0.00 99.61 FORMAT "%5.2"
 /begin AXIS_DESCR COM_AXIS wped relPED_ub_b100 8 0.00 100.0 AXIS_PTS_REF SWP08OPUB /end AXIS_DESCR
 /begin AXIS_DESCR COM_AXIS nmot nmot_ub_q40 8 0.00 10200. AXIS_PTS_REF SNM08OPUB /end AXIS_DESCR
/end CHARACTERISTIC
/begin CHARACTERISTIC KFMIZUNS "Zul‰ssiges Moment bei Nachstartaufweitung" MAP 0x4E83E4 GkfWUb 99.61 rel_ub_b99p6 0.00 99.61 FORMAT "%5.2"
 /begin AXIS_DESCR COM_AXIS wped relPED_ub_b100 8 0.00 100.0 AXIS_PTS_REF SWP08OPUB /end AXIS_DESCR
 /begin AXIS_DESCR COM_AXIS nmot nmot_ub_q40 8 0.00 10200. AXIS_PTS_REF SNM08OPUB /end AXIS_DESCR
/end CHARACTERISTIC
/begin CHARACTERISTIC KFMIZUOF "Zul‰ssiges indiziertes Moment zur Momentenbegrenzung" MAP 0x4E8424 GkfWUb 99.61 rel_ub_b99p6 0.00 99.61 FORMAT "%5.2"
 /begin AXIS_DESCR COM_AXIS mizuvfil rel_ub_b99p6 8 0.00 99.61 AXIS_PTS_REF SMO08OPUB /end AXIS_DESCR
 /begin AXIS_DESCR COM_AXIS nmot nmot_ub_q40 8 0.00 10200. AXIS_PTS_REF SNM08OPUB /end AXIS_DESCR
/end CHARACTERISTIC
/begin CHARACTERISTIC KFPSTEOFS "Saugrohrdruckoffset" MAP 0x4E4F42 KfAxUwAyUwSstxUwSstyUwWUw 2559.961 p_uw_q0p039 0.00 2559.961 FORMAT "%8.3"
 /begin AXIS_DESCR STD_AXIS rl_w rel_uw_q0p0234 8 0.00 1535.977 FORMAT "%8.3" DEPOSIT ABSOLUTE /end AXIS_DESCR
 /begin AXIS_DESCR STD_AXIS nmot_w nmot_uw_q0p25 8 0.00 16383.75 FORMAT "%8.2" DEPOSIT ABSOLUTE /end AXIS_DESCR
/end CHARACTERISTIC
/begin CHARACTERISTIC KFSLSON "Kennfeld Einschaltbedingung fuer SLS-Ventil" MAP 0x4EF1FC KfAxUbAyUbSstxUbSstyUbWUb 0.9961 fak_ub_b1 0.00 0.9961
 /begin AXIS_DESCR STD_AXIS nmot nmot_ub_q40 8 0.00 10200. FORMAT "%5.0" DEPOSIT ABSOLUTE /end AXIS_DESCR
 /begin AXIS_DESCR STD_AXIS rl rel_ub_q0p75 8 0.00 191.3 FORMAT "%5.1" DEPOSIT ABSOLUTE /end AXIS_DESCR
/end CHARACTERISTIC
/begin CHARACTERISTIC KFSLVEIN "Kennfeld SL-Ventil Freigabe" MAP 0x4EF250 KfAxUbAyUbSstxUbSstyUbWUb 0.9961 fak_ub_b1 0.00 0.9961
 /begin AXIS_DESCR STD_AXIS nmot nmot_ub_q40 8 0.00 10200. FORMAT "%5.0" DEPOSIT ABSOLUTE /end AXIS_DESCR
 /begin AXIS_DESCR STD_AXIS rl rel_ub_q0p75 8 0.00 191.3 FORMAT "%5.1" DEPOSIT ABSOLUTE /end AXIS_DESCR
/end CHARACTERISTIC
/begin CHARACTERISTIC KLKRKTE "Kennlinie f¸r Umrechnung rel. Kraftstoffmasse in eff. Einspritzzeit" CURVE 0x4E4EEC KlAxU8SstxU16WU16 0.5000000 rkt_uw_b0p5 0.00 0.5000000 FORMAT "%9.7"
 /begin AXIS_DESCR STD_AXIS rk_w rel_uw_b3072 12 0.00 3071.953 FORMAT "%8.3" DEPOSIT ABSOLUTE /end AXIS_DESCR
/end CHARACTERISTIC
/begin CHARACTERISTIC KLMDELUE "" CURVE 0x4ED846 KlAUwSstSwWUw 9.999084 rel_uw_b100 0.00 9.999084 FORMAT "%8.6"
 /begin AXIS_DESCR STD_AXIS nmot_w nmot_uw_q0p25 9 -8192.000 8191.750 FORMAT "%8.3" DEPOSIT ABSOLUTE /end AXIS_DESCR
/end CHARACTERISTIC
/begin CHARACTERISTIC KLMDSL "" CURVE 0x4ED86C KlAUwSstSwWUw 100.0000 rel_ub_b99p6 0.00 100.0000 FORMAT "%8.4"
 /begin AXIS_DESCR STD_AXIS lws_w lws_q0p04375 9 -1433.600 1433.556 FORMAT "%8.3" DEPOSIT ABSOLUTE /end AXIS_DESCR
/end CHARACTERISTIC
/begin CHARACTERISTIC KLRCKNTMOT "" CURVE 0x4E2D36 KlAUwSstUwWUw 16383.75 nmot_uw_q0p25 0.00 16383.75 FORMAT "%8.2"
 /begin AXIS_DESCR STD_AXIS tmot temp_ub_q0p75_o48 6 -48.00000 49103.25 FORMAT "%8.2" DEPOSIT ABSOLUTE /end AXIS_DESCR
/end CHARACTERISTIC
/begin CHARACTERISTIC KLTSLMX "BMW" CURVE 0x4EF2F2 KlAUbSstUwWUw 655.3500 t10msxs_uw_b655p35 0.00 655.3500 FORMAT "%8.4"
 /begin AXIS_DESCR STD_AXIS tmstzyl_w temp_ub_q0p75_o48 8 -48.00000 49103.25 FORMAT "%8.2" DEPOSIT ABSOLUTE /end AXIS_DESCR
/end CHARACTERISTIC
/begin CHARACTERISTIC LPRTDEFACT "" VALUE 0x4EFF52 KwUw 0.9999847 fak_uw_b1 0.00 0.9999847 FORMAT "%9.7" /end CHARACTERISTIC
/begin CHARACTERISTIC LPSLIPFAC "" VALUE 0x4EFEDE KwUw 0.9999847 fak_uw_b1 0.00 0.9999847 FORMAT "%9.7" /end CHARACTERISTIC
/begin CHARACTERISTIC MDATNM "Drehmomentaufnahme AT-Getriebe in Fahrstufe N/P" CURVE 0x4ED8C4 GklWSw 99.99695 rel_sw_b100 0.00 99.99695 FORMAT "%8.5"
 /begin AXIS_DESCR COM_AXIS tmot temp_ub_q0p75_o48 8 -48.00 143.3 AXIS_PTS_REF STM08MDUB /end AXIS_DESCR
/end CHARACTERISTIC
/begin CHARACTERISTIC MDATRM "Drehmomentanteil (Pumpenanteil) AT-Getriebe in Fahrstufe R" CURVE 0x4ED8D4 GklWSw 99.99695 rel_sw_b100 0.00 99.99695 FORMAT "%8.5"
 /begin AXIS_DESCR COM_AXIS tmot temp_ub_q0p75_o48 8 -48.00 143.3 AXIS_PTS_REF STM08MDUB /end AXIS_DESCR
/end CHARACTERISTIC
/begin CHARACTERISTIC MDGENVF "" VALUE 0x4E5E12 KwUb 99.61 PCENT 0.00 99.61 FORMAT "%5.2" /end CHARACTERISTIC
/begin CHARACTERISTIC MDIMX "Maximales indiziertes Motormoment" VALUE 0x4E847C KwUb 99.61 rel_ub_b99p6 0.00 99.61 FORMAT "%5.2" /end CHARACTERISTIC
/begin CHARACTERISTIC MDSL "Momentenanforderung der Servolenkung" VALUE 0x4E5E13 KwUb 49.73 rel_ub_b49p725 0.00 49.73 FORMAT "%5.2" /end CHARACTERISTIC
/begin CHARACTERISTIC MDWANER "Ersatzwert fur mdwan_w bei Fehler" VALUE 0x4E5E6C KwUb 99.61 rel_ub_b99p6 0.00 99.61 FORMAT "%5.2" /end CHARACTERISTIC
/begin CHARACTERISTIC MLSLMX "max. Motor-Luftmasse f¸r Sekund‰rlufteinblasung" VALUE 0x4EF314 KwUw 6553.500 m_q0p1 0.00 6553.500 FORMAT "%8.3" /end CHARACTERISTIC
/begin CHARACTERISTIC MSLUB "Sekund‰rluftmasse abh‰ngig von der Batteriespannung" CURVE 0x4EF316 KlAUwSstUwWUw 102.3984 m_uw_b102p4 0.00 102.3984 FORMAT "%8.4"
 /begin AXIS_DESCR STD_AXIS ubsqf_w spg_q0p00039 8 0.00 25.59961 FORMAT "%8.5" DEPOSIT ABSOLUTE /end AXIS_DESCR
/end CHARACTERISTIC
/begin CHARACTERISTIC NMAX "Drehzahlbegrenzung" VALUE 0x4E84B6 KwUw 16383.75 nmot_uw_q0p25 0.00 16383.75 FORMAT "%8.2" /end CHARACTERISTIC
/begin CHARACTERISTIC NMAXEPH "" VALUE 0x4E84B8 KwUw 16383.75 nmot_uw_q0p25 0.00 16383.75 FORMAT "%8.2" /end CHARACTERISTIC
/begin CHARACTERISTIC NMAXLR "Drehzahlbegrenzung bei Low Range Betrieb" VALUE 0x4E84BA KwUw 16383.75 nmot_uw_q0p25 0.00 16383.75 FORMAT "%8.2" /end CHARACTERISTIC
/begin CHARACTERISTIC NMAXPG "gangabh‰ngiges P-Glied bei NMAX Regelung" CURVE 0x4E8480 GklWUb 0.9961 relnmot_q0p0039 0.00 0.9961 /begin AXIS_DESCR COM_AXIS gangi dez 7 0.00 255.0 AXIS_PTS_REF SGA07MDUB /end AXIS_DESCR /end CHARACTERISTIC
/begin CHARACTERISTIC NMAXPLR "P-Glied bei NMAX-Regelung und Low Range Betrieb" VALUE 0x4EDE7C KwUb 0.9961 relnmot_q0p0039 0.00 0.9961 /end CHARACTERISTIC
/begin CHARACTERISTIC NMOTMSF "Motordrehzahlschwelle fuer Motorschutzfkt." VALUE 0x4E9750 KwUb 10200. nmot_ub_q40 0.00 10200. FORMAT "%5.0" /end CHARACTERISTIC
/begin CHARACTERISTIC NMXDAEF "Maximaldrehzahl bei Drosselklappen-Antrieb-Ersatzbetrieb" CURVE 0x4E8488 KlAUbSstUbWUb 10200. nmot_ub_q40 0.00 10200. FORMAT "%5.0"
 /begin AXIS_DESCR STD_AXIS wped relPED_ub_b100 6 0.00 100.0 FORMAT "%5.1" DEPOSIT ABSOLUTE /end AXIS_DESCR
/end CHARACTERISTIC
/begin CHARACTERISTIC NMXDKPU "Maximaldrehzahl bei Sicherheitskraftstoffabschaltung (SKA)" VALUE 0x4E84BC KwUw 16383.75 nmot_uw_q0p25 0.00 16383.75 FORMAT "%8.2" /end CHARACTERISTIC
/begin CHARACTERISTIC NSTART "Motordrehzahlschwelle f¸r Unterdrehzahl-Ausstieg bei Nachstartaufweitung" VALUE 0x4E8464 KwUb 10200. nmot_ub_q40 0.00 10200. FORMAT "%5.0" /end CHARACTERISTIC
/begin CHARACTERISTIC NSTEND "Motordrehzahlschwelle f¸r Start Ende bei Nachstartaufweitung" VALUE 0x4E8465 KwUb 10200. nmot_ub_q40 0.00 10200. FORMAT "%5.0" /end CHARACTERISTIC
/begin CHARACTERISTIC NSWO "Drehzahlschwelle Umschaltg. zur Rechenzeitersparnis" VALUE 0x4EDEB5 KwUb 10200. nmot_ub_q40 0.00 10200. FORMAT "%5.0" /end CHARACTERISTIC
/begin CHARACTERISTIC NSWO1 "Drehzahlschwelle 1 Umschaltg. zur Rechenzeitersparnis" VALUE 0x4EDEB6 KwUb 10200. nmot_ub_q40 0.00 10200. FORMAT "%5.0" /end CHARACTERISTIC
/begin CHARACTERISTIC ONE_32 "" VALUE 0x4EF594 KwUw 31.99951 fak_uw_b32 0.00 31.99951 FORMAT "%8.5" /end CHARACTERISTIC
/begin CHARACTERISTIC ONE_4 "" VALUE 0x4EF596 KwUw 3.999939 fak_uw_b4 0.00 3.999939 FORMAT "%8.6" /end CHARACTERISTIC
/begin CHARACTERISTIC ONE_64 "" VALUE 0x4EF598 KwUw 63.99902 fak_uw_b64 0.00 63.99902 FORMAT "%8.5" /end CHARACTERISTIC
/begin CHARACTERISTIC PSAPES "Saugrohrdruck f¸r Applikation Einspritzung" VALUE 0x4E4F38 KwWU16 2559.961 p_q0p039 0.00 2559.961 FORMAT "%8.3" /end CHARACTERISTIC
/begin CHARACTERISTIC ROADTYPE "" MAP 0x4E9B90 KfAxUwAyUwSstxUwSstyUwWUw 15.99976 fak_uw_b16 0.00 15.99976 FORMAT "%8.5"
 /begin AXIS_DESCR STD_AXIS mdwheel_w md_uw_q0p0625 8 0.00 4095.938 FORMAT "%8.3" DEPOSIT ABSOLUTE /end AXIS_DESCR
 /begin AXIS_DESCR STD_AXIS sliproad_w vfzg_uw_q0p00781 8 0.00 511.9922 FORMAT "%8.4" DEPOSIT ABSOLUTE /end AXIS_DESCR
/end CHARACTERISTIC
/begin CHARACTERISTIC RTCNEG "" MAP 0x4E9C34 KfAxUwAyUwSstxUwSstyUwWUw 15.99976 fak_uw_b16 0.00 15.99976 FORMAT "%8.5"
 /begin AXIS_DESCR STD_AXIS roadbuff_w fak_uw_b16 7 0.00 15.99976 FORMAT "%8.5" DEPOSIT ABSOLUTE /end AXIS_DESCR
 /begin AXIS_DESCR STD_AXIS v_vradabs vfzg_uw_q0p00781 2 0.00 511.9922 FORMAT "%8.4" DEPOSIT ABSOLUTE /end AXIS_DESCR
/end CHARACTERISTIC
/begin CHARACTERISTIC RTCPOS "" CURVE 0x4E9C66 KlAUwSstUwWUw 15.99976 fak_uw_b16 0.00 15.99976 FORMAT "%8.5"
 /begin AXIS_DESCR STD_AXIS roadbuff_w fak_uw_b16 7 0.00 15.99976 FORMAT "%8.5" DEPOSIT ABSOLUTE /end AXIS_DESCR
/end CHARACTERISTIC
/begin CHARACTERISTIC RTDEFAULT "" VALUE 0x4EFF54 KwUw 15.99976 fak_uw_b16 0.00 15.99976 FORMAT "%8.5" /end CHARACTERISTIC
/begin CHARACTERISTIC RTLOSPDLIM "" VALUE 0x4EFF56 KwUw 511.9922 vfzg_uw_q0p00781 0.00 511.9922 FORMAT "%8.4" /end CHARACTERISTIC
/begin CHARACTERISTIC SABRCNT "" VALUE 0x4E970A KwUw 65535.00 dez 0.00 65535.00 FORMAT "%8.2" /end CHARACTERISTIC
/begin AXIS_PTS SAN12ESUW "SST-Verteilung f¸r den begrenzten Einspritzz‰hler anztib_w" 0x4E2BA2 anztib_w SstAUwSstUw 65535.00 dez 12 0.00 65535.00 FORMAT "%8.2" DEPOSIT ABSOLUTE /end AXIS_PTS
/begin CHARACTERISTIC SCALING_PERC "" VALUE 0x4EF59A KwUw 0.9999847 fak_uw_b1 0.00 0.9999847 FORMAT "%9.7" /end CHARACTERISTIC
/begin CHARACTERISTIC SDFRMO "" VALUE 0x4E970C KwUw 1.999969 fak_uw_b2 0.00 1.999969 FORMAT "%8.6" /end CHARACTERISTIC
/begin CHARACTERISTIC SDFRMU "" VALUE 0x4E970E KwUw 1.999969 fak_uw_b2 0.00 1.999969 FORMAT "%8.6" /end CHARACTERISTIC
/begin AXIS_PTS SDM05TESB "dmssginr abh‰ngige St¸tzstellen (Anzahl 5)" 0x4E2A0C dmssginr SstAU8SstS8 1.992 fak_sb_b1 5 -1.000 0.9922 FORMAT "%5.3" DEPOSIT ABSOLUTE /end AXIS_PTS
/begin CHARACTERISTIC SDSLV "" VALUE 0x4E9706 KwUb 1.992 fak_ub_b2 0.00 1.992 FORMAT "%5.3" /end CHARACTERISTIC
/begin CHARACTERISTIC SDSLVE "" VALUE 0x4E9707 KwUb 1.992 fak_ub_b2 0.00 1.992 FORMAT "%5.3" /end CHARACTERISTIC
/begin CHARACTERISTIC SDSLVOF "" VALUE 0x4EF196 KwUw 65535.00 dez 0.00 65535.00 FORMAT "%8.2" /end CHARACTERISTIC
/begin CHARACTERISTIC SDSLVON "" VALUE 0x4EF198 KwUw 65535.00 dez 0.00 65535.00 FORMAT "%8.2" /end CHARACTERISTIC
/begin CHARACTERISTIC SDYNSLN "Schwelle zur Drehzahldynamikerkennung f¸r SL" VALUE 0x4EF338 KwUw 25599.94 nmotg_sw_q0p39 0.00 25599.94 FORMAT "%8.2" /end CHARACTERISTIC
/begin CHARACTERISTIC SDYNSLRL "Schwelle zur Lastdynamikerkennung f¸r SL" VALUE 0x4EF33A KwUw 1535.977 relNWU_q0p0234 0.00 1535.977 FORMAT "%8.3" /end CHARACTERISTIC
/begin AXIS_PTS SEH06KRUW "St¸tzstellenverteilung evhubi_w, 6 Sst." 0x4EA1CE evhubi_w SstASwSstSw 65.53500 hub_uw_q0p001 6 -32.76800 32.76700 FORMAT "%8.5" DEPOSIT ABSOLUTE /end AXIS_PTS
/begin AXIS_PTS SEZ06TMUB "St¸tzstellenverteilung, Z¸ndwinkelwirkungsgrad" 0x4EA0FC etazwimt SstAUbSstUb 127.5 rel_ub_b127p5 6 0.00 127.5 FORMAT "%5.1" DEPOSIT ABSOLUTE /end AXIS_PTS
/begin AXIS_PTS SFR04BBUW "" 0x4E29F0 frhol_w SstAU8SstU16 1.999969 fak_uw_b2 4 0.00 1.999969 FORMAT "%8.6" DEPOSIT ABSOLUTE /end AXIS_PTS
/begin AXIS_PTS SGA07MDUB "" 0x4E2A5C gangi SstAUbSstUb 255.0 dez 7 0.00 255.0 FORMAT "%5.1" DEPOSIT ABSOLUTE /end AXIS_PTS
/begin AXIS_PTS SGA08MDUB "St¸tzstellenverteilung Ist Gang 8 Sst." 0x4E2A64 gangi SstAUbSstUb 255.0 dez 8 0.00 255.0 FORMAT "%5.1" DEPOSIT ABSOLUTE /end AXIS_PTS
/begin AXIS_PTS SKS06ESUB "SST-Verteilung f¸r den Startadaptionsfaktor kstaa" 0x4E2A70 kstaa SstAUbSstUb 1.992 fak_ub_b2 6 0.00 1.992 FORMAT "%5.3" DEPOSIT ABSOLUTE /end AXIS_PTS
/begin CHARACTERISTIC SLDEVFACZ1 "" MAP 0x4E99E8 KfAxUwAyUwSstxUwSstyUwWUw 31.99951 fak_uw_b32 0.00 31.99951 FORMAT "%8.5"
 /begin AXIS_DESCR STD_AXIS nmot_w nmot_uw_q0p25 5 0.00 16383.75 FORMAT "%8.2" DEPOSIT ABSOLUTE /end AXIS_DESCR
 /begin AXIS_DESCR STD_AXIS roadtype_w fak_uw_b16 5 0.00 15.99976 FORMAT "%8.5" DEPOSIT ABSOLUTE /end AXIS_DESCR
/end CHARACTERISTIC
/begin CHARACTERISTIC SLDEVFACZ2 "" MAP 0x4E9A32 KfAxUwAyUwSstxUwSstyUwWUw 31.99951 fak_uw_b32 0.00 31.99951 FORMAT "%8.5"
 /begin AXIS_DESCR STD_AXIS nmot_w nmot_uw_q0p25 5 0.00 16383.75 FORMAT "%8.2" DEPOSIT ABSOLUTE /end AXIS_DESCR
 /begin AXIS_DESCR STD_AXIS roadtype_w fak_uw_b16 5 0.00 15.99976 FORMAT "%8.5" DEPOSIT ABSOLUTE /end AXIS_DESCR
/end CHARACTERISTIC
/begin CHARACTERISTIC SLDEVFACZ3 "" MAP 0x4E9A7C KfAxUwAyUwSstxUwSstyUwWUw 31.99951 fak_uw_b32 0.00 31.99951 FORMAT "%8.5"
 /begin AXIS_DESCR STD_AXIS nmot_w nmot_uw_q0p25 5 0.00 16383.75 FORMAT "%8.2" DEPOSIT ABSOLUTE /end AXIS_DESCR
 /begin AXIS_DESCR STD_AXIS roadtype_w fak_uw_b16 5 0.00 15.99976 FORMAT "%8.5" DEPOSIT ABSOLUTE /end AXIS_DESCR
/end CHARACTERISTIC
/begin CHARACTERISTIC SLDEVFACZ4 "" MAP 0x4E9AC6 KfAxUwAyUwSstxUwSstyUwWUw 31.99951 fak_uw_b32 0.00 31.99951 FORMAT "%8.5"
 /begin AXIS_DESCR STD_AXIS nmot_w nmot_uw_q0p25 5 0.00 16383.75 FORMAT "%8.2" DEPOSIT ABSOLUTE /end AXIS_DESCR
 /begin AXIS_DESCR STD_AXIS roadtype_w fak_uw_b16 5 0.00 15.99976 FORMAT "%8.5" DEPOSIT ABSOLUTE /end AXIS_DESCR
/end CHARACTERISTIC
/begin CHARACTERISTIC SLDEVFACZ5 "" MAP 0x4E9B10 KfAxUwAyUwSstxUwSstyUwWUw 31.99951 fak_uw_b32 0.00 31.99951 FORMAT "%8.5"
 /begin AXIS_DESCR STD_AXIS nmot_w nmot_uw_q0p25 5 0.00 16383.75 FORMAT "%8.2" DEPOSIT ABSOLUTE /end AXIS_DESCR
 /begin AXIS_DESCR STD_AXIS roadtype_w fak_uw_b16 5 0.00 15.99976 FORMAT "%8.5" DEPOSIT ABSOLUTE /end AXIS_DESCR
/end CHARACTERISTIC
/begin CHARACTERISTIC SLDEVFACZA "" CURVE 0x4E9B5A KlAUwSstUwWUw 7.999878 fak_uw_b8 0.00 7.999878 FORMAT "%8.6"
 /begin AXIS_DESCR STD_AXIS gearatio_w fak_uw_b16 5 0.00 15.99976 FORMAT "%8.5" DEPOSIT ABSOLUTE /end AXIS_DESCR
/end CHARACTERISTIC
/begin CHARACTERISTIC SLDIFFCORR "" MAP 0x4E9B70 KfAxUwAyUwSstxUwSstyUwWUw 31.99951 fak_uw_b32 0.00 31.99951 FORMAT "%8.5"
 /begin AXIS_DESCR STD_AXIS mo_dre_asc md_uw_q0p0625 4 0.00 4095.938 FORMAT "%8.3" DEPOSIT ABSOLUTE /end AXIS_DESCR
 /begin AXIS_DESCR STD_AXIS rai_w wink_uw_q0p1 2 0.00 6553.500 FORMAT "%8.3" DEPOSIT ABSOLUTE /end AXIS_DESCR
/end CHARACTERISTIC
/begin AXIS_PTS SLX06TMUW "St¸tzstellenverteilung, Lambdasoll" 0x4EA1DC lamsons_w SstAUwSstUw 15.99976 fak_uw_b16 6 0.00 15.99976 FORMAT "%8.5" DEPOSIT ABSOLUTE /end AXIS_PTS
/begin AXIS_PTS SLY06TMUW "St¸tzstellenverteilung, Lambdasoll Bank2" 0x4EA1EA lamsbg2_w SstAUwSstUw 15.99976 fak_uw_b16 6 0.00 15.99976 FORMAT "%8.5" DEPOSIT ABSOLUTE /end AXIS_PTS
/begin AXIS_PTS SML05DKUB "" 0x4E2A78 ml SstAUbSstUb 1020. m_ub_b1020 5 0.00 1020. FORMAT "%5.0" DEPOSIT ABSOLUTE /end AXIS_PTS
/begin AXIS_PTS SML05LKUB "" 0x4E2A80 ml SstAUbSstUb 1020. m_ub_b1020 5 0.00 1020. FORMAT "%5.0" DEPOSIT ABSOLUTE /end AXIS_PTS
/begin AXIS_PTS SML06TEUB "ml abh‰ngige St¸tzstellen (Anzahl 6)" 0x4EA104 ml SstAUbSstUb 1020. m_ub_b1020 6 0.00 1020. FORMAT "%5.0" DEPOSIT ABSOLUTE /end AXIS_PTS
/begin AXIS_PTS SML06TMUW "St¸tzstellenverteilung, Luftmasse, 6 St¸tzstellen" 0x4EA1F8 ml_w SstAUwSstUw 6553.500 m_uw_b6553p5 6 0.00 6553.500 FORMAT "%8.3" DEPOSIT ABSOLUTE /end AXIS_PTS
/begin AXIS_PTS SML07TMUW "St¸tzstellenverteilung, Luftmasse, 7 St¸tzstellen" 0x4EA206 ml_w SstAUwSstUw 6553.500 m_uw_b6553p5 7 0.00 6553.500 FORMAT "%8.3" DEPOSIT ABSOLUTE /end AXIS_PTS
/begin AXIS_PTS SML08LHUB "ml abh‰ngige St¸tzstellen (Anzahl 8)" 0x4EA10C ml SstAUbSstUb 1020. m_ub_b1020 8 0.00 1020. FORMAT "%5.0" DEPOSIT ABSOLUTE /end AXIS_PTS
/begin AXIS_PTS SMO08OPUB "St¸tzstellenverteilung f¸r zul‰ssiges Moment mizuvfil" 0x4E8468 mizuvfil SstAUbSstUb 99.61 rel_ub_b99p6 8 0.00 99.61 FORMAT "%5.2" DEPOSIT ABSOLUTE /end AXIS_PTS
/begin AXIS_PTS SN16KR1UB "" 0x4E2A14 nmot SstAU8SstU8 10200. nmot_ub_q40 16 0.00 10200. FORMAT "%5.0" DEPOSIT ABSOLUTE /end AXIS_PTS
/begin AXIS_PTS SN16KR2UB "" 0x4E2A28 nmot SstAU8SstU8 10200. nmot_ub_q40 16 0.00 10200. FORMAT "%5.0" DEPOSIT ABSOLUTE /end AXIS_PTS
/begin AXIS_PTS SNG06LLSB "St¸tzstellenverteilung Drehzahlgradient, 6 Sst." 0x4E2A88 ngfil SstAUbSstSb 25500. nmotg_sb_q100 6 -12800. 12700. FORMAT "%5.0" DEPOSIT ABSOLUTE /end AXIS_PTS
/begin AXIS_PTS SNG06LLTSB "" 0x4E2A90 ngfil SstAUbSstSb 25500. nmotg_sb_q100 6 -12800. 12700. FORMAT "%5.0" DEPOSIT ABSOLUTE /end AXIS_PTS
/begin AXIS_PTS SNM04TEUB "Motordrehzahl-abh‰ngige St¸tzstellen (Anzahl =4)" 0x4E2A3C nmot SstAU8SstU8 10200. nmot_ub_q40 4 0.00 10200. FORMAT "%5.0" DEPOSIT ABSOLUTE /end AXIS_PTS
/begin AXIS_PTS SNM05DKUB "" 0x4E2A98 nmot SstAUbSstUb 10200. nmot_ub_q40 5 0.00 10200. FORMAT "%5.0" DEPOSIT ABSOLUTE /end AXIS_PTS
/begin AXIS_PTS SNM06LHUB "" 0x4EA118 nmot SstAUbSstUb 10200. nmot_ub_q40 6 0.00 10200. FORMAT "%5.0" DEPOSIT ABSOLUTE /end AXIS_PTS
/begin AXIS_PTS SNM06LLUB "S¸tzstellenverteilung f¸r Motordrehzahl" 0x4E2AA0 nmot SstAUbSstUb 10200. nmot_ub_q40 6 0.00 10200. FORMAT "%5.0" DEPOSIT ABSOLUTE /end AXIS_PTS
/begin AXIS_PTS SNM06MDUW "Rover" 0x4EA216 nmot_w SstAUwSstUw 16383.75 nmot_uw_q0p25 6 0.00 16383.75 FORMAT "%8.2" DEPOSIT ABSOLUTE /end AXIS_PTS
/begin AXIS_PTS SNM07ESUB "St¸tzstellenverteilung Drehzahl, 7 Sst." 0x4EA120 nmot SstAUbSstUb 10200. nmot_ub_q40 7 0.00 10200. FORMAT "%5.0" DEPOSIT ABSOLUTE /end AXIS_PTS
/begin AXIS_PTS SNM07LRUB "" 0x4E2AA8 nmot SstAUbSstUb 10200. nmot_ub_q40 7 0.00 10200. FORMAT "%5.0" DEPOSIT ABSOLUTE /end AXIS_PTS
/begin AXIS_PTS SNM08FEUB "" 0x4E2AB0 nmot SstAUbSstUb 10200. nmot_ub_q40 8 0.00 10200. FORMAT "%5.0" DEPOSIT ABSOLUTE /end AXIS_PTS
/begin AXIS_PTS SNM08GKUB "St¸tzstellenverteilung Gemischkontrolle 8 nmot St¸tzstellen" 0x4E2A44 nmot SstAU8SstU8 10200. nmot_ub_q40 8 0.00 10200. FORMAT "%5.0" DEPOSIT ABSOLUTE /end AXIS_PTS
/begin AXIS_PTS SNM08KRUW "St¸tzstellenverteilung Drehzahl, 8 Sst." 0x4EA224 nmot_w SstAUwSstUw 16383.75 nmot_uw_q0p25 8 0.00 16383.75 FORMAT "%8.2" DEPOSIT ABSOLUTE /end AXIS_PTS
/begin AXIS_PTS SNM08LHUB "nmot abh‰ngige St¸tzstellen (Anzahl 8)" 0x4EA128 nmot SstAUbSstUb 10200. nmot_ub_q40 8 0.00 10200. FORMAT "%5.0" DEPOSIT ABSOLUTE /end AXIS_PTS
/begin AXIS_PTS SNM08OPUB "St¸tzstellenverteilung f¸r Motordrehzahl nmot" 0x4E2ABC nmot SstAUbSstUb 10200. nmot_ub_q40 8 0.00 10200. FORMAT "%5.0" DEPOSIT ABSOLUTE /end AXIS_PTS
/begin AXIS_PTS SNM08ZUUB "" 0x4E2AC8 nmot SstAUbSstUb 10200. nmot_ub_q40 8 0.00 10200. FORMAT "%5.0" DEPOSIT ABSOLUTE /end AXIS_PTS
/begin AXIS_PTS SNM08__UB "St¸tzstellenverteilung Drehzahl, 8 Sst." 0x4E2AD4 nmot SstAUbSstUb 10200. nmot_ub_q40 8 0.00 10200. FORMAT "%5.0" DEPOSIT ABSOLUTE /end AXIS_PTS
/begin AXIS_PTS SNM12ESUB "SST-Verteilung f¸r die Motordrehzahl nmot" 0x4E2AE0 nmot SstAUbSstUb 10200. nmot_ub_q40 12 0.00 10200. FORMAT "%5.0" DEPOSIT ABSOLUTE /end AXIS_PTS
/begin AXIS_PTS SNM12FEUB "St¸tzstellen f¸r WDKSMX, WDKUGDN" 0x4E2AF0 nmot SstAUbSstUb 10200. nmot_ub_q40 12 0.00 10200. FORMAT "%5.0" DEPOSIT ABSOLUTE /end AXIS_PTS
/begin AXIS_PTS SNM16GKUB "" 0x4EA134 nmot SstAUbSstUb 10200. nmot_ub_q40 16 0.00 10200. FORMAT "%5.0" DEPOSIT ABSOLUTE /end AXIS_PTS
/begin AXIS_PTS SNM16KRUB "St¸tzstellenverteilung Drehzahl, 16 Sst." 0x4EA148 nmot SstAUbSstUb 10200. nmot_ub_q40 16 0.00 10200. FORMAT "%5.0" DEPOSIT ABSOLUTE /end AXIS_PTS
/begin AXIS_PTS SNM16OPUW "St¸tzstellenverteilung Drehzahl" 0x4E2BBC nmot_w SstAUwSstUw 16383.75 nmot_uw_q0p25 16 0.00 16383.75 FORMAT "%8.2" DEPOSIT ABSOLUTE /end AXIS_PTS
/begin AXIS_PTS SNM16ZUUB "St¸tzstellenverteilung Drehzahl, 16 Sst." 0x4E2B00 nmot SstAUbSstUb 10200. nmot_ub_q40 16 0.00 10200. FORMAT "%5.0" DEPOSIT ABSOLUTE /end AXIS_PTS
/begin AXIS_PTS SNM24ZUUB1 "" 0x4E2B14 nzwgru SstAUbSstUb 10200. nmot_ub_q40 24 0.00 10200. FORMAT "%5.0" DEPOSIT ABSOLUTE /end AXIS_PTS
/begin CHARACTERISTIC SPRZG_AN "Position der Anschlagspreizung variable NWS" VALUE 0x4E881E KwUw 6554. sprzi_q0p1 0.00 6554. FORMAT "%2.0" /end CHARACTERISTIC
/begin AXIS_PTS SQM05TEUB "Luftmassenquotient-abh‰ngige St¸tzstellen (Anzahl =5)" 0x4E2B30 qmsdyn SstAUbSstUb 15.94 fak_ub_b16 5 0.00 15.94 FORMAT "%5.2" DEPOSIT ABSOLUTE /end AXIS_PTS
/begin AXIS_PTS SRL03ZUUB "" 0x4E2B38 rl SstAUbSstUb 191.3 rel_ub_q0p75 3 0.00 191.3 FORMAT "%5.1" DEPOSIT ABSOLUTE /end AXIS_PTS
/begin AXIS_PTS SRL04KRUB "St¸tzstellenverteilung relative F¸llung, 4 Sst." 0x4EA15C rl SstAUbSstUb 191.3 rel_ub_q0p75 4 0.00 191.3 FORMAT "%5.1" DEPOSIT ABSOLUTE /end AXIS_PTS
/begin AXIS_PTS SRL06LHUB "" 0x4E2B3C rl SstAUbSstUb 191.3 rel_ub_q0p75 6 0.00 191.3 FORMAT "%5.1" DEPOSIT ABSOLUTE /end AXIS_PTS
/begin AXIS_PTS SRL06LRUB "" 0x4E2B44 rl SstAUbSstUb 191.3 rel_ub_q0p75 6 0.00 191.3 FORMAT "%5.1" DEPOSIT ABSOLUTE /end AXIS_PTS
/begin AXIS_PTS SRL08GKUB "St¸tzstellenverteilung Gemischkontrolle 8 rl St¸tzstellen" 0x4E2A50 rl SstAU8SstU8 191.3 rel_ub_q0p75 8 0.00 191.3 FORMAT "%5.1" DEPOSIT ABSOLUTE /end AXIS_PTS
/begin AXIS_PTS SRL12ESUB "Sst-Verteilung f¸r die relative F¸llung rl" 0x4E2B4C rl SstAUbSstUb 191.3 rel_ub_q0p75 12 0.00 191.3 FORMAT "%5.1" DEPOSIT ABSOLUTE /end AXIS_PTS
/begin AXIS_PTS SRL12GKUB "" 0x4EA164 rl SstAUbSstUb 191.3 rel_ub_q0p75 12 0.00 191.3 FORMAT "%5.1" DEPOSIT ABSOLUTE /end AXIS_PTS
/begin AXIS_PTS SRL12ZUUB "St¸tzstellenverteilung relative Luftf¸llung, 12 St." 0x4E2B5C rl SstAUbSstUb 191.3 rel_ub_q0p75 12 0.00 191.3 FORMAT "%5.1" DEPOSIT ABSOLUTE /end AXIS_PTS
/begin AXIS_PTS SRL16ZUUB "St¸tzstellenverteilung relative F¸llung, 16 Sst." 0x4E2B6C rl SstAUbSstUb 191.3 rel_ub_q0p75 16 0.00 191.3 FORMAT "%5.1" DEPOSIT ABSOLUTE /end AXIS_PTS
/begin CHARACTERISTIC SSLSON "" VALUE 0x4EF2A2 KwUb 0.9961 fak_ub_b1 0.00 0.9961 /end CHARACTERISTIC
/begin CHARACTERISTIC SSLVOF "Schwelle SL-Ventil zu" VALUE 0x4EF2A3 KwUb 0.9961 fak_ub_b1 0.00 0.9961 /end CHARACTERISTIC
/begin CHARACTERISTIC SSLVON "Schwelle SL-Ventil auf" VALUE 0x4EF2A4 KwUb 0.9961 fak_ub_b1 0.00 0.9961 /end CHARACTERISTIC
/begin AXIS_PTS ST107TMUB "St¸tzstellenverteilung, Starttemperatur an Sonde vorne" 0x4EA174 tabgmst SstAUbSstUb 1275. temp_ub_q5_o50 7 -50.00 1225. FORMAT "%5.0" DEPOSIT ABSOLUTE /end AXIS_PTS
/begin AXIS_PTS ST207TMUB "St¸tzstellenverteilung, Starttemperatur an Sonde vorne, Bank2" 0x4EA17C tabgmst2 SstAUbSstUb 1275. temp_ub_q5_o50 7 -50.00 1225. FORMAT "%5.0" DEPOSIT ABSOLUTE /end AXIS_PTS
/begin AXIS_PTS ST307TMUB "St¸tzstellenverteilung, Starttemperatur an Sonde hinten" 0x4EA184 tkatmst SstAUbSstUb 1275. temp_ub_q5_o50 7 -50.00 1225. FORMAT "%5.0" DEPOSIT ABSOLUTE /end AXIS_PTS
/begin AXIS_PTS ST407TMUB "St¸tzstellenverteilung, Starttemperatur an Sonde hinten, Bank2" 0x4EA18C tkatmst2 SstAUbSstUb 1275. temp_ub_q5_o50 7 -50.00 1225. FORMAT "%5.0" DEPOSIT ABSOLUTE /end AXIS_PTS
/begin AXIS_PTS STA04SAUB "" 0x4E2B80 tans SstAUbSstUb 191.3 temp_ub_q0p75_o48 4 -48.00 143.3 FORMAT "%5.1" DEPOSIT ABSOLUTE /end AXIS_PTS
/begin AXIS_PTS STA06ESUB "SST-Verteilung f¸r die Ansauglufttemperatur" 0x4EA194 tans SstAUbSstUb 191.3 temp_ub_q0p75_o48 6 -48.00 143.3 FORMAT "%5.1" DEPOSIT ABSOLUTE /end AXIS_PTS
/begin AXIS_PTS STM04FEUB "St¸tzstellenverteilung Motortemperatur" 0x4E2B88 tmot SstAUbSstUb 191.3 temp_ub_q0p75_o48 4 -48.00 143.3 FORMAT "%5.1" DEPOSIT ABSOLUTE /end AXIS_PTS
/begin AXIS_PTS STM04SAUB "St¸tzstellenverteilung Motortemperatur, 4 Sst." 0x4E2B90 tmot SstAUbSstUb 191.3 temp_ub_q0p75_o48 4 -48.00 143.3 FORMAT "%5.1" DEPOSIT ABSOLUTE /end AXIS_PTS
/begin AXIS_PTS STM05SAUB "St¸tzstellenverteilung" 0x4EA19C tmot SstAUbSstUb 191.3 temp_ub_q0p75_o48 5 -48.00 143.3 FORMAT "%5.1" DEPOSIT ABSOLUTE /end AXIS_PTS
/begin AXIS_PTS STM05TMUB "St¸tzstellenverteilung, Motorstarttemperatur" 0x4EA236 tmst SstAUwSstUw 49151.25 temp_ub_q0p75_o48 5 -48.00000 49103.25 FORMAT "%8.2" DEPOSIT ABSOLUTE /end AXIS_PTS
/begin AXIS_PTS STM05TMUB1 "" 0x4EA242 tmstzyl1_w SstAUwSstUw 49151.25 temp_ub_q0p75_o48 5 -48.00000 49103.25 FORMAT "%8.2" DEPOSIT ABSOLUTE /end AXIS_PTS
/begin AXIS_PTS STM05TMUB2 "" 0x4EA24E tmstzyl2_w SstAUwSstUw 49151.25 temp_ub_q0p75_o48 5 -48.00000 49103.25 FORMAT "%8.2" DEPOSIT ABSOLUTE /end AXIS_PTS
/begin AXIS_PTS STM06LLTUB "" 0x4EA1A4 tmot SstAUbSstUb 191.3 temp_ub_q0p75_o48 6 -48.00 143.3 FORMAT "%5.1" DEPOSIT ABSOLUTE /end AXIS_PTS
/begin AXIS_PTS STM06LLUB "St¸tzstellenverteilung Motortemperatur, 6 Sst." 0x4EA1AC tmot SstAUbSstUb 191.3 temp_ub_q0p75_o48 6 -48.00 143.3 FORMAT "%5.1" DEPOSIT ABSOLUTE /end AXIS_PTS
/begin AXIS_PTS STM08MDUB "St¸tzstellenverteilung: tmot f¸r Drehmomentwandler" 0x4EA1B4 tmot SstAUbSstUb 191.3 temp_ub_q0p75_o48 8 -48.00 143.3 FORMAT "%5.1" DEPOSIT ABSOLUTE /end AXIS_PTS
/begin AXIS_PTS STM12ESUB "SST-Verteilung f¸r die Motortemperatur tmot" 0x4EA1C0 tmot SstAUbSstUb 191.3 temp_ub_q0p75_o48 12 -48.00 143.3 FORMAT "%5.1" DEPOSIT ABSOLUTE /end AXIS_PTS
/begin AXIS_PTS STMZYL06__UW "" 0x4EA25A tmotzyl_w SstAUwSstUw 49151.25 temp_ub_q0p75_o48 6 -48.00000 49103.25 FORMAT "%8.2" DEPOSIT ABSOLUTE /end AXIS_PTS
/begin AXIS_PTS STMZYL08BBUW "" 0x4E29FA tmotzyl_w SstAU8SstU16 49151.25 temp_ub_q0p75_o48 8 -48.00000 49103.25 FORMAT "%8.2" DEPOSIT ABSOLUTE /end AXIS_PTS
/begin AXIS_PTS STMZYL08LEUW "" 0x4EA268 tmotzyl_w SstAUwSstUw 49151.25 temp_ub_q0p75_o48 8 -48.00000 49103.25 FORMAT "%8.2" DEPOSIT ABSOLUTE /end AXIS_PTS
/begin AXIS_PTS STMZYL09ESUW "" 0x4EA27A tmotzyl_w SstAUwSstUw 49151.25 temp_ub_q0p75_o48 9 -48.00000 49103.25 FORMAT "%8.2" DEPOSIT ABSOLUTE /end AXIS_PTS
/begin AXIS_PTS STMZYL12ESUB "" 0x4EA28E tmotzyl_w SstAUwSstUw 49151.25 temp_ub_q0p75_o48 12 -48.00000 49103.25 FORMAT "%8.2" DEPOSIT ABSOLUTE /end AXIS_PTS
/begin AXIS_PTS STSZYL12ESUB "" 0x4EA2A8 tmstzyl_w SstAUwSstUw 49151.25 temp_ub_q0p75_o48 12 -48.00000 49103.25 FORMAT "%8.2" DEPOSIT ABSOLUTE /end AXIS_PTS
/begin AXIS_PTS SWD06KRSW "St¸tzstellenverteilung DK-Winkel, 6 Sst." 0x4EA2C2 wdkba_w SstASwSstSw 1599.976 relDK_q0p02441 6 -800.0000 799.9756 FORMAT "%8.4" DEPOSIT ABSOLUTE /end AXIS_PTS
/begin AXIS_PTS SWP08OPUB "St¸tzstellenverteilung f¸r Pedalstellung wped" 0x4E2B98 wped SstAUbSstUb 100.0 relPED_ub_b100 8 0.00 100.0 FORMAT "%5.1" DEPOSIT ABSOLUTE /end AXIS_PTS
/begin CHARACTERISTIC S_ZNDRLP "" VALUE 0x4E881D KwUb 255.0 dez 0.00 255.0 FORMAT "%5.1" /end CHARACTERISTIC
/begin CHARACTERISTIC TANSMN "Ansauglufttemperaturschwelle zur Nachstartaufweitung" VALUE 0x4E8471 KwUb 191.3 temp_ub_q0p75_o48 -48.00 143.3 FORMAT "%5.1" /end CHARACTERISTIC
/begin CHARACTERISTIC TANSMSF "Ansauglufttemperaturschwelle fuer Motorschutzfkt." VALUE 0x4E9751 KwUb 191.3 temp_ub_q0p75_o48 -48.00 143.3 FORMAT "%5.1" /end CHARACTERISTIC
/begin CHARACTERISTIC TANSSLVO "obere tans-Schwelle f¸r SL-Ventil" VALUE 0x4EF2A5 KwUb 191.3 temp_ub_q0p75_o48 -48.00 143.3 FORMAT "%5.1" /end CHARACTERISTIC
/begin CHARACTERISTIC TANSSLVU "untere tans-Schwelle f¸r SL-Ventil" VALUE 0x4EF2A6 KwUb 191.3 temp_ub_q0p75_o48 -48.00 143.3 FORMAT "%5.1" /end CHARACTERISTIC
/begin CHARACTERISTIC TASLSO "obere Ansauglufttemperaturschwelle f¸r Sekund‰rluftsystem" VALUE 0x4EF2A7 KwUb 191.3 temp_ub_q0p75_o48 -48.00 143.3 FORMAT "%5.1" /end CHARACTERISTIC
/begin CHARACTERISTIC TASLSU "untere Ansauglufttemperaturschwelle f¸r Sekund‰rluftsystem" VALUE 0x4EF2A8 KwUb 191.3 temp_ub_q0p75_o48 -48.00 143.3 FORMAT "%5.1" /end CHARACTERISTIC
/begin CHARACTERISTIC TDANFSLV "" VALUE 0x4E9710 KwUw 10.00000 t100msxs_uw_q100 0.00 10.00000 FORMAT "%8.5" /end CHARACTERISTIC
/begin CHARACTERISTIC TDBRFRM "" VALUE 0x4E9712 KwUw 10.00000 t100msxs_uw_q100 0.00 10.00000 FORMAT "%8.5" /end CHARACTERISTIC
/begin CHARACTERISTIC TDDSLA "Dauer Sekund‰rlufteinblasung f¸r Adaptionsphase" VALUE 0x4EF2A9 KwUb 25.50 t100msxs_ub_b25p5 0.00 25.50 FORMAT "%5.2" /end CHARACTERISTIC
/begin CHARACTERISTIC TDDSLVO "" VALUE 0x4E9714 KwUw 10.00000 t100msxs_uw_q100 0.00 10.00000 FORMAT "%8.5" /end CHARACTERISTIC
/begin CHARACTERISTIC TDFRGFRM "" VALUE 0x4E9716 KwUw 10.00000 t100msxs_uw_q100 0.00 10.00000 FORMAT "%8.5" /end CHARACTERISTIC
/begin CHARACTERISTIC TDMSF "Zeitzaehler zum aktivieren der Motorschutzfkt." VALUE 0x4E9752 KwUb 25.00 t100msxs_ub_b25p5 0.00 25.00 FORMAT "%5.2" /end CHARACTERISTIC
/begin CHARACTERISTIC TDSLKT "Dauer Kurztest Sekund‰rluftdiagnose f¸r Massenmessung" VALUE 0x4EF2AA KwUb 25.50 t100msxs_ub_b25p5 0.00 25.50 FORMAT "%5.2" /end CHARACTERISTIC
/begin CHARACTERISTIC TDSLVEIN "Zeitverzˆgerung f¸r SL-Ventil nach Start o.  Startende" VALUE 0x4EF2AB KwUb 25.40 t100msxs_ub_b25p5 0.1000 25.50 FORMAT "%5.2" /end CHARACTERISTIC
/begin CHARACTERISTIC TEMIN "minimales TE" VALUE 0x4E4F3C KwWU32 540.000000000 t1p0usxms 0.00 540.000000000 FORMAT "%13.9" /end CHARACTERISTIC
/begin CHARACTERISTIC TFASLAMN "Mindestzeit nach Katheizen f¸r Testeranforderung Sekund‰rluftdiagnose" VALUE 0x4EF33C KwUw 6553.500 t100msxs_uw_b6553p6 0.00 6553.500 FORMAT "%8.3" /end CHARACTERISTIC
/begin CHARACTERISTIC TFMIZU "Filterzeitkonstante zur Filterung des zul‰ssigen Moments" VALUE 0x4E8474 KwUw 655.350000 zk10msxs_uw_b655 0.0100001526 655.360000 FORMAT "%10.6" /end CHARACTERISTIC
/begin CHARACTERISTIC TLMSSLAB "Entprellzeit f¸r Abbruch Sekund‰rluftanfettung" VALUE 0x4EF2AC KwUb 25.40 t100msxs_ub_b25p5 0.1000 25.50 FORMAT "%5.2" /end CHARACTERISTIC
/begin CHARACTERISTIC TLMSSLMX "Maximale Zeit f¸r Sekund‰rluftanfettung im Leerlauf" VALUE 0x4EF2AD KwUb 255.0 t100msxs_ub_b255 0.00 255.0 FORMAT "%5.1" /end CHARACTERISTIC
/begin CHARACTERISTIC TMFASLMN "Motortemperaturschwelle Testeranforderung Sekund‰rluftdiagnose" VALUE 0x4EF33E KwUw 49151.25 temp_ub_q0p75_o48 -48.00000 49103.25 FORMAT "%8.2" /end CHARACTERISTIC
/begin CHARACTERISTIC TMLSDELTA "" VALUE 0x4E9700 KwUb 100.0 dez 0.00 100.0 FORMAT "%5.1" /end CHARACTERISTIC
/begin CHARACTERISTIC TMLSSTART "" VALUE 0x4E9704 KwUw 49151.25 temp_uw_q0p75_o48 -48.00000 49103.25 FORMAT "%8.2" /end CHARACTERISTIC
/begin CHARACTERISTIC TMNSMN "Motortemperaturschwelle f¸r die Nachstartaufweitung" VALUE 0x4E8476 KwUw 49151.25 temp_ub_q0p75_o48 -48.00000 49103.25 FORMAT "%8.2" /end CHARACTERISTIC
/begin CHARACTERISTIC TMOTELIMSF "Temperatursensor-Kennlinie fuer Motorschutzfkt." CURVE 0x4EF398 KlAUbSstUbWUb 255.0 temp_ub_q1_o48 -48.00 207.0 FORMAT "%5.1"
 /begin AXIS_DESCR STD_AXIS wtmot spg_ub_b5 20 0.00 4.980 FORMAT "%5.3" DEPOSIT ABSOLUTE /end AXIS_DESCR
/end CHARACTERISTIC
/begin CHARACTERISTIC TMOTSLVO "obere tmot-Schwelle f¸r SL-Ventil" VALUE 0x4EF340 KwUw 49151.25 temp_ub_q0p75_o48 -48.00000 49103.25 FORMAT "%8.2" /end CHARACTERISTIC
/begin CHARACTERISTIC TMOTSLVU "untere tmot-Schwelle f¸r SL-Ventil" VALUE 0x4EF342 KwUw 49151.25 temp_ub_q0p75_o48 -48.00000 49103.25 FORMAT "%8.2" /end CHARACTERISTIC
/begin CHARACTERISTIC TMSFDELTA "Temperaturdelta zum deaktivieren der Motorschutzfkt." VALUE 0x4E9753 KwUb 191.0 temp_ub_q1_o48 -48.00 143.0 FORMAT "%5.1" /end CHARACTERISTIC
/begin CHARACTERISTIC TMSFSTART "Temperaturschwelle zum aktivieren der Motorschutzfkt." VALUE 0x4E9754 KwUb 191.0 temp_ub_q1_o48 -48.00 143.0 FORMAT "%5.1" /end CHARACTERISTIC
/begin CHARACTERISTIC TMSSLO "obere Starttemperaturschwelle f¸r Sekund‰rluft" VALUE 0x4EF344 KwUw 49151.25 temp_ub_q0p75_o48 -48.00000 49103.25 FORMAT "%8.2" /end CHARACTERISTIC
/begin CHARACTERISTIC TMSSLSTO "obere Temperaturschwelle f¸r Sekund‰rluft im Start" VALUE 0x4EF346 KwUw 49151.25 temp_ub_q0p75_o48 -48.00000 49103.25 FORMAT "%8.2" /end CHARACTERISTIC
/begin CHARACTERISTIC TMSSLSTU "untere Temperaturschwelle f¸r Sekund‰rluft im Start" VALUE 0x4EF348 KwUw 49151.25 temp_ub_q0p75_o48 -48.00000 49103.25 FORMAT "%8.2" /end CHARACTERISTIC
/begin CHARACTERISTIC TMSSLU "untere Starttemperaturschwelle f¸r Sekund‰rluft" VALUE 0x4EF34A KwUw 49151.25 temp_ub_q0p75_o48 -48.00000 49103.25 FORMAT "%8.2" /end CHARACTERISTIC
/begin CHARACTERISTIC TMSTSLVO "ober tmot-Schwelle bei Motorstart f¸r SL-Ventil" VALUE 0x4EF34C KwUw 49150.50 temp_ub_q0p75_o48 -47.25000 49103.25 FORMAT "%8.2" /end CHARACTERISTIC
/begin CHARACTERISTIC TMSTSLVU "untere tmot-Schwelle bei Motorstart f¸r SL-Ventil" VALUE 0x4EF34E KwUw 49150.50 temp_ub_q0p75_o48 -47.25000 49103.25 FORMAT "%8.2" /end CHARACTERISTIC
/begin CHARACTERISTIC TNLSGMN "Minimale Zeit f¸r SG-Nachlauf" VALUE 0x4EDEAE KwUw 6553.300 t100msxs_uw_b6553p6 0.2000000 6553.500 FORMAT "%8.3" /end CHARACTERISTIC
/begin CHARACTERISTIC TNLSGMX "Maximale Zeit f¸r SG-Nachlauf" VALUE 0x4EDEB0 KwUw 6553.500 t100msxs_uw_b6553p6 0.00 6553.500 FORMAT "%8.3" /end CHARACTERISTIC
/begin CHARACTERISTIC TNMXPRG "gangabh‰ngiger Drehzahl-Pr‰diktionshorizont f¸r NMAX-Regelung" CURVE 0x4E8498 GklWUb 2.550 t10msxs_ub_b2p55 0.00 2.550 FORMAT "%5.3" /begin AXIS_DESCR COM_AXIS gangi dez 7 0.00 255.0 AXIS_PTS_REF SGA07MDUB /end AXIS_DESCR /end CHARACTERISTIC
/begin CHARACTERISTIC TNMXPRLR "Drehzahl-Pr‰diktionshorizont f¸r NMAX-Regelung bei Low Range" VALUE 0x4EDE7D KwUb 2.550 t10msxs_ub_b2p55 0.00 2.550 FORMAT "%5.3" /end CHARACTERISTIC
/begin CHARACTERISTIC TNSC "Nachstart¸berwachungszeit" VALUE 0x4E8478 KwUw 1310.700 t20msxs_uw_q0p02 0.00 1310.700 FORMAT "%8.3" /end CHARACTERISTIC
/begin CHARACTERISTIC TNSOF "Entprellzeit zur Abschaltung der Nachstartaufweitung" VALUE 0x4E8472 KwUb 5.100 t20msxs_ub_b5p1 0.00 5.100 FORMAT "%5.3" /end CHARACTERISTIC
/begin CHARACTERISTIC TPOS_THREE "" VALUE 0x4EF59C KwSw 1599.976 relDK_q0p02441 -800.0000 799.9756 FORMAT "%8.4" /end CHARACTERISTIC
/begin CHARACTERISTIC TRACCORR "" MAP 0x4EFEE0 KfAxUwAyUwSstxUwSstyUwWSw 511.9922 vfzg_sw_q0p00781 -256.0000 255.9922 FORMAT "%8.4"
 /begin AXIS_DESCR STD_AXIS tirefory_w fak_uw_b4 6 0.00 3.999939 FORMAT "%8.6" DEPOSIT ABSOLUTE /end AXIS_DESCR
 /begin AXIS_DESCR STD_AXIS v_vradabs vfzg_uw_q0p00781 7 0.00 511.9922 FORMAT "%8.4" DEPOSIT ABSOLUTE /end AXIS_DESCR
/end CHARACTERISTIC
/begin CHARACTERISTIC TRDVINAKT "" VALUE 0x4EA9CC KwUb 2.550 t10msxs_ub_b2p55 0.00 2.550 FORMAT "%5.3" /end CHARACTERISTIC
/begin CHARACTERISTIC TRQINCRPM "" MAP 0x4EF59E KfAxUwAyUwSstxUwSstySwWUw 63.99902 fak_uw_b64 0.00 63.99902 FORMAT "%8.5"
 /begin AXIS_DESCR STD_AXIS mo_rpm_asc nmot_uw_q0p25 5 0.00 16383.75 FORMAT "%8.2" DEPOSIT ABSOLUTE /end AXIS_DESCR
 /begin AXIS_DESCR STD_AXIS dk_pos_asc relDK_q0p02441 5 0.00 98.99902 FORMAT "%8.5" DEPOSIT ABSOLUTE /end AXIS_DESCR
/end CHARACTERISTIC
/begin CHARACTERISTIC TRQINCZ1 "" MAP 0x4EF5E8 KfAxUwAyUwSstxUwSstyUwWUw 65535.00 dez 0.00 65535.00 FORMAT "%8.2"
 /begin AXIS_DESCR STD_AXIS reltrq_red fak_uw_b1 11 0.00 0.9999847 FORMAT "%9.7" DEPOSIT ABSOLUTE /end AXIS_DESCR
 /begin AXIS_DESCR STD_AXIS roadtype_w fak_uw_b16 7 0.00 15.99976 FORMAT "%8.5" DEPOSIT ABSOLUTE /end AXIS_DESCR
/end CHARACTERISTIC
/begin CHARACTERISTIC TRQINCZ1_SF "" MAP 0x4EF6AA KfAxUwAyUwSstxSwSstySwWUw 63.99902 fak_uw_b64 0.00 63.99902 FORMAT "%8.5"
 /begin AXIS_DESCR STD_AXIS slip_mar_w vfzg_sw_q0p00781 5 0.00 20.00000 FORMAT "%8.5" DEPOSIT ABSOLUTE /end AXIS_DESCR
 /begin AXIS_DESCR STD_AXIS slipdev_w afzg_sw_q0p0625 5 -2048.000 2047.938 FORMAT "%8.3" DEPOSIT ABSOLUTE /end AXIS_DESCR
/end CHARACTERISTIC
/begin CHARACTERISTIC TRQINCZ2 "" MAP 0x4EF6F4 KfAxUwAyUwSstxUwSstyUwWUw 65535.00 dez 0.00 65535.00 FORMAT "%8.2"
 /begin AXIS_DESCR STD_AXIS reltrq_red fak_uw_b1 11 0.00 0.9999847 FORMAT "%9.7" DEPOSIT ABSOLUTE /end AXIS_DESCR
 /begin AXIS_DESCR STD_AXIS roadtype_w fak_uw_b16 7 0.00 15.99976 FORMAT "%8.5" DEPOSIT ABSOLUTE /end AXIS_DESCR
/end CHARACTERISTIC
/begin CHARACTERISTIC TRQINCZ2_SF "" MAP 0x4EF7B6 KfAxUwAyUwSstxSwSstySwWUw 63.99902 fak_uw_b64 0.00 63.99902 FORMAT "%8.5"
 /begin AXIS_DESCR STD_AXIS slip_mar_w vfzg_sw_q0p00781 5 0.00 20.00000 FORMAT "%8.5" DEPOSIT ABSOLUTE /end AXIS_DESCR
 /begin AXIS_DESCR STD_AXIS slipdev_w afzg_sw_q0p0625 5 -2048.000 2047.938 FORMAT "%8.3" DEPOSIT ABSOLUTE /end AXIS_DESCR
/end CHARACTERISTIC
/begin CHARACTERISTIC TRQINCZ3 "" MAP 0x4EF800 KfAxUwAyUwSstxUwSstyUwWUw 65535.00 dez 0.00 65535.00 FORMAT "%8.2"
 /begin AXIS_DESCR STD_AXIS reltrq_red fak_uw_b1 11 0.00 0.9999847 FORMAT "%9.7" DEPOSIT ABSOLUTE /end AXIS_DESCR
 /begin AXIS_DESCR STD_AXIS roadtype_w fak_uw_b16 7 0.00 15.99976 FORMAT "%8.5" DEPOSIT ABSOLUTE /end AXIS_DESCR
/end CHARACTERISTIC
/begin CHARACTERISTIC TRQINC_Z "" CURVE 0x4E98AC KlAUwSstSwWUw 3.999939 fak_uw_b4 0.00 3.999939 FORMAT "%8.6"
 /begin AXIS_DESCR STD_AXIS slipdev_w afzg_sw_q0p0625 3 -2048.000 2047.938 FORMAT "%8.3" DEPOSIT ABSOLUTE /end AXIS_DESCR
/end CHARACTERISTIC
/begin CHARACTERISTIC TRQINC_Z_SF "" CURVE 0x4E98BA KlAUwSstUwWUw 3.999939 fak_uw_b4 0.00 3.999939 FORMAT "%8.6"
 /begin AXIS_DESCR STD_AXIS v_vradabs vfzg_uw_q0p00781 2 0.00 511.9922 FORMAT "%8.4" DEPOSIT ABSOLUTE /end AXIS_DESCR
/end CHARACTERISTIC
/begin CHARACTERISTIC TRQMTRX "" MAP 0x4EF8C2 KfAxUwAyUwSstxUwSstyUwWUw 511.9922 vfzg_sw_q0p00781 0.00 511.9922 FORMAT "%8.4"
 /begin AXIS_DESCR STD_AXIS tred_w fak_uw_b32 21 0.00 31.99951 FORMAT "%8.5" DEPOSIT ABSOLUTE /end AXIS_DESCR
 /begin AXIS_DESCR STD_AXIS ds_w fak_uw_b64 32 0.00 63.99902 FORMAT "%8.5" DEPOSIT ABSOLUTE /end AXIS_DESCR
/end CHARACTERISTIC
/begin CHARACTERISTIC TRQMTRX_X "" CURVE 0x4E98C4 KlAUwSstUwWUw 0.9999847 fak_uw_b1 0.00 0.9999847 FORMAT "%9.7"
 /begin AXIS_DESCR STD_AXIS tred_w fak_uw_b32 21 0.00 31.99951 FORMAT "%8.5" DEPOSIT ABSOLUTE /end AXIS_DESCR
/end CHARACTERISTIC
/begin CHARACTERISTIC TSLABB "Verweilzeit f¸r Sekund‰rluft- Abbruchbedingung" VALUE 0x4EF2AE KwUb 25.40 t100msxs_ub_b25p5 0.1000 25.50 FORMAT "%5.2" /end CHARACTERISTIC
/begin CHARACTERISTIC TSLPMN "Mindesteinschaltdauer der Sekund‰rluftpumpe" VALUE 0x4EF2AF KwUb 25.40 t100msxs_ub_b25p5 0.1000 25.50 FORMAT "%5.2" /end CHARACTERISTIC
/begin CHARACTERISTIC TSLUBST "Entprellzeit f¸r Sekund‰rluft ein im Start bei UBSLSTMN" VALUE 0x4EF2B0 KwUb 25.50 t100msxs_ub_b25p5 0.00 25.50 FORMAT "%5.2" /end CHARACTERISTIC
/begin CHARACTERISTIC TSLVEIN "Einschaltdauer SL-Ventil nach Start o. Startende" VALUE 0x4EF2B1 KwUb 25.40 t100msxs_ub_b25p5 0.1000 25.50 FORMAT "%5.2" /end CHARACTERISTIC
/begin CHARACTERISTIC TVDSLOFF "Zeitverzˆgerung Schlieﬂen Sekund‰rluftventil bei Adaption/Kurztrip" VALUE 0x4EF2B2 KwUb 25.50 t100msxs_ub_b25p5 0.00 25.50 FORMAT "%5.2" /end CHARACTERISTIC
/begin CHARACTERISTIC TVFSAM "Temperaturabh‰ngige Verzˆgerungszeit f¸r Fahrstufe AUS" CURVE 0x4ED8A4 GklWUb 5.100 t20msxs_ub_b5p1 0.00 5.100 FORMAT "%5.3"
 /begin AXIS_DESCR COM_AXIS tmot temp_ub_q0p75_o48 8 -48.00 143.3 AXIS_PTS_REF STM08MDUB /end AXIS_DESCR
/end CHARACTERISTIC
/begin CHARACTERISTIC TVFSEM "Temperaturabh‰ngige Verzˆgerungszeit f¸r Fahrstufe EIN" CURVE 0x4ED8AC GklWUb 5.100 t20msxs_ub_b5p1 0.00 5.100 FORMAT "%5.3"
 /begin AXIS_DESCR COM_AXIS tmot temp_ub_q0p75_o48 8 -48.00 143.3 AXIS_PTS_REF STM08MDUB /end AXIS_DESCR
/end CHARACTERISTIC
/begin CHARACTERISTIC TVFSRAM "motortemperaturabh‰ngige Verzˆgerungszeit f¸r Fahrstufe aus (R)" CURVE 0x4ED8B4 GklWUb 5.100 t20msxs_ub_b5p1 0.00 5.100 FORMAT "%5.3"
 /begin AXIS_DESCR COM_AXIS tmot temp_ub_q0p75_o48 8 -48.00 143.3 AXIS_PTS_REF STM08MDUB /end AXIS_DESCR
/end CHARACTERISTIC
/begin CHARACTERISTIC TVFSREM "motortemperaturabh‰ngige Verzˆgerungszeit f¸r Fahrstufe ein (R)" CURVE 0x4ED8BC GklWUb 5.100 t20msxs_ub_b5p1 0.00 5.100 FORMAT "%5.3"
 /begin AXIS_DESCR COM_AXIS tmot temp_ub_q0p75_o48 8 -48.00 143.3 AXIS_PTS_REF STM08MDUB /end AXIS_DESCR
/end CHARACTERISTIC
/begin CHARACTERISTIC TVFUE "Verzˆgerungszeit f¸r den Aufbau der F¸llung" VALUE 0x4E5E6D KwUb 5.100 t20msxs_ub_b5p1 0.00 5.100 FORMAT "%5.3" /end CHARACTERISTIC
/begin CHARACTERISTIC TVSLVOFF "Zeitverzˆgerung Schlieﬂen Sekund‰rluftventil" VALUE 0x4EF2B3 KwUb 25.50 t100msxs_ub_b25p5 0.00 25.50 FORMAT "%5.2" /end CHARACTERISTIC
/begin CHARACTERISTIC TVSLVON "Zeitverzˆgerung ÷ffnen Sekund‰rluftventil" VALUE 0x4EF2B4 KwUb 25.40 t100msxs_ub_b25p5 0.1000 25.50 FORMAT "%5.2" /end CHARACTERISTIC
/begin CHARACTERISTIC TVUB "Spannungskorrektur" CURVE 0x4E4F1E KlAxU8SstxU16WU16 65.53500 t1p0usxms 0.00 65.53500 FORMAT "%8.5"
 /begin AXIS_DESCR STD_AXIS ub spg_ubatt 6 0.00 24.02100 FORMAT "%8.5" DEPOSIT ABSOLUTE /end AXIS_DESCR
/end CHARACTERISTIC
/begin CHARACTERISTIC UBNLMN "Minimale Batterie-Sollspannung" VALUE 0x4EDEAC KwUb 24.02 spg_ubatt 0.00 24.02 FORMAT "%5.2" /end CHARACTERISTIC
/begin CHARACTERISTIC UBSLMN "min. Spannung f¸r Sekund‰rluft ein" VALUE 0x4EF350 KwUw 25.59961 spg_q0p00039 0.00 25.59961 FORMAT "%8.5" /end CHARACTERISTIC
/begin CHARACTERISTIC UBSLMX "max. Spannung f¸r Sekund‰rluft ein" VALUE 0x4EF352 KwUw 25.59961 spg_q0p00039 0.00 25.59961 FORMAT "%8.5" /end CHARACTERISTIC
/begin CHARACTERISTIC UBSLSTMN "min.Spannung f¸r Sekund‰rluft ein im Start" VALUE 0x4EF354 KwUw 25.59961 spg_q0p00039 0.00 25.59961 FORMAT "%8.5" /end CHARACTERISTIC
/begin CHARACTERISTIC UEVERG "‹bersetzungsverh‰ltnis abh. vom eingelegten Gang" CURVE 0x4E5E70 FklWUb 15.94 fak_ub_b16 0.00 15.94 FORMAT "%5.2"
 /begin AXIS_DESCR FIX_AXIS gangi dez 8 0.00 7.000 FORMAT "%5.3" FIX_AXIS_PAR 0 0 8 /end AXIS_DESCR
/end CHARACTERISTIC
/begin CHARACTERISTIC UHDMX "Schwellwert f¸r stromlose Heizerendstufe" VALUE 0x4EE298 KwUb 4.980 spg_ub_b5 0.00 4.980 FORMAT "%5.3" /end CHARACTERISTIC
/begin CHARACTERISTIC UKWNMAXG "gangabh‰ngiger NW-Umdrehungsz‰hler f¸r NMAX Regelung" CURVE 0x4E84BE GklWUw 65535.00 dez 0.00 65535.00 FORMAT "%8.2" /begin AXIS_DESCR COM_AXIS gangi dez 7 0.00 255.0 AXIS_PTS_REF SGA07MDUB /end AXIS_DESCR /end CHARACTERISTIC
/begin CHARACTERISTIC UWNMAXLR "NW-Umdrehungsz‰hler f¸r NMAX Regelung bei Low Range" VALUE 0x4EDEAA KwUw 65535.00 dez 0.00 65535.00 FORMAT "%8.2" /end CHARACTERISTIC
/begin CHARACTERISTIC VMLSDELTA "" VALUE 0x4E9701 KwUb 100.0 vfzg_ub_q1p25 0.00 100.0 FORMAT "%5.1" /end CHARACTERISTIC
/begin CHARACTERISTIC VMLSMAX "" VALUE 0x4E9702 KwUb 260.0 vfzg_ub_q1p25 0.00 260.0 FORMAT "%5.1" /end CHARACTERISTIC
/begin CHARACTERISTIC VM_NMX_G4 "" VALUE 0x4E84CC KwUw 16383.75 nmot_uw_q0p25 0.00 16383.75 FORMAT "%8.2" /end CHARACTERISTIC
/begin CHARACTERISTIC VM_NMX_G5 "" VALUE 0x4E84CE KwUw 16383.75 nmot_uw_q0p25 0.00 16383.75 FORMAT "%8.2" /end CHARACTERISTIC
/begin CHARACTERISTIC VM_NMX_G6 "" VALUE 0x4E84D0 KwUw 16383.75 nmot_uw_q0p25 0.00 16383.75 FORMAT "%8.2" /end CHARACTERISTIC
/begin CHARACTERISTIC VM_NMX_LG4 "" VALUE 0x4E84D2 KwUw 16383.75 nmot_uw_q0p25 0.00 16383.75 FORMAT "%8.2" /end CHARACTERISTIC
/begin CHARACTERISTIC VM_NMX_LG5 "" VALUE 0x4E84D4 KwUw 16383.75 nmot_uw_q0p25 0.00 16383.75 FORMAT "%8.2" /end CHARACTERISTIC
/begin CHARACTERISTIC VM_NMX_LG6 "" VALUE 0x4E84D6 KwUw 16383.75 nmot_uw_q0p25 0.00 16383.75 FORMAT "%8.2" /end CHARACTERISTIC
/begin CHARACTERISTIC VR_UMFG "" VALUE 0x4EF58A KwUw 3000.000 dez 1000.000 4000.000 FORMAT "%8.3" /end CHARACTERISTIC
/begin CHARACTERISTIC VR_ZAHN "" VALUE 0x4EF58C KwUw 170.0000 dez 30.00000 200.0000 FORMAT "%8.4" /end CHARACTERISTIC
/begin CHARACTERISTIC VSLS "Schwelle Fahrzeuggeschwindigkeit f¸r SLS ein" VALUE 0x4EF2B5 KwUb 318.8 vfzg_ub_q1p25 0.00 318.8 FORMAT "%5.1" /end CHARACTERISTIC
/begin CHARACTERISTIC XSIZE "" VALUE 0x4EFE70 KwUw 31.99951 fak_uw_b32 0.00 31.99951 FORMAT "%8.5" /end CHARACTERISTIC
/begin CHARACTERISTIC YSIZE "" VALUE 0x4EFE72 KwUw 63.99902 fak_uw_b64 0.00 63.99902 FORMAT "%8.5" /end CHARACTERISTIC
/begin CHARACTERISTIC ZFLMSSL "Zeitkonstante Gemischanteil Sekund‰rluft" VALUE 0x4EF2B6 KwUb 25.4996 zk100msxs_ub_b25p5 0.100392 25.6000 FORMAT "%7.4" /end CHARACTERISTIC
/begin CHARACTERISTIC ZINMAXG "gangabh‰ngige I-Steigung f¸r NMAX-Regelung" CURVE 0x4E84A0 GklWUb 2.54000 zk10msxs_ub_b2p55 0.0100000 2.55000 FORMAT "%7.5" /begin AXIS_DESCR COM_AXIS gangi dez 7 0.00 255.0 AXIS_PTS_REF SGA07MDUB /end AXIS_DESCR /end CHARACTERISTIC
/begin CHARACTERISTIC ZINMAXLR "I-Steigung f¸r NMAX-Regelung bei Low Range Betrieb" VALUE 0x4EDE7E KwUb 2.54000 zk10msxs_ub_b2p55 0.0100000 2.55000 FORMAT "%7.5" /end CHARACTERISTIC
/begin CHARACTERISTIC ZKDMDW "Zeitkonstante f¸r Abregelung D-Anteil Wandlermoment" VALUE 0x4E5E78 KwUb 5.08000 zk20msxs_ub_b5p1 0.0200000 5.10000 FORMAT "%7.5" /end CHARACTERISTIC
/begin CHARACTERISTIC ZKMDGEN "Zeitkonstante Generator-Lastabregelung" VALUE 0x4E5E14 KwUb 5.08000 zk20msxs_ub_b5p1 0.0200000 5.10000 FORMAT "%7.5" /end CHARACTERISTIC
/begin CHARACTERISTIC ZKMDKO "Zeitkonstante Klimakompressor-Lastabregelung" VALUE 0x4E5E15 KwUb 5.08000 zk20msxs_ub_b5p1 0.0200000 5.10000 FORMAT "%7.5" /end CHARACTERISTIC
/begin CHARACTERISTIC ZKMDWAB "Zeitkonstante f¸r Abregelung der  Drehmomentaufnahme des Wandlers" VALUE 0x4E5E79 KwUb 5.08000 zk20msxs_ub_b5p1 0.0200000 5.10000 FORMAT "%7.5" /end CHARACTERISTIC
/begin CHARACTERISTIC ZKMDWAUF "Zeitkonstante f¸r Aufregelung der  Drehmomentaufnahme des Wandlers" VALUE 0x4E5E7A KwUb 5.08000 zk20msxs_ub_b5p1 0.0200000 5.10000 FORMAT "%7.5" /end CHARACTERISTIC
/begin CHARACTERISTIC ZKMDWF "Zeitkonstante f¸r Filterung Wandlermoment zur Bildung D-Anteil" VALUE 0x4E5E7B KwUb 5.08000 zk20msxs_ub_b5p1 0.0200000 5.10000 FORMAT "%7.5" /end CHARACTERISTIC
/begin CHARACTERISTIC ZKPSTE "Zeitkonstante pste_w" VALUE 0x4E4F41 KwUb 5.08000 zk20msxs_ub_b5p1 0.0200000 5.10000 FORMAT "%7.5" /end CHARACTERISTIC
/begin CHARACTERISTIC ZKSLPOFF "Zeitkonstante Runterlauf Sekund‰rluftgebl‰se" VALUE 0x4EF2B7 KwUb 25.4996 zk100msxs_ub_b25p5 0.100392 25.6000 FORMAT "%7.4" /end CHARACTERISTIC
/begin CHARACTERISTIC ZKSLPON "Zeitkonstante Hochlauf Sekund‰rluftgebl‰se" VALUE 0x4EF2B8 KwUb 25.4996 zk100msxs_ub_b25p5 0.100392 25.6000 FORMAT "%7.4" /end CHARACTERISTIC
/begin CHARACTERISTIC ZKSLSOFML "Zeitkonstante Ausr‰umen der Sekund‰rluft nach Ventil schlieﬂen" CURVE 0x4EF356 KlAUwSstUwWUw 6553.50000 zk100msxs_uw_b6553 0.100001526 6553.60000 FORMAT "%10.5"
 /begin AXIS_DESCR STD_AXIS ml_w m_uw_b6553p5 4 0.00 6553.500 FORMAT "%8.3" DEPOSIT ABSOLUTE /end AXIS_DESCR
/end CHARACTERISTIC
/begin CHARACTERISTIC ZKSLSONML "Zeitkonstante Einbringen der Sekund‰rluft nach Ventil ˆffnen" CURVE 0x4EF368 KlAUwSstUwWUw 6553.50000 zk100msxs_uw_b6553 0.100001526 6553.60000 FORMAT "%10.5"
 /begin AXIS_DESCR STD_AXIS ml_w m_uw_b6553p5 4 0.00 6553.500 FORMAT "%8.3" DEPOSIT ABSOLUTE /end AXIS_DESCR
/end CHARACTERISTIC
/begin CHARACTERISTIC ZKSLVOF "Filterkonstante f¸r Massendynamikfaktor bei SL-Ventil zu" VALUE 0x4EF37A KwUw 6553.50000 zk100msxs_uw_b6553 0.100001526 6553.60000 FORMAT "%10.5" /end CHARACTERISTIC
/begin CHARACTERISTIC ZKSLVON "Filterkonstante f¸r Massendynamikfaktor bei SL-Ventil auf" VALUE 0x4EF37C KwUw 6553.50000 zk100msxs_uw_b6553 0.100001526 6553.60000 FORMAT "%10.5" /end CHARACTERISTIC
/begin CHARACTERISTIC ZKUEVERG "Filterzeitkonstante: Turbinendrehzahl bei Gangwechsel" VALUE 0x4E5E7C KwUb 5.08000 zk20msxs_ub_b5p1 0.0200000 5.10000 FORMAT "%7.5" /end CHARACTERISTIC
/begin CHARACTERISTIC ZSLNLGFIL "" VALUE 0x4EF37E KwUw 6553.500 t100msxs_uw_b6553p6 0.00 6553.500 FORMAT "%8.3" /end CHARACTERISTIC
/begin CHARACTERISTIC ZSLRLGFIL "Filterkonstante Lastdynamikerkennung f¸r SLV Freigabe" VALUE 0x4EF380 KwUw 6553.500 t100msxs_uw_b6553p6 0.00 6553.500 FORMAT "%8.3" /end CHARACTERISTIC
/begin MEASUREMENT abmznd "Einspritzausblendmuster bei Z¸ndkreisfehler" UBYTE dez 1 100 0 255 FORMAT "%5.1" ECU_ADDRESS 0x7FD85A /end MEASUREMENT
/begin MEASUREMENT abrabw1 "" UWORD dez 1 100 0 65535 FORMAT "%8.2" ECU_ADDRESS 0x7FE0A8 /end MEASUREMENT
/begin MEASUREMENT abrabw2 "" UWORD dez 1 100 0 65535 FORMAT "%8.2" ECU_ADDRESS 0x7FE0AA /end MEASUREMENT
/begin MEASUREMENT absdfrm "" UWORD fak_uw_b2 1 100 0 1.99997 FORMAT "%8.6" ECU_ADDRESS 0x7FE0AC /end MEASUREMENT
/begin MEASUREMENT absdfrm2 "" UWORD fak_uw_b2 1 100 0 1.99997 FORMAT "%8.6" ECU_ADDRESS 0x7FE0AE /end MEASUREMENT
/begin MEASUREMENT address "Adresse des Generators oder anderer Komponente an bitsynchr. Schnittstelle" UBYTE dez 1 100 0 255 FORMAT "%5.1" ECU_ADDRESS 0x7FD85B /end MEASUREMENT
/begin MEASUREMENT anzeausb "Anzahl der auszublendenen Einspritzungen; begrenzt zwischen 4 und 7" UBYTE dez 1 100 0 255 FORMAT "%5.1" ECU_ADDRESS 0x7FD85C /end MEASUREMENT
/begin MEASUREMENT anzkwu_w "Anzahl KW-Umdrehungen" UWORD dez 1 100 0 65535 FORMAT "%8.2" ECU_ADDRESS 0x7FDF5A /end MEASUREMENT
/begin MEASUREMENT Asprl "Auslasspreizung im Leerlauf gedrosselt" UBYTE sprzi_q0p8 1 100 0 204 FORMAT "%5.1" ECU_ADDRESS 0x7FD85D /end MEASUREMENT
/begin MEASUREMENT Asprlu "Auslasspreizung im Leerlauf ungedrosselt" UBYTE sprzi_q0p8 1 100 0 204 FORMAT "%5.1" ECU_ADDRESS 0x7FD85E /end MEASUREMENT
/begin MEASUREMENT avs_w "Ueberschneidungsflaeche: AV schliesst nach OT" SWORD sprzi_q0p1 1 100 -3276.8 3276.7 FORMAT "%2.0" ECU_ADDRESS 0x7FE1B0 /end MEASUREMENT
/begin MEASUREMENT axis_w "" UWORD fak_uw_b4 1 100 0 3.99994 FORMAT "%8.6" ECU_ADDRESS 0x7FE268 /end MEASUREMENT
/begin MEASUREMENT bgCtr "" ULONG dez 1 100 0 4.29497e+009 FORMAT "%13.2" ECU_ADDRESS 0x7FE4BC /end MEASUREMENT
/begin MEASUREMENT bg_predrive_Ctr "" ULONG dez 1 100 0 4.29497e+009 FORMAT "%13.2" ECU_ADDRESS 0x7FE4C0 /end MEASUREMENT
/begin MEASUREMENT bg_swoff_Ctr "" ULONG dez 1 100 0 4.29497e+009 FORMAT "%13.2" ECU_ADDRESS 0x7FE4C4 /end MEASUREMENT
/begin MEASUREMENT B_abgraden "" UBYTE B_TRUE 1 100 0 1 BIT_MASK 0x1 FORMAT "%13.11" ECU_ADDRESS 0x7FBC73 /end MEASUREMENT
/begin MEASUREMENT B_abkombi "" UBYTE B_TRUE 1 100 0 1 BIT_MASK 0x1 FORMAT "%13.11" ECU_ADDRESS 0x7FBB6C /end MEASUREMENT
/begin MEASUREMENT B_abrabwen "" UBYTE B_TRUE 1 100 0 1 BIT_MASK 0x1 FORMAT "%13.11" ECU_ADDRESS 0x7FBC74 /end MEASUREMENT
/begin MEASUREMENT B_abrdb "" UBYTE B_TRUE 1 100 0 1 BIT_MASK 0x1 FORMAT "%13.11" ECU_ADDRESS 0x7FBC75 /end MEASUREMENT
/begin MEASUREMENT B_abstnl "Bedingung Abstellzeitermittlung ¸ber SG-Nachlauf" UBYTE B_TRUE 1 100 0 1 BIT_MASK 0x1 FORMAT "%13.11" ECU_ADDRESS 0x7FBB6D /end MEASUREMENT
/begin MEASUREMENT B_abwcten "" UBYTE B_TRUE 1 100 0 1 BIT_MASK 0x1 FORMAT "%13.11" ECU_ADDRESS 0x7FBC76 /end MEASUREMENT
/begin MEASUREMENT B_ac "Bedingung Lastaufschaltung Klimaanlage" UBYTE B_TRUE 1 100 0 1 BIT_MASK 0x1 FORMAT "%13.11" ECU_ADDRESS 0x7FBBE4 /end MEASUREMENT
/begin MEASUREMENT B_acc "Bedingung: ACC-Steuerger‰t vorhanden" UBYTE B_TRUE 1 100 0 1 BIT_MASK 0x1 FORMAT "%13.11" ECU_ADDRESS 0x7FBBE5 /end MEASUREMENT
/begin MEASUREMENT B_adslv "" UBYTE B_TRUE 1 100 0 1 BIT_MASK 0x1 FORMAT "%13.11" ECU_ADDRESS 0x7FBC77 /end MEASUREMENT
/begin MEASUREMENT B_agr "Bedingung AGR ein" UBYTE B_TRUE 1 100 0 1 BIT_MASK 0x1 FORMAT "%13.11" ECU_ADDRESS 0x7FBBE6 /end MEASUREMENT
/begin MEASUREMENT B_anfslv "" UBYTE B_TRUE 1 100 0 1 BIT_MASK 0x1 FORMAT "%13.11" ECU_ADDRESS 0x7FBC78 /end MEASUREMENT
/begin MEASUREMENT B_auakt "Bedingung Abgasuntersuchung aktiv" UBYTE B_TRUE 1 100 0 1 BIT_MASK 0x1 FORMAT "%13.11" ECU_ADDRESS 0x7FBB6E /end MEASUREMENT
/begin MEASUREMENT B_bdslv "" UBYTE B_TRUE 1 100 0 1 BIT_MASK 0x1 FORMAT "%13.11" ECU_ADDRESS 0x7FBC79 /end MEASUREMENT
/begin MEASUREMENT B_bkvleer "Bedingung Bremskraftverst‰rker ohne ausreichenden Unterdruck" UBYTE B_TRUE 1 100 0 1 BIT_MASK 0x1 FORMAT "%13.11" ECU_ADDRESS 0x7FBBE7 /end MEASUREMENT
/begin MEASUREMENT B_blkfb "MIL-Ansteuerung blinkend fremdbestimmt durch externes SG" UBYTE B_TRUE 1 100 0 1 BIT_MASK 0x1 FORMAT "%13.11" ECU_ADDRESS 0x7FB945 /end MEASUREMENT
/begin MEASUREMENT B_blkmd "MIL-Ansteuerung blinkend durch Aussetzererkennung" UBYTE B_TRUE 1 100 0 1 BIT_MASK 0x1 FORMAT "%13.11" ECU_ADDRESS 0x7FD7FE /end MEASUREMENT
/begin MEASUREMENT B_brfrm "" UBYTE B_TRUE 1 100 0 1 BIT_MASK 0x1 FORMAT "%13.11" ECU_ADDRESS 0x7FBC7A /end MEASUREMENT
/begin MEASUREMENT B_bteepcl "Bedingung Bauteileansteuerung;  EML-Lampe (enable)" UBYTE B_TRUE 1 100 0 1 BIT_MASK 0x1 FORMAT "%13.11" ECU_ADDRESS 0x7FBBE8 /end MEASUREMENT
/begin MEASUREMENT B_btefgr "Bedingung Bauteileansteuerung;  Bereitschaftsanzeige FGR-Mainswitch" UBYTE B_TRUE 1 100 0 1 BIT_MASK 0x1 FORMAT "%13.11" ECU_ADDRESS 0x7FBBE9 /end MEASUREMENT
/begin MEASUREMENT B_btepcl "Bedingung Bauteileansteuerung;  EML-Lampe" UBYTE B_TRUE 1 100 0 1 BIT_MASK 0x1 FORMAT "%13.11" ECU_ADDRESS 0x7FBBEA /end MEASUREMENT
/begin MEASUREMENT B_btfgr "Bedingung Bauteileansteuerung;  Bereitschaftsanzeige FGR-Mainswitch" UBYTE B_TRUE 1 100 0 1 BIT_MASK 0x1 FORMAT "%13.11" ECU_ADDRESS 0x7FBBEB /end MEASUREMENT
/begin MEASUREMENT B_btslp "Bedingung Bauteileansteuerung; Sekund‰rluftpumpe" UBYTE B_TRUE 1 100 0 1 BIT_MASK 0x1 FORMAT "%13.11" ECU_ADDRESS 0x7FBBEC /end MEASUREMENT
/begin MEASUREMENT B_cdagr "Funktion ¸ber Codewort CDAGR freigegeben" UWORD B_TRUE 1 100 0 1 BIT_MASK 0x8000 FORMAT "%13.11" ECU_ADDRESS 0x7FDF86 /end MEASUREMENT
/begin MEASUREMENT B_cdanws "Funktion ¸ber Codewort CDNWS freigegeben (Auslaﬂ)" UBYTE B_TRUE 1 100 0 1 BIT_MASK 0x1 FORMAT "%13.11" ECU_ADDRESS 0x7FBB6F /end MEASUREMENT
/begin MEASUREMENT B_cddmtl "Funktionfreigabe per Codewort" UBYTE B_TRUE 1 100 0 1 BIT_MASK 0x1 FORMAT "%13.11" ECU_ADDRESS 0x7FBB70 /end MEASUREMENT
/begin MEASUREMENT B_cdenws "Funktion ¸ber Codewort CDNWS freigegeben (Einlaﬂ)" UBYTE B_TRUE 1 100 0 1 BIT_MASK 0x1 FORMAT "%13.11" ECU_ADDRESS 0x7FBB71 /end MEASUREMENT
/begin MEASUREMENT B_cdhsh "Funktion ¸ber Codewort CDHSH freigegeben" UWORD B_TRUE 1 100 0 1 BIT_MASK 0x80 FORMAT "%13.11" ECU_ADDRESS 0x7FDF86 /end MEASUREMENT
/begin MEASUREMENT B_cdhsv "Funktion ¸ber Codewort CDHSV freigegeben" UWORD B_TRUE 1 100 0 1 BIT_MASK 0x40 FORMAT "%13.11" ECU_ADDRESS 0x7FDF86 /end MEASUREMENT
/begin MEASUREMENT B_cdhsvsa "Funktion ¸ber Codewort CDHSVSA freigegeben" UBYTE B_TRUE 1 100 0 1 BIT_MASK 0x1 FORMAT "%13.11" ECU_ADDRESS 0x7FBB72 /end MEASUREMENT
/begin MEASUREMENT B_cdkat "Funktion ¸ber Codewort CDKAT freigegeben" UWORD B_TRUE 1 100 0 1 BIT_MASK 0x100 FORMAT "%13.11" ECU_ADDRESS 0x7FDF86 /end MEASUREMENT
/begin MEASUREMENT B_cdkatsp "Funktion ¸ber Codewort CDKATSP freigegeben" UBYTE B_TRUE 1 100 0 1 BIT_MASK 0x1 FORMAT "%13.11" ECU_ADDRESS 0x7FBB73 /end MEASUREMENT
/begin MEASUREMENT B_cdkvs "Funktion ¸ber Codewort CDKVS freigegeben" UWORD B_TRUE 1 100 0 1 BIT_MASK 0x800 FORMAT "%13.11" ECU_ADDRESS 0x7FDF86 /end MEASUREMENT
/begin MEASUREMENT B_cdlash "Funktion ¸ber Codewort CDLASH freigegeben" UWORD B_TRUE 1 100 0 1 BIT_MASK 0x40 FORMAT "%13.11" ECU_ADDRESS 0x7FDF88 /end MEASUREMENT
/begin MEASUREMENT B_cdlatp "Funktion ¸ber Codewort CDLATP freigegeben" UWORD B_TRUE 1 100 0 1 BIT_MASK 0x10 FORMAT "%13.11" ECU_ADDRESS 0x7FDF88 /end MEASUREMENT
/begin MEASUREMENT B_cdlatv "Funktion ¸ber Codewort CDLATV freigeben" UWORD B_TRUE 1 100 0 1 BIT_MASK 0x20 FORMAT "%13.11" ECU_ADDRESS 0x7FDF88 /end MEASUREMENT
/begin MEASUREMENT B_cdldp "Funktion ¸ber Codewort CDLDP freigegeben" UWORD B_TRUE 1 100 0 1 BIT_MASK 0x4000 FORMAT "%13.11" ECU_ADDRESS 0x7FDF86 /end MEASUREMENT
/begin MEASUREMENT B_cdllr "Funktion ¸ber Codewort CDLLR freigegeben" UWORD B_TRUE 1 100 0 1 BIT_MASK 0x8 FORMAT "%13.11" ECU_ADDRESS 0x7FDF88 /end MEASUREMENT
/begin MEASUREMENT B_cdlsh "Funktion ¸ber Codewort CDLSH freigegeben" UWORD B_TRUE 1 100 0 1 BIT_MASK 0x10 FORMAT "%13.11" ECU_ADDRESS 0x7FDF86 /end MEASUREMENT
/begin MEASUREMENT B_cdlsv "Funktion ¸ber Codewort CDLSV freigegeben" UWORD B_TRUE 1 100 0 1 BIT_MASK 0x8 FORMAT "%13.11" ECU_ADDRESS 0x7FDF86 /end MEASUREMENT
/begin MEASUREMENT B_cdlsvv "Funktion ¸ber Codewort CDLSVV freigegeben" UBYTE B_TRUE 1 100 0 1 BIT_MASK 0x1 FORMAT "%13.11" ECU_ADDRESS 0x7FBB74 /end MEASUREMENT
/begin MEASUREMENT B_cdmd "Funktion ¸ber Codewort CDMD freigegeben" UWORD B_TRUE 1 100 0 1 BIT_MASK 0x1 FORMAT "%13.11" ECU_ADDRESS 0x7FDF86 /end MEASUREMENT
/begin MEASUREMENT B_cdsls "Funktion ¸ber Codewort CDSLS freigegeben" UWORD B_TRUE 1 100 0 1 BIT_MASK 0x1 FORMAT "%13.11" ECU_ADDRESS 0x7FDF88 /end MEASUREMENT
/begin MEASUREMENT B_cdswe "Funktion ¸ber Codewort CDSWE freigegeben" UWORD B_TRUE 1 100 0 1 BIT_MASK 0x2 FORMAT "%13.11" ECU_ADDRESS 0x7FDF86 /end MEASUREMENT
/begin MEASUREMENT B_cdtankl "Funktion ¸ber Codewort CDTANKL freigegeben" UWORD B_TRUE 1 100 0 1 BIT_MASK 0x4 FORMAT "%13.11" ECU_ADDRESS 0x7FDF86 /end MEASUREMENT
/begin MEASUREMENT B_cdtes "Funktion ¸ber Codewort CDTES freigegeben" UWORD B_TRUE 1 100 0 1 BIT_MASK 0x2000 FORMAT "%13.11" ECU_ADDRESS 0x7FDF86 /end MEASUREMENT
/begin MEASUREMENT B_clradbbo "Bedingung: Adaptionswerte Bereichserk. Benzin im Oel selektiv loeschen" UBYTE B_TRUE 1 100 0 1 BIT_MASK 0x1 FORMAT "%13.11" ECU_ADDRESS 0x7FBBED /end MEASUREMENT
/begin MEASUREMENT B_clradkr "Bedingung: Adaptionswerte Klopfregelung selektiv loeschen" UBYTE B_TRUE 1 100 0 1 BIT_MASK 0x1 FORMAT "%13.11" ECU_ADDRESS 0x7FBBEE /end MEASUREMENT
/begin MEASUREMENT B_clradkrd "Bedingung: Adaptionswerte Dynamikvorhalt  selektiv loeschen" UBYTE B_TRUE 1 100 0 1 BIT_MASK 0x1 FORMAT "%13.11" ECU_ADDRESS 0x7FBBEF /end MEASUREMENT
/begin MEASUREMENT B_craus "Ausgewertet durch LREB: Werkstattbit zum Stillegen LR" UBYTE DEZ 1 100 0 1 BIT_MASK 0x1 FORMAT "%5.3" ECU_ADDRESS 0x7FBBF0 /end MEASUREMENT
/begin MEASUREMENT B_cvt "Bedingung continuously variable transmission" UBYTE B_TRUE 1 100 0 1 BIT_MASK 0x1 FORMAT "%13.11" ECU_ADDRESS 0x7FBBF1 /end MEASUREMENT
/begin MEASUREMENT B_cwggmfl "Bedingung Funktionsfreigabe ¸ber Codewort CWGGMFL erteilt" UBYTE B_TRUE 1 100 0 1 BIT_MASK 0x1 FORMAT "%13.11" ECU_ADDRESS 0x7FBB75 /end MEASUREMENT
/begin MEASUREMENT B_cwggmfl1 "Bedingung FGR-Lampe aus bei  Low-Range ( ¸ber Codewort CWGGMFL)" UBYTE B_TRUE 1 100 0 1 BIT_MASK 0x1 FORMAT "%13.11" ECU_ADDRESS 0x7FBB76 /end MEASUREMENT
/begin MEASUREMENT B_cwlshdyn "Beding. Abschaltung f¸r Teilfunktion Dynamikpr¸fung Sonde hinter KAT in %DLSAHK" UBYTE B_TRUE 1 100 0 1 BIT_MASK 0x1 FORMAT "%13.11" ECU_ADDRESS 0x7FBBF2 /end MEASUREMENT
/begin MEASUREMENT B_cwlshsch "Bedingung Abschaltung f¸r Teilfunktion im Schub Sonde hinter KAT in %DLSAHK" UBYTE B_TRUE 1 100 0 1 BIT_MASK 0x1 FORMAT "%13.11" ECU_ADDRESS 0x7FBBF3 /end MEASUREMENT
/begin MEASUREMENT B_cwlshvl "Bed. Abschaltung f¸r Teilfunktion im Vollastbetrieb Sonde hinter KAT in %DLSAHK" UBYTE B_TRUE 1 100 0 1 BIT_MASK 0x1 FORMAT "%13.11" ECU_ADDRESS 0x7FBBF4 /end MEASUREMENT
/begin MEASUREMENT B_dknolu "Bedingung Drosselklappensteller stromlos" UBYTE B_TRUE 1 100 0 1 BIT_MASK 0x1 FORMAT "%13.11" ECU_ADDRESS 0x7FBBF5 /end MEASUREMENT
/begin MEASUREMENT B_dkpt "Bedingung Tester DKPADP" UBYTE B_TRUE 1 100 0 1 BIT_MASK 0x1 FORMAT "%13.11" ECU_ADDRESS 0x7FBBF6 /end MEASUREMENT
/begin MEASUREMENT B_dkpu "Bedingung Sicherheitskraftstoffabschaltung (SKA)" UBYTE B_TRUE 1 100 0 1 BIT_MASK 0x1 FORMAT "%13.11" ECU_ADDRESS 0x7FBBF7 /end MEASUREMENT
/begin MEASUREMENT B_dldpte "Anforderung TEV schlieﬂen aus Tankentl¸ftungsdiagnose" UBYTE B_TRUE 1 100 0 1 BIT_MASK 0x1 FORMAT "%13.11" ECU_ADDRESS 0x7FBBF8 /end MEASUREMENT
/begin MEASUREMENT B_dmmtev "TEV-schlieﬂen wegen Bedingung Endstufentest DMTL-Magnetventil" UBYTE B_TRUE 1 100 0 1 BIT_MASK 0x1 FORMAT "%13.11" ECU_ADDRESS 0x7FBBF9 /end MEASUREMENT
/begin MEASUREMENT B_dmrwan "Bedingung Aufbau Momentenreserve f¸r Wandlermoment" UBYTE B_TRUE 1 100 0 1 BIT_MASK 0x1 FORMAT "%13.11" ECU_ADDRESS 0x7FBB3C /end MEASUREMENT
/begin MEASUREMENT B_dmtltz "Bedingung TEV soll geschlossen werden" UBYTE B_TRUE 1 100 0 1 BIT_MASK 0x1 FORMAT "%13.11" ECU_ADDRESS 0x7FBBFA /end MEASUREMENT
/begin MEASUREMENT B_druck "Bedingung Drucklospr¸fung erf¸llt, System drucklos" UBYTE B_TRUE 1 100 0 1 BIT_MASK 0x1 FORMAT "%13.11" ECU_ADDRESS 0x7FBBFB /end MEASUREMENT
/begin MEASUREMENT B_dslreset "Bedingung: Zur¸cksetzen Sekund‰rluftadaption/Kurztest" UWORD B_TRUE 1 100 0 1 BIT_MASK 0x2 FORMAT "%13.11" ECU_ADDRESS 0x7FD7E4 /end MEASUREMENT
/begin MEASUREMENT B_dslset "Bedingung: Setzen Sekund‰rluftadaption/Kurztest" UWORD B_TRUE 1 100 0 1 BIT_MASK 0x1 FORMAT "%13.11" ECU_ADDRESS 0x7FD7E4 /end MEASUREMENT
/begin MEASUREMENT B_dslste "" UBYTE B_TRUE 1 100 0 1 BIT_MASK 0x1 FORMAT "%13.11" ECU_ADDRESS 0x7FBC84 /end MEASUREMENT
/begin MEASUREMENT B_dslv "" UBYTE B_TRUE 1 100 0 1 BIT_MASK 0x1 FORMAT "%13.11" ECU_ADDRESS 0x7FBC7B /end MEASUREMENT
/begin MEASUREMENT B_dslva "" UBYTE B_TRUE 1 100 0 1 BIT_MASK 0x1 FORMAT "%13.11" ECU_ADDRESS 0x7FBC7C /end MEASUREMENT
/begin MEASUREMENT B_dslve "" UBYTE B_TRUE 1 100 0 1 BIT_MASK 0x1 FORMAT "%13.11" ECU_ADDRESS 0x7FBC7D /end MEASUREMENT
/begin MEASUREMENT B_dtefrr "Bedingung Lambdareglerreset bei Tankentl¸ftungsdiagnose" UBYTE B_TRUE 1 100 0 1 BIT_MASK 0x1 FORMAT "%13.11" ECU_ADDRESS 0x7FBBFC /end MEASUREMENT
/begin MEASUREMENT B_dwg "Bedingung f¸r Diagnose Waste- Gate" UBYTE B_TRUE 1 100 0 1 BIT_MASK 0x1 FORMAT "%13.11" ECU_ADDRESS 0x7FBBFD /end MEASUREMENT
/begin MEASUREMENT B_dynsln "Drehzahldynamik f¸r Sekund‰rluft erkannt" UBYTE B_TRUE 1 100 0 1 BIT_MASK 0x1 FORMAT "%13.11" ECU_ADDRESS 0x7FBC82 /end MEASUREMENT
/begin MEASUREMENT B_dynslrl "Lastdynamik f¸r Sekund‰rluft erkannt" UBYTE B_TRUE 1 100 0 1 BIT_MASK 0x1 FORMAT "%13.11" ECU_ADDRESS 0x7FBC83 /end MEASUREMENT
/begin MEASUREMENT B_eepdif "Plausibilit‰tspr¸fung EEPROM und FLASH-Daten" UBYTE B_TRUE 1 100 0 1 BIT_MASK 0x1 FORMAT "%13.11" ECU_ADDRESS 0x7FBBFE /end MEASUREMENT
/begin MEASUREMENT B_elue "Bedingung zur Ansteuerung des Motorluefters" UBYTE B_TRUE 1 100 0 1 BIT_MASK 0x1 FORMAT "%13.11" ECU_ADDRESS 0x7FBC6F /end MEASUREMENT
/begin MEASUREMENT B_esnws "" UBYTE B_TRUE 1 100 0 1 BIT_MASK 0x1 FORMAT "%13.11" ECU_ADDRESS 0x7FBBFF /end MEASUREMENT
/begin MEASUREMENT B_estart "Bedingung KL 50 ein" UBYTE B_TRUE 1 100 0 1 BIT_MASK 0x1 FORMAT "%13.11" ECU_ADDRESS 0x7FBC00 /end MEASUREMENT
/begin MEASUREMENT B_etret "Bedingung elektr. Thermostatregelung ein ¸ber Tester" UBYTE B_TRUE 1 100 0 1 BIT_MASK 0x1 FORMAT "%13.11" ECU_ADDRESS 0x7FBC01 /end MEASUREMENT
/begin MEASUREMENT B_faatm "Bedingung Funktionsanforderung kurze Taupunktendezeiten" UBYTE B_TRUE 1 100 0 1 BIT_MASK 0x1 FORMAT "%13.11" ECU_ADDRESS 0x7FBC02 /end MEASUREMENT
/begin MEASUREMENT B_fabr "Bedingung Fahrer bremst aus CAN-Botschaft" UBYTE B_TRUE 1 100 0 1 BIT_MASK 0x1 FORMAT "%13.11" ECU_ADDRESS 0x7FBC03 /end MEASUREMENT
/begin MEASUREMENT B_faetr "Bedingung Funktionsanforderung elektr. Thermostatregelung" UBYTE B_TRUE 1 100 0 1 BIT_MASK 0x1 FORMAT "%13.11" ECU_ADDRESS 0x7FBC04 /end MEASUREMENT
/begin MEASUREMENT B_fakat "Bedingung Funktionsanforderung Katalysator¸berwachung" UBYTE DEZ 1 100 0 1 BIT_MASK 0x1 FORMAT "%5.3" ECU_ADDRESS 0x7FBC05 /end MEASUREMENT
/begin MEASUREMENT B_fakat2 "Bedingung Funktionanforderung Katalysator¸berwachung (Stereo 2.Bank)" UBYTE DEZ 1 100 0 1 BIT_MASK 0x1 FORMAT "%5.3" ECU_ADDRESS 0x7FBC06 /end MEASUREMENT
/begin MEASUREMENT B_fakvs "Funktionsaufforderung Diagnose Kraftstoffsystem f¸r Schnelltest" UBYTE B_TRUE 1 100 0 1 BIT_MASK 0x1 FORMAT "%13.11" ECU_ADDRESS 0x7FBC07 /end MEASUREMENT
/begin MEASUREMENT B_fash "Bedingung Funktionsanforderung Schwingungspr¸fung" UBYTE B_TRUE 1 100 0 1 BIT_MASK 0x1 FORMAT "%13.11" ECU_ADDRESS 0x7FBC08 /end MEASUREMENT
/begin MEASUREMENT B_fasla "Bedingung: externe Anforderung an Sekund‰rluft aktiv" UBYTE B_TRUE 1 100 0 1 BIT_MASK 0x1 FORMAT "%13.11" ECU_ADDRESS 0x7FBC85 /end MEASUREMENT
/begin MEASUREMENT B_fatp "Bedingung Funktionsanforderung TP-‹berwachung" UBYTE B_TRUE 1 100 0 1 BIT_MASK 0x1 FORMAT "%13.11" ECU_ADDRESS 0x7FBC09 /end MEASUREMENT
/begin MEASUREMENT B_fatp2 "Bedingung Funktionsanforderung TP-‹berwachung Bank2" UBYTE B_TRUE 1 100 0 1 BIT_MASK 0x1 FORMAT "%13.11" ECU_ADDRESS 0x7FBC0A /end MEASUREMENT
/begin MEASUREMENT B_fatv "" UBYTE B_TRUE 1 100 0 1 BIT_MASK 0x1 FORMAT "%13.11" ECU_ADDRESS 0x7FBC0B /end MEASUREMENT
/begin MEASUREMENT B_fatv2 "Bedingung Funktionsanforderung TV-‹berwachung Bank2" UBYTE B_TRUE 1 100 0 1 BIT_MASK 0x1 FORMAT "%13.11" ECU_ADDRESS 0x7FBC0C /end MEASUREMENT
/begin MEASUREMENT B_fgren "Bedingung Fahrgeschwindigkeitsregelung aktiv (Enable)" UBYTE B_TRUE 1 100 0 1 BIT_MASK 0x1 FORMAT "%13.11" ECU_ADDRESS 0x7FBC0D /end MEASUREMENT
/begin MEASUREMENT B_fhz "Bedingung Frontscheibenheizung" UBYTE B_TRUE 1 100 0 1 BIT_MASK 0x1 FORMAT "%13.11" ECU_ADDRESS 0x7FBC0E /end MEASUREMENT
/begin MEASUREMENT B_fofrun "Status fuel-off Adaption aktiv" UBYTE B_TRUE 1 100 0 1 BIT_MASK 0x1 FORMAT "%13.11" ECU_ADDRESS 0x7FD7FF /end MEASUREMENT
/begin MEASUREMENT B_fphubap "Bedingung Hubsteuerung direkt ¸ber Fahrpedal" UBYTE B_TRUE 1 100 0 1 BIT_MASK 0x1 FORMAT "%13.11" ECU_ADDRESS 0x7FBB77 /end MEASUREMENT
/begin MEASUREMENT B_fpwdkap "DK-Steuerung direkt ¸ber Fahrpedal" UBYTE B_TRUE 1 100 0 1 BIT_MASK 0x1 FORMAT "%13.11" ECU_ADDRESS 0x7FBB78 /end MEASUREMENT
/begin MEASUREMENT B_frgASG "Startfreigabe-Bit aus ASG-SG" UBYTE B_TRUE 1 100 0 1 BIT_MASK 0x1 FORMAT "%13.11" ECU_ADDRESS 0x7FBC0F /end MEASUREMENT
/begin MEASUREMENT B_frgfrm "" UBYTE B_TRUE 1 100 0 1 BIT_MASK 0x1 FORMAT "%13.11" ECU_ADDRESS 0x7FBC7E /end MEASUREMENT
/begin MEASUREMENT B_frm1 "" UBYTE B_TRUE 1 100 0 1 BIT_MASK 0x1 FORMAT "%13.11" ECU_ADDRESS 0x7FBC7F /end MEASUREMENT
/begin MEASUREMENT B_frmde "" UBYTE B_TRUE 1 100 0 1 BIT_MASK 0x1 FORMAT "%13.11" ECU_ADDRESS 0x7FBC80 /end MEASUREMENT
/begin MEASUREMENT B_fsu "Bedingung Fahrstufe, Umschaltung" UBYTE B_TRUE 1 100 0 1 BIT_MASK 0x1 FORMAT "%13.11" ECU_ADDRESS 0x7FBB3D /end MEASUREMENT
/begin MEASUREMENT B_ftedab "Bedingung Sp¸lrate f¸r Diagnose zusteuern" UBYTE B_TRUE 1 100 0 1 BIT_MASK 0x1 FORMAT "%13.11" ECU_ADDRESS 0x7FBC10 /end MEASUREMENT
/begin MEASUREMENT B_fzg_on "Bedingung Betrieb im Fahrzeug aktiviert" UBYTE B_TRUE 1 100 0 1 BIT_MASK 0x1 FORMAT "%13.11" ECU_ADDRESS 0x7FBB79 /end MEASUREMENT
/begin MEASUREMENT B_gd "Bedingung gedrosselt" UBYTE B_TRUE 1 100 0 1 BIT_MASK 0x1 FORMAT "%13.11" ECU_ADDRESS 0x7FBC11 /end MEASUREMENT
/begin MEASUREMENT B_gdst "" UBYTE dez 1 100 0 255 FORMAT "%5.1" ECU_ADDRESS 0x7FD764 /end MEASUREMENT
/begin MEASUREMENT B_gdvhub "" UBYTE dez 1 100 0 255 FORMAT "%5.1" ECU_ADDRESS 0x7FD765 /end MEASUREMENT
/begin MEASUREMENT B_gdvvtueb "" UBYTE dez 1 100 0 255 FORMAT "%5.1" ECU_ADDRESS 0x7FD766 /end MEASUREMENT
/begin MEASUREMENT B_gene "Bedingung f¸r Momentenanforderung Generator" UBYTE B_TRUE 1 100 0 1 FORMAT "%13.11" ECU_ADDRESS 0x7FD84F /end MEASUREMENT
/begin MEASUREMENT B_gsaf "Bedingung Getriebe-Schalteingriff-Anforderung" UBYTE B_TRUE 1 100 0 1 BIT_MASK 0x1 FORMAT "%13.11" ECU_ADDRESS 0x7FBC12 /end MEASUREMENT
/begin MEASUREMENT B_hfm "Bedingung HFM messbereit" UBYTE B_TRUE 1 100 0 1 BIT_MASK 0x1 FORMAT "%13.11" ECU_ADDRESS 0x7FBC13 /end MEASUREMENT
/begin MEASUREMENT B_hls "Bedingung Heizung Lambdasonde" UBYTE B_TRUE 1 100 0 1 BIT_MASK 0x1 FORMAT "%13.11" ECU_ADDRESS 0x7FBC14 /end MEASUREMENT
/begin MEASUREMENT B_HLSKW "Bedingung Heizleistungsteigerung" UBYTE B_TRUE 1 100 0 1 BIT_MASK 0x1 FORMAT "%13.11" ECU_ADDRESS 0x7FBC15 /end MEASUREMENT
/begin MEASUREMENT B_hubap "Bedingung Hubsteuerung ¸ber Festwert" UBYTE B_TRUE 1 100 0 1 BIT_MASK 0x1 FORMAT "%13.11" ECU_ADDRESS 0x7FBB7A /end MEASUREMENT
/begin MEASUREMENT B_hystmls "Ausgangszustand der Temperaturhysterese" UBYTE B_TRUE 1 100 0 1 BIT_MASK 0x1 FORMAT "%13.11" ECU_ADDRESS 0x7FBC70 /end MEASUREMENT
/begin MEASUREMENT B_ins2cok "Bedingung: CAN-Botschaft INSTR2 vorhanden" UBYTE B_TRUE 1 100 0 1 BIT_MASK 0x1 FORMAT "%13.11" ECU_ADDRESS 0x7FBC16 /end MEASUREMENT
/begin MEASUREMENT B_katfz "Bedingung Kat in Fahrzeug eingebaut" UBYTE B_TRUE 1 100 0 1 BIT_MASK 0x1 FORMAT "%13.11" ECU_ADDRESS 0x7FBB7B /end MEASUREMENT
/begin MEASUREMENT B_kmmilsct "Ausgabe ""km bei MIL on"" f¸r Scan Tool abschalten (0 = keine Ausgabe in PID $21)" UBYTE B_TRUE 1 100 0 1 BIT_MASK 0x1 FORMAT "%13.11" ECU_ADDRESS 0x7FBC17 /end MEASUREMENT
/begin MEASUREMENT B_ko "Bedingung Kompressor freigegeben" UBYTE B_TRUE 1 100 0 1 BIT_MASK 0x1 FORMAT "%13.11" ECU_ADDRESS 0x7FBC18 /end MEASUREMENT
/begin MEASUREMENT B_koger "Bedingung geregelter/ungeregelter Klimakompressor" UBYTE B_TRUE 1 100 0 1 BIT_MASK 0x1 FORMAT "%13.11" ECU_ADDRESS 0x7FBC19 /end MEASUREMENT
/begin MEASUREMENT B_kse "" UBYTE B_TRUE 1 100 0 1 BIT_MASK 0x1 FORMAT "%13.11" ECU_ADDRESS 0x7FBC1A /end MEASUREMENT
/begin MEASUREMENT B_lamdkt "Lambdasoll Eingriff f¸r Katdiagnose aktiv" UBYTE B_TRUE 1 100 0 1 FORMAT "%13.11" ECU_ADDRESS 0x7FD767 /end MEASUREMENT
/begin MEASUREMENT B_lamdkt2 "Lambdasoll Eingriff f¸r Katdiagnose aktiv" UBYTE B_TRUE 1 100 0 1 FORMAT "%13.11" ECU_ADDRESS 0x7FD768 /end MEASUREMENT
/begin MEASUREMENT B_lmsslof "Bedingung Lambda-Motor-Soll-Sekund‰rluftanteil, Aus" UBYTE B_TRUE 1 100 0 1 BIT_MASK 0x1 FORMAT "%13.11" ECU_ADDRESS 0x7FBC86 /end MEASUREMENT
/begin MEASUREMENT B_lowra "Bedingung Zwischengelege f¸r Low Range zugeschaltet" UBYTE B_TRUE 1 100 0 1 BIT_MASK 0x1 FORMAT "%13.11" ECU_ADDRESS 0x7FBC1B /end MEASUREMENT
/begin MEASUREMENT B_lrssa "LRSEB: Einschaltbed. f¸r Lambdareg. nach Schub bei langsamer Sonde" UBYTE B_TRUE 1 100 0 1 BIT_MASK 0x1 FORMAT "%13.11" ECU_ADDRESS 0x7FBC1C /end MEASUREMENT
/begin MEASUREMENT B_lsh "Bedingung Lambda-Sonde hinter Kat verbaut, 2. Sonde nach Auslaﬂ (Bank1)" UBYTE B_TRUE 1 100 0 1 BIT_MASK 0x1 FORMAT "%13.11" ECU_ADDRESS 0x7FBB7C /end MEASUREMENT
/begin MEASUREMENT B_lsh2 "Bedingung Lambda-Sonde hinter Kat verbaut, 2. Sonde nach Auslaﬂ (Bank2)" UBYTE B_TRUE 1 100 0 1 BIT_MASK 0x1 FORMAT "%13.11" ECU_ADDRESS 0x7FBB7D /end MEASUREMENT
/begin MEASUREMENT B_lsuab "Bedingung Abgleich stetige Lambda-Sonde LSU" UBYTE B_TRUE 1 100 0 1 BIT_MASK 0x1 FORMAT "%13.11" ECU_ADDRESS 0x7FBC1D /end MEASUREMENT
/begin MEASUREMENT B_lsuab2 "Bedingung Abgleich stetige Lambda-Sonde LSU2" UBYTE B_TRUE 1 100 0 1 BIT_MASK 0x1 FORMAT "%13.11" ECU_ADDRESS 0x7FBC1E /end MEASUREMENT
/begin MEASUREMENT B_lsv "Bedingung Lambda-Sonde vor Kat verbaut, 1. Sonde nach Auslaﬂ (Bank1)" UBYTE B_TRUE 1 100 0 1 BIT_MASK 0x1 FORMAT "%13.11" ECU_ADDRESS 0x7FBB7E /end MEASUREMENT
/begin MEASUREMENT B_lsv2 "Bedingung Lambda-Sonde vor Kat verbaut, 1. Sonde nach Auslaﬂ (Bank2)" UBYTE B_TRUE 1 100 0 1 BIT_MASK 0x1 FORMAT "%13.11" ECU_ADDRESS 0x7FBB7F /end MEASUREMENT
/begin MEASUREMENT B_lsvvsp "Bedingung Vertauschte Lambda-Sonden, Regelung sperren" UBYTE B_TRUE 1 100 0 1 BIT_MASK 0x1 FORMAT "%13.11" ECU_ADDRESS 0x7FBC1F /end MEASUREMENT
/begin MEASUREMENT B_masterhw "Bedingung Master-SG gem‰ﬂ Codier-Pin (plausibilisiert)" UBYTE B_TRUE 1 100 0 1 BIT_MASK 0x1 FORMAT "%13.11" ECU_ADDRESS 0x7FBC20 /end MEASUREMENT
/begin MEASUREMENT B_mdarv "kritische Aussetzerrate vorhanden" UBYTE B_TRUE 1 100 0 1 BIT_MASK 0x1 FORMAT "%13.11" ECU_ADDRESS 0x7FD800 /end MEASUREMENT
/begin MEASUREMENT B_mdee_kup "Bedingung Momentenreduzierung ¸ber Einspritzung f¸r F1-Getriebe" UBYTE B_TRUE 1 100 0 1 BIT_MASK 0x1 FORMAT "%13.11" ECU_ADDRESS 0x7FBC21 /end MEASUREMENT
/begin MEASUREMENT B_mdkat "Katsch‰digende Aussetzerrate ¸berschritten (zur Ausblendung anderer Funktionen)" UBYTE B_TRUE 1 100 0 1 BIT_MASK 0x1 FORMAT "%13.11" ECU_ADDRESS 0x7FD801 /end MEASUREMENT
/begin MEASUREMENT B_mdwaner "Bedingung Fehler auf mdwan_w" UBYTE B_TRUE 1 100 0 1 BIT_MASK 0x1 FORMAT "%13.11" ECU_ADDRESS 0x7FBC22 /end MEASUREMENT
/begin MEASUREMENT B_milfb "MIL-Ansteuerung fremdbestimmt durch externes SG" UBYTE B_TRUE 1 100 0 1 BIT_MASK 0x1 FORMAT "%13.11" ECU_ADDRESS 0x7FB946 /end MEASUREMENT
/begin MEASUREMENT B_milmd "MIL-Ansteuerung an durch Aussetzererkennung, bei ti-Abschaltung" UBYTE B_TRUE 1 100 0 1 BIT_MASK 0x1 FORMAT "%13.11" ECU_ADDRESS 0x7FD802 /end MEASUREMENT
/begin MEASUREMENT B_mls "" UBYTE B_TRUE 1 100 0 1 BIT_MASK 0x1 FORMAT "%13.11" ECU_ADDRESS 0x7FBC71 /end MEASUREMENT
/begin MEASUREMENT B_mrfavl "Vollasterkennung ¸ber relativen Fahrerwunsch" UBYTE B_TRUE 1 100 0 1 BIT_MASK 0x1 FORMAT "%13.11" ECU_ADDRESS 0x7FBB80 /end MEASUREMENT
/begin MEASUREMENT B_msf "Bedingung Motorschutzfkt. aktiv" UBYTE B_TRUE 1 100 0 1 BIT_MASK 0x1 FORMAT "%13.11" ECU_ADDRESS 0x7FBCA0 /end MEASUREMENT
/begin MEASUREMENT B_msftmp "" UBYTE B_TRUE 1 100 0 1 BIT_MASK 0x1 FORMAT "%13.11" ECU_ADDRESS 0x7FBCA1 /end MEASUREMENT
/begin MEASUREMENT B_msloff "Sekund‰rluftmasse ausger‰umt nach Sekund‰rluftphase" UBYTE B_TRUE 1 100 0 1 BIT_MASK 0x1 FORMAT "%13.11" ECU_ADDRESS 0x7FBC87 /end MEASUREMENT
/begin MEASUREMENT B_mslon "Sekund‰rluftmasse eingeschwungen nach Start der Sekund‰rluft" UBYTE B_TRUE 1 100 0 1 BIT_MASK 0x1 FORMAT "%13.11" ECU_ADDRESS 0x7FBC88 /end MEASUREMENT
/begin MEASUREMENT B_mzns "Nachstartaufweitung des zul. Moments aktiv" UBYTE B_TRUE 1 100 0 1 BIT_MASK 0x1 FORMAT "%13.11" ECU_ADDRESS 0x7FBB60 /end MEASUREMENT
/begin MEASUREMENT B_nachl "Steuerung SG-Nachlauf" UWORD B_TRUE 1 100 0 1 BIT_MASK 0x8000 FORMAT "%13.11" ECU_ADDRESS 0x7F9C50 /end MEASUREMENT
/begin MEASUREMENT B_nachlend "Bedingung SG-Nachlauf regul‰r beendet" UWORD B_TRUE 1 100 0 1 BIT_MASK 0x4000 FORMAT "%13.11" ECU_ADDRESS 0x7F9C50 /end MEASUREMENT
/begin MEASUREMENT B_nachlram "Steuerung SG-Nachlauf mit Systemcheck" UBYTE B_TRUE 1 100 0 1 BIT_MASK 0x1 FORMAT "%13.11" ECU_ADDRESS 0x7FBB6B /end MEASUREMENT
/begin MEASUREMENT B_ndsav "Bedingung EEPROM-Emulation aktiv" UBYTE B_TRUE 1 100 0 1 BIT_MASK 0x1 FORMAT "%13.11" ECU_ADDRESS 0x7FBB81 /end MEASUREMENT
/begin MEASUREMENT B_nlacls "Anforderung Steuerger‰tenachlauf von AC-L¸ftersteuerung" UWORD B_TRUE 1 100 0 1 BIT_MASK 0x2 FORMAT "%13.11" ECU_ADDRESS 0x7F9C50 /end MEASUREMENT
/begin MEASUREMENT B_nlale "Anforderung Steuerger‰tenachlauf von Funktion ALE" UWORD B_TRUE 1 100 0 1 BIT_MASK 0x1 FORMAT "%13.11" ECU_ADDRESS 0x7F9C50 /end MEASUREMENT
/begin MEASUREMENT B_nlatm "Anforderung Steuerger‰tenachlauf f¸r Abgastemp.Modell Sondenschutz" UWORD B_TRUE 1 100 0 1 BIT_MASK 0x400 FORMAT "%13.11" ECU_ADDRESS 0x7F9C50 /end MEASUREMENT
/begin MEASUREMENT B_nlcan "Bedingung f¸r SG-Nachlauf von CAN" UWORD B_TRUE 1 100 0 1 BIT_MASK 0x200 FORMAT "%13.11" ECU_ADDRESS 0x7F9C50 /end MEASUREMENT
/begin MEASUREMENT B_nldte "Anforderung Steuerger‰tenachlauf Diagnose Tankentl¸ftung" UWORD B_TRUE 1 100 0 1 BIT_MASK 0x100 FORMAT "%13.11" ECU_ADDRESS 0x7F9C50 /end MEASUREMENT
/begin MEASUREMENT B_nlEEPR "Bedingung Nachlauf EEPROM schreiben" UWORD B_TRUE 1 100 0 1 BIT_MASK 0x20 FORMAT "%13.11" ECU_ADDRESS 0x7F9C50 /end MEASUREMENT
/begin MEASUREMENT B_nlmls "Anforderung Steuerger‰tenachlauf von Motor-L¸ftersteuerung" UWORD B_TRUE 1 100 0 1 BIT_MASK 0x8 FORMAT "%13.11" ECU_ADDRESS 0x7F9C50 /end MEASUREMENT
/begin MEASUREMENT B_nlobd "Anforderung Steuerger‰tenachlauf von OBD" UWORD B_TRUE 1 100 0 1 BIT_MASK 0x10 FORMAT "%13.11" ECU_ADDRESS 0x7F9C50 /end MEASUREMENT
/begin MEASUREMENT B_nlsgls "Anforderung Steuerger‰tenachlauf von Steuerger‰te-L¸ftersteuerung" UWORD B_TRUE 1 100 0 1 BIT_MASK 0x40 FORMAT "%13.11" ECU_ADDRESS 0x7F9C50 /end MEASUREMENT
/begin MEASUREMENT B_nlsiko "Bedingung Nachlauf EGAS-‹berwachung" UWORD B_TRUE 1 100 0 1 BIT_MASK 0x80 FORMAT "%13.11" ECU_ADDRESS 0x7F9C50 /end MEASUREMENT
/begin MEASUREMENT B_nlwst "Anforderung Steuerger‰tenachlauf f¸r Wiederholstarterkennung" UWORD B_TRUE 1 100 0 1 BIT_MASK 0x4 FORMAT "%13.11" ECU_ADDRESS 0x7F9C50 /end MEASUREMENT
/begin MEASUREMENT B_nmax "Bedingung Drehzahlbegrenzung aktiv" UBYTE B_TRUE 1 100 0 1 BIT_MASK 0x1 FORMAT "%13.11" ECU_ADDRESS 0x7FBB63 /end MEASUREMENT
/begin MEASUREMENT B_nmaxd "Bedingung Drehzahlbegrenzung mit Einspritzausblendung an allen Zylindern" UBYTE B_TRUE 1 100 0 1 BIT_MASK 0x1 FORMAT "%13.11" ECU_ADDRESS 0x7FBB64 /end MEASUREMENT
/begin MEASUREMENT B_nnot "Bedingung Drehzahlanhebung im Notlauf" UBYTE DEZ 1 100 0 1 BIT_MASK 0x1 FORMAT "%5.3" ECU_ADDRESS 0x7FBC23 /end MEASUREMENT
/begin MEASUREMENT B_nozwe "Bedingung kein Z¸ndwinkeleingriff der Drehmomentstruktur" UBYTE B_TRUE 1 100 0 1 BIT_MASK 0x1 FORMAT "%13.11" ECU_ADDRESS 0x7FBC4D /end MEASUREMENT
/begin MEASUREMENT B_nsakt "Nachstart aktiv f¸r Nachstartaufweitung" UBYTE B_TRUE 1 100 0 1 BIT_MASK 0x1 FORMAT "%13.11" ECU_ADDRESS 0x7FBB61 /end MEASUREMENT
/begin MEASUREMENT B_nsend "Nachstart¸berwachungszeit abgelaufen" UBYTE B_TRUE 1 100 0 1 BIT_MASK 0x1 FORMAT "%13.11" ECU_ADDRESS 0x7FBB62 /end MEASUREMENT
/begin MEASUREMENT B_nsub "Bedingung f¸r Solldrehzahlanhebung bei niedriger Batteriespannung" UBYTE B_TRUE 1 100 0 1 FORMAT "%13.11" ECU_ADDRESS 0x7FD85F /end MEASUREMENT
/begin MEASUREMENT B_nswo1 "Bedingung Drehzahl > NSWO1" UBYTE B_TRUE 1 100 0 1 BIT_MASK 0x1 FORMAT "%13.11" ECU_ADDRESS 0x7FBB82 /end MEASUREMENT
/begin MEASUREMENT B_nswo2 "Bedingung Drehzahl > NSWO2" UBYTE B_TRUE 1 100 0 1 BIT_MASK 0x1 FORMAT "%13.11" ECU_ADDRESS 0x7FBB83 /end MEASUREMENT
/begin MEASUREMENT B_ntkw "Bedingung Anforderung niedrige K¸hlmitteltemp. (W‰rmetauscherschutz)" UBYTE B_TRUE 1 100 0 1 BIT_MASK 0x1 FORMAT "%13.11" ECU_ADDRESS 0x7FBC24 /end MEASUREMENT
/begin MEASUREMENT B_nwmoff "Bedingung Netzwerkmanagement aus von CAN empfangen" UBYTE B_TRUE 1 100 0 1 BIT_MASK 0x1 FORMAT "%13.11" ECU_ADDRESS 0x7FBC25 /end MEASUREMENT
/begin MEASUREMENT B_oelh "Oeltemp. groesser TOLREV" UBYTE dez 1 100 0 255 FORMAT "%5.1" ECU_ADDRESS 0x7FD860 /end MEASUREMENT
/begin MEASUREMENT B_phsnl "Bedingung Phasensuche w‰hrend PG-Notlauf" UBYTE B_TRUE 1 100 0 1 BIT_MASK 0x1 FORMAT "%13.11" ECU_ADDRESS 0x7FBC26 /end MEASUREMENT
/begin MEASUREMENT B_phsnlinv "Bedingung Phaselage invertieren" UBYTE B_TRUE 1 100 0 1 BIT_MASK 0x1 FORMAT "%13.11" ECU_ADDRESS 0x7FBC27 /end MEASUREMENT
/begin MEASUREMENT B_psapp "Bedingung delta Saugrohrdruck Vorsteuerung f¸r Applikation" UBYTE B_TRUE 1 100 0 1 BIT_MASK 0x1 FORMAT "%13.11" ECU_ADDRESS 0x7FBB84 /end MEASUREMENT
/begin MEASUREMENT B_psger "Bedingung Umschaltung Saugrohrdruck auf gerechnetem" UBYTE B_TRUE 1 100 0 1 BIT_MASK 0x1 FORMAT "%13.11" ECU_ADDRESS 0x7FBB85 /end MEASUREMENT
/begin MEASUREMENT B_rdvaktiv "" UBYTE B_TRUE 1 100 0 1 BIT_MASK 0x1 FORMAT "%13.11" ECU_ADDRESS 0x7FB9A6 /end MEASUREMENT
/begin MEASUREMENT B_rgang "Bedingung R¸ckw‰rtsgang eingelegt" UBYTE B_TRUE 1 100 0 1 BIT_MASK 0x1 FORMAT "%13.11" ECU_ADDRESS 0x7FBB3E /end MEASUREMENT
/begin MEASUREMENT B_roadtype "" UBYTE B_TRUE 1 100 0 1 BIT_MASK 0x1 FORMAT "%13.11" ECU_ADDRESS 0x7FBCAA /end MEASUREMENT
/begin MEASUREMENT B_sabrabw "" UBYTE B_TRUE 1 100 0 1 BIT_MASK 0x1 FORMAT "%13.11" ECU_ADDRESS 0x7FBC81 /end MEASUREMENT
/begin MEASUREMENT B_sacvt "Bedingung Schubabschaltunterst¸tzung f¸r CVT-Getriebe" UBYTE B_TRUE 1 100 0 1 BIT_MASK 0x1 FORMAT "%13.11" ECU_ADDRESS 0x7FBC28 /end MEASUREMENT
/begin MEASUREMENT B_savfgr "Bedingung: Schubabschalteverbot durch FGR" UBYTE B_TRUE 1 100 0 1 BIT_MASK 0x1 FORMAT "%13.11" ECU_ADDRESS 0x7FBC29 /end MEASUREMENT
/begin MEASUREMENT B_sch "BDE-Betriebsart schicht" UBYTE B_TRUE 1 100 0 1 BIT_MASK 0x1 FORMAT "%13.11" ECU_ADDRESS 0x7FBC2A /end MEASUREMENT
/begin MEASUREMENT B_sl "Bedingung Servo-Lenkung" UBYTE B_TRUE 1 100 0 1 BIT_MASK 0x1 FORMAT "%13.11" ECU_ADDRESS 0x7FBC2B /end MEASUREMENT
/begin MEASUREMENT B_sldsl4 "Bedingung: Freigabe Sekund‰rluft f¸r Diagnosephase 4" UWORD B_TRUE 1 100 0 1 BIT_MASK 0x4 FORMAT "%13.11" ECU_ADDRESS 0x7FD7E4 /end MEASUREMENT
/begin MEASUREMENT B_slkhof "Bedingung Abschalten der Sekund‰rluftpumpe durch imlpr-Schwelle" UBYTE B_TRUE 1 100 0 1 BIT_MASK 0x1 FORMAT "%13.11" ECU_ADDRESS 0x7FBC89 /end MEASUREMENT
/begin MEASUREMENT B_slkt "Bedingung: Freigabe Sekund‰rluft f¸r Kurztest" UWORD B_TRUE 1 100 0 1 BIT_MASK 0x8 FORMAT "%13.11" ECU_ADDRESS 0x7FD7E4 /end MEASUREMENT
/begin MEASUREMENT B_slp "Bedingung f¸r Sekund‰rluftpumpe" UBYTE B_TRUE 1 100 0 1 BIT_MASK 0x1 FORMAT "%13.11" ECU_ADDRESS 0x7FBC8A /end MEASUREMENT
/begin MEASUREMENT B_slpena "Bedingung Einschalten der Sekund‰rluftpumpe" UWORD B_TRUE 1 100 0 1 BIT_MASK 0x10 FORMAT "%13.11" ECU_ADDRESS 0x7FD7E4 /end MEASUREMENT
/begin MEASUREMENT B_slpet "Stellglieddiagnose SLP: Eingriff Tester" UBYTE B_TRUE 1 100 0 1 BIT_MASK 0x1 FORMAT "%13.11" ECU_ADDRESS 0x7FBC2C /end MEASUREMENT
/begin MEASUREMENT B_slpmn "Mindestbetriebszeit der Sekund‰rluftpumpe" UBYTE B_TRUE 1 100 0 1 BIT_MASK 0x1 FORMAT "%13.11" ECU_ADDRESS 0x7FBC8B /end MEASUREMENT
/begin MEASUREMENT B_slpoff "Sekund‰rluftpumpe abgeschaltet" UBYTE B_TRUE 1 100 0 1 BIT_MASK 0x1 FORMAT "%13.11" ECU_ADDRESS 0x7FBC8C /end MEASUREMENT
/begin MEASUREMENT B_slpofst "Bedingung f¸r Setzen Flip Flop  B_slpoff" UWORD B_TRUE 1 100 0 1 BIT_MASK 0x20 FORMAT "%13.11" ECU_ADDRESS 0x7FD7E4 /end MEASUREMENT
/begin MEASUREMENT B_sls "Bedingung Sekund‰rluft aktiv" UBYTE B_TRUE 1 100 0 1 BIT_MASK 0x1 FORMAT "%13.11" ECU_ADDRESS 0x7FBC8D /end MEASUREMENT
/begin MEASUREMENT B_slsadap "Bedingung: Sekund‰rluftmassenadaption" UBYTE B_TRUE 1 100 0 1 BIT_MASK 0x1 FORMAT "%13.11" ECU_ADDRESS 0x7FBC8E /end MEASUREMENT
/begin MEASUREMENT B_slsdis "Bedingung f¸r  Abschalten der Sekund‰rluftpumpe" UWORD B_TRUE 1 100 0 1 BIT_MASK 0x80 FORMAT "%13.11" ECU_ADDRESS 0x7FD7E4 /end MEASUREMENT
/begin MEASUREMENT B_slserr "Bedingungen sperren Einschalten der Sekund‰rluftpumpe" UWORD B_TRUE 1 100 0 1 BIT_MASK 0x100 FORMAT "%13.11" ECU_ADDRESS 0x7FD7E4 /end MEASUREMENT
/begin MEASUREMENT B_slsfz "Bedingung SLS in Fahrzeug eingebaut" UBYTE B_TRUE 1 100 0 1 BIT_MASK 0x1 FORMAT "%13.11" ECU_ADDRESS 0x7FBC2D /end MEASUREMENT
/begin MEASUREMENT B_slsinhi "Bedingung sperrt Setzen von Bit B_sls" UWORD B_TRUE 1 100 0 1 BIT_MASK 0x40 FORMAT "%13.11" ECU_ADDRESS 0x7FD7E4 /end MEASUREMENT
/begin MEASUREMENT B_slsoab "Bedingung SLS ohne Abbruchkriterium durchgef¸hrt" UWORD B_TRUE 1 100 0 1 BIT_MASK 0x200 FORMAT "%13.11" ECU_ADDRESS 0x7FD7E4 /end MEASUREMENT
/begin MEASUREMENT B_slsoff "Sekund‰rlufteinblasung nach Ausr‰umen der Sekund‰rluft beendet" UBYTE B_TRUE 1 100 0 1 BIT_MASK 0x1 FORMAT "%13.11" ECU_ADDRESS 0x7FBC8F /end MEASUREMENT
/begin MEASUREMENT B_slson "Oeffnungsbereites SLS-Ventil bei nicht vorhandener SLP" UBYTE B_TRUE 1 100 0 1 BIT_MASK 0x1 FORMAT "%13.11" ECU_ADDRESS 0x7FBC90 /end MEASUREMENT
/begin MEASUREMENT B_slste "" UBYTE B_TRUE 1 100 0 1 BIT_MASK 0x1 FORMAT "%13.11" ECU_ADDRESS 0x7FBC91 /end MEASUREMENT
/begin MEASUREMENT B_sls_me9 "" UBYTE B_TRUE 1 100 0 1 BIT_MASK 0x1 FORMAT "%13.11" ECU_ADDRESS 0x7FBC92 /end MEASUREMENT
/begin MEASUREMENT B_slv "Bedingung f¸r Sekund‰rluftventil" UBYTE B_TRUE 1 100 0 1 BIT_MASK 0x1 FORMAT "%13.11" ECU_ADDRESS 0x7FBC93 /end MEASUREMENT
/begin MEASUREMENT B_slvein "SL-Ventlil freigegeben" UBYTE B_TRUE 1 100 0 1 BIT_MASK 0x1 FORMAT "%13.11" ECU_ADDRESS 0x7FBC94 /end MEASUREMENT
/begin MEASUREMENT B_slvkfein "SL-Ventil kennfeldabh‰ngig freigegeben" UBYTE B_TRUE 1 100 0 1 BIT_MASK 0x1 FORMAT "%13.11" ECU_ADDRESS 0x7FBC95 /end MEASUREMENT
/begin MEASUREMENT B_slvtdein "SL-Vetnil zeitabh‰ngig freigegeben" UBYTE B_TRUE 1 100 0 1 BIT_MASK 0x1 FORMAT "%13.11" ECU_ADDRESS 0x7FBC96 /end MEASUREMENT
/begin MEASUREMENT B_staa "Bedingung Startadaption aktiv im Nachstart" UBYTE B_TRUE 1 100 0 1 BIT_MASK 0x1 FORMAT "%13.11" ECU_ADDRESS 0x7FBC2E /end MEASUREMENT
/begin MEASUREMENT B_tal "Bedingung Tank leer bzw. Reserve" UBYTE B_TRUE 1 100 0 1 BIT_MASK 0x1 FORMAT "%13.11" ECU_ADDRESS 0x7FBC2F /end MEASUREMENT
/begin MEASUREMENT B_talval "Bedingung : Bit Tank leer g¸ltig" UBYTE B_TRUE 1 100 0 1 BIT_MASK 0x1 FORMAT "%13.11" ECU_ADDRESS 0x7FBC30 /end MEASUREMENT
/begin MEASUREMENT B_temin "Bedingung TEMIN-Begrenzung aktiv, Bank 1" UBYTE B_TRUE 1 100 0 1 BIT_MASK 0x1 FORMAT "%13.11" ECU_ADDRESS 0x7FD7FC /end MEASUREMENT
/begin MEASUREMENT B_temin2 "Bedingung TEMIN-Begrenzung aktiv, Bank 2" UBYTE B_TRUE 1 100 0 1 BIT_MASK 0x1 FORMAT "%13.11" ECU_ADDRESS 0x7FD7FD /end MEASUREMENT
/begin MEASUREMENT B_teza "Bedingung Tankentl¸ftung zwangsaktiv" UBYTE B_TRUE 1 100 0 1 BIT_MASK 0x1 FORMAT "%13.11" ECU_ADDRESS 0x7FBC31 /end MEASUREMENT
/begin MEASUREMENT B_ubdve "Bedingung: Batteriespannung f¸r DV-E-Ansteuerung i.O." UBYTE B_TRUE 1 100 0 1 BIT_MASK 0x1 FORMAT "%13.11" ECU_ADDRESS 0x7FBC32 /end MEASUREMENT
/begin MEASUREMENT B_uhrrmin "Bedingung Uhr mit relativem Minutenz‰hler" UBYTE B_TRUE 1 100 0 1 BIT_MASK 0x1 FORMAT "%13.11" ECU_ADDRESS 0x7FBB86 /end MEASUREMENT
/begin MEASUREMENT B_uhrrsec "Bedingung Uhr mit relativem Sekundenz‰hler" UBYTE B_TRUE 1 100 0 1 BIT_MASK 0x1 FORMAT "%13.11" ECU_ADDRESS 0x7FBB87 /end MEASUREMENT
/begin MEASUREMENT B_vhystmls "" UBYTE B_TRUE 1 100 0 1 BIT_MASK 0x1 FORMAT "%13.11" ECU_ADDRESS 0x7FBC72 /end MEASUREMENT
/begin MEASUREMENT B_vlsumrb "Bedingung: LSU hat Kennlinienverschiebung nach mager (zeigt zu mager an)" UBYTE B_TRUE 1 100 0 1 BIT_MASK 0x1 FORMAT "%13.11" ECU_ADDRESS 0x7FBC33 /end MEASUREMENT
/begin MEASUREMENT B_wdksap "DK-Steuerung ¸ber Festwert, Bit 1 hat Priorit‰t" UBYTE B_TRUE 1 100 0 1 BIT_MASK 0x1 FORMAT "%13.11" ECU_ADDRESS 0x7FBB88 /end MEASUREMENT
/begin MEASUREMENT B_xff "Bedingung externer Freeze Frame" UBYTE B_TRUE 1 100 0 1 BIT_MASK 0x1 FORMAT "%13.11" ECU_ADDRESS 0x7F9AEF /end MEASUREMENT
/begin MEASUREMENT B_zwappl "Bedingung Z¸ndwinkelapplikation ohne Drehmomenteingriffe" UBYTE B_TRUE 1 100 0 1 BIT_MASK 0x1 FORMAT "%13.11" ECU_ADDRESS 0x7FBB89 /end MEASUREMENT
/begin MEASUREMENT B_zwvzm "" UBYTE B_TRUE 1 100 0 1 BIT_MASK 0x1 FORMAT "%13.11" ECU_ADDRESS 0x7FBC4E /end MEASUREMENT
/begin MEASUREMENT cd_bits1_w "" UWORD dez 1 100 0 65535 FORMAT "%8.2" ECU_ADDRESS 0x7FDF86 /end MEASUREMENT
/begin MEASUREMENT cd_bits2_w "" UWORD dez 1 100 0 65535 FORMAT "%8.2" ECU_ADDRESS 0x7FDF88 /end MEASUREMENT
/begin MEASUREMENT common_rt "" ULONG dez 1 100 0 4.29497e+009 FORMAT "%13.2" ECU_ADDRESS 0x7FE550 /end MEASUREMENT
/begin MEASUREMENT devfac1_w "" UWORD fak_uw_b32 1 100 0 31.9995 FORMAT "%8.5" ECU_ADDRESS 0x7FE0EE /end MEASUREMENT
/begin MEASUREMENT devfac2_w "" UWORD fak_uw_b32 1 100 0 31.9995 FORMAT "%8.5" ECU_ADDRESS 0x7FE0F0 /end MEASUREMENT
/begin MEASUREMENT devhubi_w "Delta Istwert Hubverstellung" SWORD hub_uw_q0p001 1 100 -32.768 32.767 FORMAT "%8.5" ECU_ADDRESS 0x7FE030 /end MEASUREMENT
/begin MEASUREMENT dlOvrunCtr "" UWORD dez 1 100 0 65535 FORMAT "%8.2" ARRAY_SIZE 4 ECU_ADDRESS 0x7F9C54 /end MEASUREMENT
/begin MEASUREMENT dmaufr_w "Delta Aufregelmoment" UWORD rel_uw_b100 1 100 0 99.9985 FORMAT "%8.5" ECU_ADDRESS 0x7FE096 /end MEASUREMENT
/begin MEASUREMENT dmdwan_w "" UWORD rel_uw_b200 1 100 0 199.997 FORMAT "%8.4" ECU_ADDRESS 0x7FDE7E /end MEASUREMENT
/begin MEASUREMENT dmnmxi_w "Drehmoment aus Integralanteil der NMAX-Regelung" SWORD rel_sw_b100 1 100 -100 99.9969 FORMAT "%8.4" ECU_ADDRESS 0x7FDF5C /end MEASUREMENT
/begin MEASUREMENT dmnmxp_w "Drehmoment aus Proportionalanteil der NMAX-Regelung" SWORD rel_sw_b100 1 100 -100 99.9969 FORMAT "%8.4" ECU_ADDRESS 0x7FDF5E /end MEASUREMENT
/begin MEASUREMENT dmrac "Reservemoment f¸r AC-Kompressor" UBYTE rel_ub_b99p6 1 100 0 99.6094 FORMAT "%5.2" ECU_ADDRESS 0x7FDA50 /end MEASUREMENT
/begin MEASUREMENT dmrwan "Momentreserve f¸r Drehmomentaufnahme des Wandlers" UBYTE rel_ub_b99p6 1 100 0 99.6094 FORMAT "%5.2" ECU_ADDRESS 0x7FDA54 /end MEASUREMENT
/begin MEASUREMENT dnsi_w "Differenz zwischen Soll- und Ist-Motordrehzahl" SWORD nmot_sw_q0p25 1 100 -8192 8191.75 FORMAT "%8.3" ECU_ADDRESS 0x7FDF60 /end MEASUREMENT
/begin MEASUREMENT dnturb_w "Turbinendrehzahldifferenz des Wandlers" SWORD nmot_q0p125 1 100 -4096 4095.88 FORMAT "%8.3" ECU_ADDRESS 0x7FDE80 /end MEASUREMENT
/begin MEASUREMENT dpdk "" UBYTE dez 1 100 0 255 FORMAT "%5.1" ECU_ADDRESS 0x7FDAAC /end MEASUREMENT
/begin MEASUREMENT dpsddss_w "delta Saugrohrdruck gemessen mit Differenzdrucksensor Saugrohr" SWORD p_sw_q0p039 1 100 -1280 1279.96 FORMAT "%8.3" ECU_ADDRESS 0x7FE1B2 /end MEASUREMENT
/begin MEASUREMENT dpssolgd_w "Differenzdruck gedrosselter Motor aus Modell" UWORD p_uw_q0p039 1 100 0 2559.96 FORMAT "%8.3" ECU_ADDRESS 0x7FE1B4 /end MEASUREMENT
/begin MEASUREMENT dpssol_uw "" UWORD p_q0p039 1 100 0 2559.96 FORMAT "%8.3" ECU_ADDRESS 0x7FE1B6 /end MEASUREMENT
/begin MEASUREMENT dpssol_w "Solldifferenzdruck Saugrohr" SWORD p_q0p039 1 100 -1280 1279.96 FORMAT "%8.3" ECU_ADDRESS 0x7FE1B8 /end MEASUREMENT
/begin MEASUREMENT dps_w "delta-Saugrohrdruck" SWORD p_sw_q0p039 1 100 -1280 1279.96 FORMAT "%8.3" ECU_ADDRESS 0x7FE1BA /end MEASUREMENT
/begin MEASUREMENT dpus_w "Delta Druck Umgebung Saugrohr" SWORD p_q0p039 1 100 -1280 1279.96 FORMAT "%8.3" ECU_ADDRESS 0x7FE12E /end MEASUREMENT
/begin MEASUREMENT dr_reg_resetBuffer "" ULONG default 1 100 0 4.29497e+009 FORMAT "%13.2" ARRAY_SIZE 60 ECU_ADDRESS 0x7FBD18 /end MEASUREMENT
/begin MEASUREMENT dr_reg_resetBuffer_cnt "" UWORD default 1 100 0 65535 FORMAT "%8.2" ECU_ADDRESS 0x7FBE10 /end MEASUREMENT
/begin MEASUREMENT dr_reg_resetBuffer_idx "" UWORD default 1 100 0 65535 FORMAT "%8.2" ECU_ADDRESS 0x7FBE0C /end MEASUREMENT
/begin MEASUREMENT dr_reg_resetTimestampBuffer "" ULONG default 1 100 0 4.29497e+009 FORMAT "%13.2" ARRAY_SIZE 10 ECU_ADDRESS 0x7FBE18 /end MEASUREMENT
/begin MEASUREMENT dr_reg_resetTimestampBuffer_idx "" UWORD default 1 100 0 65535 FORMAT "%8.2" ECU_ADDRESS 0x7FBE44 /end MEASUREMENT
/begin MEASUREMENT ds_w "" UWORD fak_uw_b64 1 100 0 63.999 FORMAT "%8.5" ECU_ADDRESS 0x7FE26A /end MEASUREMENT
/begin MEASUREMENT dzws "Delta Z¸ndwinekl zwischen zwopt und zwsol" SBYTE zw_sb_q0p75 1 100 -96 95.25 FORMAT "%5.2" ECU_ADDRESS 0x7FDAE5 /end MEASUREMENT
/begin MEASUREMENT dzwssq "Delta Z¸ndwinkel (quadratisch) zwischen zwopt und zwsol" UBYTE kwq_ub_q0p35576 1 100 0 90.72 FORMAT "%5.2" ECU_ADDRESS 0x7FD7A5 /end MEASUREMENT
/begin MEASUREMENT dzwssql "Delta Z¸ndwinkel (quadratisch) zwischen zwopt und zwsol unterer Bereich" UBYTE kwq_ub_q0p04447 1 100 0 11.34 FORMAT "%5.2" ECU_ADDRESS 0x7FD7A6 /end MEASUREMENT
/begin MEASUREMENT ekpausc "CAN-Botschaft EKP-Abschaltung ¸ber Crash-Sensor Airbag-SG" UBYTE dez 1 100 0 3 FORMAT "%5.3" ECU_ADDRESS 0x7FDAAD /end MEASUREMENT
/begin MEASUREMENT Esprl "Leerlauf Einlasspreizung gedrosselt" UBYTE sprzi_q0p8 1 100 0 204 FORMAT "%5.1" ECU_ADDRESS 0x7FD861 /end MEASUREMENT
/begin MEASUREMENT Esprlu "Leerlauf Einlasspreizung ungedrosselt" UBYTE sprzi_q0p8 1 100 0 204 FORMAT "%5.1" ECU_ADDRESS 0x7FD862 /end MEASUREMENT
/begin MEASUREMENT esst_san12esuw "" ULONG dez 1 100 0 4.29497e+009 FORMAT "%13.2" ECU_ADDRESS 0x7FE298 /end MEASUREMENT
/begin MEASUREMENT esst_sdm05tesb "" ULONG dez 1 100 0 4.29497e+009 FORMAT "%13.2" ECU_ADDRESS 0x7FE29C /end MEASUREMENT
/begin MEASUREMENT esst_seh06kruw "" ULONG dez 1 100 0 4.29497e+009 FORMAT "%13.2" ECU_ADDRESS 0x7FE2A0 /end MEASUREMENT
/begin MEASUREMENT esst_sez06tmub "" ULONG dez 1 100 0 4.29497e+009 FORMAT "%13.2" ECU_ADDRESS 0x7FE2A4 /end MEASUREMENT
/begin MEASUREMENT esst_sfr04bbuw "" ULONG dez 1 100 0 4.29497e+009 FORMAT "%13.2" ECU_ADDRESS 0x7FE2A8 /end MEASUREMENT
/begin MEASUREMENT esst_sga07mdub "" ULONG dez 1 100 0 4.29497e+009 FORMAT "%13.2" ECU_ADDRESS 0x7FE2AC /end MEASUREMENT
/begin MEASUREMENT esst_sga08mdub "" ULONG dez 1 100 0 4.29497e+009 FORMAT "%13.2" ECU_ADDRESS 0x7FE2B0 /end MEASUREMENT
/begin MEASUREMENT esst_sks06esub "" ULONG dez 1 100 0 4.29497e+009 FORMAT "%13.2" ECU_ADDRESS 0x7FE2B4 /end MEASUREMENT
/begin MEASUREMENT esst_slx06tmuw "" ULONG dez 1 100 0 4.29497e+009 FORMAT "%13.2" ECU_ADDRESS 0x7FE2B8 /end MEASUREMENT
/begin MEASUREMENT esst_sly06tmuw "" ULONG dez 1 100 0 4.29497e+009 FORMAT "%13.2" ECU_ADDRESS 0x7FE2BC /end MEASUREMENT
/begin MEASUREMENT esst_sml05dkub "" ULONG dez 1 100 0 4.29497e+009 FORMAT "%13.2" ECU_ADDRESS 0x7FE2C0 /end MEASUREMENT
/begin MEASUREMENT esst_sml05lkub "" ULONG dez 1 100 0 4.29497e+009 FORMAT "%13.2" ECU_ADDRESS 0x7FE2C4 /end MEASUREMENT
/begin MEASUREMENT esst_sml06teub "" ULONG dez 1 100 0 4.29497e+009 FORMAT "%13.2" ECU_ADDRESS 0x7FE2C8 /end MEASUREMENT
/begin MEASUREMENT esst_sml06tmuw "" ULONG dez 1 100 0 4.29497e+009 FORMAT "%13.2" ECU_ADDRESS 0x7FE2CC /end MEASUREMENT
/begin MEASUREMENT esst_sml07tmuw "" ULONG dez 1 100 0 4.29497e+009 FORMAT "%13.2" ECU_ADDRESS 0x7FE2D0 /end MEASUREMENT
/begin MEASUREMENT esst_sml08lhub "" ULONG dez 1 100 0 4.29497e+009 FORMAT "%13.2" ECU_ADDRESS 0x7FE2D4 /end MEASUREMENT
/begin MEASUREMENT esst_smo08opub "" ULONG dez 1 100 0 4.29497e+009 FORMAT "%13.2" ECU_ADDRESS 0x7FE4AC /end MEASUREMENT
/begin MEASUREMENT esst_sn16kr1ub "" ULONG dez 1 100 0 4.29497e+009 FORMAT "%13.2" ECU_ADDRESS 0x7FE2D8 /end MEASUREMENT
/begin MEASUREMENT esst_sn16kr2ub "" ULONG dez 1 100 0 4.29497e+009 FORMAT "%13.2" ECU_ADDRESS 0x7FE2DC /end MEASUREMENT
/begin MEASUREMENT esst_sng06llsb "" ULONG dez 1 100 0 4.29497e+009 FORMAT "%13.2" ECU_ADDRESS 0x7FE2E0 /end MEASUREMENT
/begin MEASUREMENT esst_sng06lltsb "" ULONG dez 1 100 0 4.29497e+009 FORMAT "%13.2" ECU_ADDRESS 0x7FE2E4 /end MEASUREMENT
/begin MEASUREMENT esst_snm04teub "" ULONG dez 1 100 0 4.29497e+009 FORMAT "%13.2" ECU_ADDRESS 0x7FE2E8 /end MEASUREMENT
/begin MEASUREMENT esst_snm05dkub "" ULONG dez 1 100 0 4.29497e+009 FORMAT "%13.2" ECU_ADDRESS 0x7FE2EC /end MEASUREMENT
/begin MEASUREMENT esst_snm06lhub "" ULONG dez 1 100 0 4.29497e+009 FORMAT "%13.2" ECU_ADDRESS 0x7FE2F0 /end MEASUREMENT
/begin MEASUREMENT esst_snm06llub "" ULONG dez 1 100 0 4.29497e+009 FORMAT "%13.2" ECU_ADDRESS 0x7FE2F4 /end MEASUREMENT
/begin MEASUREMENT esst_snm06mduw "" ULONG dez 1 100 0 4.29497e+009 FORMAT "%13.2" ECU_ADDRESS 0x7FE2F8 /end MEASUREMENT
/begin MEASUREMENT esst_snm07esub "" ULONG dez 1 100 0 4.29497e+009 FORMAT "%13.2" ECU_ADDRESS 0x7FE2FC /end MEASUREMENT
/begin MEASUREMENT esst_snm07lrub "" ULONG dez 1 100 0 4.29497e+009 FORMAT "%13.2" ECU_ADDRESS 0x7FE300 /end MEASUREMENT
/begin MEASUREMENT esst_snm08feub "" ULONG dez 1 100 0 4.29497e+009 FORMAT "%13.2" ECU_ADDRESS 0x7FE304 /end MEASUREMENT
/begin MEASUREMENT esst_snm08gkub "" ULONG dez 1 100 0 4.29497e+009 FORMAT "%13.2" ECU_ADDRESS 0x7FE308 /end MEASUREMENT
/begin MEASUREMENT esst_snm08kruw "" ULONG dez 1 100 0 4.29497e+009 FORMAT "%13.2" ECU_ADDRESS 0x7FE30C /end MEASUREMENT
/begin MEASUREMENT esst_snm08lhub "" ULONG dez 1 100 0 4.29497e+009 FORMAT "%13.2" ECU_ADDRESS 0x7FE310 /end MEASUREMENT
/begin MEASUREMENT esst_snm08opub "" ULONG dez 1 100 0 4.29497e+009 FORMAT "%13.2" ECU_ADDRESS 0x7FE314 /end MEASUREMENT
/begin MEASUREMENT esst_snm08zuub "" ULONG dez 1 100 0 4.29497e+009 FORMAT "%13.2" ECU_ADDRESS 0x7FE318 /end MEASUREMENT
/begin MEASUREMENT esst_snm08__ub "" ULONG dez 1 100 0 4.29497e+009 FORMAT "%13.2" ECU_ADDRESS 0x7FE31C /end MEASUREMENT
/begin MEASUREMENT esst_snm12esub "" ULONG dez 1 100 0 4.29497e+009 FORMAT "%13.2" ECU_ADDRESS 0x7FE320 /end MEASUREMENT
/begin MEASUREMENT esst_snm12feub "" ULONG dez 1 100 0 4.29497e+009 FORMAT "%13.2" ECU_ADDRESS 0x7FE324 /end MEASUREMENT
/begin MEASUREMENT esst_snm16gkub "" ULONG dez 1 100 0 4.29497e+009 FORMAT "%13.2" ECU_ADDRESS 0x7FE328 /end MEASUREMENT
/begin MEASUREMENT esst_snm16krub "" ULONG dez 1 100 0 4.29497e+009 FORMAT "%13.2" ECU_ADDRESS 0x7FE32C /end MEASUREMENT
/begin MEASUREMENT esst_snm16opuw "" ULONG dez 1 100 0 4.29497e+009 FORMAT "%13.2" ECU_ADDRESS 0x7FE330 /end MEASUREMENT
/begin MEASUREMENT esst_snm16zuub "" ULONG dez 1 100 0 4.29497e+009 FORMAT "%13.2" ECU_ADDRESS 0x7FE334 /end MEASUREMENT
/begin MEASUREMENT esst_snm24zuub1 "" ULONG dez 1 100 0 4.29497e+009 FORMAT "%13.2" ECU_ADDRESS 0x7FE338 /end MEASUREMENT
/begin MEASUREMENT esst_sqm05teub "" ULONG dez 1 100 0 4.29497e+009 FORMAT "%13.2" ECU_ADDRESS 0x7FE33C /end MEASUREMENT
/begin MEASUREMENT esst_srl03zuub "" ULONG dez 1 100 0 4.29497e+009 FORMAT "%13.2" ECU_ADDRESS 0x7FE340 /end MEASUREMENT
/begin MEASUREMENT esst_srl04krub "" ULONG dez 1 100 0 4.29497e+009 FORMAT "%13.2" ECU_ADDRESS 0x7FE344 /end MEASUREMENT
/begin MEASUREMENT esst_srl06lhub "" ULONG dez 1 100 0 4.29497e+009 FORMAT "%13.2" ECU_ADDRESS 0x7FE348 /end MEASUREMENT
/begin MEASUREMENT esst_srl06lrub "" ULONG dez 1 100 0 4.29497e+009 FORMAT "%13.2" ECU_ADDRESS 0x7FE34C /end MEASUREMENT
/begin MEASUREMENT esst_srl08gkub "" ULONG dez 1 100 0 4.29497e+009 FORMAT "%13.2" ECU_ADDRESS 0x7FE350 /end MEASUREMENT
/begin MEASUREMENT esst_srl12esub "" ULONG dez 1 100 0 4.29497e+009 FORMAT "%13.2" ECU_ADDRESS 0x7FE354 /end MEASUREMENT
/begin MEASUREMENT esst_srl12gkub "" ULONG dez 1 100 0 4.29497e+009 FORMAT "%13.2" ECU_ADDRESS 0x7FE358 /end MEASUREMENT
/begin MEASUREMENT esst_srl12zuub "" ULONG dez 1 100 0 4.29497e+009 FORMAT "%13.2" ECU_ADDRESS 0x7FE35C /end MEASUREMENT
/begin MEASUREMENT esst_srl16zuub "" ULONG dez 1 100 0 4.29497e+009 FORMAT "%13.2" ECU_ADDRESS 0x7FE360 /end MEASUREMENT
/begin MEASUREMENT esst_st107tmub "" ULONG dez 1 100 0 4.29497e+009 FORMAT "%13.2" ECU_ADDRESS 0x7FE364 /end MEASUREMENT
/begin MEASUREMENT esst_st207tmub "" ULONG dez 1 100 0 4.29497e+009 FORMAT "%13.2" ECU_ADDRESS 0x7FE368 /end MEASUREMENT
/begin MEASUREMENT esst_st307tmub "" ULONG dez 1 100 0 4.29497e+009 FORMAT "%13.2" ECU_ADDRESS 0x7FE36C /end MEASUREMENT
/begin MEASUREMENT esst_st407tmub "" ULONG dez 1 100 0 4.29497e+009 FORMAT "%13.2" ECU_ADDRESS 0x7FE370 /end MEASUREMENT
/begin MEASUREMENT esst_sta04saub "" ULONG dez 1 100 0 4.29497e+009 FORMAT "%13.2" ECU_ADDRESS 0x7FE374 /end MEASUREMENT
/begin MEASUREMENT esst_sta06esub "" ULONG dez 1 100 0 4.29497e+009 FORMAT "%13.2" ECU_ADDRESS 0x7FE378 /end MEASUREMENT
/begin MEASUREMENT esst_stm04feub "" ULONG dez 1 100 0 4.29497e+009 FORMAT "%13.2" ECU_ADDRESS 0x7FE37C /end MEASUREMENT
/begin MEASUREMENT esst_stm04saub "" ULONG dez 1 100 0 4.29497e+009 FORMAT "%13.2" ECU_ADDRESS 0x7FE380 /end MEASUREMENT
/begin MEASUREMENT esst_stm05saub "" ULONG dez 1 100 0 4.29497e+009 FORMAT "%13.2" ECU_ADDRESS 0x7FE384 /end MEASUREMENT
/begin MEASUREMENT esst_stm05tmub "" ULONG dez 1 100 0 4.29497e+009 FORMAT "%13.2" ECU_ADDRESS 0x7FE388 /end MEASUREMENT
/begin MEASUREMENT esst_stm05tmub1 "" ULONG dez 1 100 0 4.29497e+009 FORMAT "%13.2" ECU_ADDRESS 0x7FE38C /end MEASUREMENT
/begin MEASUREMENT esst_stm05tmub2 "" ULONG dez 1 100 0 4.29497e+009 FORMAT "%13.2" ECU_ADDRESS 0x7FE390 /end MEASUREMENT
/begin MEASUREMENT esst_stm06lltub "" ULONG dez 1 100 0 4.29497e+009 FORMAT "%13.2" ECU_ADDRESS 0x7FE394 /end MEASUREMENT
/begin MEASUREMENT esst_stm06llub "" ULONG dez 1 100 0 4.29497e+009 FORMAT "%13.2" ECU_ADDRESS 0x7FE398 /end MEASUREMENT
/begin MEASUREMENT esst_stm08mdub "" ULONG dez 1 100 0 4.29497e+009 FORMAT "%13.2" ECU_ADDRESS 0x7FE39C /end MEASUREMENT
/begin MEASUREMENT esst_stm12esub "" ULONG dez 1 100 0 4.29497e+009 FORMAT "%13.2" ECU_ADDRESS 0x7FE3A0 /end MEASUREMENT
/begin MEASUREMENT esst_stmzyl06__uw "" ULONG dez 1 100 0 4.29497e+009 FORMAT "%13.2" ECU_ADDRESS 0x7FE3A4 /end MEASUREMENT
/begin MEASUREMENT esst_stmzyl08bbuw "" ULONG dez 1 100 0 4.29497e+009 FORMAT "%13.2" ECU_ADDRESS 0x7FE3A8 /end MEASUREMENT
/begin MEASUREMENT esst_stmzyl08leuw "" ULONG dez 1 100 0 4.29497e+009 FORMAT "%13.2" ECU_ADDRESS 0x7FE3AC /end MEASUREMENT
/begin MEASUREMENT esst_stmzyl09esuw "" ULONG dez 1 100 0 4.29497e+009 FORMAT "%13.2" ECU_ADDRESS 0x7FE3B0 /end MEASUREMENT
/begin MEASUREMENT esst_stmzyl12esub "" ULONG dez 1 100 0 4.29497e+009 FORMAT "%13.2" ECU_ADDRESS 0x7FE3B4 /end MEASUREMENT
/begin MEASUREMENT esst_stmzyl1_12esub "" ULONG dez 1 100 0 4.29497e+009 FORMAT "%13.2" ECU_ADDRESS 0x7FE3B8 /end MEASUREMENT
/begin MEASUREMENT esst_stmzyl2_12esub "" ULONG dez 1 100 0 4.29497e+009 FORMAT "%13.2" ECU_ADDRESS 0x7FE3BC /end MEASUREMENT
/begin MEASUREMENT esst_stszyl12esub "" ULONG dez 1 100 0 4.29497e+009 FORMAT "%13.2" ECU_ADDRESS 0x7FE3C0 /end MEASUREMENT
/begin MEASUREMENT esst_stszyl1_12esub "" ULONG dez 1 100 0 4.29497e+009 FORMAT "%13.2" ECU_ADDRESS 0x7FE3C4 /end MEASUREMENT
/begin MEASUREMENT esst_stszyl2_12esub "" ULONG dez 1 100 0 4.29497e+009 FORMAT "%13.2" ECU_ADDRESS 0x7FE3C8 /end MEASUREMENT
/begin MEASUREMENT esst_swd06krsw "" ULONG dez 1 100 0 4.29497e+009 FORMAT "%13.2" ECU_ADDRESS 0x7FE3CC /end MEASUREMENT
/begin MEASUREMENT esst_swp08opub "" ULONG dez 1 100 0 4.29497e+009 FORMAT "%13.2" ECU_ADDRESS 0x7FE3D0 /end MEASUREMENT
/begin MEASUREMENT etazws "Sollz¸ndwinkelwirkungsgrad" UBYTE rel_ub_b127p5 1 100 0 127.5 FORMAT "%5.1" ECU_ADDRESS 0x7FDAE6 /end MEASUREMENT
/begin MEASUREMENT evhubi_w "Istwert Hubverstellung" UWORD hub_uw_q0p001 1 100 0 12 FORMAT "%8.5" ECU_ADDRESS 0x7FE1BC /end MEASUREMENT
/begin MEASUREMENT evhubs_w "Sollwert Hubverstellung" UWORD hub_uw_q0p001 1 100 0 12 FORMAT "%8.5" ECU_ADDRESS 0x7FE1BE /end MEASUREMENT
/begin MEASUREMENT execute "" UBYTE B_TRUE 1 100 0 1 BIT_MASK 0x1 FORMAT "%13.11" ECU_ADDRESS 0x7FBCA9 /end MEASUREMENT
/begin MEASUREMENT fcmclrCtr "" ULONG dez 1 100 0 4.29497e+009 FORMAT "%13.2" ECU_ADDRESS 0x7FE4C8 /end MEASUREMENT
/begin MEASUREMENT fhkrst_w "Einspritzkorrektur bei hoher Kraftstofftemperatur" SWORD fak_sw_b2x 1 100 0 1.99997 FORMAT "%8.6" ECU_ADDRESS 0x7FD5F2 /end MEASUREMENT
/begin MEASUREMENT firstsynchroCtr "" ULONG dez 1 100 0 4.29497e+009 FORMAT "%13.2" ECU_ADDRESS 0x7FE4CC /end MEASUREMENT
/begin MEASUREMENT flamsl2_w "Faktor Lambda‰nderung durch Sekund‰rluft, Bank 2" UWORD fak_uw_b16 1 100 0 15.9998 FORMAT "%8.5" ECU_ADDRESS 0x7FD7DC /end MEASUREMENT
/begin MEASUREMENT flamsl_w "Faktor Lambda‰nderung durch Sekund‰rluft" UWORD fak_uw_b16 1 100 0 15.9998 FORMAT "%8.5" ECU_ADDRESS 0x7FD7DE /end MEASUREMENT
/begin MEASUREMENT flgtiab "Statusflag ti-Abschaltung bei kat.sch‰digenden Aussetzerraten" UBYTE dez 1 100 0 255 FORMAT "%5.1" ECU_ADDRESS 0x7FD863 /end MEASUREMENT
/begin MEASUREMENT flmssl "Faktor Lambda-Motor-Soll-Sekund‰rluftanteil" UBYTE fak_ub_b1 1 100 0 0.996094 ECU_ADDRESS 0x7FD7D0 /end MEASUREMENT
/begin MEASUREMENT fmsagd "Korrekturfaktor Abgasgegendruck der Sekund‰rluftmasse" UBYTE fak_ub_b2 1 100 0 1.99219 FORMAT "%5.3" ECU_ADDRESS 0x7FD7D1 /end MEASUREMENT
/begin MEASUREMENT fmsldyn "Faktor Dynamikbeschreibung Sekund‰rluft" UBYTE fak_ub_b1 1 100 0 0.996094 ECU_ADDRESS 0x7FD7D2 /end MEASUREMENT
/begin MEASUREMENT fmslrho "Dichtekorrektur der Sekund‰rluftmasse" UBYTE fak_ub_b2 1 100 0 1.99219 FORMAT "%5.3" ECU_ADDRESS 0x7FD7D3 /end MEASUREMENT
/begin MEASUREMENT fmsltm "tmot- Korrektur der Sekund‰rluftmasse" UBYTE fak_ub_b2 1 100 0 1.99219 FORMAT "%5.3" ECU_ADDRESS 0x7FD7D4 /end MEASUREMENT
/begin MEASUREMENT fmslva "" UBYTE fak_ub_b2 1 100 0 1.99219 FORMAT "%5.3" ECU_ADDRESS 0x7F9CA4 /end MEASUREMENT
/begin MEASUREMENT fmslva2 "" UBYTE fak_ub_b2 1 100 0 1.99219 FORMAT "%5.3" ECU_ADDRESS 0x7F9CA5 /end MEASUREMENT
/begin MEASUREMENT fmslvaneu "" UBYTE fak_ub_b2 1 100 0 1.99219 FORMAT "%5.3" ECU_ADDRESS 0x7FDB1A /end MEASUREMENT
/begin MEASUREMENT fmslvaneu2 "" UBYTE fak_ub_b2 1 100 0 1.99219 FORMAT "%5.3" ECU_ADDRESS 0x7FDB1B /end MEASUREMENT
/begin MEASUREMENT frdter_w "Faktor Regelung Referenz f¸r TE-Diagnose" UWORD dez 1 100 0 65535 FORMAT "%8.2" ECU_ADDRESS 0x7FD76A /end MEASUREMENT
/begin MEASUREMENT frkte10_w "" UWORD fak_uw_b16 1 100 0 1 FORMAT "%8.6" ECU_ADDRESS 0x7FE130 /end MEASUREMENT
/begin MEASUREMENT frkte_w "Faktor Umrechnung rel. Kraftstoffmasse rk in effekt. Einspritzzeit te" UWORD fak_uw_b16 1 100 0 1 FORMAT "%8.6" ECU_ADDRESS 0x7FE132 /end MEASUREMENT
/begin MEASUREMENT frlfsdp_w "Einspritzzeitkorrektur bei returnless Systemen" SWORD fak_sw_b2x 1 100 0 1.99997 FORMAT "%8.6" ECU_ADDRESS 0x7FD5F4 /end MEASUREMENT
/begin MEASUREMENT frmslv1 "" UWORD fak_uw_b2 1 100 0 1.99997 FORMAT "%8.6" ECU_ADDRESS 0x7FE0B0 /end MEASUREMENT
/begin MEASUREMENT frmslv2 "" UWORD fak_uw_b2 1 100 0 1.99997 FORMAT "%8.6" ECU_ADDRESS 0x7FE0B2 /end MEASUREMENT
/begin MEASUREMENT frmslv21 "" UWORD fak_uw_b2 1 100 0 1.99997 FORMAT "%8.6" ECU_ADDRESS 0x7FE0B4 /end MEASUREMENT
/begin MEASUREMENT frmslv22 "" UWORD fak_uw_b2 1 100 0 1.99997 FORMAT "%8.6" ECU_ADDRESS 0x7FE0B6 /end MEASUREMENT
/begin MEASUREMENT fsldyn "Faktor Massendynamik bei SLS mit o. ohne Pumpe" UBYTE fak_ub_b1 1 100 0 0.996094 ECU_ADDRESS 0x7FD7D5 /end MEASUREMENT
/begin MEASUREMENT fsldynp "Faktor Massendynamik der SL-Pumpe" UBYTE fak_ub_b1 1 100 0 0.996094 ECU_ADDRESS 0x7FD7D6 /end MEASUREMENT
/begin MEASUREMENT fslpdyn "Faktor Dynamikbeschreibung Sekund‰rluftpumpe" UBYTE fak_ub_b1 1 100 0 0.996094 ECU_ADDRESS 0x7FD7D7 /end MEASUREMENT
/begin MEASUREMENT ftek2_w "Korrekturfaktor f¸r effektive Einspritzzeit" UWORD fak_uw_b16 1 100 0 1.99976 FORMAT "%8.6" ECU_ADDRESS 0x7FD5F6 /end MEASUREMENT
/begin MEASUREMENT ftek_w "Korrekturfaktor f¸r effektive Einspritzzeit" UWORD fak_uw_b16 1 100 0 1.99976 FORMAT "%8.6" ECU_ADDRESS 0x7FD5F8 /end MEASUREMENT
/begin MEASUREMENT fzabgzyl_w "Aussetzerz‰hler" UWORD dez 1 100 0 65535 FORMAT "%8.2" ARRAY_SIZE 12 ECU_ADDRESS 0x7FE1C0 /end MEASUREMENT
/begin MEASUREMENT gang_can "Gangposition aus dem ASG-SG ueber CAN" UBYTE dez 1 100 0 255 FORMAT "%5.1" ECU_ADDRESS 0x7FD776 /end MEASUREMENT
/begin MEASUREMENT hr_chkdata "" UWORD dez 1 100 0 65535 FORMAT "%8.2" ECU_ADDRESS 0x7FE22C /end MEASUREMENT
/begin MEASUREMENT hr_chkvld "" UWORD dez 1 100 0 65535 FORMAT "%8.2" ECU_ADDRESS 0x7FE22E /end MEASUREMENT
/begin MEASUREMENT hr_dc "" UWORD dez 1 100 0 65535 FORMAT "%8.2" ECU_ADDRESS 0x7FE230 /end MEASUREMENT
/begin MEASUREMENT hr_dc_alt "" UWORD dez 1 100 0 65535 FORMAT "%8.2" ECU_ADDRESS 0x7FE232 /end MEASUREMENT
/begin MEASUREMENT hr_freq "" UWORD dez 1 100 0 65535 FORMAT "%8.2" ECU_ADDRESS 0x7FE234 /end MEASUREMENT
/begin MEASUREMENT hr_f_alt "" UWORD dez 1 100 0 65535 FORMAT "%8.2" ECU_ADDRESS 0x7FE236 /end MEASUREMENT
/begin MEASUREMENT hr_res_co "" UWORD dez 1 100 0 65535 FORMAT "%8.2" ECU_ADDRESS 0x7FE238 /end MEASUREMENT
/begin MEASUREMENT hr_res_hi "" UWORD dez 1 100 0 65535 FORMAT "%8.2" ECU_ADDRESS 0x7FE23A /end MEASUREMENT
/begin MEASUREMENT hr_res_pe "" UWORD dez 1 100 0 65535 FORMAT "%8.2" ECU_ADDRESS 0x7FE23C /end MEASUREMENT
/begin MEASUREMENT hr_res_te "" UWORD dez 1 100 0 65535 FORMAT "%8.2" ECU_ADDRESS 0x7FE23E /end MEASUREMENT
/begin MEASUREMENT hr_tpubusy "" UWORD dez 1 100 0 65535 FORMAT "%8.2" ECU_ADDRESS 0x7FE240 /end MEASUREMENT
/begin MEASUREMENT hr_v "" UWORD vfzg_uw_q0p0625 1 100 0 4095.94 FORMAT "%8.3" ECU_ADDRESS 0x7FE242 /end MEASUREMENT
/begin MEASUREMENT hr_v_alt "" UWORD vfzg_uw_b512 1 100 0 511.992 FORMAT "%8.4" ECU_ADDRESS 0x7FE244 /end MEASUREMENT
/begin MEASUREMENT hr_v_w "" UWORD vfzg_uw_b512 1 100 0 511.992 FORMAT "%8.4" ECU_ADDRESS 0x7FE246 /end MEASUREMENT
/begin MEASUREMENT hw1Ctr "" ULONG dez 1 100 0 4.29497e+009 FORMAT "%13.2" ECU_ADDRESS 0x7FE4D0 /end MEASUREMENT
/begin MEASUREMENT hw2Ctr "" ULONG dez 1 100 0 4.29497e+009 FORMAT "%13.2" ECU_ADDRESS 0x7FE4D4 /end MEASUREMENT
/begin MEASUREMENT hw3Ctr "" ULONG dez 1 100 0 4.29497e+009 FORMAT "%13.2" ECU_ADDRESS 0x7FE4D8 /end MEASUREMENT
/begin MEASUREMENT hw4Ctr "" ULONG dez 1 100 0 4.29497e+009 FORMAT "%13.2" ECU_ADDRESS 0x7FE4DC /end MEASUREMENT
/begin MEASUREMENT imlsla_w "Luftmassenintegral f¸r Einbringen der Sekund‰rluft" UWORD m_uw_b4660 1 100 0 4660.27 FORMAT "%8.3" ECU_ADDRESS 0x7FD7E0 /end MEASUREMENT
/begin MEASUREMENT imlsle_w "Luftmassenintegral f¸r Ende der Sekund‰rluft im Abgas" UWORD m_uw_b4660 1 100 0 4660.27 FORMAT "%8.3" ECU_ADDRESS 0x7FD7E2 /end MEASUREMENT
/begin MEASUREMENT ini1_predrive_Ctr "" ULONG dez 1 100 0 4.29497e+009 FORMAT "%13.2" ECU_ADDRESS 0x7FE4E0 /end MEASUREMENT
/begin MEASUREMENT ini2_predrive_Ctr "" ULONG dez 1 100 0 4.29497e+009 FORMAT "%13.2" ECU_ADDRESS 0x7FE4E4 /end MEASUREMENT
/begin MEASUREMENT inisynchroCtr "" ULONG dez 1 100 0 4.29497e+009 FORMAT "%13.2" ECU_ADDRESS 0x7FE4E8 /end MEASUREMENT
/begin MEASUREMENT inisynct_w "Z‰hler f¸r Initialisierungsdurchl‰ufe" UWORD dez 1 100 0 65535 FORMAT "%8.2" ECU_ADDRESS 0x7FE16E /end MEASUREMENT
/begin MEASUREMENT inmax "Initialisierungswert Integrator f¸r NMAX-Regelung" SBYTE rel_sb_q0p78 1 100 -99.84 99.06 FORMAT "%5.2" ECU_ADDRESS 0x7FDA74 /end MEASUREMENT
/begin MEASUREMENT i_cnt "" UBYTE dez 1 100 0 255 FORMAT "%5.1" ECU_ADDRESS 0x7F8083 /end MEASUREMENT
/begin MEASUREMENT kfdps_aus "" UWORD p_q0p039s32768 1 100 -1280 1279.96 FORMAT "%7.2" ECU_ADDRESS 0x7FE1D8 /end MEASUREMENT
/begin MEASUREMENT kopwm "Klimakompressor-Signal als PWM-Signal" UBYTE rel_ub_b99p6 1 100 0 99.6094 FORMAT "%5.2" ECU_ADDRESS 0x7FD76C /end MEASUREMENT
/begin MEASUREMENT krkte10_w "" UWORD rkt_uw_b0p5 1 100 0 0.5 FORMAT "%9.7" ECU_ADDRESS 0x7FE134 /end MEASUREMENT
/begin MEASUREMENT krkte_w "Umrechnung relative Kraftstoffmasse rk in effektive Einspritzzeit te" UWORD rkt_uw_b0p5 1 100 0 0.5 FORMAT "%9.7" ECU_ADDRESS 0x7FE136 /end MEASUREMENT
/begin MEASUREMENT kstaa "Aktueller Startmengenadaptionsfaktor" UBYTE fak_ub_b2 1 100 0 1.99219 FORMAT "%5.3" ECU_ADDRESS 0x7FD76D /end MEASUREMENT
/begin MEASUREMENT lamdkt2_w "Lambdasoll f¸r Katdiagnose" UWORD fak_uw_b16 1 100 0 15.9998 FORMAT "%8.5" ECU_ADDRESS 0x7FD77E /end MEASUREMENT
/begin MEASUREMENT lamdkt_w "Lambdasoll f¸r Katdiagnose" UWORD fak_uw_b16 1 100 0 15.9998 FORMAT "%8.5" ECU_ADDRESS 0x7FD780 /end MEASUREMENT
/begin MEASUREMENT lditv "" SWORD rel_sw_b1536 1 100 -1536 1535.95 FORMAT "%8.3" ECU_ADDRESS 0x7FE032 /end MEASUREMENT
/begin MEASUREMENT map_ary "manifold absolute pressure from pressure sensors" UWORD p_uw_q0p039 1 100 0 2559.96 FORMAT "%8.3" ARRAY_SIZE 2 ECU_ADDRESS 0x7FE1DA /end MEASUREMENT
/begin MEASUREMENT mdarsp_w "Pr‰diziertes Moment aus ARS-Eingriff" UWORD rel_uw_b100 1 100 0 99.9985 FORMAT "%8.5" ECU_ADDRESS 0x7FE034 /end MEASUREMENT
/begin MEASUREMENT mdatxm_w "Drehmomentaufnahme des Wandlers bei B_fs = false" UWORD rel_uw_b200 1 100 0 199.997 FORMAT "%8.4" ECU_ADDRESS 0x7FDE82 /end MEASUREMENT
/begin MEASUREMENT mdelue_w "" UWORD rel_uw_b100 1 100 0 99.9985 FORMAT "%8.5" ECU_ADDRESS 0x7FDE78 /end MEASUREMENT
/begin MEASUREMENT mdgen "Momentenaufnahme Generator" UBYTE rel_ub_b99p6 1 100 0 99.6094 FORMAT "%5.2" ECU_ADDRESS 0x7FDA51 /end MEASUREMENT
/begin MEASUREMENT mdgenvf "normiertes Generatormoment" UBYTE PCENT 1 100 0 99.6094 FORMAT "%5.2" ECU_ADDRESS 0x7FD6F0 /end MEASUREMENT
/begin MEASUREMENT mdgenvf_w "" UWORD rel_uw_b100 1 100 0 99.9985 FORMAT "%8.5" ECU_ADDRESS 0x7FD6EE /end MEASUREMENT
/begin MEASUREMENT mdgen_w "Momentenaufnahme Generator" UWORD rel_uw_b100 1 100 0 99.9985 FORMAT "%8.5" ECU_ADDRESS 0x7FDE7A /end MEASUREMENT
/begin MEASUREMENT mdko "Momentenaufnahme Klimakompressor" UBYTE rel_ub_b99p6 1 100 0 99.6094 FORMAT "%5.2" ECU_ADDRESS 0x7FDA52 /end MEASUREMENT
/begin MEASUREMENT mdkog "Momentenaufnahme geregelter Klimakompressor" UBYTE md_ub_q1 1 100 0 31 FORMAT "%5.2" ECU_ADDRESS 0x7FDAAE /end MEASUREMENT
/begin MEASUREMENT mdverb "Momentenbedarf der Nebenaggregate" UBYTE rel_ub_b99p6 1 100 0 99.6094 FORMAT "%5.2" ECU_ADDRESS 0x7FDA53 /end MEASUREMENT
/begin MEASUREMENT mdverb_w "Momentenbedarf der Nebenaggregate" UWORD rel_uw_b100 1 100 0 99.9985 FORMAT "%8.5" ECU_ADDRESS 0x7FDE7C /end MEASUREMENT
/begin MEASUREMENT mdwanvf_w "Drehmomentaufnahme des Wandlers vor Filterung" UWORD rel_uw_b200 1 100 0 199.997 FORMAT "%8.4" ECU_ADDRESS 0x7FDE84 /end MEASUREMENT
/begin MEASUREMENT mdwan_w "Drehmomentaufnahme des Wandlers" UWORD rel_uw_b200 1 100 0 199.997 FORMAT "%8.4" ECU_ADDRESS 0x7FDE86 /end MEASUREMENT
/begin MEASUREMENT mdwheel_w "" UWORD md_uw_q0p0625 1 100 0 4095.94 FORMAT "%8.3" ECU_ADDRESS 0x7FE100 /end MEASUREMENT
/begin MEASUREMENT mims_w "indiziertes Motormoment zum Motorschutz" UWORD rel_uw_b100 1 100 0 99.9985 FORMAT "%8.5" ECU_ADDRESS 0x7FE036 /end MEASUREMENT
/begin MEASUREMENT minmxb_w "indiziertes Soll-Moment f¸r NMAX-Begrenzung ohne Begrenzung" SWORD rel_sw_b100 1 100 -100 99.9969 FORMAT "%8.4" ECU_ADDRESS 0x7FDF62 /end MEASUREMENT
/begin MEASUREMENT minmxs "ind. Soll-Motormoment zur Integratorinitialisierung NMAX-Regelung" SBYTE rel_sb_q0p78 1 100 -99.84 99.06 FORMAT "%5.2" ECU_ADDRESS 0x7FDA75 /end MEASUREMENT
/begin MEASUREMENT minmx_w "Momentenanforderung der Drehzahlbegrenzung" UWORD rel_uw_b100 1 100 0 99.9985 FORMAT "%8.5" ECU_ADDRESS 0x7FDF64 /end MEASUREMENT
/begin MEASUREMENT mired1 "Indiziertes Reduktionsmoment zur NMAX-Regelung" UBYTE rel_ub_b99p6 1 100 0 99.6094 FORMAT "%5.2" ECU_ADDRESS 0x7FDA76 /end MEASUREMENT
/begin MEASUREMENT misgsl_w "Inneres Soll-Motormoment luftseitig f¸r Drehzahlsynchr. bei Getriebeschaltung" UWORD rel_uw_b100 1 100 0 99.9985 FORMAT "%8.5" ECU_ADDRESS 0x7FE038 /end MEASUREMENT
/begin MEASUREMENT mistt "Startmoment" UBYTE rel_ub_b99p6 1 100 0 99.6094 FORMAT "%5.2" ECU_ADDRESS 0x7FDA56 /end MEASUREMENT
/begin MEASUREMENT miszul_w "Maximal zul‰ssiges indiziertes Moment" UWORD rel_uw_b100 1 100 0 99.9985 FORMAT "%8.5" ECU_ADDRESS 0x7FDF54 /end MEASUREMENT
/begin MEASUREMENT mizufil_w "Zul‰ssiges indiziertes Moment nach Filter" UWORD rel_uw_b100 1 100 0 99.9985 FORMAT "%8.5" ECU_ADDRESS 0x7FDF56 /end MEASUREMENT
/begin MEASUREMENT mizuofil "Zul‰ssiges indiziertes Moment ohne Filter" UBYTE rel_ub_b99p6 1 100 0 99.6094 FORMAT "%5.2" ECU_ADDRESS 0x7FDA71 /end MEASUREMENT
/begin MEASUREMENT mizuvfil "Zul‰ssiges indiziertes Moment vor Filter" UBYTE rel_ub_b99p6 1 100 0 99.6094 FORMAT "%5.2" ECU_ADDRESS 0x7FDA72 /end MEASUREMENT
/begin MEASUREMENT mrfgr_w "Relative Momentenanforderung von FGR" UWORD rel_uw_b200 1 100 0 199.997 FORMAT "%8.4" ECU_ADDRESS 0x7FE03A /end MEASUREMENT
/begin MEASUREMENT mrstt_w "relatives Startmoment" UWORD rel_uw_b200 1 100 0 199.997 FORMAT "%8.4" ECU_ADDRESS 0x7FDE8C /end MEASUREMENT
/begin MEASUREMENT mshfm_w "Massenstrom HFM 16-Bit Grˆﬂe" UWORD m_uw_b6553p5 1 100 0 6553.5 FORMAT "%8.3" ECU_ADDRESS 0x7FBD06 /end MEASUREMENT
/begin MEASUREMENT msl "Sekund‰rluftmassenstrom" UBYTE m_ub_q0p4 1 100 0 102 FORMAT "%5.1" ECU_ADDRESS 0x7FD7D8 /end MEASUREMENT
/begin MEASUREMENT msl2 "Sekund‰rluftmasse Bank 2" UBYTE m_ub_q0p4 1 100 0 102 FORMAT "%5.1" ECU_ADDRESS 0x7FD7D9 /end MEASUREMENT
/begin MEASUREMENT msl2_w "" UWORD m_uw_b6553p5 1 100 0 6553.5 FORMAT "%8.3" ECU_ADDRESS 0x7FD7CC /end MEASUREMENT
/begin MEASUREMENT mslpub "Sekund‰rluftmassenstrom, batteriespannungsabh‰ngig" UBYTE m_ub_q0p4 1 100 0 102 FORMAT "%5.1" ECU_ADDRESS 0x7FD7DA /end MEASUREMENT
/begin MEASUREMENT mslstat "statischer Sekund‰rluftmassenstrom" UBYTE m_ub_q0p4 1 100 0 102 FORMAT "%5.1" ECU_ADDRESS 0x7FD7DB /end MEASUREMENT
/begin MEASUREMENT msl_w "" UWORD m_uw_b6553p5 1 100 0 6553.5 FORMAT "%8.3" ECU_ADDRESS 0x7FD7CE /end MEASUREMENT
/begin MEASUREMENT Nc_cnt_ini "" ULONG dez 1 100 0 4.29497e+009 FORMAT "%13.2" ARRAY_SIZE 9 ECU_ADDRESS 0x7FE3E8 /end MEASUREMENT
/begin MEASUREMENT Nc_cnt_kl15 "" ULONG fak_ub_q0p01 1 100 0 4.29497e+007 FORMAT "%13.4" ARRAY_SIZE 9 ECU_ADDRESS 0x7FE40C /end MEASUREMENT
/begin MEASUREMENT Nc_cnt_nv "" ULONG dez 1 100 0 4.29497e+009 FORMAT "%13.2" ARRAY_SIZE 9 ECU_ADDRESS 0x7F9AF8 /end MEASUREMENT
/begin MEASUREMENT nmotpr_w "Pr‰dizierte Motordrehzahl f¸r NMAX-Regelung" UWORD nmot_uw_q0p25 1 100 0 16383.8 FORMAT "%8.2" ECU_ADDRESS 0x7FDF66 /end MEASUREMENT
/begin MEASUREMENT nslb "Nsoll Korrektur von Ladebilanz Batterie" UBYTE nmot_ub_q10 1 100 0 2550 FORMAT "%5.0" ECU_ADDRESS 0x7FD864 /end MEASUREMENT
/begin MEASUREMENT nturbc_w "Wandler-Turbinendrehzahl ¸ber CAN" UWORD dez 1 100 0 65535 FORMAT "%8.2" ECU_ADDRESS 0x7FE1DE /end MEASUREMENT
/begin MEASUREMENT nturbv_w "Vorraussichtliche Turbinendrehzahl des Wandlers" UWORD nmot_q0p125 1 100 0 8191.88 FORMAT "%8.3" ECU_ADDRESS 0x7FDE88 /end MEASUREMENT
/begin MEASUREMENT nturb_w "Turbinendrehzahl des Wandlers" UWORD nmot_q0p125 1 100 0 8191.88 FORMAT "%8.3" ECU_ADDRESS 0x7FDE8A /end MEASUREMENT
/begin MEASUREMENT obdsteuer "aus CAN-Signal OBD_STEUER aufbereitete Grˆﬂe f¸r ME" UBYTE dez 1 100 0 255 FORMAT "%5.1" ECU_ADDRESS 0x7FD4AA /end MEASUREMENT
/begin MEASUREMENT pdpld "Pr‰dizierter Delta Druck (‹berschwinger Soll-Ist)" UBYTE dez 1 100 0 255 FORMAT "%5.1" ECU_ADDRESS 0x7FDAAF /end MEASUREMENT
/begin MEASUREMENT performance "" UBYTE rel_ub_b100 1 100 0 100 FORMAT "%5.1" ECU_ADDRESS 0x7FD850 /end MEASUREMENT
/begin MEASUREMENT psagr_w "Partialdruck durch externes Restgas (Restluft+Inertgas)" UWORD p_uw_q0p039 1 100 0 2559.96 FORMAT "%8.3" ECU_ADDRESS 0x7FD76E /end MEASUREMENT
/begin MEASUREMENT pses_w "Saugrohrdruck ¸ber Verstellsystem korrigiert" UWORD p_q0p039 1 100 0 2559.96 FORMAT "%8.3" ECU_ADDRESS 0x7FD5FA /end MEASUREMENT
/begin MEASUREMENT psl "÷ldruck von der Servo-Lenkung" UBYTE dez 1 100 0 255 FORMAT "%5.1" ECU_ADDRESS 0x7FD770 /end MEASUREMENT
/begin MEASUREMENT pste_w "Mittlerer Saugrohrdruck w‰hrend der Einspritzung" UWORD p_uw_q0p039 1 100 0 2559.96 FORMAT "%8.3" ECU_ADDRESS 0x7FDD2E /end MEASUREMENT
/begin MEASUREMENT pte "Tankdifferenzdruck, Eingangssignal, (nach AD-Wandler)" UBYTE p_sb_q32 1 100 0 63.75 FORMAT "%5.2" ECU_ADDRESS 0x7FD771 /end MEASUREMENT
/begin MEASUREMENT qnst_w "Drehzahlquotient im Start" UWORD fak_uw_b2 1 100 0 1.99997 FORMAT "%8.6" ECU_ADDRESS 0x7FDE8E /end MEASUREMENT
/begin MEASUREMENT qntns "Quotient aus Turbinendrehzahl des Wandlers und Solldrehzahl der LLR" UBYTE fak_ub_b8 1 100 0 7.96875 FORMAT "%5.3" ECU_ADDRESS 0x7FDA55 /end MEASUREMENT
/begin MEASUREMENT r1000msCtr "" ULONG dez 1 100 0 4.29497e+009 FORMAT "%13.2" ECU_ADDRESS 0x7FE4EC /end MEASUREMENT
/begin MEASUREMENT r1000ms_predrive_Ctr "" ULONG dez 1 100 0 4.29497e+009 FORMAT "%13.2" ECU_ADDRESS 0x7FE4F0 /end MEASUREMENT
/begin MEASUREMENT r1000ms_swoff_Ctr "" ULONG dez 1 100 0 4.29497e+009 FORMAT "%13.2" ECU_ADDRESS 0x7FE4F4 /end MEASUREMENT
/begin MEASUREMENT r100msCtr "" ULONG dez 1 100 0 4.29497e+009 FORMAT "%13.2" ECU_ADDRESS 0x7FE4F8 /end MEASUREMENT
/begin MEASUREMENT r100ms_predrive_Ctr "" ULONG dez 1 100 0 4.29497e+009 FORMAT "%13.2" ECU_ADDRESS 0x7FE4FC /end MEASUREMENT
/begin MEASUREMENT r100ms_swoff_Ctr "" ULONG dez 1 100 0 4.29497e+009 FORMAT "%13.2" ECU_ADDRESS 0x7FE500 /end MEASUREMENT
/begin MEASUREMENT r10msCtr "10ms-Raster-Z‰hler der Funktion" ULONG dez 1 100 0 4.29497e+009 FORMAT "%13.2" ECU_ADDRESS 0x7FE504 /end MEASUREMENT
/begin MEASUREMENT r10ms_predrive_Ctr "" ULONG dez 1 100 0 4.29497e+009 FORMAT "%13.2" ECU_ADDRESS 0x7FE508 /end MEASUREMENT
/begin MEASUREMENT r10ms_swoff_Ctr "" ULONG dez 1 100 0 4.29497e+009 FORMAT "%13.2" ECU_ADDRESS 0x7FE50C /end MEASUREMENT
/begin MEASUREMENT r1msCtr "" ULONG dez 1 100 0 4.29497e+009 FORMAT "%13.2" ECU_ADDRESS 0x7FE4B8 /end MEASUREMENT
/begin MEASUREMENT r1ms_predrive_Ctr "" ULONG dez 1 100 0 4.29497e+009 FORMAT "%13.2" ECU_ADDRESS 0x7FE510 /end MEASUREMENT
/begin MEASUREMENT r1ms_swoff_Ctr "" ULONG dez 1 100 0 4.29497e+009 FORMAT "%13.2" ECU_ADDRESS 0x7FE514 /end MEASUREMENT
/begin MEASUREMENT r200msCtr "" ULONG dez 1 100 0 4.29497e+009 FORMAT "%13.2" ECU_ADDRESS 0x7FE518 /end MEASUREMENT
/begin MEASUREMENT r200ms_predrive_Ctr "" ULONG dez 1 100 0 4.29497e+009 FORMAT "%13.2" ECU_ADDRESS 0x7FE51C /end MEASUREMENT
/begin MEASUREMENT r200ms_swoff_Ctr "" ULONG dez 1 100 0 4.29497e+009 FORMAT "%13.2" ECU_ADDRESS 0x7FE520 /end MEASUREMENT
/begin MEASUREMENT r20msCtr "" ULONG dez 1 100 0 4.29497e+009 FORMAT "%13.2" ECU_ADDRESS 0x7FE524 /end MEASUREMENT
/begin MEASUREMENT r20ms_predrive_Ctr "" ULONG dez 1 100 0 4.29497e+009 FORMAT "%13.2" ECU_ADDRESS 0x7FE528 /end MEASUREMENT
/begin MEASUREMENT r20ms_swoff_Ctr "" ULONG dez 1 100 0 4.29497e+009 FORMAT "%13.2" ECU_ADDRESS 0x7FE52C /end MEASUREMENT
/begin MEASUREMENT r2msCtr "" ULONG dez 1 100 0 4.29497e+009 FORMAT "%13.2" ECU_ADDRESS 0x7FE530 /end MEASUREMENT
/begin MEASUREMENT r2ms_predrive_Ctr "" ULONG dez 1 100 0 4.29497e+009 FORMAT "%13.2" ECU_ADDRESS 0x7FE534 /end MEASUREMENT
/begin MEASUREMENT r2ms_swoff_Ctr "" ULONG dez 1 100 0 4.29497e+009 FORMAT "%13.2" ECU_ADDRESS 0x7FE538 /end MEASUREMENT
/begin MEASUREMENT r50msCtr "" ULONG dez 1 100 0 4.29497e+009 FORMAT "%13.2" ECU_ADDRESS 0x7FE53C /end MEASUREMENT
/begin MEASUREMENT r50ms_predrive_Ctr "" ULONG dez 1 100 0 4.29497e+009 FORMAT "%13.2" ECU_ADDRESS 0x7FE540 /end MEASUREMENT
/begin MEASUREMENT r50ms_swoff_Ctr "" ULONG dez 1 100 0 4.29497e+009 FORMAT "%13.2" ECU_ADDRESS 0x7FE544 /end MEASUREMENT
/begin MEASUREMENT rasfak "Korrekturfaktor f¸r Rasteraufweitung (10ms-Raster und grˆﬂer)" UBYTE fak_ub_b2 1 100 0 1.99219 FORMAT "%5.3" ECU_ADDRESS 0x7FDA7C /end MEASUREMENT
/begin MEASUREMENT reltrq_fin "" UWORD fak_uw_b1 1 100 0 0.999985 FORMAT "%9.7" ECU_ADDRESS 0x7FE26C /end MEASUREMENT
/begin MEASUREMENT reltrq_lim "" UWORD fak_uw_b1 1 100 0 0.999985 FORMAT "%9.7" ECU_ADDRESS 0x7FE26E /end MEASUREMENT
/begin MEASUREMENT reltrq_old "" UWORD fak_uw_b1 1 100 0 0.999985 FORMAT "%9.7" ECU_ADDRESS 0x7FE270 /end MEASUREMENT
/begin MEASUREMENT reltrq_red "" UWORD fak_uw_b1 1 100 0 0.999985 FORMAT "%9.7" ECU_ADDRESS 0x7FE272 /end MEASUREMENT
/begin MEASUREMENT rkwez_w "Vektor additive Kraftstoffmenge bei Wiedereinsetzen" UWORD t1p0usxms 1 100 0 65.535 FORMAT "%8.5" ARRAY_SIZE 2 ECU_ADDRESS 0x7FB470 /end MEASUREMENT
/begin MEASUREMENT rlmax_w "maximal erreichbare F¸llung bei Turbo" UWORD rel_uw_q0p0234 1 100 0 1535.98 FORMAT "%8.3" ECU_ADDRESS 0x7FD772 /end MEASUREMENT
/begin MEASUREMENT rltedte_w "" UWORD rel_uw_q0p0234 1 100 0 1535.98 FORMAT "%8.3" ECU_ADDRESS 0x7FE03C /end MEASUREMENT
/begin MEASUREMENT roadbuff_w "" UWORD fak_uw_b16 1 100 0 15.9998 FORMAT "%8.5" ECU_ADDRESS 0x7FE102 /end MEASUREMENT
/begin MEASUREMENT roadpre_w "" UWORD fak_uw_b16 1 100 0 15.9998 FORMAT "%8.5" ECU_ADDRESS 0x7FE104 /end MEASUREMENT
/begin MEASUREMENT roadtype_w "" UWORD fak_uw_b16 1 100 0 15.9998 FORMAT "%8.5" ECU_ADDRESS 0x7FE106 /end MEASUREMENT
/begin MEASUREMENT rt_1000ms "" UWORD txms_uw_q0p0004 1 100 0 26.214 FORMAT "%8.5" ECU_ADDRESS 0x7FE170 /end MEASUREMENT
/begin MEASUREMENT rt_100ms "" UWORD txms_uw_q0p0004 1 100 0 26.214 FORMAT "%8.5" ECU_ADDRESS 0x7FE172 /end MEASUREMENT
/begin MEASUREMENT rt_10ms "" UWORD txms_uw_q0p0004 1 100 0 26.214 FORMAT "%8.5" ECU_ADDRESS 0x7FE174 /end MEASUREMENT
/begin MEASUREMENT rt_10mss "" ULONG rel_ul_q0p0004 1 100 0 1.71799e+006 FORMAT "%13.5" ECU_ADDRESS 0x7FE554 /end MEASUREMENT
/begin MEASUREMENT rt_1ms "" UWORD txms_uw_q0p0004 1 100 0 26.214 FORMAT "%8.5" ECU_ADDRESS 0x7FE176 /end MEASUREMENT
/begin MEASUREMENT rt_1mss "" ULONG rel_ul_q0p0004 1 100 0 1.71799e+006 FORMAT "%13.5" ECU_ADDRESS 0x7FE558 /end MEASUREMENT
/begin MEASUREMENT rt_200ms "" UWORD txms_uw_q0p0004 1 100 0 26.214 FORMAT "%8.5" ECU_ADDRESS 0x7FE178 /end MEASUREMENT
/begin MEASUREMENT rt_20ms "" UWORD txms_uw_q0p0004 1 100 0 26.214 FORMAT "%8.5" ECU_ADDRESS 0x7FE17A /end MEASUREMENT
/begin MEASUREMENT rt_20mss "" ULONG rel_ul_q0p0004 1 100 0 1.71799e+006 FORMAT "%13.5" ECU_ADDRESS 0x7FE55C /end MEASUREMENT
/begin MEASUREMENT rt_2ms "" UWORD txms_uw_q0p0004 1 100 0 26.214 FORMAT "%8.5" ECU_ADDRESS 0x7FE17C /end MEASUREMENT
/begin MEASUREMENT rt_2mss "" ULONG rel_ul_q0p0004 1 100 0 1.71799e+006 FORMAT "%13.5" ECU_ADDRESS 0x7FE560 /end MEASUREMENT
/begin MEASUREMENT rt_50ms "" UWORD txms_uw_q0p0004 1 100 0 26.214 FORMAT "%8.5" ECU_ADDRESS 0x7FE17E /end MEASUREMENT
/begin MEASUREMENT rt_50mss "" ULONG rel_ul_q0p0004 1 100 0 1.71799e+006 FORMAT "%13.5" ECU_ADDRESS 0x7FE564 /end MEASUREMENT
/begin MEASUREMENT rt_bg "" UWORD txms_uw_q0p0004 1 100 0 26.214 FORMAT "%8.5" ECU_ADDRESS 0x7FE180 /end MEASUREMENT
/begin MEASUREMENT rt_bg_brutto "" UWORD txms_uw_q0p0032 1 100 0 209.712 FORMAT "%8.4" ECU_ADDRESS 0x7FE182 /end MEASUREMENT
/begin MEASUREMENT rt_bg_brutto_max "" UWORD txms_uw_q0p0032 1 100 0 209.712 FORMAT "%8.4" ECU_ADDRESS 0x7FE184 /end MEASUREMENT
/begin MEASUREMENT rt_brutto_10ms "" UWORD dez 1 100 0 65535 FORMAT "%8.2" ECU_ADDRESS 0x7FE186 /end MEASUREMENT
/begin MEASUREMENT rt_brutto_1ms "" UWORD dez 1 100 0 65535 FORMAT "%8.2" ECU_ADDRESS 0x7FE188 /end MEASUREMENT
/begin MEASUREMENT rt_brutto_2ms "" UWORD dez 1 100 0 65535 FORMAT "%8.2" ECU_ADDRESS 0x7FE18A /end MEASUREMENT
/begin MEASUREMENT rt_brutto_bg "" UWORD dez 1 100 0 65535 FORMAT "%8.2" ECU_ADDRESS 0x7FE18C /end MEASUREMENT
/begin MEASUREMENT rt_brutto_syn "" UWORD dez 1 100 0 65535 FORMAT "%8.2" ECU_ADDRESS 0x7FE18E /end MEASUREMENT
/begin MEASUREMENT rt_hw1 "" UWORD txms_uw_q0p0004 1 100 0 26.214 FORMAT "%8.5" ECU_ADDRESS 0x7FE190 /end MEASUREMENT
/begin MEASUREMENT rt_hw1s "" ULONG rel_ul_q0p0004 1 100 0 1.71799e+006 FORMAT "%13.5" ECU_ADDRESS 0x7FE568 /end MEASUREMENT
/begin MEASUREMENT rt_hw2 "" UWORD txms_uw_q0p0004 1 100 0 26.214 FORMAT "%8.5" ECU_ADDRESS 0x7FE192 /end MEASUREMENT
/begin MEASUREMENT rt_hw2s "" ULONG rel_ul_q0p0004 1 100 0 1.71799e+006 FORMAT "%13.5" ECU_ADDRESS 0x7FE56C /end MEASUREMENT
/begin MEASUREMENT rt_hw3 "" UWORD txms_uw_q0p0004 1 100 0 26.214 FORMAT "%8.5" ECU_ADDRESS 0x7FE194 /end MEASUREMENT
/begin MEASUREMENT rt_hw3s "" ULONG rel_ul_q0p0004 1 100 0 1.71799e+006 FORMAT "%13.5" ECU_ADDRESS 0x7FE570 /end MEASUREMENT
/begin MEASUREMENT rt_hw4 "" UWORD txms_uw_q0p0004 1 100 0 26.214 FORMAT "%8.5" ECU_ADDRESS 0x7FE196 /end MEASUREMENT
/begin MEASUREMENT rt_hw4s "" ULONG rel_ul_q0p0004 1 100 0 1.71799e+006 FORMAT "%13.5" ECU_ADDRESS 0x7FE574 /end MEASUREMENT
/begin MEASUREMENT rt_res5v "" UWORD txms_uw_q0p0004 1 100 0 26.214 FORMAT "%8.5" ECU_ADDRESS 0x7FE198 /end MEASUREMENT
/begin MEASUREMENT rt_syn "" UWORD txms_uw_q0p0004 1 100 0 26.214 FORMAT "%8.5" ECU_ADDRESS 0x7FE19A /end MEASUREMENT
/begin MEASUREMENT rt_syns "" ULONG rel_ul_q0p0004 1 100 0 1.71799e+006 FORMAT "%13.5" ECU_ADDRESS 0x7FE578 /end MEASUREMENT
/begin MEASUREMENT rt_taskCamshaft1 "" UWORD txms_uw_q0p0004 1 100 0 26.214 FORMAT "%8.5" ECU_ADDRESS 0x7FE19C /end MEASUREMENT
/begin MEASUREMENT rt_taskCamshaft2 "" UWORD txms_uw_q0p0004 1 100 0 26.214 FORMAT "%8.5" ECU_ADDRESS 0x7FE19E /end MEASUREMENT
/begin MEASUREMENT rt_taskCamshaft3 "" UWORD txms_uw_q0p0004 1 100 0 26.214 FORMAT "%8.5" ECU_ADDRESS 0x7FE1A0 /end MEASUREMENT
/begin MEASUREMENT rt_taskCamshaft4 "" UWORD txms_uw_q0p0004 1 100 0 26.214 FORMAT "%8.5" ECU_ADDRESS 0x7FE1A2 /end MEASUREMENT
/begin MEASUREMENT rt_taskEveryToothIntISR "" UWORD txms_uw_q0p0004 1 100 0 26.214 FORMAT "%8.5" ECU_ADDRESS 0x7FE1A4 /end MEASUREMENT
/begin MEASUREMENT rt_umtask "" UWORD txms_uw_q0p0004 1 100 0 26.214 FORMAT "%8.5" ECU_ADDRESS 0x7FE1A6 /end MEASUREMENT
/begin MEASUREMENT sabrcount "" UWORD dez 1 100 0 65535 FORMAT "%8.2" ECU_ADDRESS 0x7FE0B8 /end MEASUREMENT
/begin MEASUREMENT slipcurv_w "" SWORD vfzg_sw_q0p00781 1 100 -256 255.992 FORMAT "%8.4" ECU_ADDRESS 0x7FE0F2 /end MEASUREMENT
/begin MEASUREMENT slipdev_w "" SWORD afzg_sw_q0p0625 1 100 -2048 2047.94 FORMAT "%8.3" ECU_ADDRESS 0x7FE0F4 /end MEASUREMENT
/begin MEASUREMENT slipold_w "" SWORD vfzg_sw_q0p00781 1 100 -256 255.992 FORMAT "%8.4" ECU_ADDRESS 0x7FE0F6 /end MEASUREMENT
/begin MEASUREMENT slipraw_w "" SWORD vfzg_sw_q0p00781 1 100 -256 255.992 FORMAT "%8.4" ECU_ADDRESS 0x7FE0F8 /end MEASUREMENT
/begin MEASUREMENT sliproad_w "" UWORD vfzg_uw_q0p00781 1 100 0 511.992 FORMAT "%8.4" ECU_ADDRESS 0x7FE108 /end MEASUREMENT
/begin MEASUREMENT slipsemi_w "" SWORD vfzg_sw_q0p00781 1 100 -256 255.992 FORMAT "%8.4" ECU_ADDRESS 0x7FE0FA /end MEASUREMENT
/begin MEASUREMENT sliptrac_w "" SWORD vfzg_sw_q0p00781 1 100 -256 255.992 FORMAT "%8.4" ECU_ADDRESS 0x7FE0FC /end MEASUREMENT
/begin MEASUREMENT slip_mar_w "" SWORD vfzg_sw_q0p00781 1 100 -256 255.992 FORMAT "%8.4" ECU_ADDRESS 0x7FE274 /end MEASUREMENT
/begin MEASUREMENT slip_w "" SWORD vfzg_sw_q0p00781 1 100 -256 255.992 FORMAT "%8.4" ECU_ADDRESS 0x7FE0FE /end MEASUREMENT
/begin MEASUREMENT SLSlokBits "" UWORD dez 1 100 0 65535 FORMAT "%8.2" ECU_ADDRESS 0x7FD7E4 /end MEASUREMENT
/begin MEASUREMENT spi_max_transmission_time "" UWORD dez 1 100 0 65535 FORMAT "%8.2" ECU_ADDRESS 0x7F9AC6 /end MEASUREMENT
/begin MEASUREMENT spi_transmission_time "" ULONG dez 1 100 0 4.29497e+009 FORMAT "%13.2" ECU_ADDRESS 0x7FA67C /end MEASUREMENT
/begin MEASUREMENT spuefot_w "Schwerpunkt Ueberschneidungsfl. nach LOT" SWORD sprzi_q0p1 1 100 -3276.8 3276.7 FORMAT "%2.0" ECU_ADDRESS 0x7FE1E0 /end MEASUREMENT
/begin MEASUREMENT sumode "Zustand der Saugrohrumschaltung" UBYTE dez 1 100 0 255 FORMAT "%5.1" ECU_ADDRESS 0x7FD774 /end MEASUREMENT
/begin MEASUREMENT swOffDlBits "" UWORD dez 1 100 0 65535 FORMAT "%8.2" ECU_ADDRESS 0x7F9C50 /end MEASUREMENT
/begin MEASUREMENT synchroCtr "" ULONG dez 1 100 0 4.29497e+009 FORMAT "%13.2" ECU_ADDRESS 0x7FE548 /end MEASUREMENT
/begin MEASUREMENT synchroSwoffCtr "" ULONG dez 1 100 0 4.29497e+009 FORMAT "%13.2" ECU_ADDRESS 0x7FE54C /end MEASUREMENT
/begin MEASUREMENT S_eza "" UBYTE B_TRUE 1 100 0 1 BIT_MASK 0x1 FORMAT "%13.11" ECU_ADDRESS 0x7FBC34 /end MEASUREMENT
/begin MEASUREMENT tcr2_ticks "" ULONG dez 1 100 0 4.29497e+009 FORMAT "%13.2" ECU_ADDRESS 0x7FE584 /end MEASUREMENT
/begin MEASUREMENT te2_l "effektive Einspritzzeit (long)" ULONG t1p0usxms 1 100 0 450 FORMAT "%13.9" ECU_ADDRESS 0x7FE448 /end MEASUREMENT
/begin MEASUREMENT te2_w "effektive Einspritzzeit Bank2 (word)" UWORD t8p0usxms 1 100 0 524.28 FORMAT "%8.4" ECU_ADDRESS 0x7FE138 /end MEASUREMENT
/begin MEASUREMENT tevfa2_l "effektive Einspritzzeit vor Feinabgleich (longword) Bank 2" ULONG t1p0usxms 1 100 0 450 FORMAT "%13.9" ECU_ADDRESS 0x7FE44C /end MEASUREMENT
/begin MEASUREMENT tevfa2_w "effektive Einspritzzeit vor Feinabgleich (word)" UWORD t16p0usxms 1 100 0 524.288 FORMAT "%8.4" ECU_ADDRESS 0x7FD5FC /end MEASUREMENT
/begin MEASUREMENT tevfa_l "effektive Einspritzzeit vor Feinabgleich (longword)" ULONG t1p0usxms 1 100 0 450 FORMAT "%13.9" ECU_ADDRESS 0x7FE450 /end MEASUREMENT
/begin MEASUREMENT tevfa_w "effektive Einspritzzeit vor Feinabgleich (word)" UWORD t16p0usxms 1 100 0 524.288 FORMAT "%8.4" ECU_ADDRESS 0x7FD5FE /end MEASUREMENT
/begin MEASUREMENT tez_l "effektive Einspritzzeit (long) zylinderindividuell" ULONG t1p0usxms 1 100 0 450 FORMAT "%13.9" ARRAY_SIZE 2 ECU_ADDRESS 0x7FE454 /end MEASUREMENT
/begin MEASUREMENT tez_zsp_l "" ULONG t1p0usxms 1 100 0 450 FORMAT "%13.9" ECU_ADDRESS 0x7FE45C /end MEASUREMENT
/begin MEASUREMENT te_l "effektive Einspritzzeit (long)" ULONG t1p0usxms 1 100 0 450 FORMAT "%13.9" ECU_ADDRESS 0x7FE460 /end MEASUREMENT
/begin MEASUREMENT te_w "effektive Einspritzzeit (word)" UWORD t8p0usxms 1 100 0 524.28 FORMAT "%8.4" ECU_ADDRESS 0x7FE13A /end MEASUREMENT
/begin MEASUREMENT tick_val "" ULONG dez 1 100 0 4.29497e+009 FORMAT "%13.2" ECU_ADDRESS 0x7FE588 /end MEASUREMENT
/begin MEASUREMENT timmot_w "Z‰hler Zeit nach Motorlauf n>NINI (word)" UWORD t10msxs_uw_b655p35 1 100 0 655.35 FORMAT "%8.4" ECU_ADDRESS 0x7FDB5C /end MEASUREMENT
/begin MEASUREMENT tistzyl "Zylindernummer der ersten Einspritzung und Z¸ndung" UBYTE dez 1 100 0 255 FORMAT "%5.1" ECU_ADDRESS 0x7FDAB0 /end MEASUREMENT
/begin MEASUREMENT tka "Temperatur Motork¸hlerausgang (K¸hlmittel)" UBYTE temp_ub_q0p75_o48 1 100 -48 143.25 FORMAT "%5.1" ECU_ADDRESS 0x7FDAB1 /end MEASUREMENT
/begin MEASUREMENT tmotmsf "Motortemperatur fuer Motorschutzfkt" UBYTE temp_ub_q1_o48 1 100 -48 207 FORMAT "%5.1" ECU_ADDRESS 0x7FDB1C /end MEASUREMENT
/begin MEASUREMENT tnachl_w "SG-Nachlaufzeit" UWORD t100msxs_uw_b6553p6 1 100 0 6553.5 FORMAT "%8.3" ECU_ADDRESS 0x7F9C52 /end MEASUREMENT
/begin MEASUREMENT tnscCtr_w "" UWORD t20msxs_uw_q0p02 1 100 0 1310.7 FORMAT "%8.3" ECU_ADDRESS 0x7FDF58 /end MEASUREMENT
/begin MEASUREMENT tnsofCtr "" UBYTE t20msxs_ub_b5p1 1 100 0 5.1 FORMAT "%5.3" ECU_ADDRESS 0x7FDA73 /end MEASUREMENT
/begin MEASUREMENT tol "Motor-÷L-Temperatur" UBYTE temp_ub_q0p75_o48 1 100 -48 143.25 FORMAT "%5.1" ECU_ADDRESS 0x7FDAB2 /end MEASUREMENT
/begin MEASUREMENT tpu_ticks "" ULONG dez 1 100 0 4.29497e+009 FORMAT "%13.2" ECU_ADDRESS 0x7FE58C /end MEASUREMENT
/begin MEASUREMENT tred2_w "" UWORD fak_uw_b32 1 100 0 31.9995 FORMAT "%8.5" ECU_ADDRESS 0x7FE276 /end MEASUREMENT
/begin MEASUREMENT tred_w "" UWORD fak_uw_b32 1 100 0 31.9995 FORMAT "%8.5" ECU_ADDRESS 0x7FE278 /end MEASUREMENT
/begin MEASUREMENT trqincfact "" UWORD dez 1 100 0 65535 FORMAT "%8.2" ECU_ADDRESS 0x7FE27A /end MEASUREMENT
/begin MEASUREMENT trqspinfact "" UWORD fak_uw_b64 1 100 0 63.999 FORMAT "%8.5" ECU_ADDRESS 0x7FE27C /end MEASUREMENT
/begin MEASUREMENT tumg "Umgebungstemperatur" UBYTE temp_ub_q0p75_o48 1 100 -48 143.25 FORMAT "%5.1" ECU_ADDRESS 0x7FD777 /end MEASUREMENT
/begin MEASUREMENT tvu_w "Batteriespannungskorrektur" UWORD t1p0usxms 1 100 0 65.535 FORMAT "%8.5" ECU_ADDRESS 0x7FE13C /end MEASUREMENT
/begin MEASUREMENT t_rdvinakt "" UBYTE t10msxs_ub_b2p55 1 100 0 2.55 FORMAT "%5.3" ECU_ADDRESS 0x7FD815 /end MEASUREMENT
/begin MEASUREMENT udsl_w "Spannung Drucksensor Ladedruck (word)" UWORD spg_uw_q0p00488 1 100 0 319.995 FORMAT "%8.4" ECU_ADDRESS 0x7FE03E /end MEASUREMENT
/begin MEASUREMENT uefl_w "Groesse der Ventilueberschneidungsflaeche" UWORD flae_uw_q0p016 1 100 0 1048.56 FORMAT "%8.3" ECU_ADDRESS 0x7FE1E2 /end MEASUREMENT
/begin MEASUREMENT uhsv "Spannung an der Heizerendstufe vor Kat" UBYTE spg_ub_b5 1 100 0 4.98047 FORMAT "%5.3" ECU_ADDRESS 0x7FDAB3 /end MEASUREMENT
/begin MEASUREMENT uhsv2 "Spannung an der Heizerendstufe 2 vor Kat" UBYTE spg_ub_b5 1 100 0 4.98047 FORMAT "%5.3" ECU_ADDRESS 0x7FDAB4 /end MEASUREMENT
/begin MEASUREMENT ushk "Spannung Lambdasonde hinter Katalysator" UBYTE spg_ub_q0p0052_o0p2 1 100 -0.2 1.13 FORMAT "%5.3" ECU_ADDRESS 0x7FDAB5 /end MEASUREMENT
/begin MEASUREMENT ushk2 "Spannung Lambdasonde hinter Katalysator 2" UBYTE spg_ub_q0p0052_o0p2 1 100 -0.2 1.13 FORMAT "%5.3" ECU_ADDRESS 0x7FDAB6 /end MEASUREMENT
/begin MEASUREMENT ushk2_w "Spannung Lambdasonde (4.88mV/LSB) hinter Katalysator 2" UWORD spg_uw_q0p00488_o1 1 100 -1 318.995 FORMAT "%8.4" ECU_ADDRESS 0x7FE040 /end MEASUREMENT
/begin MEASUREMENT ushk_w "Spannung Lambdasonde (4.88mV/LSB) hinter Katalysator" UWORD spg_uw_q0p00488_o1 1 100 -1 318.995 FORMAT "%8.4" ECU_ADDRESS 0x7FE042 /end MEASUREMENT
/begin MEASUREMENT vfgr_w "Fahrzeug-Ist-Geschwindigkeit f¸r FGR" UWORD vfzg_uw_b512 1 100 0 511.992 FORMAT "%8.4" ECU_ADDRESS 0x7FE044 /end MEASUREMENT
/begin MEASUREMENT vrlsol "Verhaeltnis relative Soll-F¸llung zu Maximalfuellung" UBYTE rel_ub_b99p6 1 100 0 99.6094 FORMAT "%5.2" ECU_ADDRESS 0x7FD775 /end MEASUREMENT
/begin MEASUREMENT vr_chkdata "" UWORD dez 1 100 0 65535 FORMAT "%8.2" ECU_ADDRESS 0x7FE248 /end MEASUREMENT
/begin MEASUREMENT vr_chkvld "" UWORD dez 1 100 0 65535 FORMAT "%8.2" ECU_ADDRESS 0x7FE24A /end MEASUREMENT
/begin MEASUREMENT vr_dc "" UWORD dez 1 100 0 65535 FORMAT "%8.2" ECU_ADDRESS 0x7FE24C /end MEASUREMENT
/begin MEASUREMENT vr_dc_alt "" UWORD dez 1 100 0 65535 FORMAT "%8.2" ECU_ADDRESS 0x7FE24E /end MEASUREMENT
/begin MEASUREMENT vr_freq "" UWORD dez 1 100 0 65535 FORMAT "%8.2" ECU_ADDRESS 0x7FE250 /end MEASUREMENT
/begin MEASUREMENT vr_f_alt "" UWORD dez 1 100 0 65535 FORMAT "%8.2" ECU_ADDRESS 0x7FE252 /end MEASUREMENT
/begin MEASUREMENT vr_res_co "" UWORD dez 1 100 0 65535 FORMAT "%8.2" ECU_ADDRESS 0x7FE254 /end MEASUREMENT
/begin MEASUREMENT vr_res_hi "" UWORD dez 1 100 0 65535 FORMAT "%8.2" ECU_ADDRESS 0x7FE256 /end MEASUREMENT
/begin MEASUREMENT vr_res_pe "" UWORD dez 1 100 0 65535 FORMAT "%8.2" ECU_ADDRESS 0x7FE258 /end MEASUREMENT
/begin MEASUREMENT vr_res_te "" UWORD dez 1 100 0 65535 FORMAT "%8.2" ECU_ADDRESS 0x7FE25A /end MEASUREMENT
/begin MEASUREMENT vr_tpubusy "" UWORD dez 1 100 0 65535 FORMAT "%8.2" ECU_ADDRESS 0x7FE25C /end MEASUREMENT
/begin MEASUREMENT vr_v "" UWORD vfzg_uw_q0p0625 1 100 0 4095.94 FORMAT "%8.3" ECU_ADDRESS 0x7FE25E /end MEASUREMENT
/begin MEASUREMENT vr_v_alt "" UWORD vfzg_uw_b512 1 100 0 511.992 FORMAT "%8.4" ECU_ADDRESS 0x7FE260 /end MEASUREMENT
/begin MEASUREMENT vr_v_w "" UWORD vfzg_uw_b512 1 100 0 511.992 FORMAT "%8.4" ECU_ADDRESS 0x7FE262 /end MEASUREMENT
/begin MEASUREMENT Vsa_spri "Istwert Auslasspreizung variable NWS" UWORD sprzi_q0p1 1 100 0 6553.5 FORMAT "%2.0" ECU_ADDRESS 0x7FD77A /end MEASUREMENT
/begin MEASUREMENT vsdmr "Vorgabe Drehmomentreserve ¸ber Verstellsystem VSxy" UBYTE rel_ub_q0p3906 1 100 0 99.6094 FORMAT "%5.2" ECU_ADDRESS 0x7FDAB7 /end MEASUREMENT
/begin MEASUREMENT Vse_spri "Istwert Einlasspreizung variable NWS" UWORD sprzi_q0p1 1 100 0 6553.5 FORMAT "%2.0" ECU_ADDRESS 0x7FD77C /end MEASUREMENT
/begin MEASUREMENT vsfpses "Faktor zur Verstellung Saugrohrdruck zur Applikation Einspritzung" UBYTE fak_ub_b2 1 100 0 1.99219 FORMAT "%5.3" ECU_ADDRESS 0x7FDAB8 /end MEASUREMENT
/begin MEASUREMENT vsfrk "Korrektur der relativen Kraftstoffmasse ¸ber Verstellsysteme" UBYTE fak_ub_b1p25_o0p75 1 100 0.75 1.24805 FORMAT "%5.3" ECU_ADDRESS 0x7FDAB9 /end MEASUREMENT
/begin MEASUREMENT vske "verstellbarer Offset f¸r Klopferkennungsschwelle ¸ber VS20" SBYTE fak_ub_b4 1 100 -2 1.98438 FORMAT "%5.3" ECU_ADDRESS 0x7FDABA /end MEASUREMENT
/begin MEASUREMENT vsns "ƒnderung der Solldrehzahl ¸ber Verstellsystem VSxy" SBYTE nmot_sb_q10 1 100 -1280 1270 FORMAT "%5.0" ECU_ADDRESS 0x7FDABB /end MEASUREMENT
/begin MEASUREMENT vsskrst "Kraftstoff-Sollvolumenstrom (Betriebspunktabh‰ngiger Bedarf)" UBYTE fuel_ub_q1 1 100 0 255 FORMAT "%5.1" ECU_ADDRESS 0x7FDABC /end MEASUREMENT
/begin MEASUREMENT vsvw "ƒnderung Einspritzvorlagerungswinkel ¸ber Verstellsystem" SBYTE zw_sb_q6 1 100 -768 762 FORMAT "%5.1" ECU_ADDRESS 0x7FDABD /end MEASUREMENT
/begin MEASUREMENT vszw "Z¸ndwinkelkorrektur durch Verstellsystem" SBYTE zw_sb_q0p75 1 100 -96 95.25 FORMAT "%5.2" ECU_ADDRESS 0x7FDABE /end MEASUREMENT
/begin MEASUREMENT vszwkr "Zylinderindividuelle ZW-Verstellung durch Verstellsystem" SBYTE zw_sb_qn0p75 1 100 -95.25 96 FORMAT "%5.2" ARRAY_SIZE 8 ECU_ADDRESS 0x7FDAC0 /end MEASUREMENT
/begin MEASUREMENT wee "" UBYTE zw_ub_q6 1 100 0 1530 FORMAT "%5.0" ECU_ADDRESS 0x7FDAC8 /end MEASUREMENT
/begin MEASUREMENT wnwue "Winkel Nockenwellenueberschneidung" SBYTE kw_q1 1 100 -128 127 FORMAT "%5.1" ECU_ADDRESS 0x7FD778 /end MEASUREMENT
/begin MEASUREMENT zwsol "Soll-Z¸ndwinkel aus Momenteneingriff" SBYTE zw_sb_q0p75 1 100 -96 95.25 FORMAT "%5.2" ECU_ADDRESS 0x7FDAE8 /end MEASUREMENT
/begin MEASUREMENT zyleausb "auszublendender Zylinder; bin‰re Darstellung" UBYTE dez 1 100 0 255 FORMAT "%5.1" ECU_ADDRESS 0x7FD865 /end MEASUREMENT
/begin MEASUREMENT Zyl_zsp "" UBYTE dez 1 100 0 255 FORMAT "%5.1" ECU_ADDRESS 0x7FD5F0 /end MEASUREMENT
/begin MEASUREMENT zzbank "Zylinderzuordnung zu Einspritzb‰nken" UBYTE dez 1 100 0 255 FORMAT "%5.1" ECU_ADDRESS 0x7FD782 /end MEASUREMENT
/begin FUNCTION MDVERB "Momentenbedarf der Nebenaggregate (z.B. Klimaanlage, sonst. Verbraucher)"
 /begin DEF_CHARACTERISTIC CWMDELUE CWMDSL DMDKOE KFMDGEN KFMDKO KFMDKOG KLMDELUE KLMDSL MDGENVF MDSL ZKMDGEN ZKMDKO /end DEF_CHARACTERISTIC
 /begin REF_CHARACTERISTIC /end REF_CHARACTERISTIC
 /begin IN_MEASUREMENT B_acres B_elue B_gene B_koe B_koger B_sl kopwm lws_w mdarsp_w mdkog nmot nmot_w tans /end IN_MEASUREMENT
 /begin OUT_MEASUREMENT dmrac mdelue_w mdgen mdgenvf mdgenvf_w mdgen_w mdko mdverb mdverb_w /end OUT_MEASUREMENT
 /begin LOC_MEASUREMENT /end LOC_MEASUREMENT
 /begin SUB_FUNCTION /end SUB_FUNCTION
/end FUNCTION
/begin FUNCTION MDWAN "Drehmomentaufnahme des Wandlers"
 /begin DEF_CHARACTERISTIC CNFMDWAN DMDWHYS DMDWM FABMDWA FDMDWAN FMDWAT FNRAD FVDMDWAN KFMDWMX MDATNM MDATRM MDWANER TVFSAM TVFSEM TVFSRAM TVFSREM TVFUE UEVERG ZKDMDW ZKMDWAB ZKMDWAUF ZKMDWF ZKUEVERG /end DEF_CHARACTERISTIC
 /begin REF_CHARACTERISTIC STM08MDUB /end REF_CHARACTERISTIC
 /begin IN_MEASUREMENT B_autget B_fs B_mdwaner esst_stm08mdub gangi mdwancan nstat nturbc_w tmot vfzg vfzg_w /end IN_MEASUREMENT
 /begin OUT_MEASUREMENT B_dmrwan dmdwan_w dmrwan mdwanvf_w mdwan_w nturbv_w /end OUT_MEASUREMENT
 /begin LOC_MEASUREMENT B_fsu B_rgang dnturb_w mdatxm_w nturb_w qntns /end LOC_MEASUREMENT
 /begin SUB_FUNCTION /end SUB_FUNCTION
/end FUNCTION
/begin FUNCTION MDZUL "Maximal zul‰ssiges Moment"
 /begin DEF_CHARACTERISTIC KFMIZUFIL KFMIZUNS KFMIZUOF NSTART NSTEND SMO08OPUB TANSMN TFMIZU TMNSMN TNSC TNSOF /end DEF_CHARACTERISTIC
 /begin REF_CHARACTERISTIC MDIMX SNM08OPUB SWP08OPUB /end REF_CHARACTERISTIC
 /begin IN_MEASUREMENT B_fgr B_msr B_mzns_um esst_snm08opub esst_swp08opub nmot tans tmotzyl_w wped /end IN_MEASUREMENT
 /begin OUT_MEASUREMENT miszul_w mizuvfil /end OUT_MEASUREMENT
 /begin LOC_MEASUREMENT B_mzns B_nsakt B_nsend esst_smo08opub mizufil_w mizuofil tnscCtr_w tnsofCtr /end LOC_MEASUREMENT
 /begin SUB_FUNCTION /end SUB_FUNCTION
/end FUNCTION
/begin FUNCTION MDZW "Berechnung Moment in Sollz¸ndwinkel" /begin DEF_CHARACTERISTIC DMAUFN DZWQ2DZW DZWQ2DZWL /end DEF_CHARACTERISTIC /begin REF_CHARACTERISTIC /end REF_CHARACTERISTIC
 /begin IN_MEASUREMENT B_zwvs B_zwvz dzwkoef etazaist mibas_w miopt_w misol_w mizsol_w mizwmn_w nmot_w redist zwopt /end IN_MEASUREMENT
 /begin OUT_MEASUREMENT B_nozwe dmaufr_w dzws etazws zwsol /end OUT_MEASUREMENT
 /begin LOC_MEASUREMENT B_zwvzm dzwssq dzwssql /end LOC_MEASUREMENT
 /begin SUB_FUNCTION /end SUB_FUNCTION
/end FUNCTION
/begin FUNCTION MLS "Motorl¸fter-Steuerung" /begin DEF_CHARACTERISTIC TMLSDELTA TMLSSTART VMLSDELTA VMLSMAX /end DEF_CHARACTERISTIC /begin REF_CHARACTERISTIC CW_TZYL /end REF_CHARACTERISTIC /begin IN_MEASUREMENT B_abs B_btelue B_nmot tmotzyl_w vfzg /end IN_MEASUREMENT /begin OUT_MEASUREMENT B_elue B_hystmls B_mls B_vhystmls /end OUT_MEASUREMENT /begin LOC_MEASUREMENT /end LOC_MEASUREMENT /begin SUB_FUNCTION /end SUB_FUNCTION /end FUNCTION
/begin FUNCTION MOTAUS "Motor-Abstellen" /begin DEF_CHARACTERISTIC TNLSGMN TNLSGMX UBNLMN /end DEF_CHARACTERISTIC /begin REF_CHARACTERISTIC /end REF_CHARACTERISTIC /begin IN_MEASUREMENT B_airbag B_kl15 B_nmin B_pwf ub /end IN_MEASUREMENT
 /begin OUT_MEASUREMENT B_nachl B_nachlend B_nachlram B_nlacls B_nlale B_nlatm B_nlcan B_nldte B_nlEEPR B_nlmls B_nlobd B_nlsgls B_nlsiko B_nlwst swOffDlBits tnachl_w /end OUT_MEASUREMENT
 /begin LOC_MEASUREMENT /end LOC_MEASUREMENT
 /begin SUB_FUNCTION /end SUB_FUNCTION
/end FUNCTION
/begin FUNCTION msf "" /begin DEF_CHARACTERISTIC NMOTMSF TANSMSF TDMSF TMOTELIMSF TMSFDELTA TMSFSTART /end DEF_CHARACTERISTIC /begin REF_CHARACTERISTIC /end REF_CHARACTERISTIC /begin IN_MEASUREMENT B_vl gangi nmot tans wtmot /end IN_MEASUREMENT /begin OUT_MEASUREMENT B_msf B_msftmp tmotmsf /end OUT_MEASUREMENT /begin LOC_MEASUREMENT /end LOC_MEASUREMENT /begin SUB_FUNCTION /end SUB_FUNCTION /end FUNCTION
/begin FUNCTION NCOLL "" /begin DEF_CHARACTERISTIC CW_NCOLLAKT /end DEF_CHARACTERISTIC /begin REF_CHARACTERISTIC /end REF_CHARACTERISTIC /begin IN_MEASUREMENT Nmot /end IN_MEASUREMENT /begin OUT_MEASUREMENT Nc_cnt_ini Nc_cnt_kl15 Nc_cnt_nv /end OUT_MEASUREMENT /begin LOC_MEASUREMENT i_cnt /end LOC_MEASUREMENT /begin SUB_FUNCTION /end SUB_FUNCTION /end FUNCTION
/begin FUNCTION NMAXMD "Drehzahlbegrenzung"
 /begin DEF_CHARACTERISTIC DNMAXHG DNMAXLR KFMIRED1 MDIMX NMAX NMAXEPH NMAXLR NMAXPG NMAXPLR NMXDAEF NMXDKPU TNMXPRG TNMXPRLR UKWNMAXG UWNMAXLR VM_NMX_G4 VM_NMX_G5 VM_NMX_G6 VM_NMX_LG4 VM_NMX_LG5 VM_NMX_LG6 ZINMAXG ZINMAXLR /end DEF_CHARACTERISTIC
 /begin REF_CHARACTERISTIC SGA07MDUB /end REF_CHARACTERISTIC
 /begin IN_MEASUREMENT bfzglf B_dknolu B_dkpu B_lowra B_synph B_vmx_lim_nm B_vmx_nm esst_sga07mdub gangi mifab_w miist_w ngfil_w nmot_w rl uzkw_w wped /end IN_MEASUREMENT
 /begin OUT_MEASUREMENT B_nmax B_nmaxd minmx_w /end OUT_MEASUREMENT
 /begin LOC_MEASUREMENT anzkwu_w dmnmxi_w dmnmxp_w dnsi_w inmax minmxb_w minmxs mired1 nmotpr_w /end LOC_MEASUREMENT
 /begin SUB_FUNCTION /end SUB_FUNCTION
/end FUNCTION
/begin FUNCTION nmot_ref "" /begin DEF_CHARACTERISTIC /end DEF_CHARACTERISTIC /begin REF_CHARACTERISTIC /end REF_CHARACTERISTIC /begin IN_MEASUREMENT nmot_w /end IN_MEASUREMENT /begin OUT_MEASUREMENT /end OUT_MEASUREMENT /begin LOC_MEASUREMENT /end LOC_MEASUREMENT /begin SUB_FUNCTION /end SUB_FUNCTION /end FUNCTION
/begin FUNCTION OBDSV "OBD-Statusverwaltung" /begin DEF_CHARACTERISTIC /end DEF_CHARACTERISTIC /begin REF_CHARACTERISTIC /end REF_CHARACTERISTIC /begin IN_MEASUREMENT bbdcy bbwuc B_egscok B_pwf ffzdfp obdstegs /end IN_MEASUREMENT /begin OUT_MEASUREMENT B_blkfb B_milfb B_xff obdsteuer /end OUT_MEASUREMENT /begin LOC_MEASUREMENT /end LOC_MEASUREMENT /begin SUB_FUNCTION /end SUB_FUNCTION /end FUNCTION
/begin FUNCTION POWER_INCREASE ""
 /begin DEF_CHARACTERISTIC ONE_32 ONE_4 ONE_64 SCALING_PERC TPOS_THREE TRQINCRPM TRQINCZ1 TRQINCZ1_SF TRQINCZ2 TRQINCZ2_SF TRQINCZ3 TRQINC_Z TRQINC_Z_SF TRQMTRX TRQMTRX_X XSIZE YSIZE /end DEF_CHARACTERISTIC
 /begin REF_CHARACTERISTIC /end REF_CHARACTERISTIC
 /begin IN_MEASUREMENT dk_pos_asc drvSit mo_dre_asc mo_rpm_asc roadtype_w slipdev_w slip_w v_vradabs /end IN_MEASUREMENT
 /begin OUT_MEASUREMENT axis_w ds_w execute reltrq_fin reltrq_lim reltrq_old reltrq_red slip_mar_w tred2_w tred_w trqincfact trqspinfact /end OUT_MEASUREMENT
 /begin LOC_MEASUREMENT /end LOC_MEASUREMENT
 /begin SUB_FUNCTION /end SUB_FUNCTION
/end FUNCTION
/begin FUNCTION PROCESS "" /begin DEF_CHARACTERISTIC DL_CHECK_DEBUG_MODE /end DEF_CHARACTERISTIC /begin REF_CHARACTERISTIC /end REF_CHARACTERISTIC /begin IN_MEASUREMENT B_nachl B_nachlauf B_norm B_wakeup nmot /end IN_MEASUREMENT
 /begin OUT_MEASUREMENT bgCtr bg_predrive_Ctr bg_swoff_Ctr dlOvrunCtr fcmclrCtr firstsynchroCtr hw1Ctr hw2Ctr hw3Ctr hw4Ctr ini1_predrive_Ctr ini2_predrive_Ctr inisynchroCtr inisynct_w r1000msCtr r1000ms_predrive_Ctr r1000ms_swoff_Ctr r100msCtr r100ms_predrive_Ctr r100ms_swoff_Ctr r10msCtr r10ms_predrive_Ctr r10ms_swoff_Ctr r1msCtr r1ms_predrive_Ctr r1ms_swoff_Ctr r200msCtr r200ms_predrive_Ctr r200ms_swoff_Ctr r20msCtr r20ms_predrive_Ctr r20ms_swoff_Ctr r2msCtr r2ms_predrive_Ctr r2ms_swoff_Ctr r50msCtr r50ms_predrive_Ctr r50ms_swoff_Ctr rasfak synchroCtr synchroSwoffCtr /end OUT_MEASUREMENT
 /begin LOC_MEASUREMENT /end LOC_MEASUREMENT
 /begin SUB_FUNCTION /end SUB_FUNCTION
/end FUNCTION
/begin FUNCTION PROKON "Projektkonfiguration"
 /begin DEF_CHARACTERISTIC CDAGR CDDMTL CDHSH CDHSV CDHSVSA CDKAT CDKATSP CDKVS CDLASH CDLATP CDLATV CDLDP CDLLR CDLSH CDLSV CDLSVV CDMD CDNWS CDSLS CDSWE CDTANKL CDTES CWALE CWGEN CWGGMFL CWKONABG CWKONFLS CWKONLS CWMDAPP CWNSABG CWOBD CWPSGER CWPWF CWSLS CWUHR CWVL FZG_ON NSWO NSWO1 /end DEF_CHARACTERISTIC
 /begin REF_CHARACTERISTIC /end REF_CHARACTERISTIC
 /begin IN_MEASUREMENT nmot /end IN_MEASUREMENT
 /begin OUT_MEASUREMENT B_abkombi B_abstnl B_auakt B_cdagr B_cdanws B_cddmtl B_cdenws B_cdhsh B_cdhsv B_cdhsvsa B_cdkat B_cdkatsp B_cdkvs B_cdlash B_cdlatp B_cdlatv B_cdldp B_cdllr B_cdlsh B_cdlsv B_cdlsvv B_cdmd B_cdsls B_cdswe B_cdtankl B_cdtes B_cwggmfl B_cwggmfl1 B_fphubap B_fpwdkap B_fzg_on B_gene B_hubap B_katfz B_lsh B_lsh2 B_lsv B_lsv2 B_mrfavl B_ndsav B_nswo1 B_nswo2 B_psapp B_psger B_uhrrmin B_uhrrsec B_wdksap B_zwappl cd_bits1_w cd_bits2_w /end OUT_MEASUREMENT
 /begin LOC_MEASUREMENT /end LOC_MEASUREMENT
 /begin SUB_FUNCTION /end SUB_FUNCTION
/end FUNCTION
/begin FUNCTION RAD_V "" /begin DEF_CHARACTERISTIC ASC_SMPL HR_UMFG HR_ZAHN VR_UMFG VR_ZAHN /end DEF_CHARACTERISTIC /begin REF_CHARACTERISTIC /end REF_CHARACTERISTIC /begin IN_MEASUREMENT /end IN_MEASUREMENT
 /begin OUT_MEASUREMENT hr_chkdata hr_chkvld hr_dc hr_dc_alt hr_freq hr_f_alt hr_res_co hr_res_hi hr_res_pe hr_res_te hr_tpubusy hr_v hr_v_alt hr_v_w tcr2_ticks tick_val tpu_ticks vr_chkdata vr_chkvld vr_dc vr_dc_alt vr_freq vr_f_alt vr_res_co vr_res_hi vr_res_pe vr_res_te vr_tpubusy vr_v vr_v_alt vr_v_w /end OUT_MEASUREMENT
 /begin LOC_MEASUREMENT /end LOC_MEASUREMENT
 /begin SUB_FUNCTION /end SUB_FUNCTION
/end FUNCTION
/begin FUNCTION RDZV "" /begin DEF_CHARACTERISTIC KLRCKNTMOT TRDVINAKT /end DEF_CHARACTERISTIC /begin REF_CHARACTERISTIC /end REF_CHARACTERISTIC /begin IN_MEASUREMENT B_stend nzahn_w tmot /end IN_MEASUREMENT /begin OUT_MEASUREMENT B_rdvaktiv t_rdvinakt /end OUT_MEASUREMENT /begin LOC_MEASUREMENT /end LOC_MEASUREMENT /begin SUB_FUNCTION /end SUB_FUNCTION /end FUNCTION
/begin FUNCTION RESET_MON "" /begin DEF_CHARACTERISTIC /end DEF_CHARACTERISTIC /begin REF_CHARACTERISTIC /end REF_CHARACTERISTIC /begin IN_MEASUREMENT /end IN_MEASUREMENT
 /begin OUT_MEASUREMENT dr_reg_resetBuffer dr_reg_resetBuffer_cnt dr_reg_resetBuffer_idx dr_reg_resetTimestampBuffer dr_reg_resetTimestampBuffer_idx /end OUT_MEASUREMENT
 /begin LOC_MEASUREMENT /end LOC_MEASUREMENT
 /begin SUB_FUNCTION /end SUB_FUNCTION
/end FUNCTION
/begin FUNCTION RKTE "RKTE.     Berechnung effektive Einspritzdauer aus relativer Kraftstoffmasse rk"
 /begin DEF_CHARACTERISTIC CWPKAPP FKKVS FRHOKRSTTE FRLFSDP KFPSTEOFS KLKRKTE PSAPES TEMIN TVUB ZKPSTE /end DEF_CHARACTERISTIC
 /begin REF_CHARACTERISTIC CWFRPC /end REF_CHARACTERISTIC
 /begin IN_MEASUREMENT B_esukdk10 B_stend B_timesync_out dpsddss_w evz_austot fkez frpc_corr Fweza nmot nmot_w ps_w pu_w rk10_w rk2_10_w rk2_w rkakdk_o_w rkakdk_w rkwez_w rk_w rl_w Segakt tkrst ub vsfpses /end IN_MEASUREMENT
 /begin OUT_MEASUREMENT B_temin B_temin2 dpus_w frkte10_w frkte_w frlfsdp_w krkte10_w krkte_w pses_w pste_w te2_l te2_w tez_l tez_zsp_l te_l te_w tvu_w Zyl_zsp /end OUT_MEASUREMENT
 /begin LOC_MEASUREMENT fhkrst_w ftek2_w ftek_w tevfa2_l tevfa2_w tevfa_l tevfa_w /end LOC_MEASUREMENT
 /begin SUB_FUNCTION /end SUB_FUNCTION
/end FUNCTION
/begin FUNCTION ROADTYPE "" /begin DEF_CHARACTERISTIC LPRTDEFACT ROADTYPE RTCNEG RTCPOS RTDEFAULT RTLOSPDLIM /end DEF_CHARACTERISTIC /begin REF_CHARACTERISTIC /end REF_CHARACTERISTIC /begin IN_MEASUREMENT gearatio_w mo_dre_asc slipsemi_w v_hradabs v_vradabs /end IN_MEASUREMENT
 /begin OUT_MEASUREMENT B_roadtype mdwheel_w roadbuff_w roadpre_w roadtype_w sliproad_w /end OUT_MEASUREMENT
 /begin LOC_MEASUREMENT /end LOC_MEASUREMENT
 /begin SUB_FUNCTION /end SUB_FUNCTION
/end FUNCTION
/begin FUNCTION RUNTIME "" /begin DEF_CHARACTERISTIC CW_RUNTIME /end DEF_CHARACTERISTIC /begin REF_CHARACTERISTIC /end REF_CHARACTERISTIC /begin IN_MEASUREMENT /end IN_MEASUREMENT
 /begin OUT_MEASUREMENT common_rt performance rt_1000ms rt_100ms rt_10ms rt_10mss rt_1ms rt_1mss rt_200ms rt_20ms rt_20mss rt_2ms rt_2mss rt_50ms rt_50mss rt_bg rt_bg_brutto rt_bg_brutto_max rt_brutto_10ms rt_brutto_1ms rt_brutto_2ms rt_brutto_bg rt_brutto_syn rt_hw1 rt_hw1s rt_hw2 rt_hw2s rt_hw3 rt_hw3s rt_hw4 rt_hw4s rt_res5v rt_syn rt_syns rt_taskCamshaft1 rt_taskCamshaft2 rt_taskCamshaft3 rt_taskCamshaft4 rt_taskEveryToothIntISR rt_umtask /end OUT_MEASUREMENT
 /begin LOC_MEASUREMENT /end LOC_MEASUREMENT
 /begin SUB_FUNCTION /end SUB_FUNCTION
/end FUNCTION
/begin FUNCTION SG_IDENT "" /begin DEF_CHARACTERISTIC dataID /end DEF_CHARACTERISTIC /begin REF_CHARACTERISTIC /end REF_CHARACTERISTIC /begin IN_MEASUREMENT /end IN_MEASUREMENT /begin OUT_MEASUREMENT /end OUT_MEASUREMENT /begin LOC_MEASUREMENT /end LOC_MEASUREMENT /begin SUB_FUNCTION /end SUB_FUNCTION /end FUNCTION
/begin FUNCTION SLD ""
 /begin DEF_CHARACTERISTIC ABRABW CDSLV CWDSLVTEST DSLVTAO DSLVTAU DSLVTMO DSLVTMU KFDSLVEIN SABRCNT SDFRMO SDFRMU SDSLV SDSLVE SDSLVOF SDSLVON TDANFSLV TDBRFRM TDDSLVO TDFRGFRM /end DEF_CHARACTERISTIC
 /begin REF_CHARACTERISTIC DFRMST ZFRMST /end REF_CHARACTERISTIC
 /begin IN_MEASUREMENT B_adpini B_dynsln B_dynslrl B_fkvs B_flamad B_lr B_te E_dkp E_dkpa E_dsu E_kill E_kl15 E_llr E_ph E_sld E_sst E_stp1 E_ta E_teve E_tm E_u5vg3 frm2_w frm_w lamsons_w mlbb2_w mlbb_w msl2_w msl_w nmot rl_w tans tmot /end IN_MEASUREMENT
 /begin OUT_MEASUREMENT B_dslv B_dslva B_dslve fmslva fmslva2 /end OUT_MEASUREMENT
 /begin LOC_MEASUREMENT abrabw1 abrabw2 absdfrm absdfrm2 B_abgraden B_abrabwen B_abrdb B_abwcten B_adslv B_anfslv B_bdslv B_brfrm B_frgfrm B_frm1 B_frmde B_sabrabw fmslvaneu fmslvaneu2 frmslv1 frmslv2 frmslv21 frmslv22 sabrcount /end LOC_MEASUREMENT
 /begin SUB_FUNCTION /end SUB_FUNCTION
/end FUNCTION
/begin FUNCTION SLIPCALC ""
 /begin DEF_CHARACTERISTIC CURVECOMP CURVECORR DISTANCEDT LPSLIPFAC SLDEVFACZ1 SLDEVFACZ2 SLDEVFACZ3 SLDEVFACZ4 SLDEVFACZ5 SLDEVFACZA SLDIFFCORR TRACCORR /end DEF_CHARACTERISTIC
 /begin REF_CHARACTERISTIC /end REF_CHARACTERISTIC
 /begin IN_MEASUREMENT gearatio_w mo_dre_asc nmot_w rai_w roadtype_w tireforx_w tirefory_w v_hradabs v_vradabs /end IN_MEASUREMENT
 /begin OUT_MEASUREMENT devfac1_w devfac2_w slipcurv_w slipdev_w slipold_w slipraw_w slipsemi_w sliptrac_w slip_w /end OUT_MEASUREMENT
 /begin LOC_MEASUREMENT /end LOC_MEASUREMENT
 /begin SUB_FUNCTION /end SUB_FUNCTION
/end FUNCTION
/begin FUNCTION SLS "Sekund‰rluftsteuerung"
 /begin DEF_CHARACTERISTIC CWEBSLV CWFASL CWSLSON CWSLSOP CWSLSTE DPSLV FMSL FMSL2 FMSLOFF FMSRHOL FMSTMOT HYSSLSON IMLSLMN IMLSLMX IMLSLSA IMLSLSE KFFMSML KFSLSON KFSLVEIN KLTSLMX MLSLMX MSLUB SDYNSLN SDYNSLRL SSLSON SSLVOF SSLVON TANSSLVO TANSSLVU TASLSO TASLSU TDDSLA TDSLKT TDSLVEIN TFASLAMN TLMSSLAB TLMSSLMX TMFASLMN TMOTSLVO TMOTSLVU TMSSLO TMSSLSTO TMSSLSTU TMSSLU TMSTSLVO TMSTSLVU TSLABB TSLPMN TSLUBST TSLVEIN TVDSLOFF TVSLVOFF TVSLVON UBSLMN UBSLMX UBSLSTMN VSLS ZFLMSSL ZKSLPOFF ZKSLPON ZKSLSOFML ZKSLSONML ZKSLVOF ZKSLVON ZSLNLGFIL ZSLRLGFIL /end DEF_CHARACTERISTIC
 /begin REF_CHARACTERISTIC CWSLS /end REF_CHARACTERISTIC
 /begin IN_MEASUREMENT B_atmtpl B_brems B_btslv B_dslfa B_dslsp4 B_dslv B_dspe B_dwg B_fa B_fasls B_fs B_kh B_kha B_khab B_kuppl B_ll B_mslmn B_nmot B_sla B_slsfz B_st B_stend E_slv E_slv1e fmsla fmsla2 fmslva fmslva2 frhol_w imlpr mlbb2_w mlbb_w ml_w ngas_w nmot ps_w pu rl rlgas_w tans tmotzyl_w tmstzyl_w tnst_w ubsqf_w vfzg /end IN_MEASUREMENT
 /begin OUT_MEASUREMENT B_dslste B_dynsln B_dynslrl B_fasla B_lmsslof B_msloff B_mslon B_slkhof B_slp B_slpmn B_slpoff B_sls B_slsadap B_slsoab B_slsoff B_slson B_slste B_sls_me9 B_slv B_slvein B_slvkfein B_slvtdein flamsl2_w flamsl_w flmssl fmsldyn fmslrho fsldyn fsldynp fslpdyn msl msl2 msl2_w mslstat msl_w /end OUT_MEASUREMENT
 /begin LOC_MEASUREMENT B_dslreset B_dslset B_sldsl4 B_slkt B_slpena B_slpofst B_slsdis B_slserr B_slsinhi fmsagd fmsltm imlsla_w imlsle_w mslpub SLSlokBits /end LOC_MEASUREMENT
 /begin SUB_FUNCTION /end SUB_FUNCTION
/end FUNCTION
/begin FUNCTION SPI "" /begin DEF_CHARACTERISTIC /end DEF_CHARACTERISTIC /begin REF_CHARACTERISTIC /end REF_CHARACTERISTIC /begin IN_MEASUREMENT /end IN_MEASUREMENT /begin OUT_MEASUREMENT spi_max_transmission_time spi_transmission_time /end OUT_MEASUREMENT /begin LOC_MEASUREMENT /end LOC_MEASUREMENT /begin SUB_FUNCTION /end SUB_FUNCTION /end FUNCTION
/begin FUNCTION SSTBER ""
 /begin DEF_CHARACTERISTIC SAN12ESUW SDM05TESB SEH06KRUW SEZ06TMUB SFR04BBUW SGA07MDUB SGA08MDUB SKS06ESUB SLX06TMUW SLY06TMUW SML05DKUB SML05LKUB SML06TEUB SML06TMUW SML07TMUW SML08LHUB SN16KR1UB SN16KR2UB SNG06LLSB SNG06LLTSB SNM04TEUB SNM05DKUB SNM06LHUB SNM06LLUB SNM06MDUW SNM07ESUB SNM07LRUB SNM08FEUB SNM08GKUB SNM08KRUW SNM08LHUB SNM08OPUB SNM08ZUUB SNM08__UB SNM12ESUB SNM12FEUB SNM16GKUB SNM16KRUB SNM16OPUW SNM16ZUUB SNM24ZUUB1 SQM05TEUB SRL03ZUUB SRL04KRUB SRL06LHUB SRL06LRUB SRL08GKUB SRL12ESUB SRL12GKUB SRL12ZUUB SRL16ZUUB ST107TMUB ST207TMUB ST307TMUB ST407TMUB STA04SAUB STA06ESUB STM04FEUB STM04SAUB STM05SAUB STM05TMUB STM05TMUB1 STM05TMUB2 STM06LLTUB STM06LLUB STM08MDUB STM12ESUB STMZYL06__UW STMZYL08BBUW STMZYL08LEUW STMZYL09ESUW STMZYL12ESUB STSZYL12ESUB SWD06KRSW SWP08OPUB /end DEF_CHARACTERISTIC
 /begin REF_CHARACTERISTIC /end REF_CHARACTERISTIC
 /begin IN_MEASUREMENT anztib_w dmssginr etazwimt etazwist evhubi_w frhol_w frmit gangi kstaa lamsbg2_w lamsons_w ml ml_w ngfil nmot nmot_w nzwgru qmsdyn rl rl_w tabgmst tabgmst2 tabst_w tans tkatmst tkatmst2 tmot tmotzyl1_w tmotzyl2_w tmotzyl_w tmst tmstzyl1_w tmstzyl2_w tmstzyl_w ub vrlsol wdkba wdkba_w wped /end IN_MEASUREMENT
 /begin OUT_MEASUREMENT esst_san12esuw esst_sdm05tesb esst_seh06kruw esst_sez06tmub esst_sfr04bbuw esst_sga07mdub esst_sga08mdub esst_sks06esub esst_slx06tmuw esst_sly06tmuw esst_sml05dkub esst_sml05lkub esst_sml06teub esst_sml06tmuw esst_sml07tmuw esst_sml08lhub esst_sn16kr1ub esst_sn16kr2ub esst_sng06llsb esst_sng06lltsb esst_snm04teub esst_snm05dkub esst_snm06lhub esst_snm06llub esst_snm06mduw esst_snm07esub esst_snm07lrub esst_snm08feub esst_snm08gkub esst_snm08kruw esst_snm08lhub esst_snm08opub esst_snm08zuub esst_snm08__ub esst_snm12esub esst_snm12feub esst_snm16gkub esst_snm16krub esst_snm16opuw esst_snm16zuub esst_snm24zuub1 esst_sqm05teub esst_srl03zuub esst_srl04krub esst_srl06lhub esst_srl06lrub esst_srl08gkub esst_srl12esub esst_srl12gkub esst_srl12zuub esst_srl16zuub esst_st107tmub esst_st207tmub esst_st307tmub esst_st407tmub esst_sta04saub esst_sta06esub esst_stm04feub esst_stm04saub esst_stm05saub esst_stm05tmub esst_stm05tmub1 esst_stm05tmub2 esst_stm06lltub esst_stm06llub esst_stm08mdub esst_stm12esub esst_stmzyl06__uw esst_stmzyl08bbuw esst_stmzyl08leuw esst_stmzyl09esuw esst_stmzyl12esub esst_stmzyl1_12esub esst_stmzyl2_12esub esst_stszyl12esub esst_stszyl1_12esub esst_stszyl2_12esub esst_swd06krsw esst_swp08opub /end OUT_MEASUREMENT
 /begin LOC_MEASUREMENT /end LOC_MEASUREMENT
 /begin SUB_FUNCTION /end SUB_FUNCTION
/end FUNCTION
/begin FUNCTION STARTFREI "" /begin DEF_CHARACTERISTIC CW_secufkt /end DEF_CHARACTERISTIC /begin REF_CHARACTERISTIC /end REF_CHARACTERISTIC
 /begin IN_MEASUREMENT B_frgAnl B_MotorStp B_neutral B_nwtest B_rdvaktiv B_sperrEKP B_vnull ES_kill ES_kupp ES_sst Ews_auth frg_ASG vfzg /end IN_MEASUREMENT
 /begin OUT_MEASUREMENT /end OUT_MEASUREMENT
 /begin LOC_MEASUREMENT /end LOC_MEASUREMENT
 /begin SUB_FUNCTION /end SUB_FUNCTION
/end FUNCTION
/begin FUNCTION STMD "Startmoment" /begin DEF_CHARACTERISTIC KFMDST /end DEF_CHARACTERISTIC /begin REF_CHARACTERISTIC /end REF_CHARACTERISTIC /begin IN_MEASUREMENT B_llrein mimin_w mimxl1_w mrfamx_w nmotll nsst tmot /end IN_MEASUREMENT /begin OUT_MEASUREMENT mistt mrstt_w /end OUT_MEASUREMENT /begin LOC_MEASUREMENT qnst_w /end LOC_MEASUREMENT /begin SUB_FUNCTION /end SUB_FUNCTION /end FUNCTION
/begin FUNCTION SWADP "Software-Adapter" /begin DEF_CHARACTERISTIC CDSLSFZ SPRZG_AN S_ZNDRLP UHDMX /end DEF_CHARACTERISTIC /begin REF_CHARACTERISTIC /end REF_CHARACTERISTIC /begin IN_MEASUREMENT wvesp /end IN_MEASUREMENT
 /begin OUT_MEASUREMENT abmznd address anzeausb Asprl Asprlu avs_w B_ac B_acc B_agr B_bkvleer B_blkmd B_bteepcl B_btefgr B_btepcl B_btfgr B_btslp B_clradbbo B_clradkr B_clradkrd B_craus B_cvt B_cwlshdyn B_cwlshsch B_cwlshvl B_dknolu B_dkpt B_dkpu B_dldpte B_dmmtev B_dmtltz B_druck B_dtefrr B_dwg B_eepdif B_esnws B_estart B_etret B_faatm B_fabr B_faetr B_fakat B_fakat2 B_fakvs B_fash B_fatp B_fatp2 B_fatv B_fatv2 B_fgren B_fhz B_fofrun B_frgASG B_ftedab B_gd B_gdst B_gdvhub B_gdvvtueb B_gsaf B_hfm B_hls B_HLSKW B_ins2cok B_kmmilsct B_ko B_koger B_kse B_lamdkt B_lamdkt2 B_lowra B_lrssa B_lsuab B_lsuab2 B_lsvvsp B_masterhw B_mdarv B_mdee_kup B_mdkat B_mdwaner B_milmd B_nnot B_nsub B_ntkw B_nwmoff B_oelh B_phsnl B_phsnlinv B_sacvt B_savfgr B_sch B_sl B_slpet B_slsfz B_staa B_tal B_talval B_teza B_ubdve B_vlsumrb devhubi_w dpdk dpsddss_w dpssolgd_w dpssol_uw dpssol_w dps_w ekpausc Esprl Esprlu evhubi_w evhubs_w flgtiab frdter_w fzabgzyl_w gang_can kfdps_aus kopwm kstaa lamdkt2_w lamdkt_w lditv map_ary mdarsp_w mdkog mims_w misgsl_w mrfgr_w mshfm_w nslb nturbc_w pdpld psagr_w psl pte rkwez_w rlmax_w rltedte_w spuefot_w sumode S_eza tistzyl tka tol tumg udsl_w uefl_w uhsv uhsv2 ushk ushk2 ushk2_w ushk_w vfgr_w vrlsol Vsa_spri vsdmr Vse_spri vsfpses vsfrk vske vsns vsskrst vsvw vszw vszwkr wee wnwue zyleausb zzbank /end OUT_MEASUREMENT
 /begin LOC_MEASUREMENT /end LOC_MEASUREMENT
 /begin SUB_FUNCTION /end SUB_FUNCTION
/end FUNCTION
/begin FUNCTION SYSKN "" /begin DEF_CHARACTERISTIC /end DEF_CHARACTERISTIC /begin REF_CHARACTERISTIC /end REF_CHARACTERISTIC /begin IN_MEASUREMENT B_nmot /end IN_MEASUREMENT /begin OUT_MEASUREMENT timmot_w /end OUT_MEASUREMENT /begin LOC_MEASUREMENT /end LOC_MEASUREMENT /begin SUB_FUNCTION /end SUB_FUNCTION /end FUNCTION
/begin FUNCTION SYSKON "Systemkonstanten" /begin DEF_CHARACTERISTIC /end DEF_CHARACTERISTIC /begin REF_CHARACTERISTIC /end REF_CHARACTERISTIC /begin IN_MEASUREMENT /end IN_MEASUREMENT /begin OUT_MEASUREMENT /end OUT_MEASUREMENT /begin LOC_MEASUREMENT /end LOC_MEASUREMENT /begin SUB_FUNCTION /end SUB_FUNCTION /end FUNCTION
/begin FUNCTION SY_DFPM3 "" /begin DEF_CHARACTERISTIC /end DEF_CHARACTERISTIC /begin REF_CHARACTERISTIC /end REF_CHARACTERISTIC /begin IN_MEASUREMENT /end IN_MEASUREMENT /begin OUT_MEASUREMENT /end OUT_MEASUREMENT /begin LOC_MEASUREMENT /end LOC_MEASUREMENT /begin SUB_FUNCTION /end SUB_FUNCTION /end FUNCTION
/begin COMPU_METHOD afzg_sw_q0p0625 "" RAT_FUNC "%6.4" "km/h/s" COEFFS 0 1 0 0 0 0.0625 /end COMPU_METHOD
/begin COMPU_METHOD B_TRUE "" TAB_VERB "%6.3" "" COMPU_TAB_REF B_TRUE /end COMPU_METHOD
/begin COMPU_VTAB B_TRUE "" TAB_VERB 2 0 "false" 1 "TRUE" /end COMPU_VTAB
/begin COMPU_METHOD DEZ "" RAT_FUNC "%6.2" "" COEFFS 0 1 0 0 0 1 /end COMPU_METHOD
/begin COMPU_METHOD dez "" RAT_FUNC "%6.2" "" COEFFS 0 1 0 0 0 1 /end COMPU_METHOD
/begin COMPU_METHOD fak_sb_b1 "" RAT_FUNC "%6.4" "-" COEFFS 0 256 0 0 0 2 /end COMPU_METHOD
/begin COMPU_METHOD fak_sw_b2x "" RAT_FUNC "%6.3" "-" COEFFS 0 32768 -32768 0 0 1 /end COMPU_METHOD
/begin COMPU_METHOD fak_ub_b1 "" RAT_FUNC "%6.4" "-" COEFFS 0 256 0 0 0 1 /end COMPU_METHOD
/begin COMPU_METHOD fak_ub_b16 "" RAT_FUNC "%6.4" "-" COEFFS 0 256 0 0 0 16 /end COMPU_METHOD
/begin COMPU_METHOD fak_ub_b1p25_o0p75 "" RAT_FUNC "%6.3" "-" COEFFS 0 1 -0.75 0 0 0.00195313 /end COMPU_METHOD
/begin COMPU_METHOD fak_ub_b2 "" RAT_FUNC "%6.4" "-" COEFFS 0 256 0 0 0 2 /end COMPU_METHOD
/begin COMPU_METHOD fak_ub_b4 "" RAT_FUNC "%6.4" "-" COEFFS 0 256 0 0 0 4 /end COMPU_METHOD
/begin COMPU_METHOD fak_ub_b8 "" RAT_FUNC "%6.4" "-" COEFFS 0 256 0 0 0 8 /end COMPU_METHOD
/begin COMPU_METHOD fak_ub_q0p01 "" RAT_FUNC "%6.4" "-" COEFFS 0 1 0 0 0 0.01 /end COMPU_METHOD
/begin COMPU_METHOD fak_ub_q4p7Em7 "" RAT_FUNC "%9.8" "-" COEFFS 0 1 0 0 0 4.7e-007 /end COMPU_METHOD
/begin COMPU_METHOD fak_uw_b1 "" RAT_FUNC "%7.6" "-" COEFFS 0 65536 0 0 0 1 /end COMPU_METHOD
/begin COMPU_METHOD fak_uw_b16 "" RAT_FUNC "%6.5" "-" COEFFS 0 65536 0 0 0 16 /end COMPU_METHOD
/begin COMPU_METHOD fak_uw_b2 "" RAT_FUNC "%7.6" "-" COEFFS 0 65536 0 0 0 2 /end COMPU_METHOD
/begin COMPU_METHOD fak_uw_b32 "" RAT_FUNC "%6.5" "-" COEFFS 0 65536 0 0 0 32 /end COMPU_METHOD
/begin COMPU_METHOD fak_uw_b4 "" RAT_FUNC "%7.6" "-" COEFFS 0 65536 0 0 0 4 /end COMPU_METHOD
/begin COMPU_METHOD fak_uw_b64 "" RAT_FUNC "%6.5" "-" COEFFS 0 65536 0 0 0 64 /end COMPU_METHOD
/begin COMPU_METHOD fak_uw_b8 "" RAT_FUNC "%6.5" "-" COEFFS 0 65536 0 0 0 8 /end COMPU_METHOD
/begin COMPU_METHOD flae_uw_q0p016 "" RAT_FUNC "%6.4" "mm*gKW" COEFFS 0 1 0 0 0 0.016 /end COMPU_METHOD
/begin COMPU_METHOD fuel_ub_q1 "" RAT_FUNC "%6.2" "l" COEFFS 0 1 0 0 0 1 /end COMPU_METHOD
/begin COMPU_METHOD hub_uw_q0p001 "" RAT_FUNC "%6.5" "mm" COEFFS 0 1000 0 0 0 1 /end COMPU_METHOD
/begin COMPU_METHOD KennText "" RAT_FUNC "%6.2" "" COEFFS 0 1 0 0 0 1 /end COMPU_METHOD
/begin COMPU_METHOD kwq_ub_q0p04447 "" RAT_FUNC "%6.4" "Grad KWQ" COEFFS 0 25500 0 0 0 1134 /end COMPU_METHOD
/begin COMPU_METHOD kwq_ub_q0p35576 "" RAT_FUNC "%6.3" "Grad KWQ" COEFFS 0 25500 0 0 0 9072 /end COMPU_METHOD
/begin COMPU_METHOD kw_q1 "" RAT_FUNC "%6.2" "Grad KW" COEFFS 0 1 0 0 0 1 /end COMPU_METHOD
/begin COMPU_METHOD lws_q0p04375 "" RAT_FUNC "%6.4" "Grad" COEFFS 0 1 0 0 0 0.04375 /end COMPU_METHOD
/begin COMPU_METHOD md_ub_q1 "" RAT_FUNC "%6.2" "Nm" COEFFS 0 1 0 0 0 1 /end COMPU_METHOD
/begin COMPU_METHOD md_uw_q0p0625 "" RAT_FUNC "%6.4" "Nm" COEFFS 0 1 0 0 0 0.0625 /end COMPU_METHOD
/begin COMPU_METHOD m_q0p1 "" RAT_FUNC "%6.3" "kg/h" COEFFS 0 10 0 0 0 1 /end COMPU_METHOD
/begin COMPU_METHOD m_ub_b1020 "" RAT_FUNC "%6.2" "kg/h" COEFFS 0 1 0 0 0 4 /end COMPU_METHOD
/begin COMPU_METHOD m_ub_q0p4 "" RAT_FUNC "%6.3" "kg/h" COEFFS 0 1 0 0 0 0.4 /end COMPU_METHOD
/begin COMPU_METHOD m_uw_b102p4 "" RAT_FUNC "%6.4" "kg/h" COEFFS 0 65536 0 0 0 102.4 /end COMPU_METHOD
/begin COMPU_METHOD m_uw_b4660 "" RAT_FUNC "%6.4" "g" COEFFS 0 3600 0 0 0 256 /end COMPU_METHOD
/begin COMPU_METHOD m_uw_b6553p5 "" RAT_FUNC "%6.3" "kg/h" COEFFS 0 1 0 0 0 0.1 /end COMPU_METHOD
/begin COMPU_METHOD nmotg_sb_q100 "" RAT_FUNC "%6.0" "1/min/s" COEFFS 0 1 0 0 0 100 /end COMPU_METHOD
/begin COMPU_METHOD nmotg_sw_q0p39 "" RAT_FUNC "%6.3" "1/min/s" COEFFS 0 1 0 0 0 0.39063 /end COMPU_METHOD
/begin COMPU_METHOD nmot_q0p125 "" RAT_FUNC "%6.3" "1/min" COEFFS 0 8 0 0 0 1 /end COMPU_METHOD
/begin COMPU_METHOD nmot_sb_q10 "" RAT_FUNC "%6.1" "1/min" COEFFS 0 1 0 0 0 10 /end COMPU_METHOD
/begin COMPU_METHOD nmot_sw_q0p25 "" RAT_FUNC "%6.3" "1/min" COEFFS 0 1 0 0 0 0.25 /end COMPU_METHOD
/begin COMPU_METHOD nmot_ub_q10 "" RAT_FUNC "%6.1" "1/min" COEFFS 0 1 0 0 0 10 /end COMPU_METHOD
/begin COMPU_METHOD nmot_ub_q40 "" RAT_FUNC "%6.1" "1/min" COEFFS 0 1 0 0 0 40 /end COMPU_METHOD
/begin COMPU_METHOD nmot_uw_q0p25 "" RAT_FUNC "%6.3" "1/min" COEFFS 0 1 0 0 0 0.25 /end COMPU_METHOD
/begin COMPU_METHOD PCENT "" RAT_FUNC "%6.3" "%" COEFFS 0 256 0 0 0 100 /end COMPU_METHOD
/begin COMPU_METHOD p_q0p039 "" RAT_FUNC "%6.4" "hPa" COEFFS 0 256 0 0 0 10 /end COMPU_METHOD
/begin COMPU_METHOD p_q0p039s32768 "" RAT_FUNC "%7.1" "hPa" COEFFS 0 256 327680 0 0 10 /end COMPU_METHOD
/begin COMPU_METHOD p_sb_q32 "" RAT_FUNC "%6.3" "hPa" COEFFS 0 256 0 0 0 64 /end COMPU_METHOD
/begin COMPU_METHOD p_sw_q0p039 "" RAT_FUNC "%6.4" "hPa" COEFFS 0 256 0 0 0 10 /end COMPU_METHOD
/begin COMPU_METHOD p_ub_q5 "" RAT_FUNC "%6.2" "hPa" COEFFS 0 1 0 0 0 5 /end COMPU_METHOD
/begin COMPU_METHOD p_uw_q0p039 "" RAT_FUNC "%6.4" "hPa" COEFFS 0 256 0 0 0 10 /end COMPU_METHOD
/begin COMPU_METHOD relDK_q0p02441 "" RAT_FUNC "%6.4" "%DK" COEFFS 0 65536 0 0 0 1600 /end COMPU_METHOD
/begin COMPU_METHOD relnmot_q0p0039 "" RAT_FUNC "%6.4" "%/(1/min)" COEFFS 0 256 0 0 0 1 /end COMPU_METHOD
/begin COMPU_METHOD relNWU_q0p0234 "" RAT_FUNC "%6.4" "%/NWU" COEFFS 0 32 0 0 0 0.75 /end COMPU_METHOD
/begin COMPU_METHOD relPED_ub_b100 "" RAT_FUNC "%6.3" "%PED" COEFFS 0 255 0 0 0 100 /end COMPU_METHOD
/begin COMPU_METHOD rel_sb_q0p78 "" RAT_FUNC "%6.3" "%" COEFFS 0 1 0 0 0 0.78 /end COMPU_METHOD
/begin COMPU_METHOD rel_sw_b100 "" RAT_FUNC "%6.4" "%" COEFFS 0 32768 0 0 0 100 /end COMPU_METHOD
/begin COMPU_METHOD rel_sw_b1536 "" RAT_FUNC "%6.4" "%" COEFFS 0 65536 0 0 0 3072 /end COMPU_METHOD
/begin COMPU_METHOD rel_ub_b100 "" RAT_FUNC "%6.3" "%" COEFFS 0 255 0 0 0 100 /end COMPU_METHOD
/begin COMPU_METHOD rel_ub_b127p5 "" RAT_FUNC "%6.3" "%" COEFFS 0 2 0 0 0 1 /end COMPU_METHOD
/begin COMPU_METHOD rel_ub_b49p725 "" RAT_FUNC "%6.3" "%" COEFFS 0 255 0 0 0 49.725 /end COMPU_METHOD
/begin COMPU_METHOD rel_ub_b99p6 "" RAT_FUNC "%6.3" "%" COEFFS 0 256 0 0 0 100 /end COMPU_METHOD
/begin COMPU_METHOD rel_ub_q0p3906 "" RAT_FUNC "%6.3" "%" COEFFS 0 256 0 0 0 100 /end COMPU_METHOD
/begin COMPU_METHOD rel_ub_q0p75 "" RAT_FUNC "%6.3" "%" COEFFS 0 1 0 0 0 0.75 /end COMPU_METHOD
/begin COMPU_METHOD rel_ul_q0p0004 "" RAT_FUNC "%6.5" "%" COEFFS 0 2500 0 0 0 1 /end COMPU_METHOD
/begin COMPU_METHOD rel_uw_b100 "" RAT_FUNC "%6.4" "%" COEFFS 0 65536 0 0 0 100 /end COMPU_METHOD
/begin COMPU_METHOD rel_uw_b200 "" RAT_FUNC "%6.4" "%" COEFFS 0 65536 0 0 0 200 /end COMPU_METHOD
/begin COMPU_METHOD rel_uw_b3072 "" RAT_FUNC "%6.4" "%" COEFFS 0 65536 0 0 0 3072 /end COMPU_METHOD
/begin COMPU_METHOD rel_uw_q0p0234 "" RAT_FUNC "%6.4" "%" COEFFS 0 32 0 0 0 0.75 /end COMPU_METHOD
/begin COMPU_METHOD rkt_uw_b0p5 "" RAT_FUNC "%6.5" "" COEFFS 0 65536 0 0 0 32 /end COMPU_METHOD
/begin COMPU_METHOD spg_q0p00039 "" RAT_FUNC "%6.5" "V" COEFFS 0 1 0 0 0 0.000390625 /end COMPU_METHOD
/begin COMPU_METHOD spg_ubatt "" RAT_FUNC "%6.3" "V" COEFFS 0 1 0 0 0 0.0942 /end COMPU_METHOD
/begin COMPU_METHOD spg_ub_b5 "" RAT_FUNC "%6.4" "V" COEFFS 0 256 0 0 0 5 /end COMPU_METHOD
/begin COMPU_METHOD spg_ub_q0p0052_o0p2 "" RAT_FUNC "%6.3" "V" COEFFS 0 255 51 0 0 1.33 /end COMPU_METHOD
/begin COMPU_METHOD spg_uw_q0p00488 "" RAT_FUNC "%6.4" "V" COEFFS 0 1024 0 0 0 5 /end COMPU_METHOD
/begin COMPU_METHOD spg_uw_q0p00488_o1 "" RAT_FUNC "%6.3" "V" COEFFS 0 1024 1024 0 0 5 /end COMPU_METHOD
/begin COMPU_METHOD sprzi_q0p1 "" RAT_FUNC "%3.2" "Grad KW" COEFFS 0 10 0 0 0 1 /end COMPU_METHOD
/begin COMPU_METHOD sprzi_q0p8 "" RAT_FUNC "%6.2" "Grad KW" COEFFS 0 1 0 0 0 0.8 /end COMPU_METHOD
/begin COMPU_METHOD t100msxs_ub_b255 "" RAT_FUNC "%6.2" "s" COEFFS 0 1 0 0 0 1 /end COMPU_METHOD
/begin COMPU_METHOD t100msxs_ub_b25p5 "" RAT_FUNC "%6.3" "s" COEFFS 0 1 0 0 0 0.1 /end COMPU_METHOD
/begin COMPU_METHOD t100msxs_uw_b6553p6 "" RAT_FUNC "%6.3" "s" COEFFS 0 10 0 0 0 1 /end COMPU_METHOD
/begin COMPU_METHOD t100msxs_uw_q100 "" RAT_FUNC "%6.3" "s" COEFFS 0 1 0 0 0 0.1 /end COMPU_METHOD
/begin COMPU_METHOD t10msxs_ub_b2p55 "" RAT_FUNC "%6.4" "s" COEFFS 0 1 0 0 0 0.01 /end COMPU_METHOD
/begin COMPU_METHOD t10msxs_uw_b655p35 "" RAT_FUNC "%6.4" "s" COEFFS 0 1 0 0 0 0.01 /end COMPU_METHOD
/begin COMPU_METHOD t16p0usxms "" RAT_FUNC "%6.4" "ms" COEFFS 0 1000 0 0 0 16 /end COMPU_METHOD
/begin COMPU_METHOD t1msxms_q1 "" RAT_FUNC "%6.2" "ms" COEFFS 0 1 0 0 0 1 /end COMPU_METHOD
/begin COMPU_METHOD t1p0usxms "" RAT_FUNC "%6.5" "ms" COEFFS 0 1000 0 0 0 1 /end COMPU_METHOD
/begin COMPU_METHOD t20msxs_ub_b5p1 "" RAT_FUNC "%6.4" "s" COEFFS 0 1 0 0 0 0.02 /end COMPU_METHOD
/begin COMPU_METHOD t20msxs_uw_q0p02 "" RAT_FUNC "%6.4" "s" COEFFS 0 1 0 0 0 0.02 /end COMPU_METHOD
/begin COMPU_METHOD t8p0usxms "" RAT_FUNC "%6.4" "ms" COEFFS 0 1000 0 0 0 8 /end COMPU_METHOD
/begin COMPU_METHOD temp_ub_q0p75_o48 "" RAT_FUNC "%6.2" "Grad C" COEFFS 0 1 48 0 0 0.75 /end COMPU_METHOD
/begin COMPU_METHOD temp_ub_q1_o48 "" RAT_FUNC "%6.2" "" COEFFS 0 1 48 0 0 1 /end COMPU_METHOD
/begin COMPU_METHOD temp_ub_q5_o50 "" RAT_FUNC "%6.2" "Grad C" COEFFS 0 1 50 0 0 5 /end COMPU_METHOD
/begin COMPU_METHOD temp_uw_q0p75_o48 "" RAT_FUNC "%6.2" "Grad C" COEFFS 0 1 48 0 0 0.75 /end COMPU_METHOD
/begin COMPU_METHOD txms_uw_q0p0004 "" RAT_FUNC "%6.5" "ms" COEFFS 0 2500 0 0 0 1 /end COMPU_METHOD
/begin COMPU_METHOD txms_uw_q0p0032 "" RAT_FUNC "%6.4" "ms" COEFFS 0 625 0 0 0 2 /end COMPU_METHOD
/begin COMPU_METHOD vfzg_sw_q0p00781 "" RAT_FUNC "%6.4" "km/h" COEFFS 0 1 0 0 0 0.0078125 /end COMPU_METHOD
/begin COMPU_METHOD vfzg_ub_q1p25 "" RAT_FUNC "%6.2" "km/h" COEFFS 0 1 0 0 0 1.25 /end COMPU_METHOD
/begin COMPU_METHOD vfzg_uw_b512 "" RAT_FUNC "%6.4" "km/h" COEFFS 0 65536 0 0 0 512 /end COMPU_METHOD
/begin COMPU_METHOD vfzg_uw_q0p00781 "" RAT_FUNC "%6.4" "km/h" COEFFS 0 1 0 0 0 0.0078125 /end COMPU_METHOD
/begin COMPU_METHOD vfzg_uw_q0p0625 "" RAT_FUNC "%6.4" "km/h" COEFFS 0 1 0 0 0 0.0625 /end COMPU_METHOD
/begin COMPU_METHOD wink_uw_q0p1 "" RAT_FUNC "%6.3" "Grad" COEFFS 0 10 0 0 0 1 /end COMPU_METHOD
/begin COMPU_METHOD zk100msxs_ub_b25p5 "" RAT_FUNC "%6.3" "s" COEFFS 0 0 256 0 10 0 /end COMPU_METHOD
/begin COMPU_METHOD zk100msxs_uw_b6553 "" RAT_FUNC "%10.3" "s" COEFFS 0 0 65536 0 10 0 /end COMPU_METHOD
/begin COMPU_METHOD zk10msxs_ub_b2p55 "" RAT_FUNC "%6.4" "s" COEFFS 0 0 255 0 100 0 /end COMPU_METHOD
/begin COMPU_METHOD zk10msxs_uw_b655 "" RAT_FUNC "%10.4" "s" COEFFS 0 0 65536 0 100 0 /end COMPU_METHOD
/begin COMPU_METHOD zk20msxs_ub_b5p1 "" RAT_FUNC "%6.4" "s" COEFFS 0 0 5.1 0 1 0 /end COMPU_METHOD
/begin COMPU_METHOD zw_sb_q0p75 "" RAT_FUNC "%6.3" "Grad KW" COEFFS 0 255 0 0 0 191.25 /end COMPU_METHOD
/begin COMPU_METHOD zw_sb_q6 "" RAT_FUNC "%6.2" "Grad KW" COEFFS 0 1 0 0 0 6 /end COMPU_METHOD
/begin COMPU_METHOD zw_sb_qn0p75 "" RAT_FUNC "%6.4" "Grad KW" COEFFS 0 1 0 0 0 -0.75 /end COMPU_METHOD
/begin COMPU_METHOD zw_ub_q6 "" RAT_FUNC "%6.2" "Grad KW" COEFFS 0 255 0 0 0 1530 /end COMPU_METHOD
/begin COMPU_METHOD default "" RAT_FUNC "%6.2" "" COEFFS 0 1 0 0 0 1 /end COMPU_METHOD
/begin RECORD_LAYOUT FklWSb FNC_VALUES 1 SBYTE COLUMN_DIR DIRECT /end RECORD_LAYOUT
/begin RECORD_LAYOUT FklWUb FNC_VALUES 1 UBYTE COLUMN_DIR DIRECT /end RECORD_LAYOUT
/begin RECORD_LAYOUT GkfWUb FNC_VALUES 1 UBYTE COLUMN_DIR DIRECT /end RECORD_LAYOUT
/begin RECORD_LAYOUT GklWSw FNC_VALUES 1 SWORD COLUMN_DIR DIRECT /end RECORD_LAYOUT
/begin RECORD_LAYOUT GklWUb FNC_VALUES 1 UBYTE COLUMN_DIR DIRECT /end RECORD_LAYOUT
/begin RECORD_LAYOUT GklWUw FNC_VALUES 1 UWORD COLUMN_DIR DIRECT /end RECORD_LAYOUT
/begin RECORD_LAYOUT KfAxU8AyU8SstxU16SstyU16WU16 NO_AXIS_PTS_X 1 UWORD NO_AXIS_PTS_Y 2 UWORD AXIS_PTS_X 3 UWORD INDEX_INCR DIRECT AXIS_PTS_Y 4 UWORD INDEX_INCR DIRECT FNC_VALUES 5 UWORD COLUMN_DIR DIRECT /end RECORD_LAYOUT
/begin RECORD_LAYOUT KfAxUbAyUbSstxUbSstyUbWUb NO_AXIS_PTS_X 1 UBYTE NO_AXIS_PTS_Y 2 UBYTE AXIS_PTS_X 3 UBYTE INDEX_INCR DIRECT AXIS_PTS_Y 4 UBYTE INDEX_INCR DIRECT FNC_VALUES 5 UBYTE COLUMN_DIR DIRECT /end RECORD_LAYOUT
/begin RECORD_LAYOUT KfAxUbAyUbSstxUbSstyUwWUw NO_AXIS_PTS_X 1 UBYTE NO_AXIS_PTS_Y 2 UBYTE AXIS_PTS_X 3 UBYTE INDEX_INCR DIRECT AXIS_PTS_Y 4 UWORD INDEX_INCR DIRECT FNC_VALUES 5 UWORD COLUMN_DIR DIRECT /end RECORD_LAYOUT
/begin RECORD_LAYOUT KfAxUbAyUbSstxUwSstyUbWUb NO_AXIS_PTS_X 1 UBYTE NO_AXIS_PTS_Y 2 UBYTE AXIS_PTS_X 3 UWORD INDEX_INCR DIRECT AXIS_PTS_Y 4 UBYTE INDEX_INCR DIRECT FNC_VALUES 5 UBYTE COLUMN_DIR DIRECT /end RECORD_LAYOUT
/begin RECORD_LAYOUT KfAxUwAyUwSstxSwSstySwWUw NO_AXIS_PTS_X 1 UWORD NO_AXIS_PTS_Y 2 UWORD AXIS_PTS_X 3 SWORD INDEX_INCR DIRECT AXIS_PTS_Y 4 SWORD INDEX_INCR DIRECT FNC_VALUES 5 UWORD COLUMN_DIR DIRECT /end RECORD_LAYOUT
/begin RECORD_LAYOUT KfAxUwAyUwSstxUwSstySwWUw NO_AXIS_PTS_X 1 UWORD NO_AXIS_PTS_Y 2 UWORD AXIS_PTS_X 3 UWORD INDEX_INCR DIRECT AXIS_PTS_Y 4 SWORD INDEX_INCR DIRECT FNC_VALUES 5 UWORD COLUMN_DIR DIRECT /end RECORD_LAYOUT
/begin RECORD_LAYOUT KfAxUwAyUwSstxUwSstyUwWSw NO_AXIS_PTS_X 1 UWORD NO_AXIS_PTS_Y 2 UWORD AXIS_PTS_X 3 UWORD INDEX_INCR DIRECT AXIS_PTS_Y 4 UWORD INDEX_INCR DIRECT FNC_VALUES 5 SWORD COLUMN_DIR DIRECT /end RECORD_LAYOUT
/begin RECORD_LAYOUT KfAxUwAyUwSstxUwSstyUwWUw NO_AXIS_PTS_X 1 UWORD NO_AXIS_PTS_Y 2 UWORD AXIS_PTS_X 3 UWORD INDEX_INCR DIRECT AXIS_PTS_Y 4 UWORD INDEX_INCR DIRECT FNC_VALUES 5 UWORD COLUMN_DIR DIRECT /end RECORD_LAYOUT
/begin RECORD_LAYOUT KlAUbSstUbWUb NO_AXIS_PTS_X 1 UBYTE AXIS_PTS_X 2 UBYTE INDEX_INCR DIRECT FNC_VALUES 3 UBYTE COLUMN_DIR DIRECT /end RECORD_LAYOUT
/begin RECORD_LAYOUT KlAUbSstUwWUw NO_AXIS_PTS_X 1 UWORD AXIS_PTS_X 2 UWORD INDEX_INCR DIRECT FNC_VALUES 3 UWORD COLUMN_DIR DIRECT /end RECORD_LAYOUT
/begin RECORD_LAYOUT KlAUwSstSwWUw NO_AXIS_PTS_X 1 UWORD AXIS_PTS_X 2 SWORD INDEX_INCR DIRECT FNC_VALUES 3 UWORD COLUMN_DIR DIRECT /end RECORD_LAYOUT
/begin RECORD_LAYOUT KlAUwSstUwWUw NO_AXIS_PTS_X 1 UWORD AXIS_PTS_X 2 UWORD INDEX_INCR DIRECT FNC_VALUES 3 UWORD COLUMN_DIR DIRECT /end RECORD_LAYOUT
/begin RECORD_LAYOUT KlAxU8SstxS16WS16 NO_AXIS_PTS_X 1 SWORD AXIS_PTS_X 2 SWORD INDEX_INCR DIRECT FNC_VALUES 3 SWORD COLUMN_DIR DIRECT /end RECORD_LAYOUT
/begin RECORD_LAYOUT KlAxU8SstxU16WS16 NO_AXIS_PTS_X 1 UWORD AXIS_PTS_X 2 UWORD INDEX_INCR DIRECT FNC_VALUES 3 SWORD COLUMN_DIR DIRECT /end RECORD_LAYOUT
/begin RECORD_LAYOUT KlAxU8SstxU16WU16 NO_AXIS_PTS_X 1 UWORD AXIS_PTS_X 2 UWORD INDEX_INCR DIRECT FNC_VALUES 3 UWORD COLUMN_DIR DIRECT /end RECORD_LAYOUT
/begin RECORD_LAYOUT KwbWU8 FNC_VALUES 1 UBYTE COLUMN_DIR DIRECT /end RECORD_LAYOUT
/begin RECORD_LAYOUT KwSw FNC_VALUES 1 SWORD COLUMN_DIR DIRECT /end RECORD_LAYOUT
/begin RECORD_LAYOUT KwUb FNC_VALUES 1 UBYTE COLUMN_DIR DIRECT /end RECORD_LAYOUT
/begin RECORD_LAYOUT KwUw FNC_VALUES 1 UWORD COLUMN_DIR DIRECT /end RECORD_LAYOUT
/begin RECORD_LAYOUT KwWU16 FNC_VALUES 1 UWORD COLUMN_DIR DIRECT /end RECORD_LAYOUT
/begin RECORD_LAYOUT KwWU32 FNC_VALUES 1 ULONG COLUMN_DIR DIRECT /end RECORD_LAYOUT
/begin RECORD_LAYOUT KwWU8 FNC_VALUES 1 UBYTE COLUMN_DIR DIRECT /end RECORD_LAYOUT
/begin RECORD_LAYOUT SstASwSstSw NO_AXIS_PTS_X 1 SWORD AXIS_PTS_X 2 SWORD INDEX_INCR DIRECT /end RECORD_LAYOUT
/begin RECORD_LAYOUT SstAU8SstS8 NO_AXIS_PTS_X 1 SBYTE AXIS_PTS_X 2 SBYTE INDEX_INCR DIRECT /end RECORD_LAYOUT
/begin RECORD_LAYOUT SstAU8SstU16 NO_AXIS_PTS_X 1 UWORD AXIS_PTS_X 2 UWORD INDEX_INCR DIRECT /end RECORD_LAYOUT
/begin RECORD_LAYOUT SstAU8SstU8 NO_AXIS_PTS_X 1 UBYTE AXIS_PTS_X 2 UBYTE INDEX_INCR DIRECT /end RECORD_LAYOUT
/begin RECORD_LAYOUT SstAUbSstSb NO_AXIS_PTS_X 1 UBYTE AXIS_PTS_X 2 SBYTE INDEX_INCR DIRECT /end RECORD_LAYOUT
/begin RECORD_LAYOUT SstAUbSstUb NO_AXIS_PTS_X 1 UBYTE AXIS_PTS_X 2 UBYTE INDEX_INCR DIRECT /end RECORD_LAYOUT
/begin RECORD_LAYOUT SstAUwSstUw NO_AXIS_PTS_X 1 UWORD AXIS_PTS_X 2 UWORD INDEX_INCR DIRECT /end RECORD_LAYOUT
/end MODULE
/end PROJECT
