ASAP2_VERSION 1 3
/begin PROJECT basisme9 ""
/begin HEADER "" VERSION "basisme9" PROJECT_NO basisme9 /end HEADER
/begin MODULE DIM ""
/begin MOD_COMMON "" BYTE_ORDER MSB_FIRST ALIGNMENT_BYTE 1 ALIGNMENT_WORD 2 ALIGNMENT_LONG 2 ALIGNMENT_FLOAT32_IEEE 4 /end MOD_COMMON
/begin CHARACTERISTIC AKLEFA "" VAL_BLK 0x4E2D84 KwbUb 255.0 dez 0.00 255.0 FORMAT "%5.1" NUMBER 1 /end CHARACTERISTIC
/begin CHARACTERISTIC AKU_E_DEC "" VALUE 0x4ECAC4 KwSw 3276.100 fak_q0p1 0.6000000 3276.700 FORMAT "%8.3" /end CHARACTERISTIC
/begin CHARACTERISTIC AKU_POS_G2 "" VALUE 0x4ECAC6 KwSw 6553.500 fak_q0p1 -3276.800 3276.700 FORMAT "%8.3" /end CHARACTERISTIC
/begin CHARACTERISTIC AKU_POS_G3 "" VALUE 0x4ECAC8 KwSw 6553.500 fak_q0p1 -3276.800 3276.700 FORMAT "%8.3" /end CHARACTERISTIC
/begin CHARACTERISTIC AKU_POS_G4 "" VALUE 0x4ECACA KwSw 6553.500 fak_q0p1 -3276.800 3276.700 FORMAT "%8.3" /end CHARACTERISTIC
/begin CHARACTERISTIC ASC_SOFT_AN "" VALUE 0x4E29EC KwUw 65535.00 dez 0.00 65535.00 FORMAT "%8.2" /end CHARACTERISTIC
/begin CHARACTERISTIC BYPENDPOS "Final rest position of stepper after power down" VALUE 0x4E520E KwUw 99.99847 rel_uw_b100 0.00 99.99847 FORMAT "%8.5" /end CHARACTERISTIC
/begin CHARACTERISTIC BYPHIHYST "Upper speed hysteresis for selecting max resonance speed" VALUE 0x4E5210 KwSw 3276.700 fak_q0p1 0.00 3276.700 FORMAT "%8.3" /end CHARACTERISTIC
/begin CHARACTERISTIC BYPLOHYST "Lower speed hysteresis for selecting min resonance speed" VALUE 0x4E5212 KwSw 3276.700 fak_q0p1 0.00 3276.700 FORMAT "%8.3" /end CHARACTERISTIC
/begin CHARACTERISTIC BYPMAXRES "Max resonance speed of motor (steps/sec)" VAL_BLK 0x4E5214 KwbSw 6553.500 fak_q0p1 -3276.800 3276.700 FORMAT "%8.3" NUMBER 2 /end CHARACTERISTIC
/begin CHARACTERISTIC BYPMINRES "Min resonance speed of motor (steps/sec)" VAL_BLK 0x4E5218 KwbSw 6553.500 fak_q0p1 -3276.800 3276.700 FORMAT "%8.3" NUMBER 2 /end CHARACTERISTIC
/begin CHARACTERISTIC CBGRLP "Codewort Konfiguration Funktion BGRLP" VALUE 0x4E3FE8 KwUb 255.0 dez 0.00 255.0 FORMAT "%5.1" /end CHARACTERISTIC
/begin CHARACTERISTIC CDCAAA "Dummy: Tabellenanfang" VAL_BLK 0x4F01BA KwbUw 65535.00 dez 0.00 65535.00 FORMAT "%8.2" NUMBER 4 /end CHARACTERISTIC
/begin CHARACTERISTIC CDCAKLE "" VAL_BLK 0x4F01CA KwbWU16 65535.00 dez 0.00 65535.00 FORMAT "%8.2" NUMBER 4 /end CHARACTERISTIC
/begin CHARACTERISTIC CDCAS "" VAL_BLK 0x4F01D2 KwbWU16 65535.00 dez 0.00 65535.00 FORMAT "%8.2" NUMBER 4 /end CHARACTERISTIC
/begin CHARACTERISTIC CDCBM "Codewort CARB: Bezugsmarkengeber" VAL_BLK 0x4F01DA KwbUw 65535.00 dez 0.00 65535.00 FORMAT "%8.2" NUMBER 4 /end CHARACTERISTIC
/begin CHARACTERISTIC CDCCABS "Codewort CARB: CAN-Schnittstelle, Timeout ABS" VAL_BLK 0x4F01EA KwbWU16 65535.00 dez 0.00 65535.00 FORMAT "%8.2" NUMBER 4 /end CHARACTERISTIC
/begin CHARACTERISTIC CDCCANA "" VAL_BLK 0x4F01F2 KwbWU16 65535.00 dez 0.00 65535.00 FORMAT "%8.2" NUMBER 4 /end CHARACTERISTIC
/begin CHARACTERISTIC CDCCAS "" VAL_BLK 0x4F01FA KwbWU16 65535.00 dez 0.00 65535.00 FORMAT "%8.2" NUMBER 4 /end CHARACTERISTIC
/begin CHARACTERISTIC CDCCKOMBI "Codewort CARB: CAN-Schnittstelle, Timeout KOMBI" VAL_BLK 0x4F0202 KwbWU16 65535.00 dez 0.00 65535.00 FORMAT "%8.2" NUMBER 4 /end CHARACTERISTIC
/begin CHARACTERISTIC CDCCZFE "Codewort CARB: CAN-Schnittstelle, Timeout ZFE" VAL_BLK 0x4F020A KwbWU16 65535.00 dez 0.00 65535.00 FORMAT "%8.2" NUMBER 4 /end CHARACTERISTIC
/begin CHARACTERISTIC CDCDKP "" VAL_BLK 0x4F0212 KwbWU16 65535.00 dez 0.00 65535.00 FORMAT "%8.2" NUMBER 4 /end CHARACTERISTIC
/begin CHARACTERISTIC CDCDKPA "" VAL_BLK 0x4F021A KwbWU16 65535.00 dez 0.00 65535.00 FORMAT "%8.2" NUMBER 4 /end CHARACTERISTIC
/begin CHARACTERISTIC CDCEKPE "Codewort CARB: EKPE" VAL_BLK 0x4F024A KwbWU16 65535.00 dez 0.00 65535.00 FORMAT "%8.2" NUMBER 4 /end CHARACTERISTIC
/begin CHARACTERISTIC CDCEV1E "Codewort CARB: EV1E" VAL_BLK 0x4F0252 KwbWU16 65535.00 dez 0.00 65535.00 FORMAT "%8.2" NUMBER 4 /end CHARACTERISTIC
/begin CHARACTERISTIC CDCEV2E "Codewort CARB: EV2E" VAL_BLK 0x4F025A KwbWU16 65535.00 dez 0.00 65535.00 FORMAT "%8.2" NUMBER 4 /end CHARACTERISTIC
/begin CHARACTERISTIC CDCEV3E "Codewort CARB: EV3E" VAL_BLK 0x4F0262 KwbWU16 65535.00 dez 0.00 65535.00 FORMAT "%8.2" NUMBER 4 /end CHARACTERISTIC
/begin CHARACTERISTIC CDCEV4E "Codewort CARB: EV4E" VAL_BLK 0x4F026A KwbWU16 65535.00 dez 0.00 65535.00 FORMAT "%8.2" NUMBER 4 /end CHARACTERISTIC
/begin CHARACTERISTIC CDCEWS "" VAL_BLK 0x4F0272 KwbWU16 65535.00 dez 0.00 65535.00 FORMAT "%8.2" NUMBER 4 /end CHARACTERISTIC
/begin CHARACTERISTIC CDCEWSE "Codewort CARB: EWSE" VAL_BLK 0x4F027A KwbWU16 65535.00 dez 0.00 65535.00 FORMAT "%8.2" NUMBER 4 /end CHARACTERISTIC
/begin CHARACTERISTIC CDCKAT "Codewort CARB:	Katalysator-Konvertierung" VAL_BLK 0x4F02E2 KwbWU16 65535.00 dez 0.00 65535.00 FORMAT "%8.2" NUMBER 4 /end CHARACTERISTIC
/begin CHARACTERISTIC CDCKILL "Codewort CARB: Diagnose Killschalter" VAL_BLK 0x4F02FA KwbWU16 65535.00 dez 0.00 65535.00 FORMAT "%8.2" NUMBER 4 /end CHARACTERISTIC
/begin CHARACTERISTIC CDCKL15 "Codewort CARB: Diagnose Klemme 15 Schalter" VAL_BLK 0x4F0302 KwbWU16 65535.00 dez 0.00 65535.00 FORMAT "%8.2" NUMBER 4 /end CHARACTERISTIC
/begin CHARACTERISTIC CDCKRNT "Codewort CARB:	Klopfregelung Nulltest" VAL_BLK 0x4F030A KwbUw 65535.00 dez 0.00 65535.00 FORMAT "%8.2" NUMBER 4 /end CHARACTERISTIC
/begin CHARACTERISTIC CDCKROF "Codewort CARB: Klopfregelung Offset" VAL_BLK 0x4F0312 KwbUw 65535.00 dez 0.00 65535.00 FORMAT "%8.2" NUMBER 4 /end CHARACTERISTIC
/begin CHARACTERISTIC CDCKRTP "Codewort CARB: Klopfregelung Testimpulse" VAL_BLK 0x4F031A KwbUw 65535.00 dez 0.00 65535.00 FORMAT "%8.2" NUMBER 4 /end CHARACTERISTIC
/begin CHARACTERISTIC CDCKS "" VAL_BLK 0x4F0322 KwbUw 65535.00 dez 0.00 65535.00 FORMAT "%8.2" NUMBER 4 /end CHARACTERISTIC
/begin CHARACTERISTIC CDCKS1 "Codewort CARB:	Klopfsensor 1" VAL_BLK 0x4F032A KwbUw 65535.00 dez 0.00 65535.00 FORMAT "%8.2" NUMBER 4 /end CHARACTERISTIC
/begin CHARACTERISTIC CDCKS2 "Codewort CARB:	Klopfsensor 2" VAL_BLK 0x4F0332 KwbUw 65535.00 dez 0.00 65535.00 FORMAT "%8.2" NUMBER 4 /end CHARACTERISTIC
/begin CHARACTERISTIC CDCN "Codewort CARB: Drehzahlsignalgeber" VAL_BLK 0x4F0392 KwbUw 65535.00 dez 0.00 65535.00 FORMAT "%8.2" NUMBER 4 /end CHARACTERISTIC
/begin CHARACTERISTIC CDCZZZ "Dummy: Tabellenende" VAL_BLK 0x4F04DA KwbUw 65535.00 dez 0.00 65535.00 FORMAT "%8.2" NUMBER 4 /end CHARACTERISTIC
/begin CHARACTERISTIC CDKAAA "Dummy: Tabellenanfang" VALUE 0x4F04E2 KwUw 65535.00 dez 0.00 65535.00 FORMAT "%8.2" /end CHARACTERISTIC
/begin CHARACTERISTIC CDKAKLE "" VALUE 0x4F04E6 KwWU16 65535.00 dez 0.00 65535.00 FORMAT "%8.2" /end CHARACTERISTIC
/begin CHARACTERISTIC CDKAS "" VALUE 0x4F04E8 KwWU16 65535.00 dez 0.00 65535.00 FORMAT "%8.2" /end CHARACTERISTIC
/begin CHARACTERISTIC CDKBM "Codewort Kunde: Bezugsmarkengeber" VALUE 0x4F04EA KwUw 65535.00 dez 0.00 65535.00 FORMAT "%8.2" /end CHARACTERISTIC
/begin CHARACTERISTIC CDKCABS "Codewort Kunde: CAN- timeout, ABS" VALUE 0x4F04EE KwWU16 65535.00 dez 0.00 65535.00 FORMAT "%8.2" /end CHARACTERISTIC
/begin CHARACTERISTIC CDKCANA "" VALUE 0x4F04F0 KwWU16 65535.00 dez 0.00 65535.00 FORMAT "%8.2" /end CHARACTERISTIC
/begin CHARACTERISTIC CDKCAS "" VALUE 0x4F04F2 KwWU16 65535.00 dez 0.00 65535.00 FORMAT "%8.2" /end CHARACTERISTIC
/begin CHARACTERISTIC CDKCKOMBI "Codewort Kunde: CAN- timeout, KOMBI" VALUE 0x4F04F4 KwWU16 65535.00 dez 0.00 65535.00 FORMAT "%8.2" /end CHARACTERISTIC
/begin CHARACTERISTIC CDKCZFE "Codewort Kunde: CAN- timeout, ZFE" VALUE 0x4F04F6 KwWU16 65535.00 dez 0.00 65535.00 FORMAT "%8.2" /end CHARACTERISTIC
/begin CHARACTERISTIC CDKDKP "" VALUE 0x4F04F8 KwWU16 65535.00 dez 0.00 65535.00 FORMAT "%8.2" /end CHARACTERISTIC
/begin CHARACTERISTIC CDKDKPA "" VALUE 0x4F04FA KwWU16 65535.00 dez 0.00 65535.00 FORMAT "%8.2" /end CHARACTERISTIC
/begin CHARACTERISTIC CDKEKPE "Codewort Kunde: EKPE" VALUE 0x4F0506 KwWU16 65535.00 dez 0.00 65535.00 FORMAT "%8.2" /end CHARACTERISTIC
/begin CHARACTERISTIC CDKEV1E "Codewort Kunde: EV1E" VALUE 0x4F0508 KwWU16 65535.00 dez 0.00 65535.00 FORMAT "%8.2" /end CHARACTERISTIC
/begin CHARACTERISTIC CDKEV2E "Codewort Kunde: EV2E" VALUE 0x4F050A KwWU16 65535.00 dez 0.00 65535.00 FORMAT "%8.2" /end CHARACTERISTIC
/begin CHARACTERISTIC CDKEV3E "Codewort Kunde: EV3E" VALUE 0x4F050C KwWU16 65535.00 dez 0.00 65535.00 FORMAT "%8.2" /end CHARACTERISTIC
/begin CHARACTERISTIC CDKEV4E "Codewort Kunde: EV4E" VALUE 0x4F050E KwWU16 65535.00 dez 0.00 65535.00 FORMAT "%8.2" /end CHARACTERISTIC
/begin CHARACTERISTIC CDKEWS "" VALUE 0x4F0510 KwWU16 65535.00 dez 0.00 65535.00 FORMAT "%8.2" /end CHARACTERISTIC
/begin CHARACTERISTIC CDKEWSE "Codewort Kunde: EWSE" VALUE 0x4F0512 KwWU16 65535.00 dez 0.00 65535.00 FORMAT "%8.2" /end CHARACTERISTIC
/begin CHARACTERISTIC CDKKAT "Codewort Kunde:	Katalysator-Konvertierung" VALUE 0x4F052C KwWU16 65535.00 dez 0.00 65535.00 FORMAT "%8.2" /end CHARACTERISTIC
/begin CHARACTERISTIC CDKKILL "Codewort Kunde: Diagnose Killschalter" VALUE 0x4F0532 KwWU16 65535.00 dez 0.00 65535.00 FORMAT "%8.2" /end CHARACTERISTIC
/begin CHARACTERISTIC CDKKL15 "Codewort Kunde: Diagnose Klemme 15 Schalter" VALUE 0x4F0534 KwWU16 65535.00 dez 0.00 65535.00 FORMAT "%8.2" /end CHARACTERISTIC
/begin CHARACTERISTIC CDKKRNT "Codewort Kunde:	Klopfregelung Nulltest" VALUE 0x4F0536 KwUw 65535.00 dez 0.00 65535.00 FORMAT "%8.2" /end CHARACTERISTIC
/begin CHARACTERISTIC CDKKROF "Codewort Kunde:	Klopfregelung Offset" VALUE 0x4F0538 KwUw 65535.00 dez 0.00 65535.00 FORMAT "%8.2" /end CHARACTERISTIC
/begin CHARACTERISTIC CDKKRTP "Codewort Kunde: Klopfregelung Testimpuls" VALUE 0x4F053A KwUw 65535.00 dez 0.00 65535.00 FORMAT "%8.2" /end CHARACTERISTIC
/begin CHARACTERISTIC CDKKS "" VALUE 0x4F053C KwUw 65535.00 dez 0.00 65535.00 FORMAT "%8.2" /end CHARACTERISTIC
/begin CHARACTERISTIC CDKKS1 "Codewort Kunde:	Klopfsensor 1" VALUE 0x4F053E KwUw 65535.00 dez 0.00 65535.00 FORMAT "%8.2" /end CHARACTERISTIC
/begin CHARACTERISTIC CDKKS2 "Codewort Kunde:	Klopfsensor 2" VALUE 0x4F0540 KwUw 65535.00 dez 0.00 65535.00 FORMAT "%8.2" /end CHARACTERISTIC
/begin CHARACTERISTIC CDKN "Codewort Kunde: Drehzahlsignalgeber" VALUE 0x4F0558 KwUw 65535.00 dez 0.00 65535.00 FORMAT "%8.2" /end CHARACTERISTIC
/begin CHARACTERISTIC CDKZZZ "Dummy: Tabellenendeng" VALUE 0x4F05AA KwUw 65535.00 dez 0.00 65535.00 FORMAT "%8.2" /end CHARACTERISTIC
/begin CHARACTERISTIC CDTAAA "Dummy: Tabellenanfang" VALUE 0x4F05AC KwUw 65535.00 dez 0.00 65535.00 FORMAT "%8.2" /end CHARACTERISTIC
/begin CHARACTERISTIC CDTAKLE "" VALUE 0x4F05B0 KwWU16 65535.00 dez 0.00 65535.00 FORMAT "%8.2" /end CHARACTERISTIC
/begin CHARACTERISTIC CDTAS "" VALUE 0x4F05B2 KwWU16 65535.00 dez 0.00 65535.00 FORMAT "%8.2" /end CHARACTERISTIC
/begin CHARACTERISTIC CDTBM "Codewort Tester: Bezugsmarkengeber" VALUE 0x4F05B4 KwUw 65535.00 dez 0.00 65535.00 FORMAT "%8.2" /end CHARACTERISTIC
/begin CHARACTERISTIC CDTCABS "Codewort Tester: CAN-Timeout, ABS" VALUE 0x4F05B8 KwWU16 65535.00 dez 0.00 65535.00 FORMAT "%8.2" /end CHARACTERISTIC
/begin CHARACTERISTIC CDTCANA "" VALUE 0x4F05BA KwWU16 65535.00 dez 0.00 65535.00 FORMAT "%8.2" /end CHARACTERISTIC
/begin CHARACTERISTIC CDTCAS "" VALUE 0x4F05BC KwWU16 65535.00 dez 0.00 65535.00 FORMAT "%8.2" /end CHARACTERISTIC
/begin CHARACTERISTIC CDTCKOMBI "Codewort Tester: CAN-Timeout, KOMBI" VALUE 0x4F05BE KwWU16 65535.00 dez 0.00 65535.00 FORMAT "%8.2" /end CHARACTERISTIC
/begin CHARACTERISTIC CDTCZFE "Codewort Tester: CAN-Timeout, ZFE" VALUE 0x4F05C0 KwWU16 65535.00 dez 0.00 65535.00 FORMAT "%8.2" /end CHARACTERISTIC
/begin CHARACTERISTIC CDTDKP "" VALUE 0x4F05C2 KwWU16 65535.00 dez 0.00 65535.00 FORMAT "%8.2" /end CHARACTERISTIC
/begin CHARACTERISTIC CDTDKPA "" VALUE 0x4F05C4 KwWU16 65535.00 dez 0.00 65535.00 FORMAT "%8.2" /end CHARACTERISTIC
/begin CHARACTERISTIC CDTEKPE "Codewort Tester: EKPE" VALUE 0x4F05D0 KwWU16 65535.00 dez 0.00 65535.00 FORMAT "%8.2" /end CHARACTERISTIC
/begin CHARACTERISTIC CDTEV1E "Codewort Tester: EV1E" VALUE 0x4F05D2 KwWU16 65535.00 dez 0.00 65535.00 FORMAT "%8.2" /end CHARACTERISTIC
/begin CHARACTERISTIC CDTEV2E "Codewort Tester: EV2E" VALUE 0x4F05D4 KwWU16 65535.00 dez 0.00 65535.00 FORMAT "%8.2" /end CHARACTERISTIC
/begin CHARACTERISTIC CDTEV3E "Codewort Tester: EV3E" VALUE 0x4F05D6 KwWU16 65535.00 dez 0.00 65535.00 FORMAT "%8.2" /end CHARACTERISTIC
/begin CHARACTERISTIC CDTEV4E "Codewort Tester: EV4E" VALUE 0x4F05D8 KwWU16 65535.00 dez 0.00 65535.00 FORMAT "%8.2" /end CHARACTERISTIC
/begin CHARACTERISTIC CDTEWS "" VALUE 0x4F05DA KwWU16 65535.00 dez 0.00 65535.00 FORMAT "%8.2" /end CHARACTERISTIC
/begin CHARACTERISTIC CDTEWSE "Codewort Tester: EWSE" VALUE 0x4F05DC KwWU16 65535.00 dez 0.00 65535.00 FORMAT "%8.2" /end CHARACTERISTIC
/begin CHARACTERISTIC CDTKAT "Codewort Tester: Katalysator-Konvertierung" VALUE 0x4F05F6 KwWU16 65535.00 dez 0.00 65535.00 FORMAT "%8.2" /end CHARACTERISTIC
/begin CHARACTERISTIC CDTKILL "Codewort Tester: Diagnose Killschalter" VALUE 0x4F05FC KwWU16 65535.00 dez 0.00 65535.00 FORMAT "%8.2" /end CHARACTERISTIC
/begin CHARACTERISTIC CDTKL15 "Codewort Tester: Diagnose Klemme 15 Schalter" VALUE 0x4F05FE KwWU16 65535.00 dez 0.00 65535.00 FORMAT "%8.2" /end CHARACTERISTIC
/begin CHARACTERISTIC CDTKRNT "Codewort Tester: Klopfregelung Nulltest" VALUE 0x4F0600 KwUw 65535.00 dez 0.00 65535.00 FORMAT "%8.2" /end CHARACTERISTIC
/begin CHARACTERISTIC CDTKROF "Codewort Tester: Klopfregelung Offset" VALUE 0x4F0602 KwUw 65535.00 dez 0.00 65535.00 FORMAT "%8.2" /end CHARACTERISTIC
/begin CHARACTERISTIC CDTKRTP "Codewort Tester: Klopfregelung Testimpuls" VALUE 0x4F0604 KwUw 65535.00 dez 0.00 65535.00 FORMAT "%8.2" /end CHARACTERISTIC
/begin CHARACTERISTIC CDTKS "" VALUE 0x4F0606 KwUw 65535.00 dez 0.00 65535.00 FORMAT "%8.2" /end CHARACTERISTIC
/begin CHARACTERISTIC CDTKS1 "Codewort Tester: Klopfsensor 1" VALUE 0x4F0608 KwUw 65535.00 dez 0.00 65535.00 FORMAT "%8.2" /end CHARACTERISTIC
/begin CHARACTERISTIC CDTKS2 "Codewort Tester: Klopfsensor 2" VALUE 0x4F060A KwUw 65535.00 dez 0.00 65535.00 FORMAT "%8.2" /end CHARACTERISTIC
/begin CHARACTERISTIC CDTN "Codewort Tester: Drehzahlsignalgeber" VALUE 0x4F0622 KwUw 65535.00 dez 0.00 65535.00 FORMAT "%8.2" /end CHARACTERISTIC
/begin CHARACTERISTIC CDTZZZ "Dummy: Tabellenende" VALUE 0x4F0674 KwUw 65535.00 dez 0.00 65535.00 FORMAT "%8.2" /end CHARACTERISTIC
/begin CHARACTERISTIC CL30LINE "30. Linie der Klassentabelle" VAL_BLK 0x4F07FC KwbUb 255.0 dez 0.00 255.0 FORMAT "%5.1" NUMBER 13 /end CHARACTERISTIC
/begin CHARACTERISTIC CL31LINE "31. Linie der Klassentabelle" VAL_BLK 0x4F0809 KwbUb 255.0 dez 0.00 255.0 FORMAT "%5.1" NUMBER 13 /end CHARACTERISTIC
/begin CHARACTERISTIC CL32LINE "32. Linie der Klassentabelle" VAL_BLK 0x4F0816 KwbUb 255.0 dez 0.00 255.0 FORMAT "%5.1" NUMBER 13 /end CHARACTERISTIC
/begin CHARACTERISTIC CL33LINE "33. Linie der Klassentabelle" VAL_BLK 0x4F0823 KwbUb 255.0 dez 0.00 255.0 FORMAT "%5.1" NUMBER 13 /end CHARACTERISTIC
/begin CHARACTERISTIC CL34LINE "34. Linie der Klassentabelle" VAL_BLK 0x4F0830 KwbUb 255.0 dez 0.00 255.0 FORMAT "%5.1" NUMBER 13 /end CHARACTERISTIC
/begin CHARACTERISTIC CL35LINE "35. Linie der Klassentabelle" VAL_BLK 0x4F083D KwbUb 255.0 dez 0.00 255.0 FORMAT "%5.1" NUMBER 13 /end CHARACTERISTIC
/begin CHARACTERISTIC CL36LINE "36. Linie der Klassentabelle" VAL_BLK 0x4F084A KwbUb 255.0 dez 0.00 255.0 FORMAT "%5.1" NUMBER 13 /end CHARACTERISTIC
/begin CHARACTERISTIC CL37LINE "37. Linie der Klassentabelle" VAL_BLK 0x4F0857 KwbUb 255.0 dez 0.00 255.0 FORMAT "%5.1" NUMBER 13 /end CHARACTERISTIC
/begin CHARACTERISTIC CL38LINE "38. Linie der Klassentabelle" VAL_BLK 0x4F0864 KwbUb 255.0 dez 0.00 255.0 FORMAT "%5.1" NUMBER 13 /end CHARACTERISTIC
/begin CHARACTERISTIC CL39LINE "39. Linie der Klassentabelle" VAL_BLK 0x4F0871 KwbUb 255.0 dez 0.00 255.0 FORMAT "%5.1" NUMBER 13 /end CHARACTERISTIC
/begin CHARACTERISTIC CLAAAA "Dummy: Tabellenanfang" VALUE 0x4EFF58 KwUb 255.0 dez 0.00 255.0 FORMAT "%5.1" /end CHARACTERISTIC
/begin CHARACTERISTIC CLAAKLE "" VALUE 0x4EFF5A KwWU8 255.0 dez 0.00 255.0 FORMAT "%5.1" /end CHARACTERISTIC
/begin CHARACTERISTIC CLAAS "" VALUE 0x4EFF5B KwWU8 255.0 dez 0.00 255.0 FORMAT "%5.1" /end CHARACTERISTIC
/begin CHARACTERISTIC CLABM "Fehlerklasse: Bezugsmarkengeber" VALUE 0x4EFF5C KwUb 255.0 dez 0.00 255.0 FORMAT "%5.1" /end CHARACTERISTIC
/begin CHARACTERISTIC CLACABS "Fehlerklasse: CAN-Timeout Botschaft ABS-SG" VALUE 0x4EFF5E KwWU8 255.0 dez 0.00 255.0 FORMAT "%5.1" /end CHARACTERISTIC
/begin CHARACTERISTIC CLACANA "" VALUE 0x4EFF5F KwWU8 255.0 dez 0.00 255.0 FORMAT "%5.1" /end CHARACTERISTIC
/begin CHARACTERISTIC CLACAS "" VALUE 0x4EFF60 KwWU8 255.0 dez 0.00 255.0 FORMAT "%5.1" /end CHARACTERISTIC
/begin CHARACTERISTIC CLACKOMBI "Fehlerklasse: CAN-Timeout Botschaft Kombiinstrument" VALUE 0x4EFF61 KwWU8 255.0 dez 0.00 255.0 FORMAT "%5.1" /end CHARACTERISTIC
/begin CHARACTERISTIC CLACZFE "Fehlerklasse: CAN-Timeout Botschaft ZFE" VALUE 0x4EFF62 KwWU8 255.0 dez 0.00 255.0 FORMAT "%5.1" /end CHARACTERISTIC
/begin CHARACTERISTIC CLADKP "" VALUE 0x4EFF63 KwWU8 255.0 dez 0.00 255.0 FORMAT "%5.1" /end CHARACTERISTIC
/begin CHARACTERISTIC CLADKPA "" VALUE 0x4EFF64 KwWU8 255.0 dez 0.00 255.0 FORMAT "%5.1" /end CHARACTERISTIC
/begin CHARACTERISTIC CLAEKPE "Fehlerklasse: EKPE" VALUE 0x4EFF6A KwWU8 255.0 dez 0.00 255.0 FORMAT "%5.1" /end CHARACTERISTIC
/begin CHARACTERISTIC CLAEV1E "Fehlerklasse: EV1E" VALUE 0x4EFF6B KwWU8 255.0 dez 0.00 255.0 FORMAT "%5.1" /end CHARACTERISTIC
/begin CHARACTERISTIC CLAEV2E "Fehlerklasse: EV2E" VALUE 0x4EFF6C KwWU8 255.0 dez 0.00 255.0 FORMAT "%5.1" /end CHARACTERISTIC
/begin CHARACTERISTIC CLAEV3E "Fehlerklasse: EV3E" VALUE 0x4EFF6D KwWU8 255.0 dez 0.00 255.0 FORMAT "%5.1" /end CHARACTERISTIC
/begin CHARACTERISTIC CLAEV4E "Fehlerklasse: EV4E" VALUE 0x4EFF6E KwWU8 255.0 dez 0.00 255.0 FORMAT "%5.1" /end CHARACTERISTIC
/begin CHARACTERISTIC CLAEWS "" VALUE 0x4EFF6F KwWU8 255.0 dez 0.00 255.0 FORMAT "%5.1" /end CHARACTERISTIC
/begin CHARACTERISTIC CLAEWSE "Fehlerklasse: EWSE" VALUE 0x4EFF70 KwWU8 255.0 dez 0.00 255.0 FORMAT "%5.1" /end CHARACTERISTIC
/begin CHARACTERISTIC CLAKAT "Fehlerklasse: Katalysator" VALUE 0x4EFF7D KwWU8 255.0 dez 0.00 255.0 FORMAT "%5.1" /end CHARACTERISTIC
/begin CHARACTERISTIC CLAKILL "Fehlerklasse: Diagnose Killschalter" VALUE 0x4EFF80 KwWU8 255.0 dez 0.00 255.0 FORMAT "%5.1" /end CHARACTERISTIC
/begin CHARACTERISTIC CLAKL15 "Fehlerklasse: Diagnose Klemme 15 Schalter" VALUE 0x4EFF81 KwWU8 255.0 dez 0.00 255.0 FORMAT "%5.1" /end CHARACTERISTIC
/begin CHARACTERISTIC CLAKRNT "Fehlerklasse: Klopfregelung Nulltest" VALUE 0x4EFF82 KwUb 255.0 dez 0.00 255.0 FORMAT "%5.1" /end CHARACTERISTIC
/begin CHARACTERISTIC CLAKROF "Fehlerklasse: Klopfreglung Offset" VALUE 0x4EFF83 KwUb 255.0 dez 0.00 255.0 FORMAT "%5.1" /end CHARACTERISTIC
/begin CHARACTERISTIC CLAKRTP "Fehlerklasse: Klopfregelung Testimpuls" VALUE 0x4EFF84 KwUb 255.0 dez 0.00 255.0 FORMAT "%5.1" /end CHARACTERISTIC
/begin CHARACTERISTIC CLAKS "" VALUE 0x4EFF85 KwUb 255.0 dez 0.00 255.0 FORMAT "%5.1" /end CHARACTERISTIC
/begin CHARACTERISTIC CLAKS1 "Fehlerklasse: Klopfsensor 1" VALUE 0x4EFF86 KwUb 255.0 dez 0.00 255.0 FORMAT "%5.1" /end CHARACTERISTIC
/begin CHARACTERISTIC CLAKS2 "Fehlerklasse: Klopfsensor 2" VALUE 0x4EFF87 KwUb 255.0 dez 0.00 255.0 FORMAT "%5.1" /end CHARACTERISTIC
/begin CHARACTERISTIC CLAN "Fehlerklasse: Drehzahlgeber" VALUE 0x4EFF93 KwUb 255.0 dez 0.00 255.0 FORMAT "%5.1" /end CHARACTERISTIC
/begin CHARACTERISTIC CLAZZZ "Dummy: Tabellenende" VALUE 0x4EFFBC KwUb 255.0 dez 0.00 255.0 FORMAT "%5.1" /end CHARACTERISTIC
/begin CHARACTERISTIC CWBYPSTP "Code word software switch" VALUE 0x4E5208 KwUb 255.0 dez 0.00 255.0 FORMAT "%5.1" /end CHARACTERISTIC
/begin CHARACTERISTIC CWDASC "" VALUE 0x4E29BA KwUb 255.0 dez 0.00 255.0 FORMAT "%5.1" /end CHARACTERISTIC
/begin CHARACTERISTIC CWDEGFE "Codewort f¸r Abschaltung der Funktion %DEGFE" VALUE 0x4EB768 KwUb 255.0 dez 0.00 255.0 FORMAT "%5.1" /end CHARACTERISTIC
/begin CHARACTERISTIC CWPSAKLE "" VAL_BLK 0x4E2D88 KwbUb 255.0 dez 0.00 255.0 FORMAT "%5.1" NUMBER 1 /end CHARACTERISTIC
/begin CHARACTERISTIC CWPSEKPE "Codewort f¸r Endstufendiagnose EKP" VAL_BLK 0x4E2D5C KwbUb 255.0 dez 0.00 255.0 FORMAT "%5.1" NUMBER 1 /end CHARACTERISTIC
/begin CHARACTERISTIC CWPSEVE "Codewort f¸r Endstufendiagnose EV" VAL_BLK 0x4E2D74 KwbUb 255.0 dez 0.00 255.0 FORMAT "%5.1" NUMBER 2 /end CHARACTERISTIC
/begin CHARACTERISTIC CWPSEWSE "Codewort f¸r Endstufendiagnose EWS" VAL_BLK 0x4E2D64 KwbUb 255.0 dez 0.00 255.0 FORMAT "%5.1" NUMBER 1 /end CHARACTERISTIC
/begin CHARACTERISTIC CWRLBGSRM "Umschaltung zwischen rl aus Saugrohrmodell und rl=rlroh" VALUE 0x4E3B88 KwWU8 255.0 dez 0.00 255.0 FORMAT "%5.1" /end CHARACTERISTIC
/begin CHARACTERISTIC CWTCJ945 "Kodewort zum Abschalten der Diagnose" VALUE 0x4E2D57 KwUb 255.0 dez 0.00 255.0 FORMAT "%5.1" /end CHARACTERISTIC
/begin CHARACTERISTIC CWTCY315 "Kodewort zum Abschalten der Diagnose" VALUE 0x4E2D50 KwUb 255.0 dez 0.00 255.0 FORMAT "%5.1" /end CHARACTERISTIC
/begin CHARACTERISTIC CWTEMPK "Codeword f¸r Adressierung FWFTBRTA (tans/evtmod)" VALUE 0x4EB688 KwUb 255.0 dez 0.00 255.0 FORMAT "%5.1" /end CHARACTERISTIC
/begin CHARACTERISTIC CWU5VG "Kodewort zum Abschalten der Diagnose" VAL_BLK 0x4E2D54 KwbUb 255.0 dez 0.00 255.0 FORMAT "%5.1" NUMBER 3 /end CHARACTERISTIC
/begin CHARACTERISTIC CW_AKU "" VALUE 0x4ECABE KwWU8 2.00000000000 cw_aku 0.00 2.00000000000 FORMAT "%13.11" /end CHARACTERISTIC
/begin CHARACTERISTIC CW_CCPAKTIV "" VALUE 0x4E29EE KwWU8 255.0 default 0.00 255.0 FORMAT "%5.1" /end CHARACTERISTIC
/begin CHARACTERISTIC CW_DEWS "" VALUE 0x4ECAE8 KwWU8 255.0 dez 0.00 255.0 FORMAT "%5.1" /end CHARACTERISTIC
/begin CHARACTERISTIC CW_Dir_inv "" VALUE 0x4E5206 KwUb 255.0 dez 0.00 255.0 FORMAT "%5.1" /end CHARACTERISTIC
/begin CHARACTERISTIC CW_RLCAL "" VALUE 0x4E3B89 KwWU8 255.0 dez 0.00 255.0 FORMAT "%5.1" /end CHARACTERISTIC
/begin CHARACTERISTIC CW_VMX "" VALUE 0x4ECABF KwWU8 3.00000000000 cw_vmx 0.00 3.00000000000 FORMAT "%13.11" /end CHARACTERISTIC
/begin CHARACTERISTIC DEVTMAGR "Offset f¸r evtmod abh‰ngig von tsges_w bei hoher tans verursacht d. AGR" CURVE 0x4EB742 KlASwSstSwWSw 49151.25 temp_sw_q0p75 -24576.00 24575.25 FORMAT "%8.2"
 /begin AXIS_DESCR STD_AXIS tsges_w temp_sw_q0p75 8 -24576.00 24575.25 FORMAT "%8.2" DEPOSIT ABSOLUTE /end AXIS_DESCR
/end CHARACTERISTIC
/begin CHARACTERISTIC DKSTPGRD "" VALUE 0x4ECAC0 KwUb 255.0 dez 0.00 255.0 FORMAT "%5.1" /end CHARACTERISTIC
/begin CHARACTERISTIC DKSTPOF "" VALUE 0x4ECACC KwSw 6553.500 fak_q0p1 -3276.800 3276.700 FORMAT "%8.3" /end CHARACTERISTIC
/begin CHARACTERISTIC DMAUFASC "" VALUE 0x4E29EA KwUb 24.90 rel_ub_b24p9 0.00 24.90 FORMAT "%5.2" /end CHARACTERISTIC
/begin CHARACTERISTIC DRLDYNU "drl-Schwellwert f¸r te-Nachspritzer/Reduktion" VALUE 0x4E3FEA KwSw 1535.977 rel_sw_q0p0234 -768.0000 767.9766 FORMAT "%8.4" /end CHARACTERISTIC
/begin CHARACTERISTIC DTABUNPL "Schwelle Abstellzeit unplausibel" VALUE 0x4EB85C KwUw 65535.00 t1sxs_uw_q1 0.00 65535.00 FORMAT "%8.2" /end CHARACTERISTIC
/begin CHARACTERISTIC DTEPRU "delta-te-Schwelle fuer Nachspritzer-/ti-Reduktion erkannt" VALUE 0x4E3FEC KwUw 209.7478 t3p2usxms_uw_b209p7 0.00 209.7478 FORMAT "%8.4" /end CHARACTERISTIC
/begin CHARACTERISTIC DTNWFL "Entprellzeit NWG nach Anlasserstart" VALUE 0x4E2BFE KwWU8 25.50 t100msxs_ub_b25p5 0.00 25.50 FORMAT "%5.2" /end CHARACTERISTIC
/begin CHARACTERISTIC DTUMTA "Offset Ansauglufttemperatur -> Umgebungstemperatur" VALUE 0x4EB848 KwSb 191.3 temp_sb_q0p75 -96.00 95.25 FORMAT "%5.2" /end CHARACTERISTIC
/begin CHARACTERISTIC EKPEFA "Entprellung Fehlerz‰hler Endstufendiagnose EKP" VAL_BLK 0x4E2D60 KwbUb 255.0 dez 0.00 255.0 FORMAT "%5.1" NUMBER 1 /end CHARACTERISTIC
/begin CHARACTERISTIC EVEFA "Entprellung Fehlerz‰hler Endstufendiagnose EV" VAL_BLK 0x4E2D78 KwbUb 255.0 dez 0.00 255.0 FORMAT "%5.1" NUMBER 2 /end CHARACTERISTIC
/begin CHARACTERISTIC EVTMODO "Offset f¸r evtmod abh‰ngig von gefilterter Motortemperatur" CURVE 0x4EB68C KlAUbSstUbWUb 191.3 temp_ub_q0p75_o48 -48.00 143.3 FORMAT "%5.1"
 /begin AXIS_DESCR STD_AXIS tmotfil temp_ub_q0p75_o48 12 -48.00 143.3 FORMAT "%5.1" DEPOSIT ABSOLUTE /end AXIS_DESCR
/end CHARACTERISTIC
/begin CHARACTERISTIC EWSEFA "Entprellung Fehlerz‰hler Endstufendiagnose EWS" VAL_BLK 0x4E2D68 KwbUb 255.0 dez 0.00 255.0 FORMAT "%5.1" NUMBER 1 /end CHARACTERISTIC
/begin CHARACTERISTIC EWS_FSW_IN "" VAL_BLK 0x4ECAEC KwbWU8 255.0 dez 0.00 255.0 FORMAT "%5.1" NUMBER 6 /end CHARACTERISTIC
/begin CHARACTERISTIC EWS_FSW_OUT "" VAL_BLK 0x4ECAF4 KwbWU8 255.0 dez 0.00 255.0 FORMAT "%5.1" NUMBER 6 /end CHARACTERISTIC
/begin CHARACTERISTIC FDVANS "Temperaturfaktor f¸r Drosselventildurchfluﬂ" CURVE 0x4EB6A8 KlAUbSstUbWUb 1.992 fak_ub_b2 0.00 1.992 FORMAT "%5.3"
 /begin AXIS_DESCR STD_AXIS tans temp_ub_q0p75_o48 8 -48.00 143.3 FORMAT "%5.1" DEPOSIT ABSOLUTE /end AXIS_DESCR
/end CHARACTERISTIC
/begin CHARACTERISTIC FFTAAA "Dummy: Tabellenanfang" VAL_BLK 0x4EFFC0 KwbUb 255.0 dez 0.00 255.0 FORMAT "%5.1" NUMBER 4 /end CHARACTERISTIC
/begin CHARACTERISTIC FFTAKLE "" VAL_BLK 0x4EFFC8 KwbWU8 255.0 dez 0.00 255.0 FORMAT "%5.1" NUMBER 4 /end CHARACTERISTIC
/begin CHARACTERISTIC FFTAS "" VAL_BLK 0x4EFFCC KwbWU8 255.0 dez 0.00 255.0 FORMAT "%5.1" NUMBER 4 /end CHARACTERISTIC
/begin CHARACTERISTIC FFTBM "Freeze Frame Tabelle: Bezugsmarkengeber" VAL_BLK 0x4EFFD0 KwbUb 255.0 dez 0.00 255.0 FORMAT "%5.1" NUMBER 4 /end CHARACTERISTIC
/begin CHARACTERISTIC FFTCABS "Freeze Frame Tabelle: CAN-Timeout ABS-Botschaft" VAL_BLK 0x4EFFD8 KwbWU8 255.0 dez 0.00 255.0 FORMAT "%5.1" NUMBER 4 /end CHARACTERISTIC
/begin CHARACTERISTIC FFTCANA "" VAL_BLK 0x4EFFDC KwbWU8 255.0 dez 0.00 255.0 FORMAT "%5.1" NUMBER 4 /end CHARACTERISTIC
/begin CHARACTERISTIC FFTCAS "" VAL_BLK 0x4EFFE0 KwbWU8 255.0 dez 0.00 255.0 FORMAT "%5.1" NUMBER 4 /end CHARACTERISTIC
/begin CHARACTERISTIC FFTCKOMBI "Freeze Frame Tabelle: CAN-Timeout KOMBI-Botschaft" VAL_BLK 0x4EFFE4 KwbWU8 255.0 dez 0.00 255.0 FORMAT "%5.1" NUMBER 4 /end CHARACTERISTIC
/begin CHARACTERISTIC FFTCZFE "Freeze Frame Tabelle: CAN-Timeout ZFE-Botschaft" VAL_BLK 0x4EFFE8 KwbWU8 255.0 dez 0.00 255.0 FORMAT "%5.1" NUMBER 4 /end CHARACTERISTIC
/begin CHARACTERISTIC FFTDKP "" VAL_BLK 0x4EFFEC KwbWU8 255.0 dez 0.00 255.0 FORMAT "%5.1" NUMBER 4 /end CHARACTERISTIC
/begin CHARACTERISTIC FFTDKPA "" VAL_BLK 0x4EFFF0 KwbWU8 255.0 dez 0.00 255.0 FORMAT "%5.1" NUMBER 4 /end CHARACTERISTIC
/begin CHARACTERISTIC FFTEKPE "Freeze Frame Tabelle: EKPE" VAL_BLK 0x4F0008 KwbWU8 255.0 dez 0.00 255.0 FORMAT "%5.1" NUMBER 4 /end CHARACTERISTIC
/begin CHARACTERISTIC FFTEV1E "Freeze Frame Tabelle: EV1E" VAL_BLK 0x4F000C KwbWU8 255.0 dez 0.00 255.0 FORMAT "%5.1" NUMBER 4 /end CHARACTERISTIC
/begin CHARACTERISTIC FFTEV2E "Freeze Frame Tabelle: EV2E" VAL_BLK 0x4F0010 KwbWU8 255.0 dez 0.00 255.0 FORMAT "%5.1" NUMBER 4 /end CHARACTERISTIC
/begin CHARACTERISTIC FFTEV3E "Freeze Frame Tabelle: EV3E" VAL_BLK 0x4F0014 KwbWU8 255.0 dez 0.00 255.0 FORMAT "%5.1" NUMBER 4 /end CHARACTERISTIC
/begin CHARACTERISTIC FFTEV4E "Freeze Frame Tabelle: EV4E" VAL_BLK 0x4F0018 KwbWU8 255.0 dez 0.00 255.0 FORMAT "%5.1" NUMBER 4 /end CHARACTERISTIC
/begin CHARACTERISTIC FFTEWS "" VAL_BLK 0x4F001C KwbWU8 255.0 dez 0.00 255.0 FORMAT "%5.1" NUMBER 4 /end CHARACTERISTIC
/begin CHARACTERISTIC FFTEWSE "Freeze Frame Tabelle: EWSE" VAL_BLK 0x4F0020 KwbWU8 255.0 dez 0.00 255.0 FORMAT "%5.1" NUMBER 4 /end CHARACTERISTIC
/begin CHARACTERISTIC FFTKAT "Freeze Frame Tabelle: Katalysator" VAL_BLK 0x4F0054 KwbWU8 255.0 dez 0.00 255.0 FORMAT "%5.1" NUMBER 4 /end CHARACTERISTIC
/begin CHARACTERISTIC FFTKILL "Freeze Frame Tabelle: Diagnose Killschalter" VAL_BLK 0x4F0060 KwbWU8 255.0 dez 0.00 255.0 FORMAT "%5.1" NUMBER 4 /end CHARACTERISTIC
/begin CHARACTERISTIC FFTKL15 "Freeze Frame Tabelle: Diagnose Klemme 15 Schalter" VAL_BLK 0x4F0064 KwbWU8 255.0 dez 0.00 255.0 FORMAT "%5.1" NUMBER 4 /end CHARACTERISTIC
/begin CHARACTERISTIC FFTKRNT "Freeze frame Tabelle: Klopfregelung Nulltest" VAL_BLK 0x4F0068 KwbUb 255.0 dez 0.00 255.0 FORMAT "%5.1" NUMBER 4 /end CHARACTERISTIC
/begin CHARACTERISTIC FFTKROF "Freeze Frame Tabelle: Klopfregelung Offset" VAL_BLK 0x4F006C KwbUb 255.0 dez 0.00 255.0 FORMAT "%5.1" NUMBER 4 /end CHARACTERISTIC
/begin CHARACTERISTIC FFTKRTP "Freeze Frame Tabelle: Klopfregelung Testimpuls" VAL_BLK 0x4F0070 KwbUb 255.0 dez 0.00 255.0 FORMAT "%5.1" NUMBER 4 /end CHARACTERISTIC
/begin CHARACTERISTIC FFTKS "" VAL_BLK 0x4F0074 KwbUb 255.0 dez 0.00 255.0 FORMAT "%5.1" NUMBER 4 /end CHARACTERISTIC
/begin CHARACTERISTIC FFTKS1 "Freeze Frame Tabelle: Klopfsensor 1" VAL_BLK 0x4F0078 KwbUb 255.0 dez 0.00 255.0 FORMAT "%5.1" NUMBER 4 /end CHARACTERISTIC
/begin CHARACTERISTIC FFTKS2 "Freeze Frame Tabelle: Klopfsensor 2" VAL_BLK 0x4F007C KwbUb 255.0 dez 0.00 255.0 FORMAT "%5.1" NUMBER 4 /end CHARACTERISTIC
/begin CHARACTERISTIC FFTN "Freeze Frame Tabelle: Drehzahlgeber" VAL_BLK 0x4F00AC KwbUb 255.0 dez 0.00 255.0 FORMAT "%5.1" NUMBER 4 /end CHARACTERISTIC
/begin CHARACTERISTIC FFTZZZ "Dummy: Tabellenende" VAL_BLK 0x4F0150 KwbUb 255.0 dez 0.00 255.0 FORMAT "%5.1" NUMBER 4 /end CHARACTERISTIC
/begin CHARACTERISTIC FILT_CY315 "" VALUE 0x4EA0F6 KwUb 3.000 dez 0.00 3.000 FORMAT "%5.3" /end CHARACTERISTIC
/begin CHARACTERISTIC FMTEVEIN "Faktor Massenstrom durch TEV abh‰ngig von der Ansteuerzeit" CURVE 0x4E8842 KlAUwSstUwWUw 0.9999847 fak_uw_b1 0.00 0.9999847 FORMAT "%9.7"
 /begin AXIS_DESCR STD_AXIS ttevein t128ms_uw 10 0.00 128.0 FORMAT "%5.1" DEPOSIT ABSOLUTE /end AXIS_DESCR
/end CHARACTERISTIC
/begin CHARACTERISTIC FPVMXN "Faktor maximales Druckverh‰ltnis mit Hauptlastsignal" CURVE 0x4EACB4 KlAUwSstUwWUw 1.999969 fak_uw_b2 0.00 1.999969 FORMAT "%8.6"
 /begin AXIS_DESCR STD_AXIS nmot_w nmot_uw_q0p25 6 0.00 16383.75 FORMAT "%8.2" DEPOSIT ABSOLUTE /end AXIS_DESCR
/end CHARACTERISTIC
/begin CHARACTERISTIC FPVMXN2 "Faktor maximales Druckverh‰ltnis mit Nebenlastsignal" CURVE 0x4EACCE KlAUwSstUwWUw 1.999969 fak_uw_b2 0.00 1.999969 FORMAT "%8.6"
 /begin AXIS_DESCR STD_AXIS nmot_w nmot_uw_q0p25 6 0.00 16383.75 FORMAT "%8.2" DEPOSIT ABSOLUTE /end AXIS_DESCR
/end CHARACTERISTIC
/begin CHARACTERISTIC FSKRIT "Fehlerschwehre kritischer KWG-Fehler" VALUE 0x4E2BF4 KwWU16 65535.00 dez 0.00 65535.00 FORMAT "%8.2" /end CHARACTERISTIC
/begin CHARACTERISTIC FSUKRIT "Fehlerschwehre unkritischer KWG-Fehler" VALUE 0x4E2BF6 KwWU16 65535.00 dez 0.00 65535.00 FORMAT "%8.2" /end CHARACTERISTIC
/begin CHARACTERISTIC FUMRMV "Faktor Dichte der Luft" VALUE 0x4E8828 KwUb 1.992 dichte_ub_b2 0.00 1.992 FORMAT "%5.3" /end CHARACTERISTIC
/begin CHARACTERISTIC FWFTBRTA "Wichtung ftbr in Abh‰ngigkeit von tans" CURVE 0x4EB6BC KlAUbSstUbWUb 1.992 fak_ub_b2 0.00 1.992 FORMAT "%5.3"
 /begin AXIS_DESCR STD_AXIS tempin temp_ub_q0p75_o48 14 -48.00 143.3 FORMAT "%5.1" DEPOSIT ABSOLUTE /end AXIS_DESCR
/end CHARACTERISTIC
/begin CHARACTERISTIC IMTUMTA "Schwelle integrierte Luftmasse f¸r Bestimmung Umgebungstemperatur" VALUE 0x4EB849 KwUb 23.21 m_ub_b23p3 0.00 23.21 FORMAT "%5.2" /end CHARACTERISTIC
/begin CHARACTERISTIC KFFWTBR "Wichtungsfaktor Tans/Tmot f¸r Brennraumtemperaturmodell" MAP 0x4EB6DC KfAxUbAyUbSstxUbSstyUbWUb 3.984 fak_ub_b4 0.00 3.984 FORMAT "%5.3"
 /begin AXIS_DESCR STD_AXIS rl rel_ub_q0p75 10 0.00 191.3 FORMAT "%5.1" DEPOSIT ABSOLUTE /end AXIS_DESCR
 /begin AXIS_DESCR STD_AXIS nmot nmot_ub_q40 8 0.00 10200. FORMAT "%5.0" DEPOSIT ABSOLUTE /end AXIS_DESCR
/end CHARACTERISTIC
/begin CHARACTERISTIC KFINDFMS "" MAP 0x4EE354 KfAxUbAyUbSstxUbSstyUbWUb 99.61 rel_ub_b99p6 0.00 99.61 FORMAT "%5.2"
 /begin AXIS_DESCR STD_AXIS vtevo rel_ub_b99p6 12 0.00 99.61 FORMAT "%5.2" DEPOSIT ABSOLUTE /end AXIS_DESCR
 /begin AXIS_DESCR STD_AXIS rl rel_ub_q0p75 8 0.00 191.3 FORMAT "%5.1" DEPOSIT ABSOLUTE /end AXIS_DESCR
/end CHARACTERISTIC
/begin CHARACTERISTIC KFMSTEMX "" MAP 0x4EE3CA KfAxUwAyUwSstxUwSstyUwWUw 25.59961 m_uw_b25p6 0.00 25.59961 FORMAT "%8.5"
 /begin AXIS_DESCR STD_AXIS nmot_w nmot_uw_q0p25 12 0.00 16383.75 FORMAT "%8.2" DEPOSIT ABSOLUTE /end AXIS_DESCR
 /begin AXIS_DESCR STD_AXIS rl_w rel_uw_q0p0234 8 0.00 1535.977 FORMAT "%8.3" DEPOSIT ABSOLUTE /end AXIS_DESCR
/end CHARACTERISTIC
/begin CHARACTERISTIC KFPRGF "Rover" MAP 0x4EACE8 KfAxUwAyUwSstxUwSstyUwWUw 65.53500 rel_uw_q0p001 0.00 65.53500 FORMAT "%8.5"
 /begin AXIS_DESCR STD_AXIS Vse_spri sprzi_q0p1 8 0.00 6554. FORMAT "%2.0" DEPOSIT ABSOLUTE /end AXIS_DESCR
 /begin AXIS_DESCR STD_AXIS nmot_w nmot_uw_q0p25 16 0.00 16383.75 FORMAT "%8.2" DEPOSIT ABSOLUTE /end AXIS_DESCR
/end CHARACTERISTIC
/begin CHARACTERISTIC KFPRGF1 "Rover" MAP 0x4EAE1C KfAxUwAyUwSstxUwSstyUwWUw 65.53500 rel_uw_q0p001 0.00 65.53500 FORMAT "%8.5"
 /begin AXIS_DESCR STD_AXIS Vse_spri sprzi_q0p1 8 0.00 6554. FORMAT "%2.0" DEPOSIT ABSOLUTE /end AXIS_DESCR
 /begin AXIS_DESCR STD_AXIS nmot_w nmot_uw_q0p25 16 0.00 16383.75 FORMAT "%8.2" DEPOSIT ABSOLUTE /end AXIS_DESCR
/end CHARACTERISTIC
/begin CHARACTERISTIC KFPRGR "Rover" MAP 0x4EAF50 KfAxUwAyUwSstxUwSstyUwWUw 2559.961 p_uw_q0p039 0.00 2559.961 FORMAT "%8.3"
 /begin AXIS_DESCR STD_AXIS wnwue_w kw_q1_o128 8 -128.0000 65407.00 FORMAT "%8.2" DEPOSIT ABSOLUTE /end AXIS_DESCR
 /begin AXIS_DESCR STD_AXIS nmot_w nmot_uw_q0p25 16 0.00 16383.75 FORMAT "%8.2" DEPOSIT ABSOLUTE /end AXIS_DESCR
/end CHARACTERISTIC
/begin CHARACTERISTIC KFPRGR1 "Rover" MAP 0x4EB084 KfAxUwAyUwSstxUwSstyUwWUw 2559.961 p_uw_q0p039 0.00 2559.961 FORMAT "%8.3"
 /begin AXIS_DESCR STD_AXIS wnwue_w kw_q1_o128 8 -128.0000 65407.00 FORMAT "%8.2" DEPOSIT ABSOLUTE /end AXIS_DESCR
 /begin AXIS_DESCR STD_AXIS nmot_w nmot_uw_q0p25 16 0.00 16383.75 FORMAT "%8.2" DEPOSIT ABSOLUTE /end AXIS_DESCR
/end CHARACTERISTIC
/begin CHARACTERISTIC KFURLF "Rover" MAP 0x4EB1B8 KfAxUwAyUwSstxUwSstyUwWUw 65.53500 rel_uw_q0p001 0.00 65.53500 FORMAT "%8.5"
 /begin AXIS_DESCR STD_AXIS Vse_spri sprzi_q0p1 8 0.00 6554. FORMAT "%2.0" DEPOSIT ABSOLUTE /end AXIS_DESCR
 /begin AXIS_DESCR STD_AXIS nmot_w nmot_uw_q0p25 16 0.00 16383.75 FORMAT "%8.2" DEPOSIT ABSOLUTE /end AXIS_DESCR
/end CHARACTERISTIC
/begin CHARACTERISTIC KFURLF1 "Rover" MAP 0x4EB2EC KfAxUwAyUwSstxUwSstyUwWUw 65.53500 rel_uw_q0p001 0.00 65.53500 FORMAT "%8.5"
 /begin AXIS_DESCR STD_AXIS Vse_spri sprzi_q0p1 8 0.00 6554. FORMAT "%2.0" DEPOSIT ABSOLUTE /end AXIS_DESCR
 /begin AXIS_DESCR STD_AXIS nmot_w nmot_uw_q0p25 16 0.00 16383.75 FORMAT "%8.2" DEPOSIT ABSOLUTE /end AXIS_DESCR
/end CHARACTERISTIC
/begin CHARACTERISTIC KFURLR "Rover" MAP 0x4EB420 KfAxUwAyUwSstxUwSstyUwWUw 0.2999954 rel_uw_b0p3 0.00 0.2999954 FORMAT "%9.7"
 /begin AXIS_DESCR STD_AXIS wnwue_w kw_q1_o128 8 -128.0000 65407.00 FORMAT "%8.2" DEPOSIT ABSOLUTE /end AXIS_DESCR
 /begin AXIS_DESCR STD_AXIS nmot_w nmot_uw_q0p25 16 0.00 16383.75 FORMAT "%8.2" DEPOSIT ABSOLUTE /end AXIS_DESCR
/end CHARACTERISTIC
/begin CHARACTERISTIC KFURLR1 "Rover" MAP 0x4EB554 KfAxUwAyUwSstxUwSstyUwWUw 0.2999954 rel_uw_b0p3 0.00 0.2999954 FORMAT "%9.7"
 /begin AXIS_DESCR STD_AXIS wnwue_w kw_q1_o128 8 -128.0000 65407.00 FORMAT "%8.2" DEPOSIT ABSOLUTE /end AXIS_DESCR
 /begin AXIS_DESCR STD_AXIS nmot_w nmot_uw_q0p25 16 0.00 16383.75 FORMAT "%8.2" DEPOSIT ABSOLUTE /end AXIS_DESCR
/end CHARACTERISTIC
/begin CHARACTERISTIC KISRM "Integratorbeiwert f¸r Saugrohrmodell (Dynamik)" VALUE 0x4E3B8C KwUw 0.9999847 fak_uw_b1 0.00 0.9999847 FORMAT "%9.7" /end CHARACTERISTIC
/begin CHARACTERISTIC KISRMSU "Integrationsbeiwert f¸r Saugrohrmodell bei sumode=1" VALUE 0x4E3B8E KwUw 0.9999847 fak_uw_b1 0.00 0.9999847 FORMAT "%9.7" /end CHARACTERISTIC
/begin CHARACTERISTIC KLTATEMX "" CURVE 0x4E882C KlAUbSstUbWUb 99.61 rel_ub_b99p6 0.00 99.61 FORMAT "%5.2"
 /begin AXIS_DESCR STD_AXIS rl rel_ub_q0p75 10 0.00 191.3 FORMAT "%5.1" DEPOSIT ABSOLUTE /end AXIS_DESCR
/end CHARACTERISTIC
/begin CHARACTERISTIC KLVXDSPOS "" CURVE 0x4E521C KlASwSstSwWSw 6553.500 fak_q0p1 -3276.800 3276.700 FORMAT "%8.3"
 /begin AXIS_DESCR STD_AXIS d_vfzg_vmx vfzg_ub_q1p25 11 -40960.00 40958.75 FORMAT "%8.2" DEPOSIT ABSOLUTE /end AXIS_DESCR
/end CHARACTERISTIC
/begin CHARACTERISTIC KW_UbStpMin "" VALUE 0x4ECAAE KwUb 24.02 spg_ubatt 0.00 24.02 FORMAT "%5.2" /end CHARACTERISTIC
/begin CHARACTERISTIC LBMHYS "Hysterrese Fehlerschwehrezaehler KWG" VALUE 0x4E2BF8 KwWU16 65535.00 dez 0.00 65535.00 FORMAT "%8.2" /end CHARACTERISTIC
/begin CHARACTERISTIC LBMINIT "Initialisierungswert des Z‰hlers Bezugsmarkenverlust, wenn SG zuvor im NLDG war" VALUE 0x4E2BFA KwWU16 65535.00 dez 0.00 65535.00 FORMAT "%8.2" /end CHARACTERISTIC
/begin CHARACTERISTIC LBMMX "Maximalwert f¸r Z‰hler Bezugsmarkenverlust" VALUE 0x4E2BFC KwWU16 65535.00 dez 0.00 65535.00 FORMAT "%8.2" /end CHARACTERISTIC
/begin CHARACTERISTIC LNXQTM "Nat¸rlicher Logarithmus aus Temperaturquotient" CURVE 0x4EB85E KlAUwSstUwWUw 3.999939 fak_uw_b4 0.00 3.999939 FORMAT "%8.6"
 /begin AXIS_DESCR STD_AXIS xqtm_w fak_uw_b16 12 0.00 15.99976 FORMAT "%8.5" DEPOSIT ABSOLUTE /end AXIS_DESCR
/end CHARACTERISTIC
/begin CHARACTERISTIC MDNORM "Maximales indiziertes Motormoment f¸r Moment-Normierung" VALUE 0x4E29E9 KwUb 1008. md_ub_q16 0.00 1008. FORMAT "%5.0" /end CHARACTERISTIC
/begin CHARACTERISTIC MIMSRMXN "" CURVE 0x4E29BE KlAUwSstUwWUw 99.99847 rel_uw_b100 0.00 99.99847 FORMAT "%8.5"
 /begin AXIS_DESCR STD_AXIS nmot_w nmot_uw_q0p25 6 0.00 16383.75 FORMAT "%8.2" DEPOSIT ABSOLUTE /end AXIS_DESCR
/end CHARACTERISTIC
/begin CHARACTERISTIC MLMAX "Maximaler Luftfluﬂ f¸r die Lastberechnung nach SAE J1979" VALUE 0x4EACB2 KwUw 6553.500 m_uw_b6553p5 0.00 6553.500 FORMAT "%8.3" /end CHARACTERISTIC
/begin CHARACTERISTIC NKWKRIT "Drehzahlschwelle unterhalb der Krittische BM Fehler beruecksichtigt werden" VALUE 0x4E2BFF KwWU8 10200. nmot_ub_q40 0.00 10200. FORMAT "%5.0" /end CHARACTERISTIC
/begin CHARACTERISTIC NMOTOEL1 "Drehzahlschwelle 1 f¸r ÷ldruckanzeige" VALUE 0x4E2D14 KwWU16 16383.75 nmot_uw_q0p25 0.00 16383.75 FORMAT "%8.2" /end CHARACTERISTIC
/begin CHARACTERISTIC NMOTOEL2 "Drehzahlschwelle 2 f¸r ÷ldruckanzeige" VALUE 0x4E2D16 KwWU16 16383.75 nmot_uw_q0p25 0.00 16383.75 FORMAT "%8.2" /end CHARACTERISTIC
/begin CHARACTERISTIC NTUMTA "Schwelle Drehzahl f¸r Bestimmung Umgebungstemperatur" VALUE 0x4EB84A KwUb 10200. nmot_ub_q40 0.00 10200. FORMAT "%5.0" /end CHARACTERISTIC
/begin CHARACTERISTIC PGFLWA "Anzahl PG-Flankenwechsel f¸r DG-Fehler B_signal" VALUE 0x4E2C00 KwWU8 255.0 DEZ 0.00 255.0 FORMAT "%5.1" /end CHARACTERISTIC
/begin CHARACTERISTIC REF_OFFSET "Anzahl der Prellschritte f¸r Referenzierung" VAL_BLK 0x4ECAB0 KwbUw 6553.500 fak_q0p1 0.00 6553.500 FORMAT "%8.3" NUMBER 2 /end CHARACTERISTIC
/begin CHARACTERISTIC RKACOMN "untere Schwelle additive Korrektur pro Zeit LL-CO Abgleich" VALUE 0x4E3FF0 KwSw 20.01563 rel_sw_b1536 -20.01563 0.00 FORMAT "%8.5" /end CHARACTERISTIC
/begin CHARACTERISTIC RKACOMX "obere Schwelle additive Korrektur pro Zeit LL-CO Abgleich" VALUE 0x4E3FF2 KwSw 20.01563 rel_sw_b1536 0.00 20.01563 FORMAT "%8.5" /end CHARACTERISTIC
/begin CHARACTERISTIC STEPS_AKU "" MAP 0x4E524A KfAxUwAyUwSstxUwSstyUwWUw 6553.400 fak_q0p1 0.1000000 6553.500 FORMAT "%8.3"
 /begin AXIS_DESCR STD_AXIS nmot_w nmot_uw_q0p25 14 0.00 16383.75 FORMAT "%8.2" DEPOSIT ABSOLUTE /end AXIS_DESCR
 /begin AXIS_DESCR STD_AXIS vfzg_w vfzg_uw_b512 14 0.00 511.9922 FORMAT "%8.4" DEPOSIT ABSOLUTE /end AXIS_DESCR
/end CHARACTERISTIC
/begin CHARACTERISTIC STPSPEEDS "Desired speed values for the stepper (steps/sec)" CURVE 0x4E540E KlASwSstSwWSw 3276.700 fak_q0p1 0.00 3276.700 FORMAT "%8.3"
 /begin AXIS_DESCR STD_AXIS bypdiff_w_temp rel_sw_b100 11 -100.0000 99.99695 FORMAT "%8.4" DEPOSIT ABSOLUTE /end AXIS_DESCR
/end CHARACTERISTIC
/begin CHARACTERISTIC STP_INI "" VAL_BLK 0x4ECACE KwbUw 65535.00 dez 0.00 65535.00 FORMAT "%8.2" NUMBER 2 /end CHARACTERISTIC
/begin CHARACTERISTIC STP_MAX_POSITION "" VAL_BLK 0x4ECAB4 KwbSw 6553.500 fak_q0p1 -3276.800 3276.700 FORMAT "%8.3" NUMBER 2 /end CHARACTERISTIC
/begin CHARACTERISTIC STP_MAX_SPEED "" VALUE 0x4ECAB8 KwSw 6553.500 fak_q0p1 -3276.800 3276.700 FORMAT "%8.3" /end CHARACTERISTIC
/begin CHARACTERISTIC STP_REF "" VAL_BLK 0x4ECAD2 KwbUw 65535.00 dez 0.00 65535.00 FORMAT "%8.2" NUMBER 2 /end CHARACTERISTIC
/begin CHARACTERISTIC STP_VX_INC "" VALUE 0x4ECAC1 KwSb 12.10 fak_q0p1 0.6000 12.70 FORMAT "%5.2" /end CHARACTERISTIC
/begin CHARACTERISTIC STP_WIDE "Kennwertecodeblock Voll/Halbschrittmodus" VAL_BLK 0x4ECABA KwbUw 65535.00 dez 0.00 65535.00 FORMAT "%8.2" NUMBER 2 /end CHARACTERISTIC
/begin CHARACTERISTIC ST_DKW_MIN "" VALUE 0x4ECAD6 KwSw 6553.500 fak_q0p1 -3276.800 3276.700 FORMAT "%8.3" /end CHARACTERISTIC
/begin CHARACTERISTIC ST_REF_SPD "" VAL_BLK 0x4ECAD8 KwbSw 6553.500 fak_q0p1 -3276.800 3276.700 FORMAT "%8.3" NUMBER 2 /end CHARACTERISTIC
/begin CHARACTERISTIC ST_SPD_A_N "" VALUE 0x4ECADC KwSw 6553.500 fak_q0p1 -3276.800 3276.700 FORMAT "%8.3" /end CHARACTERISTIC
/begin CHARACTERISTIC ST_SPD_A_R "" VALUE 0x4ECADE KwSw 6553.500 fak_q0p1 -3276.800 3276.700 FORMAT "%8.3" /end CHARACTERISTIC
/begin CHARACTERISTIC ST_SPD_V_N1 "" VALUE 0x4ECAE0 KwSw 6553.500 fak_q0p1 -3276.800 3276.700 FORMAT "%8.3" /end CHARACTERISTIC
/begin CHARACTERISTIC ST_SPD_V_N2 "" VALUE 0x4ECAE2 KwSw 6553.500 fak_q0p1 -3276.800 3276.700 FORMAT "%8.3" /end CHARACTERISTIC
/begin CHARACTERISTIC TARGETBYPFIL "" CURVE 0x4E543C KlAUbSstUbWUw 655.350000 zk10msxs_uw_b655 0.0100001526 655.360000 FORMAT "%10.6"
 /begin AXIS_DESCR STD_AXIS tans temp_ub_q0p75_o48 5 -48.00 143.3 FORMAT "%5.1" DEPOSIT ABSOLUTE /end AXIS_DESCR
/end CHARACTERISTIC
/begin CHARACTERISTIC TASCNP "" VALUE 0x4E29BB KwUb 25.50 t100msxs_ub_b25p5 0.00 25.50 FORMAT "%5.2" /end CHARACTERISTIC
/begin CHARACTERISTIC TASCNP2 "" VALUE 0x4E29BC KwUb 2.550 t10msxs_ub_b2p55 0.00 2.550 FORMAT "%5.3" /end CHARACTERISTIC
/begin CHARACTERISTIC TDCABS "Zeit f¸r Timeouterkennung CAN-Schnittstelle ABS-SG" VALUE 0x4E29E2 KwWU16 655.3500 t10msxs_uw_b655p35 0.00 655.3500 FORMAT "%8.4" /end CHARACTERISTIC
/begin CHARACTERISTIC TDCANA1 "Zeit f¸r Fehlererkennung ""CAN_A Error passiv""" VALUE 0x4E29E6 KwWU8 2.550 t10msxs_ub_b2p55 0.00 2.550 FORMAT "%5.3" /end CHARACTERISTIC
/begin CHARACTERISTIC TDCANA3 "Zeit f¸r Fehlererkennung ""CAN_A BUS off""" VALUE 0x4E29E7 KwWU8 2.550 t10msxs_ub_b2p55 0.00 2.550 FORMAT "%5.3" /end CHARACTERISTIC
/begin CHARACTERISTIC TDCANAH "Heilungsentprellzeit f¸r CAN_A-Fehler" VALUE 0x4E29E8 KwWU8 2.550 t10msxs_ub_b2p55 0.00 2.550 FORMAT "%5.3" /end CHARACTERISTIC
/begin CHARACTERISTIC TDCAS "" VALUE 0x4E29D8 KwWU16 655.3500 t10msxs_uw_b655p35 0.00 655.3500 FORMAT "%8.4" /end CHARACTERISTIC
/begin CHARACTERISTIC TDCKOMBI "Zeit f¸r Timeouterkennung CAN-Schnittstelle Kombi-Instr." VALUE 0x4E29DA KwWU16 6553.500 t100msxs_uw_b6553p5 0.00 6553.500 FORMAT "%8.3" /end CHARACTERISTIC
/begin CHARACTERISTIC TDCZFE "Zeit f¸r Timeouterkennung CAN-Schnittstelle ZFE-SG" VALUE 0x4E29DE KwWU16 655.3500 t10msxs_uw_b655p35 0.00 655.3500 FORMAT "%8.4" /end CHARACTERISTIC
/begin CHARACTERISTIC TDEGFEMN "Zeitverzˆgerung f¸r Setzen des MIN-Fehlers" VALUE 0x4EB769 KwUb 25.50 t100msxs_ub_b25p5 0.00 25.50 FORMAT "%5.2" /end CHARACTERISTIC
/begin CHARACTERISTIC TDEGFEMX "Zeitverzˆgerung f¸r Setzen des MAX-Fehlers" VALUE 0x4EB76A KwUb 25.50 t100msxs_ub_b25p5 0.00 25.50 FORMAT "%5.2" /end CHARACTERISTIC
/begin CHARACTERISTIC TDEGFENO "Zeitverzˆgerung f¸r Setzen des NO-Fehlers" VALUE 0x4EB76B KwUb 25.50 t100msxs_ub_b25p5 0.00 25.50 FORMAT "%5.2" /end CHARACTERISTIC
/begin CHARACTERISTIC TDEGFEST "Zeitverzˆgerung nach Start" VALUE 0x4EB76C KwUb 25.50 t100msxs_ub_b25p5 0.00 25.50 FORMAT "%5.2" /end CHARACTERISTIC
/begin CHARACTERISTIC TDHCABS "Zeit f¸r Fehlerheilung CAN-Timeout ABS-SG" VALUE 0x4E29E4 KwWU16 6553.500 t100msxs_uw_b6553p5 0.00 6553.500 FORMAT "%8.3" /end CHARACTERISTIC
/begin CHARACTERISTIC TDHCKOMBI "Zeit f¸r Fehlerheilung CAN-Timeout Kombi-Instr." VALUE 0x4E29DC KwWU16 65535.00 t1sxs_uw_b65535 0.00 65535.00 FORMAT "%8.2" /end CHARACTERISTIC
/begin CHARACTERISTIC TDHCZFE "Zeit f¸r Fehlerheilung CAN-Timeout ZFE-SG" VALUE 0x4E29E0 KwWU16 6553.500 t100msxs_uw_b6553p5 0.00 6553.500 FORMAT "%8.3" /end CHARACTERISTIC
/begin CHARACTERISTIC TDVMAXH "" VALUE 0x4ECAC2 KwUb 25.50 t100msxs_ub_b25p5 0.00 25.50 FORMAT "%5.2" /end CHARACTERISTIC
/begin CHARACTERISTIC TDVMAXS "" VALUE 0x4ECAC3 KwUb 25.50 t100msxs_ub_b25p5 0.00 25.50 FORMAT "%5.2" /end CHARACTERISTIC
/begin CHARACTERISTIC TEPCL "Zeit ab Motorlauf bis EPCL-Testansteuerung Ende" VALUE 0x4E2BE3 KwUb 51.00 t200msxs_ub_b51 0.00 51.00 FORMAT "%5.2" /end CHARACTERISTIC
/begin CHARACTERISTIC TEPCLI "Zeit ab INI bis EPCL-Testansteuerung Ende" VALUE 0x4E2BE4 KwUb 51.00 t200msxs_ub_b51 0.00 51.00 FORMAT "%5.2" /end CHARACTERISTIC
/begin CHARACTERISTIC TLLCO "Motortemp. - Schwelle CO - Korrektur" VALUE 0x4E3FEE KwUb 191.3 temp_ub_q0p75_o48 -48.00 143.3 FORMAT "%5.1" /end CHARACTERISTIC
/begin CHARACTERISTIC TNLSGM "Nachlaufzeit f¸r SG abschalten" CURVE 0x4EB84C KlAUbSstUbWUb 255.0 t1sxs_ub_b255 0.00 255.0 FORMAT "%5.1"
 /begin AXIS_DESCR STD_AXIS tmotab temp_ub_q0p75_o48 6 -48.00 143.3 FORMAT "%5.1" DEPOSIT ABSOLUTE /end AXIS_DESCR
/end CHARACTERISTIC
/begin CHARACTERISTIC TNSURLP "Zeit rl-Praediktionsunterdrueckung im Nachlauf" VALUE 0x4E3FE9 KwUb 25.50 t100msxs_ub_b25p5 0.00 25.50 FORMAT "%5.2" /end CHARACTERISTIC
/begin CHARACTERISTIC TPLUHRC "Zeit f¸r Erkennung relative Zeit von Kombi-Uhr plausibel" VALUE 0x4EB890 KwUw 65535.00 t1sxs_ul_q1 0.00 65535.00 FORMAT "%8.2" /end CHARACTERISTIC
/begin CHARACTERISTIC TPLUHRR "Zeit f¸r Erkennung relative Zeit von Kombi-Uhr unplausibel" VALUE 0x4EB892 KwUw 655.3500 t10msxs_uw_b655p35 0.00 655.3500 FORMAT "%8.4" /end CHARACTERISTIC
/begin CHARACTERISTIC TRUECKDREH "" VALUE 0x4E2C01 KwWU8 25.50 t100msxs_ub_b25p5 0.00 25.50 FORMAT "%5.2" /end CHARACTERISTIC
/begin CHARACTERISTIC TSFAAA "Dummy: Tabellenanfang" VALUE 0x4F0154 KwUb 255.0 dez 0.00 255.0 FORMAT "%5.1" /end CHARACTERISTIC
/begin CHARACTERISTIC TSFAKLE "" VALUE 0x4F0156 KwWU8 255.0 dez 0.00 255.0 FORMAT "%5.1" /end CHARACTERISTIC
/begin CHARACTERISTIC TSFAS "" VALUE 0x4F0157 KwWU8 255.0 dez 0.00 255.0 FORMAT "%5.1" /end CHARACTERISTIC
/begin CHARACTERISTIC TSFBM "Fehlersummenzeit: Bezugsmarkengeber" VALUE 0x4F0158 KwUb 255.0 dez 0.00 255.0 FORMAT "%5.1" /end CHARACTERISTIC
/begin CHARACTERISTIC TSFCABS "Fehlersummenzeit: CAN-Schnittstelle, Timeout ABS" VALUE 0x4F015A KwWU8 255.0 dez 0.00 255.0 FORMAT "%5.1" /end CHARACTERISTIC
/begin CHARACTERISTIC TSFCANA "" VALUE 0x4F015B KwWU8 255.0 dez 0.00 255.0 FORMAT "%5.1" /end CHARACTERISTIC
/begin CHARACTERISTIC TSFCAS "" VALUE 0x4F015C KwWU8 255.0 dez 0.00 255.0 FORMAT "%5.1" /end CHARACTERISTIC
/begin CHARACTERISTIC TSFCKOMBI "Fehlersummenzeit: CAN-Schnittstelle, Timeout KOMBI" VALUE 0x4F015D KwWU8 255.0 dez 0.00 255.0 FORMAT "%5.1" /end CHARACTERISTIC
/begin CHARACTERISTIC TSFCZFE "Fehlersummenzeit: CAN-Schnittstelle, Timeout ZFE" VALUE 0x4F015E KwWU8 255.0 dez 0.00 255.0 FORMAT "%5.1" /end CHARACTERISTIC
/begin CHARACTERISTIC TSFDKP "" VALUE 0x4F015F KwWU8 255.0 dez 0.00 255.0 FORMAT "%5.1" /end CHARACTERISTIC
/begin CHARACTERISTIC TSFDKPA "" VALUE 0x4F0160 KwWU8 255.0 dez 0.00 255.0 FORMAT "%5.1" /end CHARACTERISTIC
/begin CHARACTERISTIC TSFEKPE "Schwelle f¸r Fehlerschwere: EKPE" VALUE 0x4F0166 KwWU8 255.0 dez 0.00 255.0 FORMAT "%5.1" /end CHARACTERISTIC
/begin CHARACTERISTIC TSFEV1E "Schwelle f¸r Fehlerschwere: EV1E" VALUE 0x4F0167 KwWU8 255.0 dez 0.00 255.0 FORMAT "%5.1" /end CHARACTERISTIC
/begin CHARACTERISTIC TSFEV2E "Schwelle f¸r Fehlerschwere: EV2E" VALUE 0x4F0168 KwWU8 255.0 dez 0.00 255.0 FORMAT "%5.1" /end CHARACTERISTIC
/begin CHARACTERISTIC TSFEV3E "Schwelle f¸r Fehlerschwere: EV3E" VALUE 0x4F0169 KwWU8 255.0 dez 0.00 255.0 FORMAT "%5.1" /end CHARACTERISTIC
/begin CHARACTERISTIC TSFEV4E "Schwelle f¸r Fehlerschwere: EV4E" VALUE 0x4F016A KwWU8 255.0 dez 0.00 255.0 FORMAT "%5.1" /end CHARACTERISTIC
/begin CHARACTERISTIC TSFEWS "" VALUE 0x4F016B KwWU8 255.0 dez 0.00 255.0 FORMAT "%5.1" /end CHARACTERISTIC
/begin CHARACTERISTIC TSFEWSE "Schwelle f¸r Fehlerschwere: EWSE" VALUE 0x4F016C KwWU8 255.0 dez 0.00 255.0 FORMAT "%5.1" /end CHARACTERISTIC
/begin CHARACTERISTIC TSFKAT "Fehlersummenzeit: Katalysator-Konvertierung" VALUE 0x4F0179 KwWU8 255.0 dez 0.00 255.0 FORMAT "%5.1" /end CHARACTERISTIC
/begin CHARACTERISTIC TSFKILL "Fehlersummenzeit: Diagnose Killschalter" VALUE 0x4F017C KwWU8 255.0 dez 0.00 255.0 FORMAT "%5.1" /end CHARACTERISTIC
/begin CHARACTERISTIC TSFKL15 "Fehlersummenzeit: Diagnose Klemme 15 Schalter" VALUE 0x4F017D KwWU8 255.0 dez 0.00 255.0 FORMAT "%5.1" /end CHARACTERISTIC
/begin CHARACTERISTIC TSFKRNT "Fehlersummenzeit: Klopfregelung Nulltest" VALUE 0x4F017E KwUb 255.0 dez 0.00 255.0 FORMAT "%5.1" /end CHARACTERISTIC
/begin CHARACTERISTIC TSFKROF "Fehlersummenzeit: Klopfregelung Offset" VALUE 0x4F017F KwUb 255.0 dez 0.00 255.0 FORMAT "%5.1" /end CHARACTERISTIC
/begin CHARACTERISTIC TSFKRTP "Fehlersummenzeit: Klopfregelung Testimpuls" VALUE 0x4F0180 KwUb 255.0 dez 0.00 255.0 FORMAT "%5.1" /end CHARACTERISTIC
/begin CHARACTERISTIC TSFKS "" VALUE 0x4F0181 KwUb 255.0 dez 0.00 255.0 FORMAT "%5.1" /end CHARACTERISTIC
/begin CHARACTERISTIC TSFKS1 "Fehlersummenzeit: Klopfsensor 1" VALUE 0x4F0182 KwUb 255.0 dez 0.00 255.0 FORMAT "%5.1" /end CHARACTERISTIC
/begin CHARACTERISTIC TSFKS2 "Fehlersummenzeit: Klopfsensor 2" VALUE 0x4F0183 KwUb 255.0 dez 0.00 255.0 FORMAT "%5.1" /end CHARACTERISTIC
/begin CHARACTERISTIC TSFN "Fehlersummenzeit: Drehzahlgeber" VALUE 0x4F018F KwUb 255.0 dez 0.00 255.0 FORMAT "%5.1" /end CHARACTERISTIC
/begin CHARACTERISTIC TSFZZZ "Dummy: Tabellenende" VALUE 0x4F01B8 KwUb 255.0 dez 0.00 255.0 FORMAT "%5.1" /end CHARACTERISTIC
/begin CHARACTERISTIC TUMTAI "Initialisierungswert Umgebungstemperatur" VALUE 0x4EB859 KwUb 191.3 temp_ub_q0p75_o48 -48.00 143.3 FORMAT "%5.1" /end CHARACTERISTIC
/begin CHARACTERISTIC TVCO "CO-Korrektur" CURVE 0x4E3FF4 KlASwSstSwWSw 3071.953 rel_sw_b1536 -1536.000 1535.953 FORMAT "%8.3"
 /begin AXIS_DESCR STD_AXIS co_pot_w dez 8 -32768.00 32767.00 FORMAT "%8.2" DEPOSIT ABSOLUTE /end AXIS_DESCR
/end CHARACTERISTIC
/begin CHARACTERISTIC TVPOELAN1 "Verzˆgerungszeit 1 f¸r ÷ldruckanzeige" VALUE 0x4E2D18 KwWU8 25.50 t_q0p1 0.00 25.50 FORMAT "%5.2" /end CHARACTERISTIC
/begin CHARACTERISTIC TVPOELAN2 "Verzˆgerungszeit 2 f¸r ÷ldruckanzeige" VALUE 0x4E2D19 KwWU8 25.50 t_q0p1 0.00 25.50 FORMAT "%5.2" /end CHARACTERISTIC
/begin CHARACTERISTIC TWBDCY "Wartezeit f¸r Erkennung Bedingung 'driving cycle'" VALUE 0x4EA2D0 KwUw 13107.00 t200msxs_uw_q0p2 0.00 13107.00 FORMAT "%8.2" /end CHARACTERISTIC
/begin CHARACTERISTIC UBDDG "" VALUE 0x4E2C02 KwWU8 24.02 spg_ubatt 0.00 24.02 FORMAT "%5.2" /end CHARACTERISTIC
/begin CHARACTERISTIC VASRM "Geschwindigkeitsschwelle f¸r Schlechtwegerkennung" VALUE 0x4E2D1A KwUb 318.8 vfzg_ub_q1p25 0.00 318.8 FORMAT "%5.1" /end CHARACTERISTIC
/begin CHARACTERISTIC VTUMTA "Schwelle Fahrzeuggeschwindigkeit f¸r Bestimmung Umgebungstemperatur" VALUE 0x4EB85A KwUb 318.8 vfzg_ub_q1p25 0.00 318.8 FORMAT "%5.1" /end CHARACTERISTIC
/begin CHARACTERISTIC VX_ACT_THR "" VALUE 0x4E5209 KwUb 318.8 vfzg_ub_q1p25 0.00 318.8 FORMAT "%5.1" /end CHARACTERISTIC
/begin CHARACTERISTIC VX_DVFZST "" VALUE 0x4ECAE4 KwSw 40958.75 vfzg_ub_q1p25 0.00 40958.75 FORMAT "%8.2" /end CHARACTERISTIC
/begin CHARACTERISTIC VX_THR_NX "" VALUE 0x4E520A KwUb 318.8 vfzg_ub_q1p25 0.00 318.8 FORMAT "%5.1" /end CHARACTERISTIC
/begin CHARACTERISTIC VX_THR_NXL "" VALUE 0x4E520B KwUb 318.8 vfzg_ub_q1p25 0.00 318.8 FORMAT "%5.1" /end CHARACTERISTIC
/begin CHARACTERISTIC VX_THR_NXN "" VALUE 0x4E520C KwUb 318.8 vfzg_ub_q1p25 0.00 318.8 FORMAT "%5.1" /end CHARACTERISTIC
/begin CHARACTERISTIC ZBRT "Zeitkonstante f¸r Brennraumtempmodell" VALUE 0x4EB740 KwUb 25.4996 zk100msxs_ub_b25p5 0.100392 25.6000 FORMAT "%7.4" /end CHARACTERISTIC
/begin CHARACTERISTIC ZKTABTU "Zeitkonstante f¸r Motorabk¸hlung" CURVE 0x4EB894 KlAUbSstUwWUw 65535.00 t1sxs_uw_q1 0.00 65535.00 FORMAT "%8.2"
 /begin AXIS_DESCR STD_AXIS tum_ein temp_ub_q0p75_o48 4 -48.00000 49103.25 FORMAT "%8.2" DEPOSIT ABSOLUTE /end AXIS_DESCR
/end CHARACTERISTIC
/begin CHARACTERISTIC ZTDAGR "Zeitkonstante Temperaturdynamik bei AGR Auf- Abschaltung" VALUE 0x4EB764 KwUw 6553.50000 zk100msxs_uw_b6553 0.100001526 6553.60000 FORMAT "%10.5" /end CHARACTERISTIC
/begin CHARACTERISTIC ZTMMBR "Zeitkonstante Motortemperatur f¸r Brennraumtempmodell" VALUE 0x4EB766 KwUw 6553.50000 zk100msxs_uw_b6553 0.100001526 6553.60000 FORMAT "%10.5" /end CHARACTERISTIC
/begin CHARACTERISTIC ZVTPRGSU "Zeitkonstante Tiefpaﬂfilterung bei Saugrohrklappendynamik" VALUE 0x4E3B8A KwUb 5.08000 zk20msxs_ub_b5p1 0.0200000 5.10000 FORMAT "%7.5" /end CHARACTERISTIC
/begin MEASUREMENT addsu_u "AD-Messwert Umgebungsdrucksensor; DFPM Umweltbedingung" UBYTE dez 1 100 0 255 FORMAT "%5.1" ECU_ADDRESS 0x7FD894 /end MEASUREMENT
/begin MEASUREMENT adta_u "AD-Messwert Ansauglufttemperatur; DFPM Umweltbedingung" UBYTE dez 1 100 0 255 FORMAT "%5.1" ECU_ADDRESS 0x7FD895 /end MEASUREMENT
/begin MEASUREMENT adtm_u "AD-Messwert Motortemperatur; DFPM Umweltbedingung" UBYTE dez 1 100 0 255 FORMAT "%5.1" ECU_ADDRESS 0x7FD896 /end MEASUREMENT
/begin MEASUREMENT agrr "Abgasr¸ckf¸hrrate" UBYTE rel_ub_b99p6 1 100 0 99.6094 FORMAT "%5.2" ECU_ADDRESS 0x7FD90A /end MEASUREMENT
/begin MEASUREMENT agrr_w "Abgasr¸ckf¸hrrate word" UWORD rel_uw_b100 1 100 0 99.9985 FORMAT "%8.5" ECU_ADDRESS 0x7FDC1A /end MEASUREMENT
/begin MEASUREMENT asccod "" UBYTE dez 1 100 0 255 FORMAT "%5.1" ECU_ADDRESS 0x7F9ACB /end MEASUREMENT
/begin MEASUREMENT asc_alive "" UBYTE dez 1 100 0 15 FORMAT "%5.2" ECU_ADDRESS 0x7FD889 /end MEASUREMENT
/begin MEASUREMENT Async_cntr "" UBYTE dez 1 100 0 255 FORMAT "%5.1" ARRAY_SIZE 2 ECU_ADDRESS 0x7FD98C /end MEASUREMENT
/begin MEASUREMENT bbdcy "Byte f¸r Bedingung B_dcy als Triggerevent in DCLA" UBYTE dez 1 100 0 255 FORMAT "%5.1" ECU_ADDRESS 0x7FD891 /end MEASUREMENT
/begin MEASUREMENT bbno "Byte f¸r Bedingung B_no  als Triggerevent in DCLA" UBYTE dez 1 100 0 255 FORMAT "%5.1" ECU_ADDRESS 0x7F9ADB /end MEASUREMENT
/begin MEASUREMENT bbsp3 "Byte f¸r Bedingung B_sp3 als Triggerevent in DCLA" UBYTE dez 1 100 0 255 FORMAT "%5.1" ECU_ADDRESS 0x7F9ADC /end MEASUREMENT
/begin MEASUREMENT bbtim "Byte f¸r Bedingung B_tim als Triggerevent in DCLA" UBYTE dez 1 100 0 255 FORMAT "%5.1" ECU_ADDRESS 0x7FD8C8 /end MEASUREMENT
/begin MEASUREMENT BgtabstNvBits "" UBYTE dez 1 100 0 255 FORMAT "%5.1" ECU_ADDRESS 0x7F9BAC /end MEASUREMENT
/begin MEASUREMENT bsc "Radbeschleunigungssignal aus ABS-Sensorsignal berechnet" UBYTE acc_ub_b55p55 1 100 0 55.335 FORMAT "%5.2" ECU_ADDRESS 0x7FD8F8 /end MEASUREMENT
/begin MEASUREMENT bypdiff_w_temp "" SWORD rel_sw_b100 1 100 -100 99.9969 FORMAT "%8.4" ECU_ADDRESS 0x7FDDF0 /end MEASUREMENT
/begin MEASUREMENT bypdif_w_a "Differenz zw. Soll und Istwert Stepper" SWORD rel_sw_b100 1 100 -100 99.9969 FORMAT "%8.4" ARRAY_SIZE 2 ECU_ADDRESS 0x7FDDF2 /end MEASUREMENT
/begin MEASUREMENT bypinp_w_a "Stepper position input for target stepper position generation" UWORD rel_uw_b100 1 100 0 99.9985 FORMAT "%8.5" ARRAY_SIZE 2 ECU_ADDRESS 0x7FDDF6 /end MEASUREMENT
/begin MEASUREMENT bypist_a "aktuelle Stepperposition" UBYTE rel_ub_b99p6 1 100 0 99.6094 FORMAT "%5.2" ARRAY_SIZE 2 ECU_ADDRESS 0x7FD9A0 /end MEASUREMENT
/begin MEASUREMENT bypist_w_a "Current stepper position in % (WORD)" UWORD rel_uw_b100 1 100 0 99.9985 FORMAT "%8.5" ARRAY_SIZE 2 ECU_ADDRESS 0x7FDDFA /end MEASUREMENT
/begin MEASUREMENT bypstp_w_a "" UWORD rel_uw_b100 1 100 0 99.9985 FORMAT "%8.5" ARRAY_SIZE 2 ECU_ADDRESS 0x7FDDFE /end MEASUREMENT
/begin MEASUREMENT B_abs "" UBYTE B_TRUE 1 100 0 1 BIT_MASK 0x1 FORMAT "%13.11" ECU_ADDRESS 0x7F9ACD /end MEASUREMENT
/begin MEASUREMENT B_abs1cok "Bedingung: CAN-Botschaft ABS_1_MOTBK vorhanden" UBYTE B_TRUE 1 100 0 1 BIT_MASK 0x1 FORMAT "%13.11" ECU_ADDRESS 0x7FB939 /end MEASUREMENT
/begin MEASUREMENT B_abs1new "Bedingung CAN-ABS_1_MOTBK-Botschaft empfangen" UBYTE B_TRUE 1 100 0 1 BIT_MASK 0x1 FORMAT "%13.11" ECU_ADDRESS 0x7FB93A /end MEASUREMENT
/begin MEASUREMENT B_abs2cok "Bedingung: CAN-Botschaft SPEED_MOTBK vorhanden" UBYTE B_TRUE 1 100 0 1 BIT_MASK 0x1 FORMAT "%13.11" ECU_ADDRESS 0x7FB93B /end MEASUREMENT
/begin MEASUREMENT B_abs2new "Bedingung CAN-SPEED_MOTBK-Botschaft empfangen" UBYTE B_TRUE 1 100 0 1 BIT_MASK 0x1 FORMAT "%13.11" ECU_ADDRESS 0x7FB93C /end MEASUREMENT
/begin MEASUREMENT B_asc1cok "" UBYTE B_TRUE 1 100 0 1 BIT_MASK 0x1 FORMAT "%13.11" ECU_ADDRESS 0x7FB91E /end MEASUREMENT
/begin MEASUREMENT B_asc1new "" UBYTE B_TRUE 1 100 0 1 BIT_MASK 0x1 FORMAT "%13.11" ECU_ADDRESS 0x7FB91F /end MEASUREMENT
/begin MEASUREMENT B_ascdme "" UBYTE B_TRUE 1 100 0 1 BIT_MASK 0x1 FORMAT "%13.11" ECU_ADDRESS 0x7FB91A /end MEASUREMENT
/begin MEASUREMENT B_ascpkw "" UBYTE B_TRUE 1 100 0 1 BIT_MASK 0x1 FORMAT "%13.11" ECU_ADDRESS 0x7F9ACA /end MEASUREMENT
/begin MEASUREMENT B_ascsipl "" UBYTE B_TRUE 1 100 0 1 BIT_MASK 0x1 FORMAT "%13.11" ECU_ADDRESS 0x7FB91B /end MEASUREMENT
/begin MEASUREMENT B_asc_reg "" UBYTE B_TRUE 1 100 0 1 BIT_MASK 0x1 FORMAT "%13.11" ECU_ADDRESS 0x7FB920 /end MEASUREMENT
/begin MEASUREMENT B_asrext "Bedingung f¸r externe ASR-Anforderung" UBYTE B_TRUE 1 100 0 1 BIT_MASK 0x1 FORMAT "%13.11" ECU_ADDRESS 0x7FB921 /end MEASUREMENT
/begin MEASUREMENT B_asrextmem "" UBYTE B_TRUE 1 100 0 1 BIT_MASK 0x1 FORMAT "%13.11" ECU_ADDRESS 0x7FB922 /end MEASUREMENT
/begin MEASUREMENT B_autget "Bedingung Automatikgetriebe" UBYTE B_TRUE 1 100 0 1 BIT_MASK 0x1 FORMAT "%13.11" ECU_ADDRESS 0x7FB925 /end MEASUREMENT
/begin MEASUREMENT B_beakle "" UWORD B_TRUE 1 100 0 1 BIT_MASK 0x20 FORMAT "%13.11" ECU_ADDRESS 0x7F9570 /end MEASUREMENT
/begin MEASUREMENT B_beas "" UWORD B_TRUE 1 100 0 1 BIT_MASK 0x20 FORMAT "%13.11" ECU_ADDRESS 0x7F9574 /end MEASUREMENT
/begin MEASUREMENT B_bebm "Bedingung Bandende-Funktionsanforderung Bezugsmarke erkannt" UWORD B_TRUE 1 100 0 1 BIT_MASK 0x20 FORMAT "%13.11" ECU_ADDRESS 0x7F9578 /end MEASUREMENT
/begin MEASUREMENT B_becabs "" UWORD B_TRUE 1 100 0 1 BIT_MASK 0x20 FORMAT "%13.11" ECU_ADDRESS 0x7F9580 /end MEASUREMENT
/begin MEASUREMENT B_becana "" UWORD B_TRUE 1 100 0 1 BIT_MASK 0x20 FORMAT "%13.11" ECU_ADDRESS 0x7F9584 /end MEASUREMENT
/begin MEASUREMENT B_becas "" UWORD B_TRUE 1 100 0 1 BIT_MASK 0x20 FORMAT "%13.11" ECU_ADDRESS 0x7F9588 /end MEASUREMENT
/begin MEASUREMENT B_beckombi "" UWORD B_TRUE 1 100 0 1 BIT_MASK 0x20 FORMAT "%13.11" ECU_ADDRESS 0x7F958C /end MEASUREMENT
/begin MEASUREMENT B_beczfe "" UWORD B_TRUE 1 100 0 1 BIT_MASK 0x20 FORMAT "%13.11" ECU_ADDRESS 0x7F9590 /end MEASUREMENT
/begin MEASUREMENT B_bedkp "" UWORD B_TRUE 1 100 0 1 BIT_MASK 0x20 FORMAT "%13.11" ECU_ADDRESS 0x7F9594 /end MEASUREMENT
/begin MEASUREMENT B_bedkpa "" UWORD B_TRUE 1 100 0 1 BIT_MASK 0x20 FORMAT "%13.11" ECU_ADDRESS 0x7F9598 /end MEASUREMENT
/begin MEASUREMENT B_beekpe "Pr¸fung am Bandende: EKPE" UWORD B_TRUE 1 100 0 1 BIT_MASK 0x20 FORMAT "%13.11" ECU_ADDRESS 0x7F95B0 /end MEASUREMENT
/begin MEASUREMENT B_beev1e "Pr¸fung am Bandende: EV1E" UWORD B_TRUE 1 100 0 1 BIT_MASK 0x20 FORMAT "%13.11" ECU_ADDRESS 0x7F95B4 /end MEASUREMENT
/begin MEASUREMENT B_beev2e "Pr¸fung am Bandende: EV2E" UWORD B_TRUE 1 100 0 1 BIT_MASK 0x20 FORMAT "%13.11" ECU_ADDRESS 0x7F95B8 /end MEASUREMENT
/begin MEASUREMENT B_beev3e "Pr¸fung am Bandende: EV3E" UWORD B_TRUE 1 100 0 1 BIT_MASK 0x20 FORMAT "%13.11" ECU_ADDRESS 0x7F95BC /end MEASUREMENT
/begin MEASUREMENT B_beev4e "Pr¸fung am Bandende: EV4E" UWORD B_TRUE 1 100 0 1 BIT_MASK 0x20 FORMAT "%13.11" ECU_ADDRESS 0x7F95C0 /end MEASUREMENT
/begin MEASUREMENT B_beews "" UWORD B_TRUE 1 100 0 1 BIT_MASK 0x20 FORMAT "%13.11" ECU_ADDRESS 0x7F95C4 /end MEASUREMENT
/begin MEASUREMENT B_beewse "Pr¸fung am Bandende: EWSE" UWORD B_TRUE 1 100 0 1 BIT_MASK 0x20 FORMAT "%13.11" ECU_ADDRESS 0x7F95C8 /end MEASUREMENT
/begin MEASUREMENT B_bekat "Bedingung Bandende-Funktionsanforderung Katalysatordiagnose" UWORD B_TRUE 1 100 0 1 BIT_MASK 0x20 FORMAT "%13.11" ECU_ADDRESS 0x7F95FC /end MEASUREMENT
/begin MEASUREMENT B_bekill "" UWORD B_TRUE 1 100 0 1 BIT_MASK 0x20 FORMAT "%13.11" ECU_ADDRESS 0x7F9608 /end MEASUREMENT
/begin MEASUREMENT B_bekl15 "" UWORD B_TRUE 1 100 0 1 BIT_MASK 0x20 FORMAT "%13.11" ECU_ADDRESS 0x7F960C /end MEASUREMENT
/begin MEASUREMENT B_bekrnt "Bedingung Bandende-Funktionsanforderung Klopfregelung Diagnose Nulltest" UWORD B_TRUE 1 100 0 1 BIT_MASK 0x20 FORMAT "%13.11" ECU_ADDRESS 0x7F9610 /end MEASUREMENT
/begin MEASUREMENT B_bekrof "Bedingung Bandende-Funktionsanforderung Klopfregelung Diagnose Integrator Offset" UWORD B_TRUE 1 100 0 1 BIT_MASK 0x20 FORMAT "%13.11" ECU_ADDRESS 0x7F9614 /end MEASUREMENT
/begin MEASUREMENT B_bekrtp "Bedingung Bandende-Funktionsanforderung Klopfregelung Diagnose Testpuls" UWORD B_TRUE 1 100 0 1 BIT_MASK 0x20 FORMAT "%13.11" ECU_ADDRESS 0x7F9618 /end MEASUREMENT
/begin MEASUREMENT B_beks "" UWORD B_TRUE 1 100 0 1 BIT_MASK 0x20 FORMAT "%13.11" ECU_ADDRESS 0x7F961C /end MEASUREMENT
/begin MEASUREMENT B_beks1 "Bedingung Bandende-Funktionsanforderung Diagnose Klopfsensor 1" UWORD B_TRUE 1 100 0 1 BIT_MASK 0x20 FORMAT "%13.11" ECU_ADDRESS 0x7F9620 /end MEASUREMENT
/begin MEASUREMENT B_beks2 "Bedingung Bandende-Funktionsanforderung Diagnose Klopfsensor 2" UWORD B_TRUE 1 100 0 1 BIT_MASK 0x20 FORMAT "%13.11" ECU_ADDRESS 0x7F9624 /end MEASUREMENT
/begin MEASUREMENT B_ben "" UWORD B_TRUE 1 100 0 1 BIT_MASK 0x20 FORMAT "%13.11" ECU_ADDRESS 0x7F9654 /end MEASUREMENT
/begin MEASUREMENT B_bkakle "" UWORD B_TRUE 1 100 0 1 BIT_MASK 0x40 FORMAT "%13.11" ECU_ADDRESS 0x7F9570 /end MEASUREMENT
/begin MEASUREMENT B_bkas "" UWORD B_TRUE 1 100 0 1 BIT_MASK 0x40 FORMAT "%13.11" ECU_ADDRESS 0x7F9574 /end MEASUREMENT
/begin MEASUREMENT B_bkbm "Bedingung Ersatzwert aktiv: Bezugsmarke" UWORD B_TRUE 1 100 0 1 BIT_MASK 0x40 FORMAT "%13.11" ECU_ADDRESS 0x7F9578 /end MEASUREMENT
/begin MEASUREMENT B_bkcabs "Bedingung: CAN-Schnittstelle, Timeout ABS" UWORD B_TRUE 1 100 0 1 BIT_MASK 0x40 FORMAT "%13.11" ECU_ADDRESS 0x7F9580 /end MEASUREMENT
/begin MEASUREMENT B_bkcana "" UWORD B_TRUE 1 100 0 1 BIT_MASK 0x40 FORMAT "%13.11" ECU_ADDRESS 0x7F9584 /end MEASUREMENT
/begin MEASUREMENT B_bkcas "" UWORD B_TRUE 1 100 0 1 BIT_MASK 0x40 FORMAT "%13.11" ECU_ADDRESS 0x7F9588 /end MEASUREMENT
/begin MEASUREMENT B_bkckombi "Bedingung: CAN-Schnittstelle, Timeout KOMBI" UWORD B_TRUE 1 100 0 1 BIT_MASK 0x40 FORMAT "%13.11" ECU_ADDRESS 0x7F958C /end MEASUREMENT
/begin MEASUREMENT B_bkczfe "Bedingung: CAN-Schnittstelle, Timeout ZFE" UWORD B_TRUE 1 100 0 1 BIT_MASK 0x40 FORMAT "%13.11" ECU_ADDRESS 0x7F9590 /end MEASUREMENT
/begin MEASUREMENT B_bkdkp "" UWORD B_TRUE 1 100 0 1 BIT_MASK 0x40 FORMAT "%13.11" ECU_ADDRESS 0x7F9594 /end MEASUREMENT
/begin MEASUREMENT B_bkdkpa "" UWORD B_TRUE 1 100 0 1 BIT_MASK 0x40 FORMAT "%13.11" ECU_ADDRESS 0x7F9598 /end MEASUREMENT
/begin MEASUREMENT B_bkekpe "Diagnose verwendet Ersatzwert: EKPE" UWORD B_TRUE 1 100 0 1 BIT_MASK 0x40 FORMAT "%13.11" ECU_ADDRESS 0x7F95B0 /end MEASUREMENT
/begin MEASUREMENT B_bkev1e "Diagnose verwendet Ersatzwert: EV1E" UWORD B_TRUE 1 100 0 1 BIT_MASK 0x40 FORMAT "%13.11" ECU_ADDRESS 0x7F95B4 /end MEASUREMENT
/begin MEASUREMENT B_bkev2e "Diagnose verwendet Ersatzwert: EV2E" UWORD B_TRUE 1 100 0 1 BIT_MASK 0x40 FORMAT "%13.11" ECU_ADDRESS 0x7F95B8 /end MEASUREMENT
/begin MEASUREMENT B_bkev3e "Diagnose verwendet Ersatzwert: EV3E" UWORD B_TRUE 1 100 0 1 BIT_MASK 0x40 FORMAT "%13.11" ECU_ADDRESS 0x7F95BC /end MEASUREMENT
/begin MEASUREMENT B_bkev4e "Diagnose verwendet Ersatzwert: EV4E" UWORD B_TRUE 1 100 0 1 BIT_MASK 0x40 FORMAT "%13.11" ECU_ADDRESS 0x7F95C0 /end MEASUREMENT
/begin MEASUREMENT B_bkews "" UWORD B_TRUE 1 100 0 1 BIT_MASK 0x40 FORMAT "%13.11" ECU_ADDRESS 0x7F95C4 /end MEASUREMENT
/begin MEASUREMENT B_bkewse "Diagnose verwendet Ersatzwert: EWSE" UWORD B_TRUE 1 100 0 1 BIT_MASK 0x40 FORMAT "%13.11" ECU_ADDRESS 0x7F95C8 /end MEASUREMENT
/begin MEASUREMENT B_bkkat "Bedingung Ersatzwert f¸r Katalysator" UWORD B_TRUE 1 100 0 1 BIT_MASK 0x40 FORMAT "%13.11" ECU_ADDRESS 0x7F95FC /end MEASUREMENT
/begin MEASUREMENT B_bkkill "Bedingung: Diagnose Killschalter" UWORD B_TRUE 1 100 0 1 BIT_MASK 0x40 FORMAT "%13.11" ECU_ADDRESS 0x7F9608 /end MEASUREMENT
/begin MEASUREMENT B_bkkl15 "Bedingung: Diagnose Klemme 15 Schalter" UWORD B_TRUE 1 100 0 1 BIT_MASK 0x40 FORMAT "%13.11" ECU_ADDRESS 0x7F960C /end MEASUREMENT
/begin MEASUREMENT B_bkkrnt "Bedingung: Klopfregelung Nulltest aktiv" UWORD B_TRUE 1 100 0 1 BIT_MASK 0x40 FORMAT "%13.11" ECU_ADDRESS 0x7F9610 /end MEASUREMENT
/begin MEASUREMENT B_bkkrof "Bedingung: Klopfregelung Offset aktiv" UWORD B_TRUE 1 100 0 1 BIT_MASK 0x40 FORMAT "%13.11" ECU_ADDRESS 0x7F9614 /end MEASUREMENT
/begin MEASUREMENT B_bkkrtp "Bedingung: Klopfregelung Testimpuls aktiv" UWORD B_TRUE 1 100 0 1 BIT_MASK 0x40 FORMAT "%13.11" ECU_ADDRESS 0x7F9618 /end MEASUREMENT
/begin MEASUREMENT B_bkks "" UWORD B_TRUE 1 100 0 1 BIT_MASK 0x40 FORMAT "%13.11" ECU_ADDRESS 0x7F961C /end MEASUREMENT
/begin MEASUREMENT B_bkks1 "Bedingung: Klopfsensor 1 aktiv" UWORD B_TRUE 1 100 0 1 BIT_MASK 0x40 FORMAT "%13.11" ECU_ADDRESS 0x7F9620 /end MEASUREMENT
/begin MEASUREMENT B_bkks2 "Bedingung: Klopfsensor 2 aktiv" UWORD B_TRUE 1 100 0 1 BIT_MASK 0x40 FORMAT "%13.11" ECU_ADDRESS 0x7F9624 /end MEASUREMENT
/begin MEASUREMENT B_bkn "Bedingung: Drehzahlsignalgeber aktiv" UWORD B_TRUE 1 100 0 1 BIT_MASK 0x40 FORMAT "%13.11" ECU_ADDRESS 0x7F9654 /end MEASUREMENT
/begin MEASUREMENT B_brefab_a "Bit f¸r Referenzierung abgebrochen" UBYTE dez 1 100 0 255 FORMAT "%5.1" ARRAY_SIZE 2 ECU_ADDRESS 0x7FD9A4 /end MEASUREMENT
/begin MEASUREMENT B_brkfoot "Bedingung Fussbremse betaetigt" UBYTE B_TRUE 1 100 0 1 BIT_MASK 0x1 FORMAT "%13.11" ECU_ADDRESS 0x7FB930 /end MEASUREMENT
/begin MEASUREMENT B_brkhand "Bedingung Handbremse betaetigt" UBYTE B_TRUE 1 100 0 1 BIT_MASK 0x1 FORMAT "%13.11" ECU_ADDRESS 0x7FB931 /end MEASUREMENT
/begin MEASUREMENT B_bypav "Condition: average value of desired stepper positions to be used in calculations" UBYTE B_TRUE 1 100 0 1 BIT_MASK 0x1 FORMAT "%13.11" ECU_ADDRESS 0x7FBAB2 /end MEASUREMENT
/begin MEASUREMENT B_bypresck "" UBYTE B_TRUE 1 100 0 1 BIT_MASK 0x1 FORMAT "%13.11" ECU_ADDRESS 0x7FBAB3 /end MEASUREMENT
/begin MEASUREMENT B_bypres_a "Condition: stepper desired speed is in resonance speed range" UBYTE dez 1 100 0 255 FORMAT "%5.1" ARRAY_SIZE 2 ECU_ADDRESS 0x7FD9A8 /end MEASUREMENT
/begin MEASUREMENT B_clakle "" UWORD B_TRUE 1 100 0 1 BIT_MASK 0x80 FORMAT "%13.11" ECU_ADDRESS 0x7F9570 /end MEASUREMENT
/begin MEASUREMENT B_clas "" UWORD B_TRUE 1 100 0 1 BIT_MASK 0x80 FORMAT "%13.11" ECU_ADDRESS 0x7F9574 /end MEASUREMENT
/begin MEASUREMENT B_clbm "Bedingung Fehlerpfad Bezugsmarkengeber lˆschen" UWORD B_TRUE 1 100 0 1 BIT_MASK 0x80 FORMAT "%13.11" ECU_ADDRESS 0x7F9578 /end MEASUREMENT
/begin MEASUREMENT B_clcabs "Bedingung Fehlerpfad CABS lˆschen" UWORD B_TRUE 1 100 0 1 BIT_MASK 0x80 FORMAT "%13.11" ECU_ADDRESS 0x7F9580 /end MEASUREMENT
/begin MEASUREMENT B_clcana "" UWORD B_TRUE 1 100 0 1 BIT_MASK 0x80 FORMAT "%13.11" ECU_ADDRESS 0x7F9584 /end MEASUREMENT
/begin MEASUREMENT B_clcas "" UWORD B_TRUE 1 100 0 1 BIT_MASK 0x80 FORMAT "%13.11" ECU_ADDRESS 0x7F9588 /end MEASUREMENT
/begin MEASUREMENT B_clckombi "Bedingung Fehlerpfad CKOMBI lˆschen" UWORD B_TRUE 1 100 0 1 BIT_MASK 0x80 FORMAT "%13.11" ECU_ADDRESS 0x7F958C /end MEASUREMENT
/begin MEASUREMENT B_clczfe "Bedingung Fehlerpfad CZFE lˆschen" UWORD B_TRUE 1 100 0 1 BIT_MASK 0x80 FORMAT "%13.11" ECU_ADDRESS 0x7F9590 /end MEASUREMENT
/begin MEASUREMENT B_cldkp "" UWORD B_TRUE 1 100 0 1 BIT_MASK 0x80 FORMAT "%13.11" ECU_ADDRESS 0x7F9594 /end MEASUREMENT
/begin MEASUREMENT B_cldkpa "" UWORD B_TRUE 1 100 0 1 BIT_MASK 0x80 FORMAT "%13.11" ECU_ADDRESS 0x7F9598 /end MEASUREMENT
/begin MEASUREMENT B_clekpe "Fehlerpfad wird gelˆscht: EKPE" UWORD B_TRUE 1 100 0 1 BIT_MASK 0x80 FORMAT "%13.11" ECU_ADDRESS 0x7F95B0 /end MEASUREMENT
/begin MEASUREMENT B_clev1e "Fehlerpfad wird gelˆscht: EV1E" UWORD B_TRUE 1 100 0 1 BIT_MASK 0x80 FORMAT "%13.11" ECU_ADDRESS 0x7F95B4 /end MEASUREMENT
/begin MEASUREMENT B_clev2e "Fehlerpfad wird gelˆscht: EV2E" UWORD B_TRUE 1 100 0 1 BIT_MASK 0x80 FORMAT "%13.11" ECU_ADDRESS 0x7F95B8 /end MEASUREMENT
/begin MEASUREMENT B_clev3e "Fehlerpfad wird gelˆscht: EV3E" UWORD B_TRUE 1 100 0 1 BIT_MASK 0x80 FORMAT "%13.11" ECU_ADDRESS 0x7F95BC /end MEASUREMENT
/begin MEASUREMENT B_clev4e "Fehlerpfad wird gelˆscht: EV4E" UWORD B_TRUE 1 100 0 1 BIT_MASK 0x80 FORMAT "%13.11" ECU_ADDRESS 0x7F95C0 /end MEASUREMENT
/begin MEASUREMENT B_clews "" UWORD B_TRUE 1 100 0 1 BIT_MASK 0x80 FORMAT "%13.11" ECU_ADDRESS 0x7F95C4 /end MEASUREMENT
/begin MEASUREMENT B_clewse "Fehlerpfad wird gelˆscht: EWSE" UWORD B_TRUE 1 100 0 1 BIT_MASK 0x80 FORMAT "%13.11" ECU_ADDRESS 0x7F95C8 /end MEASUREMENT
/begin MEASUREMENT B_clkat "Bedingung Fehlerpfad DKAT lˆschen" UWORD B_TRUE 1 100 0 1 BIT_MASK 0x80 FORMAT "%13.11" ECU_ADDRESS 0x7F95FC /end MEASUREMENT
/begin MEASUREMENT B_clkill "Bedingung Fehlerpfad DKILL lˆschen" UWORD B_TRUE 1 100 0 1 BIT_MASK 0x80 FORMAT "%13.11" ECU_ADDRESS 0x7F9608 /end MEASUREMENT
/begin MEASUREMENT B_clkl15 "Bedingung Fehlerpfad DKL15 lˆschen" UWORD B_TRUE 1 100 0 1 BIT_MASK 0x80 FORMAT "%13.11" ECU_ADDRESS 0x7F960C /end MEASUREMENT
/begin MEASUREMENT B_clkrnt "Bedingung Fehlerpfad KR-Diagnose Integratorsteigung lˆschen" UWORD B_TRUE 1 100 0 1 BIT_MASK 0x80 FORMAT "%13.11" ECU_ADDRESS 0x7F9610 /end MEASUREMENT
/begin MEASUREMENT B_clkrof "Bedingung Fehlerpfad KR-Diagnose Resetwert lˆschen" UWORD B_TRUE 1 100 0 1 BIT_MASK 0x80 FORMAT "%13.11" ECU_ADDRESS 0x7F9614 /end MEASUREMENT
/begin MEASUREMENT B_clkrtp "Bedingung Fehlerpfad KR-Diagnose Testimpuls lˆschen" UWORD B_TRUE 1 100 0 1 BIT_MASK 0x80 FORMAT "%13.11" ECU_ADDRESS 0x7F9618 /end MEASUREMENT
/begin MEASUREMENT B_clks "" UWORD B_TRUE 1 100 0 1 BIT_MASK 0x80 FORMAT "%13.11" ECU_ADDRESS 0x7F961C /end MEASUREMENT
/begin MEASUREMENT B_clks1 "Bedingung Fehlerpfad Klopfsensor 1 lˆschen" UWORD B_TRUE 1 100 0 1 BIT_MASK 0x80 FORMAT "%13.11" ECU_ADDRESS 0x7F9620 /end MEASUREMENT
/begin MEASUREMENT B_clks2 "Bedingung Fehlerpfad Klopfsensor 2 lˆschen" UWORD B_TRUE 1 100 0 1 BIT_MASK 0x80 FORMAT "%13.11" ECU_ADDRESS 0x7F9624 /end MEASUREMENT
/begin MEASUREMENT B_cln "Bedingung Fehlerpfad Drehzahlgeber lˆschen" UWORD B_TRUE 1 100 0 1 BIT_MASK 0x80 FORMAT "%13.11" ECU_ADDRESS 0x7F9654 /end MEASUREMENT
/begin MEASUREMENT B_cotrim "Bedingung f¸r LL-CO Abgleich erf¸llt" UBYTE B_TRUE 1 100 0 1 BIT_MASK 0x1 FORMAT "%13.11" ECU_ADDRESS 0x7FB9EC /end MEASUREMENT
/begin MEASUREMENT B_dcy "Bedingung 'driving cycle' erkannt" UBYTE B_TRUE 1 100 0 1 BIT_MASK 0x1 FORMAT "%13.11" ECU_ADDRESS 0x7FD891 /end MEASUREMENT
/begin MEASUREMENT B_dkpstp_init "" UBYTE B_TRUE 1 100 0 1 BIT_MASK 0x1 FORMAT "%13.11" ECU_ADDRESS 0x7FBAB4 /end MEASUREMENT
/begin MEASUREMENT B_eakle "" UBYTE B_TRUE 1 100 0 1 BIT_MASK 0x1 FORMAT "%13.11" ECU_ADDRESS 0x7FB9B8 /end MEASUREMENT
/begin MEASUREMENT B_ecj945 "" UBYTE B_TRUE 1 100 0 1 BIT_MASK 0x1 FORMAT "%13.11" ECU_ADDRESS 0x7FB9B0 /end MEASUREMENT
/begin MEASUREMENT B_ecj945_mux "" UBYTE B_TRUE 1 100 0 1 BIT_MASK 0x1 FORMAT "%13.11" ECU_ADDRESS 0x7FB9B1 /end MEASUREMENT
/begin MEASUREMENT B_ecj945_temp "" UBYTE B_TRUE 1 100 0 1 BIT_MASK 0x1 FORMAT "%13.11" ECU_ADDRESS 0x7FB9B2 /end MEASUREMENT
/begin MEASUREMENT B_ecy315 "" UBYTE B_TRUE 1 100 0 1 BIT_MASK 0x1 FORMAT "%13.11" ECU_ADDRESS 0x7FB9AA /end MEASUREMENT
/begin MEASUREMENT B_ecy315_main_relay "" UBYTE B_TRUE 1 100 0 1 BIT_MASK 0x1 FORMAT "%13.11" ECU_ADDRESS 0x7FB9AB /end MEASUREMENT
/begin MEASUREMENT B_ecy315_supply_1 "" UBYTE B_TRUE 1 100 0 1 BIT_MASK 0x1 FORMAT "%13.11" ECU_ADDRESS 0x7FB9AC /end MEASUREMENT
/begin MEASUREMENT B_ecy315_supply_2 "" UBYTE B_TRUE 1 100 0 1 BIT_MASK 0x1 FORMAT "%13.11" ECU_ADDRESS 0x7FB9AD /end MEASUREMENT
/begin MEASUREMENT B_ecy315_supply_3 "" UBYTE B_TRUE 1 100 0 1 BIT_MASK 0x1 FORMAT "%13.11" ECU_ADDRESS 0x7FB9AE /end MEASUREMENT
/begin MEASUREMENT B_ecy315_temp "" UBYTE B_TRUE 1 100 0 1 BIT_MASK 0x1 FORMAT "%13.11" ECU_ADDRESS 0x7FB9AF /end MEASUREMENT
/begin MEASUREMENT B_edprcana "Bedingung Fehler im dualported Ram CAN A" UBYTE B_TRUE 1 100 0 1 BIT_MASK 0x1 FORMAT "%13.11" ECU_ADDRESS 0x7FD7EE /end MEASUREMENT
/begin MEASUREMENT B_eekpe "Bedingung Endstufenfehler EKP" UBYTE B_TRUE 1 100 0 1 BIT_MASK 0x1 FORMAT "%13.11" ECU_ADDRESS 0x7FB9B3 /end MEASUREMENT
/begin MEASUREMENT B_eeve "Bedingung Endstufenfehler EV" UBYTE B_TRUE 1 100 0 1 BIT_MASK 0x1 FORMAT "%13.11" ECU_ADDRESS 0x7FB9B6 /end MEASUREMENT
/begin MEASUREMENT B_eewse "Bedingung Endstufenfehler EWS" UBYTE B_TRUE 1 100 0 1 BIT_MASK 0x1 FORMAT "%13.11" ECU_ADDRESS 0x7FB9B4 /end MEASUREMENT
/begin MEASUREMENT B_egscok "Bedingung Getriebebotschaft CAN empfangen" UBYTE B_TRUE 1 100 0 1 BIT_MASK 0x1 FORMAT "%13.11" ECU_ADDRESS 0x7FB926 /end MEASUREMENT
/begin MEASUREMENT B_egsnew "Bedingung, daﬂ eine neue Getriebebotschaft erkannt wurde" UBYTE B_TRUE 1 100 0 1 BIT_MASK 0x1 FORMAT "%13.11" ECU_ADDRESS 0x7FB927 /end MEASUREMENT
/begin MEASUREMENT B_epcl "Bedingung f¸r Ansteuerung EGAS-Fehlerlampe" UBYTE B_TRUE 1 100 0 1 BIT_MASK 0x1 FORMAT "%13.11" ECU_ADDRESS 0x7FB93D /end MEASUREMENT
/begin MEASUREMENT B_epclloc "Bedingung f¸r Ansteuerung EGAS-Fehlerlampe loc." UBYTE B_TRUE 1 100 0 1 BIT_MASK 0x1 FORMAT "%13.11" ECU_ADDRESS 0x7FB93E /end MEASUREMENT
/begin MEASUREMENT B_evfzgv1 "" UBYTE B_TRUE 1 100 0 1 BIT_MASK 0x1 FORMAT "%13.11" ECU_ADDRESS 0x7FB923 /end MEASUREMENT
/begin MEASUREMENT B_fs "Bedingung Fahrstufe" UBYTE B_TRUE 1 100 0 1 BIT_MASK 0x1 FORMAT "%13.11" ECU_ADDRESS 0x7FB928 /end MEASUREMENT
/begin MEASUREMENT B_ftakle "" UWORD B_TRUE 1 100 0 1 BIT_MASK 0x10 FORMAT "%13.11" ECU_ADDRESS 0x7F9570 /end MEASUREMENT
/begin MEASUREMENT B_ftas "" UWORD B_TRUE 1 100 0 1 BIT_MASK 0x10 FORMAT "%13.11" ECU_ADDRESS 0x7F9574 /end MEASUREMENT
/begin MEASUREMENT B_ftbm "" UWORD B_TRUE 1 100 0 1 BIT_MASK 0x10 FORMAT "%13.11" ECU_ADDRESS 0x7F9578 /end MEASUREMENT
/begin MEASUREMENT B_ftcabs "" UWORD B_TRUE 1 100 0 1 BIT_MASK 0x10 FORMAT "%13.11" ECU_ADDRESS 0x7F9580 /end MEASUREMENT
/begin MEASUREMENT B_ftcana "" UWORD B_TRUE 1 100 0 1 BIT_MASK 0x10 FORMAT "%13.11" ECU_ADDRESS 0x7F9584 /end MEASUREMENT
/begin MEASUREMENT B_ftcas "" UWORD B_TRUE 1 100 0 1 BIT_MASK 0x10 FORMAT "%13.11" ECU_ADDRESS 0x7F9588 /end MEASUREMENT
/begin MEASUREMENT B_ftckombi "" UWORD B_TRUE 1 100 0 1 BIT_MASK 0x10 FORMAT "%13.11" ECU_ADDRESS 0x7F958C /end MEASUREMENT
/begin MEASUREMENT B_ftczfe "" UWORD B_TRUE 1 100 0 1 BIT_MASK 0x10 FORMAT "%13.11" ECU_ADDRESS 0x7F9590 /end MEASUREMENT
/begin MEASUREMENT B_ftdkp "" UWORD B_TRUE 1 100 0 1 BIT_MASK 0x10 FORMAT "%13.11" ECU_ADDRESS 0x7F9594 /end MEASUREMENT
/begin MEASUREMENT B_ftdkpa "" UWORD B_TRUE 1 100 0 1 BIT_MASK 0x10 FORMAT "%13.11" ECU_ADDRESS 0x7F9598 /end MEASUREMENT
/begin MEASUREMENT B_ftekpe "Pr¸fung durch Kundendiensttester: EKPE" UWORD B_TRUE 1 100 0 1 BIT_MASK 0x10 FORMAT "%13.11" ECU_ADDRESS 0x7F95B0 /end MEASUREMENT
/begin MEASUREMENT B_ftev1e "Pr¸fung durch Kundendiensttester: EV1E" UWORD B_TRUE 1 100 0 1 BIT_MASK 0x10 FORMAT "%13.11" ECU_ADDRESS 0x7F95B4 /end MEASUREMENT
/begin MEASUREMENT B_ftev2e "Pr¸fung durch Kundendiensttester: EV2E" UWORD B_TRUE 1 100 0 1 BIT_MASK 0x10 FORMAT "%13.11" ECU_ADDRESS 0x7F95B8 /end MEASUREMENT
/begin MEASUREMENT B_ftev3e "Pr¸fung durch Kundendiensttester: EV3E" UWORD B_TRUE 1 100 0 1 BIT_MASK 0x10 FORMAT "%13.11" ECU_ADDRESS 0x7F95BC /end MEASUREMENT
/begin MEASUREMENT B_ftev4e "Pr¸fung durch Kundendiensttester: EV4E" UWORD B_TRUE 1 100 0 1 BIT_MASK 0x10 FORMAT "%13.11" ECU_ADDRESS 0x7F95C0 /end MEASUREMENT
/begin MEASUREMENT B_ftews "" UWORD B_TRUE 1 100 0 1 BIT_MASK 0x10 FORMAT "%13.11" ECU_ADDRESS 0x7F95C4 /end MEASUREMENT
/begin MEASUREMENT B_ftewse "Pr¸fung durch Kundendiensttester: EWSE" UWORD B_TRUE 1 100 0 1 BIT_MASK 0x10 FORMAT "%13.11" ECU_ADDRESS 0x7F95C8 /end MEASUREMENT
/begin MEASUREMENT B_ftkat "Bedingung: Fehlereintrag durch Tester f¸r Katalysator" UWORD B_TRUE 1 100 0 1 BIT_MASK 0x10 FORMAT "%13.11" ECU_ADDRESS 0x7F95FC /end MEASUREMENT
/begin MEASUREMENT B_ftkill "" UWORD B_TRUE 1 100 0 1 BIT_MASK 0x10 FORMAT "%13.11" ECU_ADDRESS 0x7F9608 /end MEASUREMENT
/begin MEASUREMENT B_ftkl15 "" UWORD B_TRUE 1 100 0 1 BIT_MASK 0x10 FORMAT "%13.11" ECU_ADDRESS 0x7F960C /end MEASUREMENT
/begin MEASUREMENT B_ftkrnt "" UWORD B_TRUE 1 100 0 1 BIT_MASK 0x10 FORMAT "%13.11" ECU_ADDRESS 0x7F9610 /end MEASUREMENT
/begin MEASUREMENT B_ftkrof "" UWORD B_TRUE 1 100 0 1 BIT_MASK 0x10 FORMAT "%13.11" ECU_ADDRESS 0x7F9614 /end MEASUREMENT
/begin MEASUREMENT B_ftkrtp "" UWORD B_TRUE 1 100 0 1 BIT_MASK 0x10 FORMAT "%13.11" ECU_ADDRESS 0x7F9618 /end MEASUREMENT
/begin MEASUREMENT B_ftks "" UWORD B_TRUE 1 100 0 1 BIT_MASK 0x10 FORMAT "%13.11" ECU_ADDRESS 0x7F961C /end MEASUREMENT
/begin MEASUREMENT B_ftks1 "" UWORD B_TRUE 1 100 0 1 BIT_MASK 0x10 FORMAT "%13.11" ECU_ADDRESS 0x7F9620 /end MEASUREMENT
/begin MEASUREMENT B_ftks2 "" UWORD B_TRUE 1 100 0 1 BIT_MASK 0x10 FORMAT "%13.11" ECU_ADDRESS 0x7F9624 /end MEASUREMENT
/begin MEASUREMENT B_ftn "" UWORD B_TRUE 1 100 0 1 BIT_MASK 0x10 FORMAT "%13.11" ECU_ADDRESS 0x7F9654 /end MEASUREMENT
/begin MEASUREMENT B_gangwe "" UBYTE B_TRUE 1 100 0 1 BIT_MASK 0x1 FORMAT "%13.11" ECU_ADDRESS 0x7FB91C /end MEASUREMENT
/begin MEASUREMENT B_got "Bedingung Getriebeˆl_‹bertemperatur Stufe I" UBYTE B_TRUE 1 100 0 1 BIT_MASK 0x1 FORMAT "%13.11" ECU_ADDRESS 0x7FB929 /end MEASUREMENT
/begin MEASUREMENT B_gts "Bedingung Getriebeschutz" UBYTE B_TRUE 1 100 0 1 BIT_MASK 0x1 FORMAT "%13.11" ECU_ADDRESS 0x7FB92A /end MEASUREMENT
/begin MEASUREMENT B_kl15_zfe "Klemme 15 Signal aus ZFE-SG ueber CAN" UBYTE B_TRUE 1 100 0 1 BIT_MASK 0x1 FORMAT "%13.11" ECU_ADDRESS 0x7FB932 /end MEASUREMENT
/begin MEASUREMENT B_kombi1cok "" UBYTE B_TRUE 1 100 0 1 BIT_MASK 0x1 FORMAT "%13.11" ECU_ADDRESS 0x7FB92E /end MEASUREMENT
/begin MEASUREMENT B_kombi1new "" UBYTE B_TRUE 1 100 0 1 BIT_MASK 0x1 FORMAT "%13.11" ECU_ADDRESS 0x7FB92F /end MEASUREMENT
/begin MEASUREMENT B_kwcheck "Flag Beruecksichtigung der kritischen KWG-Fehler (Synchro)" UBYTE B_TRUE 1 100 0 1 BIT_MASK 0x1 FORMAT "%13.11" ECU_ADDRESS 0x7FB949 /end MEASUREMENT
/begin MEASUREMENT B_limiter_aktiv "" UBYTE B_TRUE 1 100 0 1 BIT_MASK 0x1 FORMAT "%13.11" ECU_ADDRESS 0x7FBAB5 /end MEASUREMENT
/begin MEASUREMENT B_mnakle "" UWORD B_TRUE 1 100 0 1 BIT_MASK 0x200 FORMAT "%13.11" ECU_ADDRESS 0x7F9570 /end MEASUREMENT
/begin MEASUREMENT B_mnas "" UWORD B_TRUE 1 100 0 1 BIT_MASK 0x200 FORMAT "%13.11" ECU_ADDRESS 0x7F9574 /end MEASUREMENT
/begin MEASUREMENT B_mnbm "Fehlertyp: h‰ufige Korrektur bei einem Zahn zuwenig" UWORD B_TRUE 1 100 0 1 BIT_MASK 0x200 FORMAT "%13.11" ECU_ADDRESS 0x7F9578 /end MEASUREMENT
/begin MEASUREMENT B_mncabs "Fehlertyp min.: CAN-Schnittstelle, Timeout ABS" UWORD B_TRUE 1 100 0 1 BIT_MASK 0x200 FORMAT "%13.11" ECU_ADDRESS 0x7F9580 /end MEASUREMENT
/begin MEASUREMENT B_mncana "Bedingung min-Fehler,  DPRAM defekt (von CAN_A)" UWORD B_TRUE 1 100 0 1 BIT_MASK 0x200 FORMAT "%13.11" ECU_ADDRESS 0x7F9584 /end MEASUREMENT
/begin MEASUREMENT B_mncas "" UWORD B_TRUE 1 100 0 1 BIT_MASK 0x200 FORMAT "%13.11" ECU_ADDRESS 0x7F9588 /end MEASUREMENT
/begin MEASUREMENT B_mnckombi "Fehlertyp min.: CAN-Schnittstelle, Timeout KOMBI" UWORD B_TRUE 1 100 0 1 BIT_MASK 0x200 FORMAT "%13.11" ECU_ADDRESS 0x7F958C /end MEASUREMENT
/begin MEASUREMENT B_mnczfe "Fehlertyp min.: CAN-Schnittstelle, Timeout ZFE" UWORD B_TRUE 1 100 0 1 BIT_MASK 0x200 FORMAT "%13.11" ECU_ADDRESS 0x7F9590 /end MEASUREMENT
/begin MEASUREMENT B_mndkp "Fehlerart: Wert zu niedrig" UWORD B_TRUE 1 100 0 1 BIT_MASK 0x200 FORMAT "%13.11" ECU_ADDRESS 0x7F9594 /end MEASUREMENT
/begin MEASUREMENT B_mndkpa "Fehlerart: Wert zu niedrig" UWORD B_TRUE 1 100 0 1 BIT_MASK 0x200 FORMAT "%13.11" ECU_ADDRESS 0x7F9598 /end MEASUREMENT
/begin MEASUREMENT B_mnekpe "Fehlerart: Kurzschluﬂ Masse an Endstufe EKPE" UWORD B_TRUE 1 100 0 1 BIT_MASK 0x200 FORMAT "%13.11" ECU_ADDRESS 0x7F95B0 /end MEASUREMENT
/begin MEASUREMENT B_mnev1e "Fehlerart: Kurzschluﬂ Masse an Endstufe EV1E" UWORD B_TRUE 1 100 0 1 BIT_MASK 0x200 FORMAT "%13.11" ECU_ADDRESS 0x7F95B4 /end MEASUREMENT
/begin MEASUREMENT B_mnev2e "Fehlerart: Kurzschluﬂ Masse an Endstufe EV2E" UWORD B_TRUE 1 100 0 1 BIT_MASK 0x200 FORMAT "%13.11" ECU_ADDRESS 0x7F95B8 /end MEASUREMENT
/begin MEASUREMENT B_mnev3e "Fehlerart: Kurzschluﬂ Masse an Endstufe EV3E" UWORD B_TRUE 1 100 0 1 BIT_MASK 0x200 FORMAT "%13.11" ECU_ADDRESS 0x7F95BC /end MEASUREMENT
/begin MEASUREMENT B_mnev4e "Fehlerart: Kurzschluﬂ Masse an Endstufe EV4E" UWORD B_TRUE 1 100 0 1 BIT_MASK 0x200 FORMAT "%13.11" ECU_ADDRESS 0x7F95C0 /end MEASUREMENT
/begin MEASUREMENT B_mnews "" UWORD B_TRUE 1 100 0 1 BIT_MASK 0x200 FORMAT "%13.11" ECU_ADDRESS 0x7F95C4 /end MEASUREMENT
/begin MEASUREMENT B_mnewse "Fehlerart: Kurzschluﬂ Masse an Endstufe EWSE" UWORD B_TRUE 1 100 0 1 BIT_MASK 0x200 FORMAT "%13.11" ECU_ADDRESS 0x7F95C8 /end MEASUREMENT
/begin MEASUREMENT B_mnkat "Fehlertyp 'Minimalwert' erkannt (Katalysator defekt)" UWORD B_TRUE 1 100 0 1 BIT_MASK 0x200 FORMAT "%13.11" ECU_ADDRESS 0x7F95FC /end MEASUREMENT
/begin MEASUREMENT B_mnkill "Fehlertyp min.: Diagnose Killschalter" UWORD B_TRUE 1 100 0 1 BIT_MASK 0x200 FORMAT "%13.11" ECU_ADDRESS 0x7F9608 /end MEASUREMENT
/begin MEASUREMENT B_mnkl15 "Fehlertyp min.: Diagnose Klemme 15 Schalter" UWORD B_TRUE 1 100 0 1 BIT_MASK 0x200 FORMAT "%13.11" ECU_ADDRESS 0x7F960C /end MEASUREMENT
/begin MEASUREMENT B_mnkrnt "Fehlertyp min.: Klopfregelung Nulltest" UWORD B_TRUE 1 100 0 1 BIT_MASK 0x200 FORMAT "%13.11" ECU_ADDRESS 0x7F9610 /end MEASUREMENT
/begin MEASUREMENT B_mnkrof "Fehlertyp min.: Klopfregelung Offset" UWORD B_TRUE 1 100 0 1 BIT_MASK 0x200 FORMAT "%13.11" ECU_ADDRESS 0x7F9614 /end MEASUREMENT
/begin MEASUREMENT B_mnkrtp "Fehlertyp min.: Klopfregelung Testimpuls" UWORD B_TRUE 1 100 0 1 BIT_MASK 0x200 FORMAT "%13.11" ECU_ADDRESS 0x7F9618 /end MEASUREMENT
/begin MEASUREMENT B_mnks "" UWORD B_TRUE 1 100 0 1 BIT_MASK 0x200 FORMAT "%13.11" ECU_ADDRESS 0x7F961C /end MEASUREMENT
/begin MEASUREMENT B_mnks1 "Bedingung: Min-Fehler Klopfsensor 1" UWORD B_TRUE 1 100 0 1 BIT_MASK 0x200 FORMAT "%13.11" ECU_ADDRESS 0x7F9620 /end MEASUREMENT
/begin MEASUREMENT B_mnks2 "Bedingung: Min-Fehler Klopfsensor 2" UWORD B_TRUE 1 100 0 1 BIT_MASK 0x200 FORMAT "%13.11" ECU_ADDRESS 0x7F9624 /end MEASUREMENT
/begin MEASUREMENT B_mnn "Fehlerart: Synchronisationsmarke h‰ufig nicht gefunden" UWORD B_TRUE 1 100 0 1 BIT_MASK 0x200 FORMAT "%13.11" ECU_ADDRESS 0x7F9654 /end MEASUREMENT
/begin MEASUREMENT B_movbck_a "" UBYTE B_TRUE 1 100 0 1 BIT_MASK 0x1 FORMAT "%13.11" ARRAY_SIZE 2 ECU_ADDRESS 0x7FBAAC /end MEASUREMENT
/begin MEASUREMENT B_movfor_a "" UBYTE B_TRUE 1 100 0 1 BIT_MASK 0x1 FORMAT "%13.11" ARRAY_SIZE 2 ECU_ADDRESS 0x7FBAB0 /end MEASUREMENT
/begin MEASUREMENT B_msrext "Bedingung f¸r externe Anforderung MSR" UBYTE B_TRUE 1 100 0 1 BIT_MASK 0x1 FORMAT "%13.11" ECU_ADDRESS 0x7FB924 /end MEASUREMENT
/begin MEASUREMENT B_mxakle "" UWORD B_TRUE 1 100 0 1 BIT_MASK 0x100 FORMAT "%13.11" ECU_ADDRESS 0x7F9570 /end MEASUREMENT
/begin MEASUREMENT B_mxas "" UWORD B_TRUE 1 100 0 1 BIT_MASK 0x100 FORMAT "%13.11" ECU_ADDRESS 0x7F9574 /end MEASUREMENT
/begin MEASUREMENT B_mxbm "Fehlertyp: h‰ufige Korrektur bei einem Zahn zuviel" UWORD B_TRUE 1 100 0 1 BIT_MASK 0x100 FORMAT "%13.11" ECU_ADDRESS 0x7F9578 /end MEASUREMENT
/begin MEASUREMENT B_mxcabs "Fehlertyp max.: CAN-Schnittstelle, Timeout ABS" UWORD B_TRUE 1 100 0 1 BIT_MASK 0x100 FORMAT "%13.11" ECU_ADDRESS 0x7F9580 /end MEASUREMENT
/begin MEASUREMENT B_mxcana "Bedingung max-Fehler,   (CAN_A ""Error passiv"")" UWORD B_TRUE 1 100 0 1 BIT_MASK 0x100 FORMAT "%13.11" ECU_ADDRESS 0x7F9584 /end MEASUREMENT
/begin MEASUREMENT B_mxcas "" UWORD B_TRUE 1 100 0 1 BIT_MASK 0x100 FORMAT "%13.11" ECU_ADDRESS 0x7F9588 /end MEASUREMENT
/begin MEASUREMENT B_mxckombi "Fehlertyp max.: CAN-Schnittstelle, Timeout KOMBI" UWORD B_TRUE 1 100 0 1 BIT_MASK 0x100 FORMAT "%13.11" ECU_ADDRESS 0x7F958C /end MEASUREMENT
/begin MEASUREMENT B_mxczfe "Fehlertyp max.: CAN-Schnittstelle, Timeout ZFE" UWORD B_TRUE 1 100 0 1 BIT_MASK 0x100 FORMAT "%13.11" ECU_ADDRESS 0x7F9590 /end MEASUREMENT
/begin MEASUREMENT B_mxdkp "Fehlerart: Wert zu hoch" UWORD B_TRUE 1 100 0 1 BIT_MASK 0x100 FORMAT "%13.11" ECU_ADDRESS 0x7F9594 /end MEASUREMENT
/begin MEASUREMENT B_mxdkpa "Fehlerart: Wert zu hoch" UWORD B_TRUE 1 100 0 1 BIT_MASK 0x100 FORMAT "%13.11" ECU_ADDRESS 0x7F9598 /end MEASUREMENT
/begin MEASUREMENT B_mxekpe "Fehlerart: Kurzschluﬂ UBat an Endstufe EKPE" UWORD B_TRUE 1 100 0 1 BIT_MASK 0x100 FORMAT "%13.11" ECU_ADDRESS 0x7F95B0 /end MEASUREMENT
/begin MEASUREMENT B_mxev1e "Fehlerart: Kurzschluﬂ UBat an Endstufe EV1E" UWORD B_TRUE 1 100 0 1 BIT_MASK 0x100 FORMAT "%13.11" ECU_ADDRESS 0x7F95B4 /end MEASUREMENT
/begin MEASUREMENT B_mxev2e "Fehlerart: Kurzschluﬂ UBat an Endstufe EV2E" UWORD B_TRUE 1 100 0 1 BIT_MASK 0x100 FORMAT "%13.11" ECU_ADDRESS 0x7F95B8 /end MEASUREMENT
/begin MEASUREMENT B_mxev3e "Fehlerart: Kurzschluﬂ UBat an Endstufe EV3E" UWORD B_TRUE 1 100 0 1 BIT_MASK 0x100 FORMAT "%13.11" ECU_ADDRESS 0x7F95BC /end MEASUREMENT
/begin MEASUREMENT B_mxev4e "Fehlerart: Kurzschluﬂ UBat an Endstufe EV4E" UWORD B_TRUE 1 100 0 1 BIT_MASK 0x100 FORMAT "%13.11" ECU_ADDRESS 0x7F95C0 /end MEASUREMENT
/begin MEASUREMENT B_mxews "" UWORD B_TRUE 1 100 0 1 BIT_MASK 0x100 FORMAT "%13.11" ECU_ADDRESS 0x7F95C4 /end MEASUREMENT
/begin MEASUREMENT B_mxewse "Fehlerart: Kurzschluﬂ UBat an Endstufe EWSE" UWORD B_TRUE 1 100 0 1 BIT_MASK 0x100 FORMAT "%13.11" ECU_ADDRESS 0x7F95C8 /end MEASUREMENT
/begin MEASUREMENT B_mxkat "Bedingung obere Plausibilit‰tsschwelle ¸berschritten" UWORD B_TRUE 1 100 0 1 BIT_MASK 0x100 FORMAT "%13.11" ECU_ADDRESS 0x7F95FC /end MEASUREMENT
/begin MEASUREMENT B_mxkill "Fehlertyp max.: Diagnose Killschalter" UWORD B_TRUE 1 100 0 1 BIT_MASK 0x100 FORMAT "%13.11" ECU_ADDRESS 0x7F9608 /end MEASUREMENT
/begin MEASUREMENT B_mxkl15 "Fehlertyp max.: Diagnose Klemme 15 Schalter" UWORD B_TRUE 1 100 0 1 BIT_MASK 0x100 FORMAT "%13.11" ECU_ADDRESS 0x7F960C /end MEASUREMENT
/begin MEASUREMENT B_mxkrnt "Fehlertyp max.: Klopfregelung Nulltest" UWORD B_TRUE 1 100 0 1 BIT_MASK 0x100 FORMAT "%13.11" ECU_ADDRESS 0x7F9610 /end MEASUREMENT
/begin MEASUREMENT B_mxkrof "Fehlertyp max.: Klopfregelung Offset" UWORD B_TRUE 1 100 0 1 BIT_MASK 0x100 FORMAT "%13.11" ECU_ADDRESS 0x7F9614 /end MEASUREMENT
/begin MEASUREMENT B_mxkrtp "Fehlertyp max.: Klopfregelung Testimpuls" UWORD B_TRUE 1 100 0 1 BIT_MASK 0x100 FORMAT "%13.11" ECU_ADDRESS 0x7F9618 /end MEASUREMENT
/begin MEASUREMENT B_mxks "" UWORD B_TRUE 1 100 0 1 BIT_MASK 0x100 FORMAT "%13.11" ECU_ADDRESS 0x7F961C /end MEASUREMENT
/begin MEASUREMENT B_mxks1 "Bedingung: Max-Fehler Klopfsensor 1" UWORD B_TRUE 1 100 0 1 BIT_MASK 0x100 FORMAT "%13.11" ECU_ADDRESS 0x7F9620 /end MEASUREMENT
/begin MEASUREMENT B_mxks2 "Bedingung: Max-Fehler Klopfsensor 2" UWORD B_TRUE 1 100 0 1 BIT_MASK 0x100 FORMAT "%13.11" ECU_ADDRESS 0x7F9624 /end MEASUREMENT
/begin MEASUREMENT B_mxn "Fehlerart: h‰ufiger L¸ckenverlust beim L¸ckencheck" UWORD B_TRUE 1 100 0 1 BIT_MASK 0x100 FORMAT "%13.11" ECU_ADDRESS 0x7F9654 /end MEASUREMENT
/begin MEASUREMENT B_nlbyp "Condition: request for ECU after-run from idle speed stepper control" UBYTE B_TRUE 1 100 0 1 BIT_MASK 0x1 FORMAT "%13.11" ECU_ADDRESS 0x7FBAB6 /end MEASUREMENT
/begin MEASUREMENT B_nldg "Bedingung Drehzahlgeber-Notlauf" UBYTE B_TRUE 1 100 0 1 BIT_MASK 0x1 FORMAT "%13.11" ECU_ADDRESS 0x7FB94A /end MEASUREMENT
/begin MEASUREMENT B_no "unendlich-Trigger f¸r Fehlerpfadmanagement" UBYTE B_TRUE 1 100 0 1 BIT_MASK 0x1 FORMAT "%13.11" ECU_ADDRESS 0x7F9ADB /end MEASUREMENT
/begin MEASUREMENT B_npakle "" UWORD B_TRUE 1 100 0 1 BIT_MASK 0x800 FORMAT "%13.11" ECU_ADDRESS 0x7F9570 /end MEASUREMENT
/begin MEASUREMENT B_npas "" UWORD B_TRUE 1 100 0 1 BIT_MASK 0x800 FORMAT "%13.11" ECU_ADDRESS 0x7F9574 /end MEASUREMENT
/begin MEASUREMENT B_npbm "Fehlertyp: Bezugsmarkenfehler beim L¸ckencheck" UWORD B_TRUE 1 100 0 1 BIT_MASK 0x800 FORMAT "%13.11" ECU_ADDRESS 0x7F9578 /end MEASUREMENT
/begin MEASUREMENT B_npcabs "Fehlerart:CAN-Schnittstelle, Timeout ABS" UWORD B_TRUE 1 100 0 1 BIT_MASK 0x800 FORMAT "%13.11" ECU_ADDRESS 0x7F9580 /end MEASUREMENT
/begin MEASUREMENT B_npcana "Bedingung Plausfehler  (CAN_A ""Bus off"")" UWORD B_TRUE 1 100 0 1 BIT_MASK 0x800 FORMAT "%13.11" ECU_ADDRESS 0x7F9584 /end MEASUREMENT
/begin MEASUREMENT B_npcas "" UWORD B_TRUE 1 100 0 1 BIT_MASK 0x800 FORMAT "%13.11" ECU_ADDRESS 0x7F9588 /end MEASUREMENT
/begin MEASUREMENT B_npckombi "Fehlerart:CAN-Schnittstelle, Timeout KOMBI" UWORD B_TRUE 1 100 0 1 BIT_MASK 0x800 FORMAT "%13.11" ECU_ADDRESS 0x7F958C /end MEASUREMENT
/begin MEASUREMENT B_npczfe "Fehlerart:CAN-Schnittstelle, Timeout ZFE" UWORD B_TRUE 1 100 0 1 BIT_MASK 0x800 FORMAT "%13.11" ECU_ADDRESS 0x7F9590 /end MEASUREMENT
/begin MEASUREMENT B_npdkp "" UWORD B_TRUE 1 100 0 1 BIT_MASK 0x800 FORMAT "%13.11" ECU_ADDRESS 0x7F9594 /end MEASUREMENT
/begin MEASUREMENT B_npdkpa "" UWORD B_TRUE 1 100 0 1 BIT_MASK 0x800 FORMAT "%13.11" ECU_ADDRESS 0x7F9598 /end MEASUREMENT
/begin MEASUREMENT B_npekpe "Fehlerart: Zustand nicht plausibel EKPE" UWORD B_TRUE 1 100 0 1 BIT_MASK 0x800 FORMAT "%13.11" ECU_ADDRESS 0x7F95B0 /end MEASUREMENT
/begin MEASUREMENT B_npev1e "Fehlerart: Zustand nicht plausibel EV1E" UWORD B_TRUE 1 100 0 1 BIT_MASK 0x800 FORMAT "%13.11" ECU_ADDRESS 0x7F95B4 /end MEASUREMENT
/begin MEASUREMENT B_npev2e "Fehlerart: Zustand nicht plausibel EV2E" UWORD B_TRUE 1 100 0 1 BIT_MASK 0x800 FORMAT "%13.11" ECU_ADDRESS 0x7F95B8 /end MEASUREMENT
/begin MEASUREMENT B_npev3e "Fehlerart: Zustand nicht plausibel EV3E" UWORD B_TRUE 1 100 0 1 BIT_MASK 0x800 FORMAT "%13.11" ECU_ADDRESS 0x7F95BC /end MEASUREMENT
/begin MEASUREMENT B_npev4e "Fehlerart: Zustand nicht plausibel EV4E" UWORD B_TRUE 1 100 0 1 BIT_MASK 0x800 FORMAT "%13.11" ECU_ADDRESS 0x7F95C0 /end MEASUREMENT
/begin MEASUREMENT B_npews "" UWORD B_TRUE 1 100 0 1 BIT_MASK 0x800 FORMAT "%13.11" ECU_ADDRESS 0x7F95C4 /end MEASUREMENT
/begin MEASUREMENT B_npewse "Fehlerart: Zustand nicht plausibel EWSE" UWORD B_TRUE 1 100 0 1 BIT_MASK 0x800 FORMAT "%13.11" ECU_ADDRESS 0x7F95C8 /end MEASUREMENT
/begin MEASUREMENT B_npkat "Fehlertyp 'unplausibles Pr¸fresultat' erkannt (Katalysator)" UWORD B_TRUE 1 100 0 1 BIT_MASK 0x800 FORMAT "%13.11" ECU_ADDRESS 0x7F95FC /end MEASUREMENT
/begin MEASUREMENT B_npkill "Fehlerart:Diagnose Killschalter" UWORD B_TRUE 1 100 0 1 BIT_MASK 0x800 FORMAT "%13.11" ECU_ADDRESS 0x7F9608 /end MEASUREMENT
/begin MEASUREMENT B_npkl15 "Fehlerart kein plausibles Signal:Diagnose Klemme 15 Schalter" UWORD B_TRUE 1 100 0 1 BIT_MASK 0x800 FORMAT "%13.11" ECU_ADDRESS 0x7F960C /end MEASUREMENT
/begin MEASUREMENT B_npkrnt "Bedingung Plausibilit‰tsfehler der KR-Diagnose Integratorsteigung" UWORD B_TRUE 1 100 0 1 BIT_MASK 0x800 FORMAT "%13.11" ECU_ADDRESS 0x7F9610 /end MEASUREMENT
/begin MEASUREMENT B_npkrof "Bedingung Plausibilit‰tsfehler der KR-Diagnose Resetwert" UWORD B_TRUE 1 100 0 1 BIT_MASK 0x800 FORMAT "%13.11" ECU_ADDRESS 0x7F9614 /end MEASUREMENT
/begin MEASUREMENT B_npkrtp "Bedingung Plausibilit‰tsfehler der KR-Diagnose Testimpuls" UWORD B_TRUE 1 100 0 1 BIT_MASK 0x800 FORMAT "%13.11" ECU_ADDRESS 0x7F9618 /end MEASUREMENT
/begin MEASUREMENT B_npks "" UWORD B_TRUE 1 100 0 1 BIT_MASK 0x800 FORMAT "%13.11" ECU_ADDRESS 0x7F961C /end MEASUREMENT
/begin MEASUREMENT B_npks1 "Nicht plausibler Fehler: Klopfsensor 1" UWORD B_TRUE 1 100 0 1 BIT_MASK 0x800 FORMAT "%13.11" ECU_ADDRESS 0x7F9620 /end MEASUREMENT
/begin MEASUREMENT B_npks2 "Nicht plausibler Fehler: Klopfsensor 2" UWORD B_TRUE 1 100 0 1 BIT_MASK 0x800 FORMAT "%13.11" ECU_ADDRESS 0x7F9624 /end MEASUREMENT
/begin MEASUREMENT B_npn "Fehlerart: h‰ufiger Bezugsmarkenfehler beim L¸ckencheck" UWORD B_TRUE 1 100 0 1 BIT_MASK 0x800 FORMAT "%13.11" ECU_ADDRESS 0x7F9654 /end MEASUREMENT
/begin MEASUREMENT B_nsp "" UBYTE B_TRUE 1 100 0 1 BIT_MASK 0x1 FORMAT "%13.11" ECU_ADDRESS 0x7FB9E6 /end MEASUREMENT
/begin MEASUREMENT B_nsubcan "" UBYTE B_TRUE 1 100 0 1 BIT_MASK 0x1 FORMAT "%13.11" ECU_ADDRESS 0x7FB933 /end MEASUREMENT
/begin MEASUREMENT B_oeldran "Bedingung ÷ldruckanzeige" UBYTE B_TRUE 1 100 0 1 FORMAT "%13.11" ECU_ADDRESS 0x7FD572 /end MEASUREMENT
/begin MEASUREMENT B_oldmiistc "" UBYTE B_TRUE 1 100 0 1 BIT_MASK 0x1 FORMAT "%13.11" ECU_ADDRESS 0x7FB91D /end MEASUREMENT
/begin MEASUREMENT B_pltab "Bedingung Plausibilit‰tspr¸fung Abstellzeit mˆglich" UBYTE B_TRUE 1 100 0 1 BIT_MASK 0x1 FORMAT "%13.11" ECU_ADDRESS 0x7FB9EA /end MEASUREMENT
/begin MEASUREMENT B_pn "Bedingung f¸r Fahrstufe P oder N" UBYTE B_TRUE 1 100 0 1 BIT_MASK 0x1 FORMAT "%13.11" ECU_ADDRESS 0x7FB92B /end MEASUREMENT
/begin MEASUREMENT B_prell_a "Bit Prellen aktiv" UBYTE dez 1 100 0 255 FORMAT "%5.1" ARRAY_SIZE 2 ECU_ADDRESS 0x7FD990 /end MEASUREMENT
/begin MEASUREMENT B_prell_spez_a "" UBYTE dez 1 100 0 255 FORMAT "%5.1" ARRAY_SIZE 2 ECU_ADDRESS 0x7FD994 /end MEASUREMENT
/begin MEASUREMENT B_pwfref_a "Bit Referenzierung nach Powerfail aktiv" UBYTE dez 1 100 0 255 FORMAT "%5.1" ARRAY_SIZE 2 ECU_ADDRESS 0x7FD9AC /end MEASUREMENT
/begin MEASUREMENT B_refakt_a "Bit Referenzierung aktiv" UBYTE dez 1 100 0 255 FORMAT "%5.1" ARRAY_SIZE 2 ECU_ADDRESS 0x7FD9B0 /end MEASUREMENT
/begin MEASUREMENT B_reffin_a "Bit Referenzierung abgeschlossen" UBYTE dez 1 100 0 255 FORMAT "%5.1" ARRAY_SIZE 2 ECU_ADDRESS 0x7FD9B4 /end MEASUREMENT
/begin MEASUREMENT B_refon_a "Bit Referenzierung aktivieren" UBYTE dez 1 100 0 255 FORMAT "%5.1" ARRAY_SIZE 2 ECU_ADDRESS 0x7FD9B8 /end MEASUREMENT
/begin MEASUREMENT B_refpwf_a "Bit Powerfail w‰hrend Referenzierung" UBYTE dez 1 100 0 255 FORMAT "%5.1" ARRAY_SIZE 2 ECU_ADDRESS 0x7FD9BC /end MEASUREMENT
/begin MEASUREMENT B_rffail_a "Bit Referenzierung fehlgeschlagen" UBYTE dez 1 100 0 255 FORMAT "%5.1" ARRAY_SIZE 2 ECU_ADDRESS 0x7F9C14 /end MEASUREMENT
/begin MEASUREMENT B_rlp "Bedingung Lastpraediktion aktiv" UBYTE B_TRUE 1 100 0 1 BIT_MASK 0x1 FORMAT "%13.11" ECU_ADDRESS 0x7FB9E7 /end MEASUREMENT
/begin MEASUREMENT B_rlpns "Einschaltbedingung Lastpraediktion nach Start" UBYTE B_TRUE 1 100 0 1 BIT_MASK 0x1 FORMAT "%13.11" ECU_ADDRESS 0x7FB9E8 /end MEASUREMENT
/begin MEASUREMENT B_rsg_edge "" UBYTE B_TRUE 1 100 0 1 BIT_MASK 0x1 FORMAT "%13.11" ECU_ADDRESS 0x7FB94B /end MEASUREMENT
/begin MEASUREMENT B_siakle "" UWORD B_TRUE 1 100 0 1 BIT_MASK 0x400 FORMAT "%13.11" ECU_ADDRESS 0x7F9570 /end MEASUREMENT
/begin MEASUREMENT B_sias "" UWORD B_TRUE 1 100 0 1 BIT_MASK 0x400 FORMAT "%13.11" ECU_ADDRESS 0x7F9574 /end MEASUREMENT
/begin MEASUREMENT B_sibm "Fehlertyp: keine Bezugsmarke im Start gefunden" UWORD B_TRUE 1 100 0 1 BIT_MASK 0x400 FORMAT "%13.11" ECU_ADDRESS 0x7F9578 /end MEASUREMENT
/begin MEASUREMENT B_sicabs "Signalfehler CAN-Timeout Botschaft ABS-SG" UWORD B_TRUE 1 100 0 1 BIT_MASK 0x400 FORMAT "%13.11" ECU_ADDRESS 0x7F9580 /end MEASUREMENT
/begin MEASUREMENT B_sicana "" UWORD B_TRUE 1 100 0 1 BIT_MASK 0x400 FORMAT "%13.11" ECU_ADDRESS 0x7F9584 /end MEASUREMENT
/begin MEASUREMENT B_sicas "" UWORD B_TRUE 1 100 0 1 BIT_MASK 0x400 FORMAT "%13.11" ECU_ADDRESS 0x7F9588 /end MEASUREMENT
/begin MEASUREMENT B_sickombi "Signalfehler CAN-Timeout Botschaft Kombi-Instruments" UWORD B_TRUE 1 100 0 1 BIT_MASK 0x400 FORMAT "%13.11" ECU_ADDRESS 0x7F958C /end MEASUREMENT
/begin MEASUREMENT B_siczfe "Signalfehler CAN-Timeout Botschaft ZFE-SG" UWORD B_TRUE 1 100 0 1 BIT_MASK 0x400 FORMAT "%13.11" ECU_ADDRESS 0x7F9590 /end MEASUREMENT
/begin MEASUREMENT B_sidkp "" UWORD B_TRUE 1 100 0 1 BIT_MASK 0x400 FORMAT "%13.11" ECU_ADDRESS 0x7F9594 /end MEASUREMENT
/begin MEASUREMENT B_sidkpa "" UWORD B_TRUE 1 100 0 1 BIT_MASK 0x400 FORMAT "%13.11" ECU_ADDRESS 0x7F9598 /end MEASUREMENT
/begin MEASUREMENT B_siekpe "Fehlerart: Unterbrechung an Endstufe EKPE" UWORD B_TRUE 1 100 0 1 BIT_MASK 0x400 FORMAT "%13.11" ECU_ADDRESS 0x7F95B0 /end MEASUREMENT
/begin MEASUREMENT B_siev1e "Fehlerart: Unterbrechung an Endstufe EV1E" UWORD B_TRUE 1 100 0 1 BIT_MASK 0x400 FORMAT "%13.11" ECU_ADDRESS 0x7F95B4 /end MEASUREMENT
/begin MEASUREMENT B_siev2e "Fehlerart: Unterbrechung an Endstufe EV2E" UWORD B_TRUE 1 100 0 1 BIT_MASK 0x400 FORMAT "%13.11" ECU_ADDRESS 0x7F95B8 /end MEASUREMENT
/begin MEASUREMENT B_siev3e "Fehlerart: Unterbrechung an Endstufe EV3E" UWORD B_TRUE 1 100 0 1 BIT_MASK 0x400 FORMAT "%13.11" ECU_ADDRESS 0x7F95BC /end MEASUREMENT
/begin MEASUREMENT B_siev4e "Fehlerart: Unterbrechung an Endstufe EV4E" UWORD B_TRUE 1 100 0 1 BIT_MASK 0x400 FORMAT "%13.11" ECU_ADDRESS 0x7F95C0 /end MEASUREMENT
/begin MEASUREMENT B_siews "" UWORD B_TRUE 1 100 0 1 BIT_MASK 0x400 FORMAT "%13.11" ECU_ADDRESS 0x7F95C4 /end MEASUREMENT
/begin MEASUREMENT B_siewse "Fehlerart: Unterbrechung an Endstufe EWSE" UWORD B_TRUE 1 100 0 1 BIT_MASK 0x400 FORMAT "%13.11" ECU_ADDRESS 0x7F95C8 /end MEASUREMENT
/begin MEASUREMENT B_sikat "Fehlertyp 'Signal fehlt' f¸r DKAT erkannt" UWORD B_TRUE 1 100 0 1 BIT_MASK 0x400 FORMAT "%13.11" ECU_ADDRESS 0x7F95FC /end MEASUREMENT
/begin MEASUREMENT B_sikill "Signalfehler Diagnose Killschalter" UWORD B_TRUE 1 100 0 1 BIT_MASK 0x400 FORMAT "%13.11" ECU_ADDRESS 0x7F9608 /end MEASUREMENT
/begin MEASUREMENT B_sikl15 "Signalfehler Diagnose Klemme 15 Schalter" UWORD B_TRUE 1 100 0 1 BIT_MASK 0x400 FORMAT "%13.11" ECU_ADDRESS 0x7F960C /end MEASUREMENT
/begin MEASUREMENT B_sikrnt "Fehlertyp: Klopfregelung Nulltest" UWORD B_TRUE 1 100 0 1 BIT_MASK 0x400 FORMAT "%13.11" ECU_ADDRESS 0x7F9610 /end MEASUREMENT
/begin MEASUREMENT B_sikrof "Fehlertyp: Klopfregelung Offset" UWORD B_TRUE 1 100 0 1 BIT_MASK 0x400 FORMAT "%13.11" ECU_ADDRESS 0x7F9614 /end MEASUREMENT
/begin MEASUREMENT B_sikrtp "Fehlertyp: Klopfregelung Testimpuls" UWORD B_TRUE 1 100 0 1 BIT_MASK 0x400 FORMAT "%13.11" ECU_ADDRESS 0x7F9618 /end MEASUREMENT
/begin MEASUREMENT B_siks "" UWORD B_TRUE 1 100 0 1 BIT_MASK 0x400 FORMAT "%13.11" ECU_ADDRESS 0x7F961C /end MEASUREMENT
/begin MEASUREMENT B_siks1 "Fehlertyp: Klopfsensor 1" UWORD B_TRUE 1 100 0 1 BIT_MASK 0x400 FORMAT "%13.11" ECU_ADDRESS 0x7F9620 /end MEASUREMENT
/begin MEASUREMENT B_siks2 "Fehlertyp: Klopfsensor 2" UWORD B_TRUE 1 100 0 1 BIT_MASK 0x400 FORMAT "%13.11" ECU_ADDRESS 0x7F9624 /end MEASUREMENT
/begin MEASUREMENT B_sin "Fehlertyp: kein Drehzahlsignal vorhanden" UWORD B_TRUE 1 100 0 1 BIT_MASK 0x400 FORMAT "%13.11" ECU_ADDRESS 0x7F9654 /end MEASUREMENT
/begin MEASUREMENT B_sp3 "Spezial-Bereichs-Trigger der Diagnose Kraftstoffversorgungssystem" UBYTE B_TRUE 1 100 0 1 BIT_MASK 0x1 FORMAT "%13.11" ECU_ADDRESS 0x7F9ADC /end MEASUREMENT
/begin MEASUREMENT B_stag_dkp "" UBYTE B_TRUE 1 100 0 1 BIT_MASK 0x1 FORMAT "%13.11" ECU_ADDRESS 0x7FBAB7 /end MEASUREMENT
/begin MEASUREMENT B_stmove_a "Bit Stepper wird verfahren" UBYTE dez 1 100 0 255 FORMAT "%5.1" ARRAY_SIZE 2 ECU_ADDRESS 0x7FD9C0 /end MEASUREMENT
/begin MEASUREMENT B_tabunpl "Bedingung Abstellzeit unplausibel" UBYTE B_TRUE 1 100 0 1 BIT_MASK 0x1 FORMAT "%13.11" ECU_ADDRESS 0x7FB9EB /end MEASUREMENT
/begin MEASUREMENT B_tempomat "" UBYTE B_TRUE 1 100 0 1 BIT_MASK 0x1 FORMAT "%13.11" ECU_ADDRESS 0x7FB934 /end MEASUREMENT
/begin MEASUREMENT B_tim "Zeit-Trigger f¸r Fehlerpfadmanagement" UBYTE B_TRUE 1 100 0 1 BIT_MASK 0x1 FORMAT "%13.11" ECU_ADDRESS 0x7FD8C8 /end MEASUREMENT
/begin MEASUREMENT B_tired "" UBYTE B_TRUE 1 100 0 1 BIT_MASK 0x1 FORMAT "%13.11" ECU_ADDRESS 0x7FB9E9 /end MEASUREMENT
/begin MEASUREMENT B_uhrrnpl "Bedingung Uhr mit relativem Minutenz‰hler unplausibel" UBYTE B_TRUE 1 100 0 1 BIT_MASK 0x1 FORMAT "%13.11" ECU_ADDRESS 0x7F9BAC /end MEASUREMENT
/begin MEASUREMENT B_vmax_was_active "" UBYTE B_TRUE 1 100 0 1 BIT_MASK 0x1 FORMAT "%13.11" ECU_ADDRESS 0x7FBAB8 /end MEASUREMENT
/begin MEASUREMENT B_vmx_lim_nm "" UBYTE B_TRUE 1 100 0 1 BIT_MASK 0x1 FORMAT "%13.11" ECU_ADDRESS 0x7FBAB9 /end MEASUREMENT
/begin MEASUREMENT B_vmx_nm "" UBYTE B_TRUE 1 100 0 1 BIT_MASK 0x1 FORMAT "%13.11" ECU_ADDRESS 0x7FBABA /end MEASUREMENT
/begin MEASUREMENT B_wk "Bedingung: Wandlerkupplung ¸berbr¸ckt" UBYTE B_TRUE 1 100 0 1 BIT_MASK 0x1 FORMAT "%13.11" ECU_ADDRESS 0x7FB92C /end MEASUREMENT
/begin MEASUREMENT B_wkr "Bedingung f¸r Wandlerkupplung geregelt" UBYTE B_TRUE 1 100 0 1 BIT_MASK 0x1 FORMAT "%13.11" ECU_ADDRESS 0x7FB92D /end MEASUREMENT
/begin MEASUREMENT B_zfe1cok "" UBYTE B_TRUE 1 100 0 1 BIT_MASK 0x1 FORMAT "%13.11" ECU_ADDRESS 0x7FB935 /end MEASUREMENT
/begin MEASUREMENT B_zfe1new "" UBYTE B_TRUE 1 100 0 1 BIT_MASK 0x1 FORMAT "%13.11" ECU_ADDRESS 0x7FB936 /end MEASUREMENT
/begin MEASUREMENT B_zfe2cok "Bedingung: CAN-Botschaft ZFE vorhanden" UBYTE B_TRUE 1 100 0 1 BIT_MASK 0x1 FORMAT "%13.11" ECU_ADDRESS 0x7FB937 /end MEASUREMENT
/begin MEASUREMENT B_zfe2new "Bedingung CAN-ZFE-Botschaft empfangen" UBYTE B_TRUE 1 100 0 1 BIT_MASK 0x1 FORMAT "%13.11" ECU_ADDRESS 0x7FB938 /end MEASUREMENT
/begin MEASUREMENT canastat "Fehlerstatus des CAN A" UBYTE dez 1 100 0 255 FORMAT "%5.1" ECU_ADDRESS 0x7FD4A6 /end MEASUREMENT
/begin MEASUREMENT canastati "" UBYTE dez 1 100 0 255 FORMAT "%5.1" ECU_ADDRESS 0x7FD4A7 /end MEASUREMENT
/begin MEASUREMENT cmd_stp_ref "" UBYTE dez 1 100 0 255 FORMAT "%5.1" ARRAY_SIZE 2 ECU_ADDRESS 0x7FD9C4 /end MEASUREMENT
/begin MEASUREMENT co_pot "Leerlauf-CO-Gemisch-Versteller" SBYTE dez 1 100 -128 127 FORMAT "%5.1" ECU_ADDRESS 0x7FD920 /end MEASUREMENT
/begin MEASUREMENT co_pot_w "Leerlauf-CO-Gemisch-Versteller" SWORD dez 1 100 -32768 32767 FORMAT "%8.2" ECU_ADDRESS 0x7FDC8E /end MEASUREMENT
/begin MEASUREMENT curbyp_w_a "aktuelle Stepperposition nach Ansteuerung in %" UWORD rel_uw_b100 1 100 0 99.9985 FORMAT "%8.5" ARRAY_SIZE 2 ECU_ADDRESS 0x7FDE02 /end MEASUREMENT
/begin MEASUREMENT curspd_w_a "aktuelle Steppergeschwindigkeit nach Ansteuerung" SWORD fak_q0p1 1 100 -3276.8 3276.7 FORMAT "%8.3" ARRAY_SIZE 2 ECU_ADDRESS 0x7FDE06 /end MEASUREMENT
/begin MEASUREMENT curstp_w_a "aktuelle Stepperposition nach Ansteuerung" SWORD fak_q0p1 1 100 -3276.8 3276.7 FORMAT "%8.3" ARRAY_SIZE 2 ECU_ADDRESS 0x7FDE0A /end MEASUREMENT
/begin MEASUREMENT dcycnt "Driving cycle - counter" UWORD dez 1 100 0 65535 FORMAT "%8.2" ECU_ADDRESS 0x7F9AD6 /end MEASUREMENT
/begin MEASUREMENT debug_sw "" SWORD fak_q0p1 1 100 -3276.8 3276.7 FORMAT "%8.3" ARRAY_SIZE 2 ECU_ADDRESS 0x7FDDCC /end MEASUREMENT
/begin MEASUREMENT debug_uw "" SWORD default 1 100 -32768 32767 FORMAT "%8.2" ECU_ADDRESS 0x7FDE0E /end MEASUREMENT
/begin MEASUREMENT desspd_w_a "gew¸nschte Geschwindigkeit f¸r Stepperansteuerung" SWORD fak_q0p1 1 100 -3276.8 3276.7 FORMAT "%8.3" ARRAY_SIZE 2 ECU_ADDRESS 0x7FDE10 /end MEASUREMENT
/begin MEASUREMENT dfcmFcm "" UBYTE dez 1 100 0 255 FORMAT "%5.1" ECU_ADDRESS 0x7F9ADD /end MEASUREMENT
/begin MEASUREMENT dfcmNo "" UBYTE dez 1 100 0 255 FORMAT "%5.1" ECU_ADDRESS 0x7F9ADE /end MEASUREMENT
/begin MEASUREMENT dfcmSfp "" UBYTE dez 1 100 0 255 FORMAT "%5.1" ECU_ADDRESS 0x7F9ADF /end MEASUREMENT
/begin MEASUREMENT dfpmEpclState "" UBYTE dez 1 100 0 255 FORMAT "%5.1" ECU_ADDRESS 0x7F9ADA /end MEASUREMENT
/begin MEASUREMENT dfpmMilState "" UBYTE dez 1 100 0 255 FORMAT "%5.1" ECU_ADDRESS 0x7F9AD9 /end MEASUREMENT
/begin MEASUREMENT dfp_ap "" UBYTE dez 1 100 0 255 FORMAT "%5.1" ECU_ADDRESS 0x7F9AE0 /end MEASUREMENT
/begin MEASUREMENT digit_step "Umrechnungswert digit2steps" SWORD fak_q0p1 1 100 -3276.8 3276.7 FORMAT "%8.3" ECU_ADDRESS 0x7FDDD0 /end MEASUREMENT
/begin MEASUREMENT dpsdvs_w "" SWORD p_sw_q0p039 1 100 -1280 1279.96 FORMAT "%8.3" ECU_ADDRESS 0x7FDC78 /end MEASUREMENT
/begin MEASUREMENT dpsfg_w "delta-Frischgaspartialdruck im Saugrohr" SWORD p_sw_q0p039 1 100 -1280 1279.96 FORMAT "%8.3" ECU_ADDRESS 0x7FDC1C /end MEASUREMENT
/begin MEASUREMENT dpsmp_w "" SWORD p_sw_q0p039 1 100 -1280 1279.96 FORMAT "%8.3" ECU_ADDRESS 0x7FDC7A /end MEASUREMENT
/begin MEASUREMENT dps_uw "Delta-Saugrohrdruck (unsigned word)" UWORD p_q0p039s32768 1 100 -1280 1279.96 FORMAT "%7.2" ECU_ADDRESS 0x7FE04A /end MEASUREMENT
/begin MEASUREMENT drlas_w "F¸llungs‰nderung pro Arbeitsspiel" SWORD relNWU_q0p0234 1 100 -768 767.977 FORMAT "%8.4" ECU_ADDRESS 0x7FDC0C /end MEASUREMENT
/begin MEASUREMENT drlp_w "delta-Einspritzberechnungs-Last aus Praediktion (Word)" SWORD rel_sw_q0p0234 1 100 -768 767.977 FORMAT "%8.4" ECU_ADDRESS 0x7FBCEA /end MEASUREMENT
/begin MEASUREMENT drl_w "F¸llungs‰nderung (Word)" SWORD rel_sw_q0p0234 1 100 -768 767.977 FORMAT "%8.4" ECU_ADDRESS 0x7FDC1E /end MEASUREMENT
/begin MEASUREMENT dtnwfl_ct2 "" UBYTE t100msxs_ub_b25p5 1 100 0 25.5 FORMAT "%5.2" ECU_ADDRESS 0x7FD813 /end MEASUREMENT
/begin MEASUREMENT dv_lh "Radgeschwindigkeitsdifferenz links hinten" SWORD vfzg_uw_q0p0625 1 100 -2048 2047.94 FORMAT "%8.3" ECU_ADDRESS 0x7FDB90 /end MEASUREMENT
/begin MEASUREMENT dv_lv "Radgeschwindigkeitsdifferenz links vorne" SWORD vfzg_uw_q0p0625 1 100 -2048 2047.94 FORMAT "%8.3" ECU_ADDRESS 0x7FDB92 /end MEASUREMENT
/begin MEASUREMENT dv_rh "Radgeschwindigkeitsdifferenz rechts hinten" SWORD vfzg_uw_q0p0625 1 100 -2048 2047.94 FORMAT "%8.3" ECU_ADDRESS 0x7FDB94 /end MEASUREMENT
/begin MEASUREMENT dv_rv "Radgeschwindigkeitsdifferenz rechts vorne" SWORD vfzg_uw_q0p0625 1 100 -2048 2047.94 FORMAT "%8.3" ECU_ADDRESS 0x7FDB96 /end MEASUREMENT
/begin MEASUREMENT d_vfzg_vmx "" SWORD vfzg_ub_q1p25 1 100 -40960 40958.8 FORMAT "%8.2" ECU_ADDRESS 0x7FDE14 /end MEASUREMENT
/begin MEASUREMENT egscod "" UBYTE dez 1 100 0 255 FORMAT "%5.1" ECU_ADDRESS 0x7F9ACC /end MEASUREMENT
/begin MEASUREMENT evtmod "Einlaﬂventiltemperatur modelliert (Temperaturmodell)" UBYTE temp_ub_q0p75_o48 1 100 -48 143.25 FORMAT "%5.1" ECU_ADDRESS 0x7FD57A /end MEASUREMENT
/begin MEASUREMENT E_akle "" UWORD B_TRUE 1 100 0 1 BIT_MASK 0x1 FORMAT "%13.11" ECU_ADDRESS 0x7F9570 /end MEASUREMENT
/begin MEASUREMENT E_as "" UWORD B_TRUE 1 100 0 1 BIT_MASK 0x1 FORMAT "%13.11" ECU_ADDRESS 0x7F9574 /end MEASUREMENT
/begin MEASUREMENT E_bm "Errorflag: Bezugsmarkengeber" UWORD B_TRUE 1 100 0 1 BIT_MASK 0x1 FORMAT "%13.11" ECU_ADDRESS 0x7F9578 /end MEASUREMENT
/begin MEASUREMENT E_CABS "Errorflag: CAN-Schnittstelle, Timeout ABS" UWORD B_TRUE 1 100 0 1 BIT_MASK 0x1 FORMAT "%13.11" ECU_ADDRESS 0x7F9580 /end MEASUREMENT
/begin MEASUREMENT E_cana "Errorflag: CAN-Schnittstelle ""CAN_A defekt""" UWORD B_TRUE 1 100 0 1 BIT_MASK 0x1 FORMAT "%13.11" ECU_ADDRESS 0x7F9584 /end MEASUREMENT
/begin MEASUREMENT E_CAS "" UWORD B_TRUE 1 100 0 1 BIT_MASK 0x1 FORMAT "%13.11" ECU_ADDRESS 0x7F9588 /end MEASUREMENT
/begin MEASUREMENT E_CKOMBI "Errorflag: CAN-Schnittstelle, Timeout KOMBI" UWORD B_TRUE 1 100 0 1 BIT_MASK 0x1 FORMAT "%13.11" ECU_ADDRESS 0x7F958C /end MEASUREMENT
/begin MEASUREMENT E_CZFE "Errorflag: CAN-Schnittstelle, Timeout ZFE" UWORD B_TRUE 1 100 0 1 BIT_MASK 0x1 FORMAT "%13.11" ECU_ADDRESS 0x7F9590 /end MEASUREMENT
/begin MEASUREMENT E_dkp "" UWORD B_TRUE 1 100 0 1 BIT_MASK 0x1 FORMAT "%13.11" ECU_ADDRESS 0x7F9594 /end MEASUREMENT
/begin MEASUREMENT E_dkpa "Error: DKPA" UWORD B_TRUE 1 100 0 1 BIT_MASK 0x1 FORMAT "%13.11" ECU_ADDRESS 0x7F9598 /end MEASUREMENT
/begin MEASUREMENT E_ekpe "Errorflag: EKPE" UWORD B_TRUE 1 100 0 1 BIT_MASK 0x1 FORMAT "%13.11" ECU_ADDRESS 0x7F95B0 /end MEASUREMENT
/begin MEASUREMENT E_ev1e "Errorflag: EV1E" UWORD B_TRUE 1 100 0 1 BIT_MASK 0x1 FORMAT "%13.11" ECU_ADDRESS 0x7F95B4 /end MEASUREMENT
/begin MEASUREMENT E_ev2e "Errorflag: EV2E" UWORD B_TRUE 1 100 0 1 BIT_MASK 0x1 FORMAT "%13.11" ECU_ADDRESS 0x7F95B8 /end MEASUREMENT
/begin MEASUREMENT E_ev3e "Errorflag: EV3E" UWORD B_TRUE 1 100 0 1 BIT_MASK 0x1 FORMAT "%13.11" ECU_ADDRESS 0x7F95BC /end MEASUREMENT
/begin MEASUREMENT E_ev4e "Errorflag: EV4E" UWORD B_TRUE 1 100 0 1 BIT_MASK 0x1 FORMAT "%13.11" ECU_ADDRESS 0x7F95C0 /end MEASUREMENT
/begin MEASUREMENT E_ews "" UWORD B_TRUE 1 100 0 1 BIT_MASK 0x1 FORMAT "%13.11" ECU_ADDRESS 0x7F95C4 /end MEASUREMENT
/begin MEASUREMENT E_ewse "Errorflag: EWSE" UWORD B_TRUE 1 100 0 1 BIT_MASK 0x1 FORMAT "%13.11" ECU_ADDRESS 0x7F95C8 /end MEASUREMENT
/begin MEASUREMENT E_kat "Errorflag: Katalysator-Konvertierung" UWORD B_TRUE 1 100 0 1 BIT_MASK 0x1 FORMAT "%13.11" ECU_ADDRESS 0x7F95FC /end MEASUREMENT
/begin MEASUREMENT E_kill "Errorflag: Diagnose Killschalter" UWORD B_TRUE 1 100 0 1 BIT_MASK 0x1 FORMAT "%13.11" ECU_ADDRESS 0x7F9608 /end MEASUREMENT
/begin MEASUREMENT E_kl15 "Errorflag: Diagnose Klemme 15 Schalter" UWORD B_TRUE 1 100 0 1 BIT_MASK 0x1 FORMAT "%13.11" ECU_ADDRESS 0x7F960C /end MEASUREMENT
/begin MEASUREMENT E_krnt "Errorflag: Klopfregelung Nulltest" UWORD B_TRUE 1 100 0 1 BIT_MASK 0x1 FORMAT "%13.11" ECU_ADDRESS 0x7F9610 /end MEASUREMENT
/begin MEASUREMENT E_krof "Errorflag: Klopfregelung Offset" UWORD B_TRUE 1 100 0 1 BIT_MASK 0x1 FORMAT "%13.11" ECU_ADDRESS 0x7F9614 /end MEASUREMENT
/begin MEASUREMENT E_krtp "Errorflag: Klopfregelung Testimpuls" UWORD B_TRUE 1 100 0 1 BIT_MASK 0x1 FORMAT "%13.11" ECU_ADDRESS 0x7F9618 /end MEASUREMENT
/begin MEASUREMENT E_ks "" UWORD B_TRUE 1 100 0 1 BIT_MASK 0x1 FORMAT "%13.11" ECU_ADDRESS 0x7F961C /end MEASUREMENT
/begin MEASUREMENT E_ks1 "Errorflag: Klopfsensor 1" UWORD B_TRUE 1 100 0 1 BIT_MASK 0x1 FORMAT "%13.11" ECU_ADDRESS 0x7F9620 /end MEASUREMENT
/begin MEASUREMENT E_ks2 "Errorflag: Klopfsensor 2" UWORD B_TRUE 1 100 0 1 BIT_MASK 0x1 FORMAT "%13.11" ECU_ADDRESS 0x7F9624 /end MEASUREMENT
/begin MEASUREMENT E_n "Errorflag: Drehzahlsignalgeber" UWORD B_TRUE 1 100 0 1 BIT_MASK 0x1 FORMAT "%13.11" ECU_ADDRESS 0x7F9654 /end MEASUREMENT
/begin MEASUREMENT fcmcla_0_A "" UBYTE default 1 100 0 255 FORMAT "%5.1" ECU_ADDRESS 0x7F9700 /end MEASUREMENT
/begin MEASUREMENT fcmdfp_0_A "" UBYTE default 1 100 0 255 FORMAT "%5.1" ECU_ADDRESS 0x7F96FC /end MEASUREMENT
/begin MEASUREMENT fcmdlc_0_A "" UBYTE default 1 100 0 255 FORMAT "%5.1" ECU_ADDRESS 0x7F9704 /end MEASUREMENT
/begin MEASUREMENT fcmEnd "Anzahl Eintr‰ge im Fehlerspeicher" UBYTE dez 1 100 0 255 FORMAT "%5.1" ECU_ADDRESS 0x7F9AE1 /end MEASUREMENT
/begin MEASUREMENT fcmfes_0_A "" UBYTE default 1 100 0 255 FORMAT "%5.1" ECU_ADDRESS 0x7F9701 /end MEASUREMENT
/begin MEASUREMENT fcmflc_0_A "" UBYTE default 1 100 0 255 FORMAT "%5.1" ECU_ADDRESS 0x7F9702 /end MEASUREMENT
/begin MEASUREMENT fcmfps_0_A "" UBYTE default 1 100 0 255 FORMAT "%5.1" ECU_ADDRESS 0x7F96FF /end MEASUREMENT
/begin MEASUREMENT fcmfrz0_0_A "" UBYTE default 1 100 0 255 FORMAT "%5.1" ECU_ADDRESS 0x7F9705 /end MEASUREMENT
/begin MEASUREMENT fcmfrz1_0_A "" UBYTE default 1 100 0 255 FORMAT "%5.1" ECU_ADDRESS 0x7F9706 /end MEASUREMENT
/begin MEASUREMENT fcmfrz10_0_A "" UBYTE default 1 100 0 255 FORMAT "%5.1" ECU_ADDRESS 0x7F970F /end MEASUREMENT
/begin MEASUREMENT fcmfrz2_0_A "" UBYTE default 1 100 0 255 FORMAT "%5.1" ECU_ADDRESS 0x7F9707 /end MEASUREMENT
/begin MEASUREMENT fcmfrz3_0_A "" UBYTE default 1 100 0 255 FORMAT "%5.1" ECU_ADDRESS 0x7F9708 /end MEASUREMENT
/begin MEASUREMENT fcmfrz4_0_A "" UBYTE default 1 100 0 255 FORMAT "%5.1" ECU_ADDRESS 0x7F9709 /end MEASUREMENT
/begin MEASUREMENT fcmfrz5_0_A "" UBYTE default 1 100 0 255 FORMAT "%5.1" ECU_ADDRESS 0x7F970A /end MEASUREMENT
/begin MEASUREMENT fcmfrz6_0_A "" UBYTE default 1 100 0 255 FORMAT "%5.1" ECU_ADDRESS 0x7F970B /end MEASUREMENT
/begin MEASUREMENT fcmfrz7_0_A "" UBYTE default 1 100 0 255 FORMAT "%5.1" ECU_ADDRESS 0x7F970C /end MEASUREMENT
/begin MEASUREMENT fcmfrz8_0_A "" UBYTE default 1 100 0 255 FORMAT "%5.1" ECU_ADDRESS 0x7F970D /end MEASUREMENT
/begin MEASUREMENT fcmfrz9_0_A "" UBYTE default 1 100 0 255 FORMAT "%5.1" ECU_ADDRESS 0x7F970E /end MEASUREMENT
/begin MEASUREMENT fcmHis "" UBYTE dez 1 100 0 255 FORMAT "%5.1" ECU_ADDRESS 0x7FD2A4 /end MEASUREMENT
/begin MEASUREMENT fcmhlc_0_A "" UBYTE default 1 100 0 255 FORMAT "%5.1" ECU_ADDRESS 0x7F9703 /end MEASUREMENT
/begin MEASUREMENT fcmhz_0_A "" UBYTE default 1 100 0 255 FORMAT "%5.1" ECU_ADDRESS 0x7F9722 /end MEASUREMENT
/begin MEASUREMENT FCMTab "" UWORD dez 1 100 0 65535 FORMAT "%8.2" ECU_ADDRESS 0x7F96FC /end MEASUREMENT
/begin MEASUREMENT fcmtsf_0_A "" UBYTE default 1 100 0 255 FORMAT "%5.1" ECU_ADDRESS 0x7F96FD /end MEASUREMENT
/begin MEASUREMENT fcmtyp_0_A "" UBYTE default 1 100 0 255 FORMAT "%5.1" ECU_ADDRESS 0x7F96FE /end MEASUREMENT
/begin MEASUREMENT fmtate_w "Berechnung der Blendenˆffnung ¸ber Tastverh‰ltnis" UWORD fak_uw_b1 1 100 0 0.999985 FORMAT "%9.7" ECU_ADDRESS 0x7FE04C /end MEASUREMENT
/begin MEASUREMENT fmtev_w "Faktor Massenstrom durch TEV" UWORD fak_uw_b1 1 100 0 0.999985 FORMAT "%9.7" ECU_ADDRESS 0x7FE04E /end MEASUREMENT
/begin MEASUREMENT fr2_u "Lambda-Regler-Ausgang; Bank2 (Byte)" UBYTE fak_ub_b2 1 100 0 1.99219 FORMAT "%5.3" ECU_ADDRESS 0x7FD897 /end MEASUREMENT
/begin MEASUREMENT fra2_u "multiplikative Gemischkorrektur der Gemischadaption (Byte)" UBYTE fak_ub_b2 1 100 0 1.99219 FORMAT "%5.3" ECU_ADDRESS 0x7FD898 /end MEASUREMENT
/begin MEASUREMENT frau2_u "multipl. Gemischadaptionsfaktor unterer mult. Bereich der Bank 2 (Byte)" UBYTE fak_ub_b2 1 100 0 1.99219 FORMAT "%5.3" ECU_ADDRESS 0x7FD899 /end MEASUREMENT
/begin MEASUREMENT frau_u "multiplikativer Gemischadaptionsfaktor unterer mult. Bereich (Byte)" UBYTE fak_ub_b2 1 100 0 1.99219 FORMAT "%5.3" ECU_ADDRESS 0x7FD89A /end MEASUREMENT
/begin MEASUREMENT fra_u "multiplikative Gemischkorrektur der Gemischadaption (Byte)" UBYTE fak_ub_b2 1 100 0 1.99219 FORMAT "%5.3" ECU_ADDRESS 0x7FD89B /end MEASUREMENT
/begin MEASUREMENT frhol_u "" UBYTE fak_ub_b2 1 100 0 1.99219 FORMAT "%5.3" ECU_ADDRESS 0x7FD89C /end MEASUREMENT
/begin MEASUREMENT frm2_u "schneller Mittelwert des Lambdaregelfaktors Bank 2 (1 Byte f¸r Tester)" UBYTE fak_ub_b2 1 100 0 1.99219 FORMAT "%5.3" ECU_ADDRESS 0x7FD89D /end MEASUREMENT
/begin MEASUREMENT frm_u "schneller Mittelwert des Lambdaregelfaktors ( 1 Byte f¸r Tester )" UBYTE fak_ub_b2 1 100 0 1.99219 FORMAT "%5.3" ECU_ADDRESS 0x7FD89E /end MEASUREMENT
/begin MEASUREMENT frps_fu "Kraftstoffdruck gefiltert umgerechnet in Byte-Groesse" UBYTE p_ub_q51p2 1 100 0 13056 FORMAT "%5.0" ECU_ADDRESS 0x7FD89F /end MEASUREMENT
/begin MEASUREMENT frps_measu "" UBYTE p_ub_q51p2 1 100 0 13056 FORMAT "%5.0" ECU_ADDRESS 0x7FD8A0 /end MEASUREMENT
/begin MEASUREMENT fr_u "Lambda-Regler-Ausgang (Byte)" UBYTE fak_ub_b2 1 100 0 1.99219 FORMAT "%5.3" ECU_ADDRESS 0x7FD8A1 /end MEASUREMENT
/begin MEASUREMENT Fszbm "Fehlerschwehrez‰hler KWG-Fehler" UWORD dez 1 100 0 65535 FORMAT "%8.2" ECU_ADDRESS 0x7FE11A /end MEASUREMENT
/begin MEASUREMENT ftbr "Faktor Temperaturkorrektur im Brennraum" UBYTE fak_ub_b2 1 100 0 1.99219 FORMAT "%5.3" ECU_ADDRESS 0x7FD57B /end MEASUREMENT
/begin MEASUREMENT ftbr_w "Faktor Temperaturkorrektur im Brennraum" UWORD fak_uw_b2 1 100 0 1.99997 FORMAT "%8.6" ECU_ADDRESS 0x7FD580 /end MEASUREMENT
/begin MEASUREMENT ftsr "Korrekturfaktor Lufttemperatur im Saugrohr" UBYTE fak_ub_b2 1 100 0 1.99219 FORMAT "%5.3" ECU_ADDRESS 0x7FD90B /end MEASUREMENT
/begin MEASUREMENT ftu "Faktor Temperatur Umgebung" UBYTE fak_ub_b2 1 100 0 1.99219 FORMAT "%5.3" ECU_ADDRESS 0x7FD57C /end MEASUREMENT
/begin MEASUREMENT ftvdk "Korrekturfaktor Temperatur vor Drosselklappe" UBYTE fak_ub_b2 1 100 0 1.99219 FORMAT "%5.3" ECU_ADDRESS 0x7FD90C /end MEASUREMENT
/begin MEASUREMENT ftvdkho_w "" UWORD fak_uw_b8 1 100 0 7.99988 FORMAT "%8.6" ECU_ADDRESS 0x7FE1E8 /end MEASUREMENT
/begin MEASUREMENT ftw "Faktor Temperaturgewichtung tmot, tans" UBYTE fak_ub_b4 1 100 0 3.98438 FORMAT "%5.3" ECU_ADDRESS 0x7FD57D /end MEASUREMENT
/begin MEASUREMENT fuel_level "Kraftstoff-Fuellstand" UBYTE rel_q0p392 1 100 0 100 FORMAT "%5.1" ECU_ADDRESS 0x7FD890 /end MEASUREMENT
/begin MEASUREMENT fupsrlf_w "Rover" UWORD rel_uw_q0p001 1 100 0 65.535 FORMAT "%8.5" ECU_ADDRESS 0x7FDC20 /end MEASUREMENT
/begin MEASUREMENT fupsrlr_w "Rover" UWORD rel_uw_b0p3 1 100 0 0.299995 FORMAT "%9.7" ECU_ADDRESS 0x7FDC22 /end MEASUREMENT
/begin MEASUREMENT fupsrl_w "Faktor systembezogene Umrechnung Druck auf F¸llung (16-Bit)" UWORD rel_uw_b0p3 1 100 0 0.299995 FORMAT "%9.7" ECU_ADDRESS 0x7FDC24 /end MEASUREMENT
/begin MEASUREMENT fvisrm_w "Faktor Verst‰rkung Integrator Saugrohrmodell" UWORD p_uw_b32 1 100 0 31.9995 FORMAT "%8.5" ECU_ADDRESS 0x7FDC26 /end MEASUREMENT
/begin MEASUREMENT fwprs_w "Faktor Preadiktionswinkel bezogen auf Segment" UWORD fak_uw_b32 1 100 0 31.9995 FORMAT "%8.5" ECU_ADDRESS 0x7FDC7C /end MEASUREMENT
/begin MEASUREMENT gangauti "bei Automatikgetriebe ¸ber CAN empfangener aktueller Gang" UBYTE dez 1 100 0 255 FORMAT "%5.1" ECU_ADDRESS 0x7FD88D /end MEASUREMENT
/begin MEASUREMENT iegr_w "" UWORD rel_uw_b100 1 100 0 99.9985 FORMAT "%8.5" ECU_ADDRESS 0x7FDC28 /end MEASUREMENT
/begin MEASUREMENT igod_u "Integratorgradient f¸r Nulltest-Diagnose Klopfregelung (1 Byte f¸r Tester)" SBYTE spgg_sb_b3052 1 100 -3052.01 3028.16 FORMAT "%5.0" ECU_ADDRESS 0x7FD8A2 /end MEASUREMENT
/begin MEASUREMENT igokr_u "Integratorgradient f¸r Offsetkorrektur Klopfregelung (Byte)" SBYTE spgg_sb_b3052 1 100 -3052.01 3028.16 FORMAT "%5.0" ECU_ADDRESS 0x7FD8A3 /end MEASUREMENT
/begin MEASUREMENT Klvxdspos_aus "" SWORD fak_q0p1 1 100 -3276.8 3276.7 FORMAT "%8.3" ECU_ADDRESS 0x7FDE16 /end MEASUREMENT
/begin MEASUREMENT kmstand "Fahrstrecke des Fahrzeugs als Information ¸ber CAN" ULONG km_ul_q1 1 100 0 4.29497e+009 FORMAT "%13.2" ECU_ADDRESS 0x7FE28C /end MEASUREMENT
/begin MEASUREMENT lamsons2_u "Lambda-Sollwert bezogen auf Einbauort Lambda-Sensor Bank2 (1 Byte f¸r Tester)" UBYTE fak_ub_b16 1 100 0 15.9375 FORMAT "%5.2" ECU_ADDRESS 0x7FD8A4 /end MEASUREMENT
/begin MEASUREMENT lamsons_u "Lambda-Sollwert bezogen auf Einbauort Lambda-Sensor (1 Byte f¸r Tester)" UBYTE fak_ub_b16 1 100 0 15.9375 FORMAT "%5.2" ECU_ADDRESS 0x7FD8A5 /end MEASUREMENT
/begin MEASUREMENT mdwancan "Drehmomentaufnahme des Wandlers ¸ber CAN" UBYTE rel_ub_b99p6 1 100 0 99.6094 FORMAT "%5.2" ECU_ADDRESS 0x7FD88E /end MEASUREMENT
/begin MEASUREMENT miasrl "" UBYTE rel_ub_b100 1 100 0 100 FORMAT "%5.1" ECU_ADDRESS 0x7FD88A /end MEASUREMENT
/begin MEASUREMENT miasrl_w "Indiziertes Soll-Motormoment ASR f¸r langsamen Eingriff" UWORD rel_uw_b100 1 100 0 99.9985 FORMAT "%8.5" ECU_ADDRESS 0x7FDB50 /end MEASUREMENT
/begin MEASUREMENT miasrs "" UBYTE rel_ub_b100 1 100 0 100 FORMAT "%5.1" ECU_ADDRESS 0x7FD88B /end MEASUREMENT
/begin MEASUREMENT miasrs_w "Indiziertes Soll-Motormoment ASR f¸r schnellen Eingriff" UWORD rel_uw_b100 1 100 0 99.9985 FORMAT "%8.5" ECU_ADDRESS 0x7FDB52 /end MEASUREMENT
/begin MEASUREMENT migs_w "Indiziertes Soll-Motormoment GS f¸r schnellen Eingriff" UWORD rel_uw_b100 1 100 0 99.9985 FORMAT "%8.5" ECU_ADDRESS 0x7FDB56 /end MEASUREMENT
/begin MEASUREMENT miistc "" UBYTE rel_ub_b100 1 100 0 100 FORMAT "%5.1" ECU_ADDRESS 0x7FD887 /end MEASUREMENT
/begin MEASUREMENT mimsr "Indiziertes Soll-Motormoment MSR" UBYTE rel_ub_b100 1 100 0 100 FORMAT "%5.1" ECU_ADDRESS 0x7FD88C /end MEASUREMENT
/begin MEASUREMENT mimsr_w "Indiziertes Soll-Motormoment MSR" UWORD rel_uw_b100 1 100 0 99.9985 FORMAT "%8.5" ECU_ADDRESS 0x7FDB4A /end MEASUREMENT
/begin MEASUREMENT ml "Luftmassenfluﬂ" UBYTE m_ub_b1020 1 100 0 1020 FORMAT "%5.0" ECU_ADDRESS 0x7FBCB0 /end MEASUREMENT
/begin MEASUREMENT ml_w "Luftmassenfluﬂ gefiltert (Word)" UWORD m_uw_b6553p5 1 100 0 6553.5 FORMAT "%8.3" ECU_ADDRESS 0x7FBCE2 /end MEASUREMENT
/begin MEASUREMENT msndkpk_w "" UWORD m_uw_b6553p5 1 100 0 6553.5 FORMAT "%8.3" ECU_ADDRESS 0x7FDC7E /end MEASUREMENT
/begin MEASUREMENT msntevo_w "normierter, ¸berkritischer Massenstrom durch das 100% offene TEV" UWORD m_uw_b25p6 1 100 0 25.5996 FORMAT "%8.5" ECU_ADDRESS 0x7FD786 /end MEASUREMENT
/begin MEASUREMENT mste "Massenstrom Tankentl¸ftung ins Saugrohr" UBYTE m_ub_b25p6 1 100 0 25.5 FORMAT "%5.2" ECU_ADDRESS 0x7FBCDC /end MEASUREMENT
/begin MEASUREMENT mstedp_w "Normierter Massenstrom durch das TEV mit Zeitverhalten" UWORD m_uw_b25p6 1 100 0 25.5996 FORMAT "%8.5" ECU_ADDRESS 0x7FE050 /end MEASUREMENT
/begin MEASUREMENT mstedte "Massenstrom TEV f¸r DTEV" UBYTE m_ub_b25p6 1 100 0 25.5 FORMAT "%5.2" ECU_ADDRESS 0x7FDAD1 /end MEASUREMENT
/begin MEASUREMENT mstedte_w "Massenstrom TEV f¸r DTEV (Word)" UWORD m_uw_b25p6 1 100 0 25.5996 FORMAT "%8.5" ECU_ADDRESS 0x7FE052 /end MEASUREMENT
/begin MEASUREMENT msteo_w "Massenstom durch das 100% offene TEV" UWORD m_uw_b25p6 1 100 0 25.5996 FORMAT "%8.5" ECU_ADDRESS 0x7FE054 /end MEASUREMENT
/begin MEASUREMENT mste_w "Massenstrom Tankentl¸ftung in das Saugrohr" UWORD m_uw_b25p6 1 100 0 25.5996 FORMAT "%8.5" ECU_ADDRESS 0x7FE056 /end MEASUREMENT
/begin MEASUREMENT nmot "Motordrehzahl" UBYTE nmot_ub_q40 1 100 0 10000 FORMAT "%5.0" ECU_ADDRESS 0x7FD80F /end MEASUREMENT
/begin MEASUREMENT nmotll "Motordrehzahl im Leerlaufbereich" UBYTE nmot_ub_q10 1 100 0 2550 FORMAT "%5.0" ECU_ADDRESS 0x7FD810 /end MEASUREMENT
/begin MEASUREMENT nmotllfil "Gefilterte Drehzahl nmotll" UBYTE nmot_ub_q10 1 100 0 2550 FORMAT "%5.0" ECU_ADDRESS 0x7FD811 /end MEASUREMENT
/begin MEASUREMENT nmotseg "" UBYTE nmot_ub_q40 1 100 0 10200 FORMAT "%5.0" ECU_ADDRESS 0x7FD812 /end MEASUREMENT
/begin MEASUREMENT obdstegs "aus CAN-Signal OBD_STAT_GS aufbereitete Grˆﬂe f¸r ME" UBYTE dez 1 100 0 4 FORMAT "%5.3" ECU_ADDRESS 0x7FD88F /end MEASUREMENT
/begin MEASUREMENT pirgf_w "Rover" UWORD rel_uw_q0p001 1 100 0 65.535 FORMAT "%8.5" ECU_ADDRESS 0x7FDC2A /end MEASUREMENT
/begin MEASUREMENT pirgro_w "Rohwert Partialdruck Restgas internes AGR" UWORD p_uw_q0p039 1 100 0 2559.96 FORMAT "%8.3" ECU_ADDRESS 0x7FD574 /end MEASUREMENT
/begin MEASUREMENT pirgr_w "Rover" UWORD p_uw_q0p039 1 100 0 2559.96 FORMAT "%8.3" ECU_ADDRESS 0x7FDC2C /end MEASUREMENT
/begin MEASUREMENT pirg_w "Partialdruck Restgas interne AGR (16-Bit)" UWORD p_uw_q0p039 1 100 0 2559.96 FORMAT "%8.3" ECU_ADDRESS 0x7FDC2E /end MEASUREMENT
/begin MEASUREMENT psfg_w "Frischgaspartialdruck im Saugrohr (word)" UWORD p_uw_q0p039 1 100 0 2559.96 FORMAT "%8.3" ECU_ADDRESS 0x7FDC30 /end MEASUREMENT
/begin MEASUREMENT psmppvdk_w "" UWORD fak_uw_q0p001 1 100 0 65.535 FORMAT "%8.5" ECU_ADDRESS 0x7FDC80 /end MEASUREMENT
/begin MEASUREMENT psmp_w "" UWORD p_uw_q0p039 1 100 0 2559.96 FORMAT "%8.3" ECU_ADDRESS 0x7FDC82 /end MEASUREMENT
/begin MEASUREMENT psmx_w "Saugrohrmaximaldruckbegrenzung f¸r modellierten Saugrohrdruck" UWORD p_uw_q0p039 1 100 0 2559.96 FORMAT "%8.3" ECU_ADDRESS 0x7FDC32 /end MEASUREMENT
/begin MEASUREMENT psp_w "" UWORD p_uw_q0p039 1 100 0 2559.96 FORMAT "%8.3" ECU_ADDRESS 0x7FDC84 /end MEASUREMENT
/begin MEASUREMENT psrlro_w "Rohwert f¸r Faktor systembezogene Umrechnung Druck auf F¸llung" UWORD rel_uw_b0p3 1 100 0 0.299995 FORMAT "%9.7" ECU_ADDRESS 0x7FD576 /end MEASUREMENT
/begin MEASUREMENT ps_w "Saugrohr-Absolutdruck (Word)" UWORD p_uw_q0p039 1 100 0 2559.96 FORMAT "%8.3" ECU_ADDRESS 0x7FBCE4 /end MEASUREMENT
/begin MEASUREMENT resspd_w_a "verwendete Geschwindigkeit nach Resonanzkorrektur" SWORD fak_q0p1 1 100 -3276.8 3276.7 FORMAT "%8.3" ARRAY_SIZE 2 ECU_ADDRESS 0x7FDE18 /end MEASUREMENT
/begin MEASUREMENT rfagr_w "relative F¸llung AGR (word)" UWORD rel_uw_q0p0234 1 100 0 1535.98 FORMAT "%8.3" ECU_ADDRESS 0x7FDC34 /end MEASUREMENT
/begin MEASUREMENT rfges_w "gesamte relative F¸llung (inclusive AGR) 16-Bit" UWORD rel_uw_q0p0234 1 100 0 1535.98 FORMAT "%8.3" ECU_ADDRESS 0x7FDC36 /end MEASUREMENT
/begin MEASUREMENT rinv2_u "Istwert (Byte) Innenwiderstand Ri-Nernstzelle der Lambdasonde vor KAT Bank2" UBYTE r_ub_q64 1 100 0 16320 FORMAT "%5.0" ECU_ADDRESS 0x7FD8A6 /end MEASUREMENT
/begin MEASUREMENT rinv_u "Istwert (Byte) Innenwiderstand Ri-Nernstzelle der Lambdasonde vor KAT" UBYTE r_ub_q64 1 100 0 16320 FORMAT "%5.0" ECU_ADDRESS 0x7FD8A7 /end MEASUREMENT
/begin MEASUREMENT rkaco_w "Additive Korrektur der rel. Kraftstoffmasse f¸r LL-CO einstellen" SWORD rel_sw_b1536 1 100 -1536 1535.95 FORMAT "%8.3" ECU_ADDRESS 0x7FDC90 /end MEASUREMENT
/begin MEASUREMENT rkrn_u "" UBYTE spg_q0p625 1 100 0 159.375 FORMAT "%5.1" ARRAY_SIZE 8 ECU_ADDRESS 0x7FD8A8 /end MEASUREMENT
/begin MEASUREMENT rl "relative Luftf¸llung" UBYTE rel_ub_q0p75 1 100 0 191.25 FORMAT "%5.1" ECU_ADDRESS 0x7FBCB1 /end MEASUREMENT
/begin MEASUREMENT rlgas_w "F¸llungsgradient ¸ber ein Arbeitsspiel bestimmt" SWORD relNWU_q0p0234 1 100 -768 767.977 FORMAT "%8.4" ECU_ADDRESS 0x7FDC0E /end MEASUREMENT
/begin MEASUREMENT rlmp_w "" UWORD rel_uw_q0p0234 1 100 0 1535.98 FORMAT "%8.3" ECU_ADDRESS 0x7FDC86 /end MEASUREMENT
/begin MEASUREMENT rlp "rel. Luftf¸llung praediziert f¸r Einspritzberechnung" UBYTE rel_ub_q0p75 1 100 0 191.25 FORMAT "%5.1" ECU_ADDRESS 0x7FD91C /end MEASUREMENT
/begin MEASUREMENT rlp_w "rel. Luftf¸llung praediziert f¸r Einspritzberechnung (Word)" UWORD rel_uw_q0p0234 1 100 0 1535.98 FORMAT "%8.3" ECU_ADDRESS 0x7FDC88 /end MEASUREMENT
/begin MEASUREMENT rlrohmp_w "" UWORD rel_uw_q0p0234 1 100 0 1535.98 FORMAT "%8.3" ECU_ADDRESS 0x7FDC8A /end MEASUREMENT
/begin MEASUREMENT rlrsp_w "Beginn Ringspeicher relative F¸llung" UWORD rel_uw_q0p0234 1 100 0 1535.98 FORMAT "%8.3" ARRAY_SIZE 4 ECU_ADDRESS 0x7FDC10 /end MEASUREMENT
/begin MEASUREMENT rltmp_w "RL fuer Saugrohrmodell" UWORD rel_uw_q0p0234 1 100 0 1535.98 FORMAT "%8.3" ECU_ADDRESS 0x7FBCE6 /end MEASUREMENT
/begin MEASUREMENT rl_u "relative Luftf¸llung (Byte) f¸r Fehlerspeicher-Umwelten" UBYTE rel_ub_b100 1 100 0 100 FORMAT "%5.1" ECU_ADDRESS 0x7FD8B0 /end MEASUREMENT
/begin MEASUREMENT rl_w "relative Luftf¸llung (Word)" UWORD rel_uw_q0p0234 1 100 0 1535.98 FORMAT "%8.3" ECU_ADDRESS 0x7FBCE8 /end MEASUREMENT
/begin MEASUREMENT rml "relative Luftmasse (calc. load value) nach SAE J1979" UBYTE rel_ub_b99p6 1 100 0 99.6094 FORMAT "%5.2" ECU_ADDRESS 0x7FD573 /end MEASUREMENT
/begin MEASUREMENT sfpaaa "Status Fehlerpfad: Tabellenanfang" UWORD dez 1 100 0 65535 FORMAT "%8.2" ECU_ADDRESS 0x7F9568 /end MEASUREMENT
/begin MEASUREMENT sfpakle "" UWORD default 1 100 0 65535 FORMAT "%8.2" ECU_ADDRESS 0x7F9570 /end MEASUREMENT
/begin MEASUREMENT sfpas "" UWORD default 1 100 0 65535 FORMAT "%8.2" ECU_ADDRESS 0x7F9574 /end MEASUREMENT
/begin MEASUREMENT sfpbm "Status Fehlerpfad: Bezugsmarkengeber" UWORD dez 1 100 0 65535 FORMAT "%8.2" ECU_ADDRESS 0x7F9578 /end MEASUREMENT
/begin MEASUREMENT sfpcabs "Status Fehlerpfad: Diagnose CAN-Timeout ABS-SG" UWORD dez 1 100 0 65535 FORMAT "%8.2" ECU_ADDRESS 0x7F9580 /end MEASUREMENT
/begin MEASUREMENT sfpcana "Status Fehlerpfad: Diagnose CAN A (Fahrzeug-CAN)" UWORD default 1 100 0 65535 FORMAT "%8.2" ECU_ADDRESS 0x7F9584 /end MEASUREMENT
/begin MEASUREMENT sfpcas "" UWORD dez 1 100 0 65535 FORMAT "%8.2" ECU_ADDRESS 0x7F9588 /end MEASUREMENT
/begin MEASUREMENT sfpckombi "Status Fehlerpfad: Diagnose CAN-Timeout Kombiinstr." UWORD dez 1 100 0 65535 FORMAT "%8.2" ECU_ADDRESS 0x7F958C /end MEASUREMENT
/begin MEASUREMENT sfpczfe "Status Fehlerpfad: Diagnose CAN-Timeout ZFE-SG" UWORD dez 1 100 0 65535 FORMAT "%8.2" ECU_ADDRESS 0x7F9590 /end MEASUREMENT
/begin MEASUREMENT sfpdkp "Status Fehlerpfad: DKP" UWORD default 1 100 0 65535 FORMAT "%8.2" ECU_ADDRESS 0x7F9594 /end MEASUREMENT
/begin MEASUREMENT sfpdkpa "Status Fehlerpfad: DKPA" UWORD default 1 100 0 65535 FORMAT "%8.2" ECU_ADDRESS 0x7F9598 /end MEASUREMENT
/begin MEASUREMENT sfpekpe "Status Fehlerpfad: EKPE" UWORD default 1 100 0 65535 FORMAT "%8.2" ECU_ADDRESS 0x7F95B0 /end MEASUREMENT
/begin MEASUREMENT sfpev1e "Status Fehlerpfad: EV1E" UWORD default 1 100 0 65535 FORMAT "%8.2" ECU_ADDRESS 0x7F95B4 /end MEASUREMENT
/begin MEASUREMENT sfpev2e "Status Fehlerpfad: EV2E" UWORD default 1 100 0 65535 FORMAT "%8.2" ECU_ADDRESS 0x7F95B8 /end MEASUREMENT
/begin MEASUREMENT sfpev3e "Status Fehlerpfad: EV3E" UWORD default 1 100 0 65535 FORMAT "%8.2" ECU_ADDRESS 0x7F95BC /end MEASUREMENT
/begin MEASUREMENT sfpev4e "Status Fehlerpfad: EV4E" UWORD default 1 100 0 65535 FORMAT "%8.2" ECU_ADDRESS 0x7F95C0 /end MEASUREMENT
/begin MEASUREMENT sfpews "" UWORD default 1 100 0 65535 FORMAT "%8.2" ECU_ADDRESS 0x7F95C4 /end MEASUREMENT
/begin MEASUREMENT sfpewse "Status Fehlerpfad: EWSE" UWORD default 1 100 0 65535 FORMAT "%8.2" ECU_ADDRESS 0x7F95C8 /end MEASUREMENT
/begin MEASUREMENT sfpkat "Status Fehlerpfad: Katalysator-‹berwachung" UWORD dez 1 100 0 65535 FORMAT "%8.2" ECU_ADDRESS 0x7F95FC /end MEASUREMENT
/begin MEASUREMENT sfpkill "Status Fehlerpfad: Diagnose Killschalter" UWORD dez 1 100 0 65535 FORMAT "%8.2" ECU_ADDRESS 0x7F9608 /end MEASUREMENT
/begin MEASUREMENT sfpkl15 "" UWORD dez 1 100 0 65535 FORMAT "%8.2" ECU_ADDRESS 0x7F960C /end MEASUREMENT
/begin MEASUREMENT sfpkrnt "Status Fehlerpfad: Klopfregelung Nulltest" UWORD dez 1 100 0 65535 FORMAT "%8.2" ECU_ADDRESS 0x7F9610 /end MEASUREMENT
/begin MEASUREMENT sfpkrof "Status Fehlerpfad: Klopfregelung Offset" UWORD dez 1 100 0 65535 FORMAT "%8.2" ECU_ADDRESS 0x7F9614 /end MEASUREMENT
/begin MEASUREMENT sfpkrtp "Status Fehlerpfad: Klopfregelung Testimpuls" UWORD dez 1 100 0 65535 FORMAT "%8.2" ECU_ADDRESS 0x7F9618 /end MEASUREMENT
/begin MEASUREMENT sfpks "" UWORD dez 1 100 0 65535 FORMAT "%8.2" ECU_ADDRESS 0x7F961C /end MEASUREMENT
/begin MEASUREMENT sfpks1 "Status Fehlerpfad: Klopfsensor 1" UWORD dez 1 100 0 65535 FORMAT "%8.2" ECU_ADDRESS 0x7F9620 /end MEASUREMENT
/begin MEASUREMENT sfpks2 "Status Fehlerpfad: Klopfsensor 2" UWORD dez 1 100 0 65535 FORMAT "%8.2" ECU_ADDRESS 0x7F9624 /end MEASUREMENT
/begin MEASUREMENT sfpn "Status Fehlerpfad: Drehzahlgeber" UWORD dez 1 100 0 65535 FORMAT "%8.2" ECU_ADDRESS 0x7F9654 /end MEASUREMENT
/begin MEASUREMENT sfpzzz "Dummy: Tabellenende" UWORD dez 1 100 0 65535 FORMAT "%8.2" ECU_ADDRESS 0x7F96F8 /end MEASUREMENT
/begin MEASUREMENT slsstat "SLS-Status ¸ber CAN" UBYTE dez 1 100 0 255 FORMAT "%5.1" ECU_ADDRESS 0x7FD7AB /end MEASUREMENT
/begin MEASUREMENT Stat_md_e "" UBYTE dez 1 100 0 255 FORMAT "%5.1" ECU_ADDRESS 0x7FD888 /end MEASUREMENT
/begin MEASUREMENT stp_ref_offset_lok "" SWORD fak_q0p1 1 100 -3276.8 3276.7 FORMAT "%8.3" ARRAY_SIZE 2 ECU_ADDRESS 0x7FDDD2 /end MEASUREMENT
/begin MEASUREMENT stp_wide "" UWORD dez 1 100 0 65535 FORMAT "%8.2" ECU_ADDRESS 0x7FDDD6 /end MEASUREMENT
/begin MEASUREMENT st_cmd_pos "gew¸nschte Stepperansteuerposition" SWORD fak_q0p1 1 100 -3276.8 3276.7 FORMAT "%8.3" ARRAY_SIZE 2 ECU_ADDRESS 0x7FDDD8 /end MEASUREMENT
/begin MEASUREMENT st_cmd_spd "gew¸nschte Stepperansteuergeschwindigkeit" SWORD fak_q0p1 1 100 -3276.8 3276.7 FORMAT "%8.3" ARRAY_SIZE 2 ECU_ADDRESS 0x7FDDDC /end MEASUREMENT
/begin MEASUREMENT st_cmd_typ "Stepper Kommando Befehl" UWORD dez 1 100 0 65535 FORMAT "%8.2" ARRAY_SIZE 2 ECU_ADDRESS 0x7FDDE0 /end MEASUREMENT
/begin MEASUREMENT st_curp1_u "" UBYTE dez 1 100 0 255 FORMAT "%5.1" ECU_ADDRESS 0x7FD8B1 /end MEASUREMENT
/begin MEASUREMENT st_curp2_u "" UBYTE dez 1 100 0 255 FORMAT "%5.1" ECU_ADDRESS 0x7FD8B2 /end MEASUREMENT
/begin MEASUREMENT st_curs1_u "" UBYTE fak_4 1 100 0 1020 FORMAT "%5.0" ECU_ADDRESS 0x7FD8B3 /end MEASUREMENT
/begin MEASUREMENT st_curs2_u "" UBYTE fak_4 1 100 0 1020 FORMAT "%5.0" ECU_ADDRESS 0x7FD8B4 /end MEASUREMENT
/begin MEASUREMENT st_cur_pos "tats‰chliche Position Steppermotor" SWORD fak_q0p1 1 100 -3276.8 3276.7 FORMAT "%8.3" ARRAY_SIZE 2 ECU_ADDRESS 0x7FDDE4 /end MEASUREMENT
/begin MEASUREMENT st_cur_spd "tats‰chliche Geschwindigkeit Steppermotor" SWORD fak_q0p1 1 100 -3276.8 3276.7 FORMAT "%8.3" ARRAY_SIZE 2 ECU_ADDRESS 0x7FDDE8 /end MEASUREMENT
/begin MEASUREMENT st_err_sta "" UBYTE dez 1 100 0 255 FORMAT "%5.1" ARRAY_SIZE 2 ECU_ADDRESS 0x7FD644 /end MEASUREMENT
/begin MEASUREMENT st_move_a "Zustand Stepper in Bewegeung" UBYTE dez 1 100 0 255 FORMAT "%5.1" ARRAY_SIZE 2 ECU_ADDRESS 0x7FD998 /end MEASUREMENT
/begin MEASUREMENT st_pos_dif "Differenz Soll/Istposition in Steps" SWORD fak_q0p1 1 100 -3276.8 3276.7 FORMAT "%8.3" ARRAY_SIZE 2 ECU_ADDRESS 0x7FDDEC /end MEASUREMENT
/begin MEASUREMENT st_ref_a "" UBYTE dez 1 100 0 255 FORMAT "%5.1" ARRAY_SIZE 2 ECU_ADDRESS 0x7FD99C /end MEASUREMENT
/begin MEASUREMENT st_ti_half "Z‰hler bis Ausf¸hrung n‰chsten Halbschritt (Vollschrittmodus:Faktor 2 l‰nger)" UWORD t1msxms_q1 1 100 0 65535 FORMAT "%8.2" ARRAY_SIZE 2 ECU_ADDRESS 0x7FD646 /end MEASUREMENT
/begin MEASUREMENT st_ti_ha_deb "" UWORD t1msxms_q1 1 100 0 65535 FORMAT "%8.2" ARRAY_SIZE 2 ECU_ADDRESS 0x7FD64A /end MEASUREMENT
/begin MEASUREMENT tabsmn_w "Abstellzeit aus relativem Minutenz‰hler" UWORD t1sxs_uw_q1 1 100 0 65535 FORMAT "%8.2" ECU_ADDRESS 0x7FD59A /end MEASUREMENT
/begin MEASUREMENT tabsnl_w "Abstellzeit aus SG-Nachlauf" UWORD t1sxs_uw_q1 1 100 0 65535 FORMAT "%8.2" ECU_ADDRESS 0x7F9BB4 /end MEASUREMENT
/begin MEASUREMENT tabssc_w "Abstellzeit aus relativem Sekundenz‰hler" UWORD t1sxs_uw_q1 1 100 0 65535 FORMAT "%8.2" ECU_ADDRESS 0x7FD59C /end MEASUREMENT
/begin MEASUREMENT tabstm_w "Abstellzeit aus Abk¸hlung des Motors" UWORD t1sxs_uw_q1 1 100 0 65535 FORMAT "%8.2" ECU_ADDRESS 0x7FD59E /end MEASUREMENT
/begin MEASUREMENT tabst_u "Abstellzeit (Byte)" UBYTE t_q256 1 100 0 65280 FORMAT "%5.0" ECU_ADDRESS 0x7FD8B5 /end MEASUREMENT
/begin MEASUREMENT tabst_w "Abstellzeit" UWORD t1sxs_uw_q1 1 100 0 65535 FORMAT "%8.2" ECU_ADDRESS 0x7FD5A0 /end MEASUREMENT
/begin MEASUREMENT tas_w "Zeit ¸ber ein Arbeitsspiel f¸r rlgas_w" UWORD t_q16us 1 100 0 1.04856e+006 FORMAT "%8.0" ECU_ADDRESS 0x7FDC18 /end MEASUREMENT
/begin MEASUREMENT tatemax "" UBYTE rel_ub_b99p6 1 100 0 99.6094 FORMAT "%5.2" ECU_ADDRESS 0x7FDAD2 /end MEASUREMENT
/begin MEASUREMENT tbypfil_w "Filter value for generation of target stepper position" UWORD zk10msxs_uw_b655 1 100 0.0100002 655.36 FORMAT "%10.6" ECU_ADDRESS 0x7FDE1C /end MEASUREMENT
/begin MEASUREMENT tdcas_ctr1 "" UWORD t10msxs_uw_b655p35 1 100 0 655.35 FORMAT "%8.4" ECU_ADDRESS 0x7FDB4C /end MEASUREMENT
/begin MEASUREMENT tdcas_ctr2 "" UWORD t10msxs_uw_b655p35 1 100 0 655.35 FORMAT "%8.4" ECU_ADDRESS 0x7FDB4E /end MEASUREMENT
/begin MEASUREMENT tefreq "" UBYTE freq2000_ub 1 100 0 199.219 FORMAT "%5.1" ECU_ADDRESS 0x7FDAD3 /end MEASUREMENT
/begin MEASUREMENT tempin "Temperatur Eingang (Adressierung von FWFTBRTA)" UBYTE temp_ub_q0p75_o48 1 100 -48 143.25 FORMAT "%5.1" ECU_ADDRESS 0x7FD57E /end MEASUREMENT
/begin MEASUREMENT te_u "" UBYTE t64p0usxms_ub 1 100 0 16.32 FORMAT "%5.2" ECU_ADDRESS 0x7FD8B6 /end MEASUREMENT
/begin MEASUREMENT tgtbyp_w_a "Zielposition Steppermotor in %" UWORD rel_uw_b100 1 100 0 99.9985 FORMAT "%8.5" ARRAY_SIZE 2 ECU_ADDRESS 0x7FDE1E /end MEASUREMENT
/begin MEASUREMENT tmotfil "gefilterte Motortemperatur" UWORD temp_ub_q0p75_o48 1 100 -48 49103.3 FORMAT "%8.2" ECU_ADDRESS 0x7F9BAA /end MEASUREMENT
/begin MEASUREMENT tmotzyl_u "Zylinderkopftemperatur umgerechnet in Byte-Groesse" UBYTE temp_ub_q0p75_o48 1 100 -48 143.25 FORMAT "%5.1" ECU_ADDRESS 0x7FD8B7 /end MEASUREMENT
/begin MEASUREMENT tmot_u "Motor-Temperatur mit def. Quantisierung f¸r FSP-Umwelten" UBYTE temp_ub_q1_o40 1 100 -40 215 FORMAT "%5.1" ECU_ADDRESS 0x7FD8B8 /end MEASUREMENT
/begin MEASUREMENT tnse_u "Zeit nach Startende Byte" UBYTE t25p6sxs_ub_b6528 1 100 0 6528 FORMAT "%5.0" ECU_ADDRESS 0x7FD8B9 /end MEASUREMENT
/begin MEASUREMENT tnst_u "Zeit nach Motorstart umgerechnet in Byte-Groesse" UBYTE t640msxs_ub_b163p2 1 100 0 163.2 FORMAT "%5.1" ECU_ADDRESS 0x7FD8BA /end MEASUREMENT
/begin MEASUREMENT tpsvkmf2_u "gefilterter Periodendauerwert des Sondensignals vor Kat, Bank2 (Byte)" UBYTE t10msxs_ub_b10p2 1 100 0 10.2 FORMAT "%5.2" ECU_ADDRESS 0x7FD8BB /end MEASUREMENT
/begin MEASUREMENT tpsvkmf_u "gefilterter Periodendauerwert des Sondensignals vor Kat. (Byte)" UBYTE t10msxs_ub_b10p2 1 100 0 10.2 FORMAT "%5.2" ECU_ADDRESS 0x7FD8BC /end MEASUREMENT
/begin MEASUREMENT trigger "" UBYTE dez 1 100 0 255 FORMAT "%5.1" ARRAY_SIZE 2 ECU_ADDRESS 0x7FD9C8 /end MEASUREMENT
/begin MEASUREMENT trsec "" ULONG t1sxs_ul_q1 1 100 0 4.29497e+009 FORMAT "%13.2" ECU_ADDRESS 0x7FE290 /end MEASUREMENT
/begin MEASUREMENT trsec_abst "" ULONG t1sxs_ul_q1 1 100 0 4.29497e+009 FORMAT "%13.2" ECU_ADDRESS 0x7F9BB0 /end MEASUREMENT
/begin MEASUREMENT tsges_w "Saugrohrgesamttemperatur (nach AGR-Einleitung) (word)" SWORD temp_sw_q0p75 1 100 -24576 24575.3 FORMAT "%8.2" ECU_ADDRESS 0x7FD582 /end MEASUREMENT
/begin MEASUREMENT tumta "Umgebungstemperatur aus Ansauglufttemperatur" UBYTE temp_ub_q0p75_o48 1 100 -48 143.25 FORMAT "%5.1" ECU_ADDRESS 0x7F9BAD /end MEASUREMENT
/begin MEASUREMENT tum_ein "Umgebungstemperatur f¸r Abstellzeitberechnung" UBYTE temp_ub_q0p75_o48 1 100 -48 143.25 FORMAT "%5.1" ECU_ADDRESS 0x7FD598 /end MEASUREMENT
/begin MEASUREMENT TYP_akle "" UWORD SFP_TYP 1 100 0 8 BIT_MASK 0xf00 FORMAT "%13.11" ECU_ADDRESS 0x7F9570 /end MEASUREMENT
/begin MEASUREMENT TYP_as "" UWORD B_TRUE 1 100 0 1 BIT_MASK 0xf00 FORMAT "%13.11" ECU_ADDRESS 0x7F9574 /end MEASUREMENT
/begin MEASUREMENT TYP_bm "" UWORD B_TRUE 1 100 0 1 BIT_MASK 0xf00 FORMAT "%13.11" ECU_ADDRESS 0x7F9578 /end MEASUREMENT
/begin MEASUREMENT TYP_cabs "" UWORD B_TRUE 1 100 0 1 BIT_MASK 0xf00 FORMAT "%13.11" ECU_ADDRESS 0x7F9580 /end MEASUREMENT
/begin MEASUREMENT TYP_cana "" UWORD B_TRUE 1 100 0 1 BIT_MASK 0xf00 FORMAT "%13.11" ECU_ADDRESS 0x7F9584 /end MEASUREMENT
/begin MEASUREMENT TYP_cas "" UWORD B_TRUE 1 100 0 1 BIT_MASK 0xf00 FORMAT "%13.11" ECU_ADDRESS 0x7F9588 /end MEASUREMENT
/begin MEASUREMENT TYP_ckombi "" UWORD B_TRUE 1 100 0 1 BIT_MASK 0xf00 FORMAT "%13.11" ECU_ADDRESS 0x7F958C /end MEASUREMENT
/begin MEASUREMENT TYP_czfe "" UWORD B_TRUE 1 100 0 1 BIT_MASK 0xf00 FORMAT "%13.11" ECU_ADDRESS 0x7F9590 /end MEASUREMENT
/begin MEASUREMENT TYP_dkp "" UWORD SFP_TYP 1 100 0 8 BIT_MASK 0xf00 FORMAT "%13.11" ECU_ADDRESS 0x7F9594 /end MEASUREMENT
/begin MEASUREMENT TYP_dkpa "" UWORD SFP_TYP 1 100 0 8 BIT_MASK 0xf00 FORMAT "%13.11" ECU_ADDRESS 0x7F9598 /end MEASUREMENT
/begin MEASUREMENT TYP_ekpe "Fehlertyp: EKPE" UWORD SFP_TYP 1 100 0 8 BIT_MASK 0xf00 FORMAT "%13.11" ECU_ADDRESS 0x7F95B0 /end MEASUREMENT
/begin MEASUREMENT TYP_ev1e "Fehlertyp: EV1E" UWORD SFP_TYP 1 100 0 8 BIT_MASK 0xf00 FORMAT "%13.11" ECU_ADDRESS 0x7F95B4 /end MEASUREMENT
/begin MEASUREMENT TYP_ev2e "Fehlertyp: EV2E" UWORD SFP_TYP 1 100 0 8 BIT_MASK 0xf00 FORMAT "%13.11" ECU_ADDRESS 0x7F95B8 /end MEASUREMENT
/begin MEASUREMENT TYP_ev3e "Fehlertyp: EV3E" UWORD SFP_TYP 1 100 0 8 BIT_MASK 0xf00 FORMAT "%13.11" ECU_ADDRESS 0x7F95BC /end MEASUREMENT
/begin MEASUREMENT TYP_ev4e "Fehlertyp: EV4E" UWORD SFP_TYP 1 100 0 8 BIT_MASK 0xf00 FORMAT "%13.11" ECU_ADDRESS 0x7F95C0 /end MEASUREMENT
/begin MEASUREMENT TYP_ews "" UWORD B_TRUE 1 100 0 1 BIT_MASK 0xf00 FORMAT "%13.11" ECU_ADDRESS 0x7F95C4 /end MEASUREMENT
/begin MEASUREMENT TYP_ewse "Fehlertyp: EWSE" UWORD SFP_TYP 1 100 0 8 BIT_MASK 0xf00 FORMAT "%13.11" ECU_ADDRESS 0x7F95C8 /end MEASUREMENT
/begin MEASUREMENT TYP_kat "Fehlertyp: Katalysator-Diagnose" UWORD B_TRUE 1 100 0 1 BIT_MASK 0xf00 FORMAT "%13.11" ECU_ADDRESS 0x7F95FC /end MEASUREMENT
/begin MEASUREMENT TYP_kill "" UWORD SFP_TYP 1 100 0 8 BIT_MASK 0xf00 FORMAT "%13.11" ECU_ADDRESS 0x7F9608 /end MEASUREMENT
/begin MEASUREMENT TYP_kl15 "" UWORD SFP_TYP 1 100 0 8 BIT_MASK 0xf00 FORMAT "%13.11" ECU_ADDRESS 0x7F960C /end MEASUREMENT
/begin MEASUREMENT TYP_krnt "" UWORD B_TRUE 1 100 0 1 BIT_MASK 0xf00 FORMAT "%13.11" ECU_ADDRESS 0x7F9610 /end MEASUREMENT
/begin MEASUREMENT TYP_krof "" UWORD B_TRUE 1 100 0 1 BIT_MASK 0xf00 FORMAT "%13.11" ECU_ADDRESS 0x7F9614 /end MEASUREMENT
/begin MEASUREMENT TYP_krtp "" UWORD B_TRUE 1 100 0 1 BIT_MASK 0xf00 FORMAT "%13.11" ECU_ADDRESS 0x7F9618 /end MEASUREMENT
/begin MEASUREMENT TYP_ks "" UWORD B_TRUE 1 100 0 1 BIT_MASK 0xf00 FORMAT "%13.11" ECU_ADDRESS 0x7F961C /end MEASUREMENT
/begin MEASUREMENT TYP_ks1 "" UWORD B_TRUE 1 100 0 1 BIT_MASK 0xf00 FORMAT "%13.11" ECU_ADDRESS 0x7F9620 /end MEASUREMENT
/begin MEASUREMENT TYP_ks2 "" UWORD B_TRUE 1 100 0 1 BIT_MASK 0xf00 FORMAT "%13.11" ECU_ADDRESS 0x7F9624 /end MEASUREMENT
/begin MEASUREMENT TYP_n "" UWORD B_TRUE 1 100 0 1 BIT_MASK 0xf00 FORMAT "%13.11" ECU_ADDRESS 0x7F9654 /end MEASUREMENT
/begin MEASUREMENT udkp1_u "Spannung Drosselklappen-Poti 1 (Byte)" UBYTE spg_ub_b5 1 100 0 4.98047 FORMAT "%5.3" ECU_ADDRESS 0x7FD8BD /end MEASUREMENT
/begin MEASUREMENT udkpa_u "" UBYTE spg_ub_b5 1 100 0 4.98047 FORMAT "%5.3" ECU_ADDRESS 0x7FD8BE /end MEASUREMENT
/begin MEASUREMENT uulsuv2_u "Sondenspannung vor Kat einer Breitbandlambdasonde Bank2 (ADC-Wert) (Byte)" UBYTE spg_ub_b5 1 100 0 4.98047 FORMAT "%5.3" ECU_ADDRESS 0x7FD8BF /end MEASUREMENT
/begin MEASUREMENT uulsuv_u "Sondenspannung vor Kat einer Breitbandlambdasonde (ADC-Wert) (Byte)" UBYTE spg_ub_b5 1 100 0 4.98047 FORMAT "%5.3" ECU_ADDRESS 0x7FD8C0 /end MEASUREMENT
/begin MEASUREMENT uusvk2_u "ADC-Spannung Lambdasonde vor Katalysator 2 (Byte)" UBYTE spg_ub_b5 1 100 0 4.98047 FORMAT "%5.3" ECU_ADDRESS 0x7FD8C1 /end MEASUREMENT
/begin MEASUREMENT uusvk_u "ADC-Spannung Lambdasonde vor Katalysator (Byte)" UBYTE spg_ub_b5 1 100 0 4.98047 FORMAT "%5.3" ECU_ADDRESS 0x7FD8C2 /end MEASUREMENT
/begin MEASUREMENT vfzggang_u "" UBYTE vfzg_q1p0 1 100 0 255 FORMAT "%5.1" ECU_ADDRESS 0x7FD8C3 /end MEASUREMENT
/begin MEASUREMENT vfzgv1_w "" UWORD vfzg_uw_b512 1 100 0 511.992 FORMAT "%8.4" ECU_ADDRESS 0x7FDB54 /end MEASUREMENT
/begin MEASUREMENT vfzg_u "Fahrzeuggeschwindigkeit, mit def. Quantisierung f¸r Tester" UBYTE vfzg_q1p0 1 100 0 255 FORMAT "%5.1" ECU_ADDRESS 0x7FD8C4 /end MEASUREMENT
/begin MEASUREMENT vregdia_w "Volumenstrom Tankentl¸ftungsventil: Wert f¸r Diagnose Tankdichtheit" UWORD vs_uw_b25p6 1 100 0 25.5996 FORMAT "%8.5" ECU_ADDRESS 0x7FE058 /end MEASUREMENT
/begin MEASUREMENT vtevo "" UBYTE rel_ub_b99p6 1 100 0 99.6094 FORMAT "%5.2" ECU_ADDRESS 0x7FDAD4 /end MEASUREMENT
/begin MEASUREMENT vwkw "KW-Winkelgeschwindigkeit" UBYTE rel_ub_q0p1875 1 100 0 47.8125 FORMAT "%5.2" ECU_ADDRESS 0x7FD91D /end MEASUREMENT
/begin MEASUREMENT v_hrad "Geschwindigkeitssignal am Hinterrad aus ABS-SG ueber CAN" UWORD vfzg_uw_q0p0625 1 100 0 4095.94 FORMAT "%8.3" ECU_ADDRESS 0x7FDB58 /end MEASUREMENT
/begin MEASUREMENT v_vrad "Geschwindigkeitssignal am Vorderrad aus ABS-SG ueber CAN" UWORD vfzg_uw_q0p0625 1 100 0 4095.94 FORMAT "%8.3" ECU_ADDRESS 0x7FDB5A /end MEASUREMENT
/begin MEASUREMENT wdkbapb_w "" UWORD rel_uw_b100 1 100 0 99.9985 FORMAT "%8.5" ECU_ADDRESS 0x7FDC8C /end MEASUREMENT
/begin MEASUREMENT wdkbastp "" UBYTE relDK_ub_b100 1 100 0 100 FORMAT "%5.1" ECU_ADDRESS 0x7FD9CA /end MEASUREMENT
/begin MEASUREMENT wnwue_w "Winkel Nockenwellenueberschneidung" UWORD kw_q1_o128 1 100 -128 65407 FORMAT "%8.2" ECU_ADDRESS 0x7FD578 /end MEASUREMENT
/begin MEASUREMENT wpr "" UBYTE zw_ub_q6 1 100 0 1530 FORMAT "%5.0" ECU_ADDRESS 0x7FD91E /end MEASUREMENT
/begin MEASUREMENT wprnsp "" UBYTE zw_ub_q6 1 100 0 1530 FORMAT "%5.0" ECU_ADDRESS 0x7FD91F /end MEASUREMENT
/begin MEASUREMENT xqtm_w "Temperaturquotient" UWORD fak_uw_b16 1 100 0 15.9998 FORMAT "%8.5" ECU_ADDRESS 0x7FD5A2 /end MEASUREMENT
/begin MEASUREMENT zwout_u "" UBYTE zw_sb_q0p75 1 100 0 191.25 FORMAT "%5.1" ECU_ADDRESS 0x7FD8C5 /end MEASUREMENT
/begin MEASUREMENT Z_akle "" UWORD B_TRUE 1 100 0 1 BIT_MASK 0x2 FORMAT "%13.11" ECU_ADDRESS 0x7F9570 /end MEASUREMENT
/begin MEASUREMENT Z_as "" UWORD B_TRUE 1 100 0 1 BIT_MASK 0x2 FORMAT "%13.11" ECU_ADDRESS 0x7F9574 /end MEASUREMENT
/begin MEASUREMENT Z_bm "Zyklusflag: Bezugsmarkengeber" UWORD B_TRUE 1 100 0 1 BIT_MASK 0x2 FORMAT "%13.11" ECU_ADDRESS 0x7F9578 /end MEASUREMENT
/begin MEASUREMENT Z_CABS "Zyklusflag: CAN-Schnittstelle, Timeout ABS" UWORD B_TRUE 1 100 0 1 BIT_MASK 0x2 FORMAT "%13.11" ECU_ADDRESS 0x7F9580 /end MEASUREMENT
/begin MEASUREMENT Z_cana "Zyklusflag: CAN-Schnittstelle ""CAN_A""" UWORD B_TRUE 1 100 0 1 BIT_MASK 0x2 FORMAT "%13.11" ECU_ADDRESS 0x7F9584 /end MEASUREMENT
/begin MEASUREMENT Z_CAS "" UWORD B_TRUE 1 100 0 1 BIT_MASK 0x2 FORMAT "%13.11" ECU_ADDRESS 0x7F9588 /end MEASUREMENT
/begin MEASUREMENT Z_CKOMBI "Zyklusflag: CAN-Schnittstelle, Timeout KOMBI" UWORD B_TRUE 1 100 0 1 BIT_MASK 0x2 FORMAT "%13.11" ECU_ADDRESS 0x7F958C /end MEASUREMENT
/begin MEASUREMENT Z_CZFE "Zyklusflag: CAN-Schnittstelle, Timeout ZFE" UWORD B_TRUE 1 100 0 1 BIT_MASK 0x2 FORMAT "%13.11" ECU_ADDRESS 0x7F9590 /end MEASUREMENT
/begin MEASUREMENT Z_dkp "" UWORD B_TRUE 1 100 0 1 BIT_MASK 0x2 FORMAT "%13.11" ECU_ADDRESS 0x7F9594 /end MEASUREMENT
/begin MEASUREMENT Z_dkpa "Zyklusflag: DKPA" UWORD B_TRUE 1 100 0 1 BIT_MASK 0x2 FORMAT "%13.11" ECU_ADDRESS 0x7F9598 /end MEASUREMENT
/begin MEASUREMENT Z_ekpe "Zyklusflag: EKPE" UWORD B_TRUE 1 100 0 1 BIT_MASK 0x2 FORMAT "%13.11" ECU_ADDRESS 0x7F95B0 /end MEASUREMENT
/begin MEASUREMENT Z_ev1e "Zyklusflag: EV1E" UWORD B_TRUE 1 100 0 1 BIT_MASK 0x2 FORMAT "%13.11" ECU_ADDRESS 0x7F95B4 /end MEASUREMENT
/begin MEASUREMENT Z_ev2e "Zyklusflag: EV2E" UWORD B_TRUE 1 100 0 1 BIT_MASK 0x2 FORMAT "%13.11" ECU_ADDRESS 0x7F95B8 /end MEASUREMENT
/begin MEASUREMENT Z_ev3e "Zyklusflag: EV3E" UWORD B_TRUE 1 100 0 1 BIT_MASK 0x2 FORMAT "%13.11" ECU_ADDRESS 0x7F95BC /end MEASUREMENT
/begin MEASUREMENT Z_ev4e "Zyklusflag: EV4E" UWORD B_TRUE 1 100 0 1 BIT_MASK 0x2 FORMAT "%13.11" ECU_ADDRESS 0x7F95C0 /end MEASUREMENT
/begin MEASUREMENT Z_ews "" UWORD B_TRUE 1 100 0 1 BIT_MASK 0x2 FORMAT "%13.11" ECU_ADDRESS 0x7F95C4 /end MEASUREMENT
/begin MEASUREMENT Z_ewse "Zyklusflag: EWSE" UWORD B_TRUE 1 100 0 1 BIT_MASK 0x2 FORMAT "%13.11" ECU_ADDRESS 0x7F95C8 /end MEASUREMENT
/begin MEASUREMENT Z_kat "Zyklusflag:	Katalysator-Konvertierung" UWORD B_TRUE 1 100 0 1 BIT_MASK 0x2 FORMAT "%13.11" ECU_ADDRESS 0x7F95FC /end MEASUREMENT
/begin MEASUREMENT Z_kill "Zyklusflag: Diagnose Killschalter" UWORD B_TRUE 1 100 0 1 BIT_MASK 0x2 FORMAT "%13.11" ECU_ADDRESS 0x7F9608 /end MEASUREMENT
/begin MEASUREMENT Z_kl15 "Zyklusflag: Diagnose Klemme 15 Schalter" UWORD B_TRUE 1 100 0 1 BIT_MASK 0x2 FORMAT "%13.11" ECU_ADDRESS 0x7F960C /end MEASUREMENT
/begin MEASUREMENT Z_krnt "Zyklusflag: Klopfregelung Nulltest" UWORD B_TRUE 1 100 0 1 BIT_MASK 0x2 FORMAT "%13.11" ECU_ADDRESS 0x7F9610 /end MEASUREMENT
/begin MEASUREMENT Z_krof "Zyklusflag: Klopfregelung Offset" UWORD B_TRUE 1 100 0 1 BIT_MASK 0x2 FORMAT "%13.11" ECU_ADDRESS 0x7F9614 /end MEASUREMENT
/begin MEASUREMENT Z_krtp "Zyklusflag: Klopfregelung Testimpuls" UWORD B_TRUE 1 100 0 1 BIT_MASK 0x2 FORMAT "%13.11" ECU_ADDRESS 0x7F9618 /end MEASUREMENT
/begin MEASUREMENT Z_ks "" UWORD B_TRUE 1 100 0 1 BIT_MASK 0x2 FORMAT "%13.11" ECU_ADDRESS 0x7F961C /end MEASUREMENT
/begin MEASUREMENT Z_ks1 "Zyklusflag: Klopfsensor 1" UWORD B_TRUE 1 100 0 1 BIT_MASK 0x2 FORMAT "%13.11" ECU_ADDRESS 0x7F9620 /end MEASUREMENT
/begin MEASUREMENT Z_ks2 "Zyklusflag:	Klopfsensor 2" UWORD B_TRUE 1 100 0 1 BIT_MASK 0x2 FORMAT "%13.11" ECU_ADDRESS 0x7F9624 /end MEASUREMENT
/begin MEASUREMENT Z_n "Zyklusflag: Drehzahlsignalgeber" UWORD B_TRUE 1 100 0 1 BIT_MASK 0x2 FORMAT "%13.11" ECU_ADDRESS 0x7F9654 /end MEASUREMENT
/begin FUNCTION bgnmot "bgnmot.   Berechnete Grˆﬂe Drehzahl" /begin DEF_CHARACTERISTIC /end DEF_CHARACTERISTIC /begin REF_CHARACTERISTIC /end REF_CHARACTERISTIC /begin IN_MEASUREMENT B_nmin nmot_w /end IN_MEASUREMENT /begin OUT_MEASUREMENT nmot nmotll nmotllfil nmotseg /end OUT_MEASUREMENT /begin LOC_MEASUREMENT /end LOC_MEASUREMENT /begin SUB_FUNCTION /end SUB_FUNCTION /end FUNCTION
/begin FUNCTION BGODS "BGODS.    Berechnete Grˆﬂe ÷ldruckschalter" /begin DEF_CHARACTERISTIC NMOTOEL1 NMOTOEL2 TVPOELAN1 TVPOELAN2 /end DEF_CHARACTERISTIC /begin REF_CHARACTERISTIC /end REF_CHARACTERISTIC /begin IN_MEASUREMENT ES_poel nmot_w /end IN_MEASUREMENT /begin OUT_MEASUREMENT B_oeldran /end OUT_MEASUREMENT /begin LOC_MEASUREMENT /end LOC_MEASUREMENT /begin SUB_FUNCTION /end SUB_FUNCTION /end FUNCTION
/begin FUNCTION BGRBS "Berechnete Grˆﬂe Radbeschleunigung aus Raddrehzahl" /begin DEF_CHARACTERISTIC VASRM /end DEF_CHARACTERISTIC /begin REF_CHARACTERISTIC /end REF_CHARACTERISTIC /begin IN_MEASUREMENT B_cdswe vfzg v_hrad v_vrad /end IN_MEASUREMENT /begin OUT_MEASUREMENT bsc dv_lh dv_lv dv_rh dv_rv /end OUT_MEASUREMENT /begin LOC_MEASUREMENT /end LOC_MEASUREMENT /begin SUB_FUNCTION /end SUB_FUNCTION /end FUNCTION
/begin FUNCTION BGRGM "Restgasmodell" /begin DEF_CHARACTERISTIC /end DEF_CHARACTERISTIC /begin REF_CHARACTERISTIC /end REF_CHARACTERISTIC /begin IN_MEASUREMENT dps_w nmot /end IN_MEASUREMENT /begin OUT_MEASUREMENT /end OUT_MEASUREMENT /begin LOC_MEASUREMENT /end LOC_MEASUREMENT /begin SUB_FUNCTION /end SUB_FUNCTION /end FUNCTION
/begin FUNCTION BGRLG "Berechnete Grˆﬂe RL-GRADIENT" /begin DEF_CHARACTERISTIC /end DEF_CHARACTERISTIC /begin REF_CHARACTERISTIC /end REF_CHARACTERISTIC /begin IN_MEASUREMENT B_ngasok irspsyn rl_w tsegrsp_l /end IN_MEASUREMENT /begin OUT_MEASUREMENT drlas_w rlgas_w /end OUT_MEASUREMENT /begin LOC_MEASUREMENT rlrsp_w tas_w /end LOC_MEASUREMENT /begin SUB_FUNCTION /end SUB_FUNCTION /end FUNCTION
/begin FUNCTION BGRLP "" /begin DEF_CHARACTERISTIC CBGRLP DRLDYNU DTEPRU TNSURLP /end DEF_CHARACTERISTIC /begin REF_CHARACTERISTIC KFMSNWDK KLAF PSPVDKUGN /end REF_CHARACTERISTIC
 /begin IN_MEASUREMENT B_ll B_nswo2 B_st B_stend dpsfg_w drl_w frhodk_w fupsrl_w fvisrm_w klaf_kge msndko_w mste nmot nmot_w pirg_w psmx_w ps_w pvdk_w rfagr_w rfges_w rldvs_w rl_w te_w tvu_w umsrln_w wdkbap_w wdkugd_w wea wee wes /end IN_MEASUREMENT
 /begin OUT_MEASUREMENT B_nsp B_tired drlp_w fwprs_w rlp rlp_w /end OUT_MEASUREMENT
 /begin LOC_MEASUREMENT B_rlp B_rlpns dpsdvs_w dpsmp_w msndkpk_w psmppvdk_w psmp_w psp_w rlmp_w rlrohmp_w vwkw wdkbapb_w wpr wprnsp /end LOC_MEASUREMENT
 /begin SUB_FUNCTION /end SUB_FUNCTION
/end FUNCTION
/begin FUNCTION BGRML "Berechnungsgrˆﬂe relative Luftmasse nach SAE J1979 Mode $01 + $02 PID $04" /begin DEF_CHARACTERISTIC MLMAX /end DEF_CHARACTERISTIC /begin REF_CHARACTERISTIC /end REF_CHARACTERISTIC /begin IN_MEASUREMENT fpvdk_w ml_w /end IN_MEASUREMENT /begin OUT_MEASUREMENT rml /end OUT_MEASUREMENT /begin LOC_MEASUREMENT /end LOC_MEASUREMENT /begin SUB_FUNCTION /end SUB_FUNCTION /end FUNCTION
/begin FUNCTION BGSRM "F¸llungserfassung Saugrohrmodell"
 /begin DEF_CHARACTERISTIC CWRLBGSRM CW_RLCAL FPVMXN FPVMXN2 KFPRGF KFPRGF1 KFPRGR KFPRGR1 KFURLF KFURLF1 KFURLR KFURLR1 KISRM KISRMSU ZVTPRGSU /end DEF_CHARACTERISTIC
 /begin REF_CHARACTERISTIC /end REF_CHARACTERISTIC
 /begin IN_MEASUREMENT B_hfm B_psger dps_w fho_w ftbr_w ftsr nmot_w psagr_w pu_w pvdkds_w rlroh_w sumode umsrln_w Vse_spri wnwue /end IN_MEASUREMENT
 /begin OUT_MEASUREMENT agrr agrr_w dpsfg_w drl_w fupsrlf_w fupsrlr_w fupsrl_w fvisrm_w iegr_w ml ml_w pirgf_w pirgr_w pirg_w psfg_w psmx_w ps_w rfagr_w rfges_w rl rltmp_w rl_w /end OUT_MEASUREMENT
 /begin LOC_MEASUREMENT pirgro_w psrlro_w wnwue_w /end LOC_MEASUREMENT
 /begin SUB_FUNCTION /end SUB_FUNCTION
/end FUNCTION
/begin FUNCTION BGSTDSLS "Berechnete Grˆﬂe; Status Diagnose Sekund‰rluftsystem bei Systemtest" /begin DEF_CHARACTERISTIC /end DEF_CHARACTERISTIC /begin REF_CHARACTERISTIC /end REF_CHARACTERISTIC /begin IN_MEASUREMENT B_dslfa B_dsls B_fasla B_fasls B_szsls /end IN_MEASUREMENT /begin OUT_MEASUREMENT slsstat /end OUT_MEASUREMENT /begin LOC_MEASUREMENT /end LOC_MEASUREMENT /begin SUB_FUNCTION /end SUB_FUNCTION /end FUNCTION
/begin FUNCTION BGTABST "Berechnete Grˆﬂe Abstellzeit"
 /begin DEF_CHARACTERISTIC DTABUNPL DTUMTA IMTUMTA LNXQTM NTUMTA TNLSGM TPLUHRC TPLUHRR TUMTAI VTUMTA ZKTABTU /end DEF_CHARACTERISTIC
 /begin REF_CHARACTERISTIC /end REF_CHARACTERISTIC
 /begin IN_MEASUREMENT B_abkombi B_abstnl B_adpini B_nlwst B_nmin B_pwf B_stend B_uhrrmin B_uhrrsec B_vbemg imlatm nmot swOffDlBits tans tmotab tmst tnst_w trsec vfzg /end IN_MEASUREMENT
 /begin OUT_MEASUREMENT tabstm_w tabst_w /end OUT_MEASUREMENT
 /begin LOC_MEASUREMENT BgtabstNvBits B_pltab B_tabunpl B_uhrrnpl tabsmn_w tabsnl_w tabssc_w trsec_abst tumta tum_ein xqtm_w /end LOC_MEASUREMENT
 /begin SUB_FUNCTION /end SUB_FUNCTION
/end FUNCTION
/begin FUNCTION BGTEMPK "F¸llungserfassung Berechnung Temperaturkompensation"
 /begin DEF_CHARACTERISTIC CWTEMPK DEVTMAGR EVTMODO FDVANS FWFTBRTA KFFWTBR ZBRT ZTDAGR ZTMMBR /end DEF_CHARACTERISTIC
 /begin REF_CHARACTERISTIC /end REF_CHARACTERISTIC
 /begin IN_MEASUREMENT nmot rl tans tmotzyl_w /end IN_MEASUREMENT
 /begin OUT_MEASUREMENT evtmod ftbr ftbr_w ftsr ftu ftvdk ftw /end OUT_MEASUREMENT
 /begin LOC_MEASUREMENT tempin tmotfil tsges_w /end LOC_MEASUREMENT
 /begin SUB_FUNCTION /end SUB_FUNCTION
/end FUNCTION
/begin FUNCTION BGTEV "Berechnungsgrˆﬂe Massenstrom TEV" /begin DEF_CHARACTERISTIC FMTEVEIN FUMRMV KFINDFMS KFMSTEMX KLTATEMX /end DEF_CHARACTERISTIC /begin REF_CHARACTERISTIC CWTEVPOS /end REF_CHARACTERISTIC
 /begin IN_MEASUREMENT B_dteaa dpssol_w dpus_w fho ftvdk ml_w nmot_w rl rl_w tateroh tevper ttevein /end IN_MEASUREMENT
 /begin OUT_MEASUREMENT dps_uw ftvdkho_w msntevo_w mste mstedte mstedte_w msteo_w mste_w tatemax tefreq vregdia_w vtevo /end OUT_MEASUREMENT
 /begin LOC_MEASUREMENT fmtate_w fmtev_w mstedp_w /end LOC_MEASUREMENT
 /begin SUB_FUNCTION /end SUB_FUNCTION
/end FUNCTION
/begin FUNCTION BKL15RESET "" /begin DEF_CHARACTERISTIC /end DEF_CHARACTERISTIC /begin REF_CHARACTERISTIC /end REF_CHARACTERISTIC /begin IN_MEASUREMENT S_kl15 /end IN_MEASUREMENT /begin OUT_MEASUREMENT /end OUT_MEASUREMENT /begin LOC_MEASUREMENT /end LOC_MEASUREMENT /begin SUB_FUNCTION /end SUB_FUNCTION /end FUNCTION
/begin FUNCTION BYPTOSTP ""
 /begin DEF_CHARACTERISTIC AKU_E_DEC AKU_POS_G2 AKU_POS_G3 AKU_POS_G4 BYPENDPOS BYPHIHYST BYPLOHYST BYPMAXRES BYPMINRES CWBYPSTP CW_AKU CW_VMX DKSTPGRD DKSTPOF KLVXDSPOS STEPS_AKU STPSPEEDS STP_INI STP_REF STP_VX_INC ST_DKW_MIN ST_REF_SPD ST_SPD_A_N ST_SPD_A_R ST_SPD_V_N1 ST_SPD_V_N2 TARGETBYPFIL TDVMAXH TDVMAXS VX_ACT_THR VX_DVFZST VX_THR_NX VX_THR_NXL VX_THR_NXN /end DEF_CHARACTERISTIC
 /begin REF_CHARACTERISTIC KW_UbStpMin STP_MAX_POSITION STP_MAX_SPEED /end REF_CHARACTERISTIC
 /begin IN_MEASUREMENT bypsolary bypsol_w B_adpini B_bt B_btstpabg B_btstpll1 B_btstpll2 B_kl15 B_tempomat gangi nmot_w st_cmd_pos st_cmd_spd st_cmd_typ st_cur_pos st_cur_spd st_err_sta st_move_a st_noise st_ref_a swOffDlBits tans t_btstpll1 t_btstpll2 uusys vfzg vfzg_w /end IN_MEASUREMENT
 /begin OUT_MEASUREMENT bypist_a bypist_w_a B_bypres_a B_limiter_aktiv B_nlbyp B_pwfref_a B_reffin_a B_refpwf_a B_stag_dkp B_vmx_lim_nm B_vmx_nm cmd_stp_ref debug_uw d_vfzg_vmx Klvxdspos_aus wdkbastp /end OUT_MEASUREMENT
 /begin LOC_MEASUREMENT bypdiff_w_temp bypdif_w_a bypinp_w_a bypstp_w_a B_brefab_a B_bypav B_bypresck B_dkpstp_init B_refakt_a B_refon_a B_rffail_a B_stmove_a B_vmax_was_active curbyp_w_a curspd_w_a curstp_w_a desspd_w_a resspd_w_a tbypfil_w tgtbyp_w_a trigger /end LOC_MEASUREMENT
 /begin SUB_FUNCTION /end SUB_FUNCTION
/end FUNCTION
/begin FUNCTION CANABS "" /begin DEF_CHARACTERISTIC /end DEF_CHARACTERISTIC /begin REF_CHARACTERISTIC /end REF_CHARACTERISTIC /begin IN_MEASUREMENT /end IN_MEASUREMENT
 /begin OUT_MEASUREMENT B_abs B_abs1cok B_abs1new B_abs2cok B_abs2new v_hrad v_vrad /end OUT_MEASUREMENT
 /begin LOC_MEASUREMENT /end LOC_MEASUREMENT
 /begin SUB_FUNCTION /end SUB_FUNCTION
/end FUNCTION
/begin FUNCTION CANASR "CAN-Botschafts- und Signaldefinition Antriebsschlupfregelung" /begin DEF_CHARACTERISTIC ASC_SOFT_AN DMAUFASC /end DEF_CHARACTERISTIC /begin REF_CHARACTERISTIC /end REF_CHARACTERISTIC
 /begin IN_MEASUREMENT ascModus B_ascFreig B_clvar B_msr B_pwf mdindlm_w reltrq_fin /end IN_MEASUREMENT
 /begin OUT_MEASUREMENT asc_alive B_asc1cok B_asc1new B_ascpkw B_asc_reg B_asrext B_asrextmem B_evfzgv1 B_msrext miasrl miasrl_w miasrs miasrs_w mimsr vfzgv1_w /end OUT_MEASUREMENT
 /begin LOC_MEASUREMENT asccod /end LOC_MEASUREMENT
 /begin SUB_FUNCTION /end SUB_FUNCTION
/end FUNCTION
/begin FUNCTION CANDME "DME CAN-Botschafts- und Signaldefinitionen" /begin DEF_CHARACTERISTIC MDNORM /end DEF_CHARACTERISTIC /begin REF_CHARACTERISTIC CW_asg /end REF_CHARACTERISTIC
 /begin IN_MEASUREMENT A_anlasser B_ekpbts B_los B_mil B_sysbts B_uetmc B_zdgbts ES_kill ES_kupp ES_poel EWS_status gangcan kvaverbr nmot_w synchroCtr tmot wdkba /end IN_MEASUREMENT
 /begin OUT_MEASUREMENT B_gangwe /end OUT_MEASUREMENT
 /begin LOC_MEASUREMENT /end LOC_MEASUREMENT
 /begin SUB_FUNCTION /end SUB_FUNCTION
/end FUNCTION
/begin FUNCTION CANDME2 "" /begin DEF_CHARACTERISTIC /end DEF_CHARACTERISTIC /begin REF_CHARACTERISTIC MDNORM /end REF_CHARACTERISTIC
 /begin IN_MEASUREMENT B_ascdme B_kl15 B_koe B_sa etazaist mdindlm_w mdverl_w miist_w mivbeg_w nmot_w synchroCtr S_eza zwout zwspae /end IN_MEASUREMENT
 /begin OUT_MEASUREMENT B_oldmiistc miistc Stat_md_e /end OUT_MEASUREMENT
 /begin LOC_MEASUREMENT /end LOC_MEASUREMENT
 /begin SUB_FUNCTION /end SUB_FUNCTION
/end FUNCTION
/begin FUNCTION CANEGS "CAN-Botschafts- und Signaldefinition Getriebesteuerung" /begin DEF_CHARACTERISTIC /end DEF_CHARACTERISTIC /begin REF_CHARACTERISTIC /end REF_CHARACTERISTIC /begin IN_MEASUREMENT B_clvar B_pwf /end IN_MEASUREMENT
 /begin OUT_MEASUREMENT B_autget B_egscok B_egsnew B_fs B_got B_gts B_pn B_wk B_wkr gangauti mdwancan migs_w obdstegs /end OUT_MEASUREMENT
 /begin LOC_MEASUREMENT egscod /end LOC_MEASUREMENT
 /begin SUB_FUNCTION /end SUB_FUNCTION
/end FUNCTION
/begin FUNCTION CANKOMBI "" /begin DEF_CHARACTERISTIC /end DEF_CHARACTERISTIC /begin REF_CHARACTERISTIC /end REF_CHARACTERISTIC /begin IN_MEASUREMENT /end IN_MEASUREMENT /begin OUT_MEASUREMENT B_kombi1cok B_kombi1new kmstand trsec /end OUT_MEASUREMENT /begin LOC_MEASUREMENT /end LOC_MEASUREMENT /begin SUB_FUNCTION /end SUB_FUNCTION /end FUNCTION
/begin FUNCTION CANZFE "" /begin DEF_CHARACTERISTIC /end DEF_CHARACTERISTIC /begin REF_CHARACTERISTIC /end REF_CHARACTERISTIC /begin IN_MEASUREMENT /end IN_MEASUREMENT
 /begin OUT_MEASUREMENT B_brkfoot B_brkhand B_kl15_zfe B_nsubcan B_tempomat B_zfe1cok B_zfe1new B_zfe2cok B_zfe2new fuel_level /end OUT_MEASUREMENT
 /begin LOC_MEASUREMENT /end LOC_MEASUREMENT
 /begin SUB_FUNCTION /end SUB_FUNCTION
/end FUNCTION
/begin FUNCTION CAN_CONF "" /begin DEF_CHARACTERISTIC /end DEF_CHARACTERISTIC /begin REF_CHARACTERISTIC /end REF_CHARACTERISTIC /begin IN_MEASUREMENT /end IN_MEASUREMENT /begin OUT_MEASUREMENT /end OUT_MEASUREMENT /begin LOC_MEASUREMENT /end LOC_MEASUREMENT /begin SUB_FUNCTION /end SUB_FUNCTION /end FUNCTION
/begin FUNCTION CCP "‹bertragungsprotokoll f¸r Applikationstools" /begin DEF_CHARACTERISTIC CW_CCPAKTIV /end DEF_CHARACTERISTIC /begin REF_CHARACTERISTIC /end REF_CHARACTERISTIC /begin IN_MEASUREMENT /end IN_MEASUREMENT /begin OUT_MEASUREMENT /end OUT_MEASUREMENT /begin LOC_MEASUREMENT /end LOC_MEASUREMENT /begin SUB_FUNCTION /end SUB_FUNCTION /end FUNCTION
/begin FUNCTION CCP_CONF "" /begin DEF_CHARACTERISTIC /end DEF_CHARACTERISTIC /begin REF_CHARACTERISTIC /end REF_CHARACTERISTIC /begin IN_MEASUREMENT /end IN_MEASUREMENT /begin OUT_MEASUREMENT /end OUT_MEASUREMENT /begin LOC_MEASUREMENT /end LOC_MEASUREMENT /begin SUB_FUNCTION /end SUB_FUNCTION /end FUNCTION
/begin FUNCTION COSA "Software-Abgleich" /begin DEF_CHARACTERISTIC RKACOMN RKACOMX TLLCO TVCO /end DEF_CHARACTERISTIC /begin REF_CHARACTERISTIC N0 NRKAB /end REF_CHARACTERISTIC /begin IN_MEASUREMENT B_eepdif B_ll B_nokatfz nmot tmot /end IN_MEASUREMENT /begin OUT_MEASUREMENT B_cotrim co_pot co_pot_w rkaco_w /end OUT_MEASUREMENT /begin LOC_MEASUREMENT /end LOC_MEASUREMENT /begin SUB_FUNCTION /end SUB_FUNCTION /end FUNCTION
/begin FUNCTION CTRLSTPPR ""
 /begin DEF_CHARACTERISTIC CW_Dir_inv KW_UbStpMin REF_OFFSET STP_MAX_POSITION STP_MAX_SPEED STP_WIDE /end DEF_CHARACTERISTIC
 /begin REF_CHARACTERISTIC UBDE UBDMN2 /end REF_CHARACTERISTIC
 /begin IN_MEASUREMENT B_pwfref_a B_refpwf_a B_sysbts stp_diag_act tmot ub /end IN_MEASUREMENT
 /begin OUT_MEASUREMENT Async_cntr B_movbck_a B_movfor_a B_prell_a B_prell_spez_a debug_sw digit_step stp_ref_offset_lok stp_wide st_cmd_pos st_cmd_spd st_cmd_typ st_cur_pos st_cur_spd st_err_sta st_move_a st_pos_dif st_ref_a st_ti_half st_ti_ha_deb /end OUT_MEASUREMENT
 /begin LOC_MEASUREMENT /end LOC_MEASUREMENT
 /begin SUB_FUNCTION /end SUB_FUNCTION
/end FUNCTION
/begin FUNCTION CY315 "" /begin DEF_CHARACTERISTIC FILT_CY315 /end DEF_CHARACTERISTIC /begin REF_CHARACTERISTIC /end REF_CHARACTERISTIC /begin IN_MEASUREMENT /end IN_MEASUREMENT /begin OUT_MEASUREMENT /end OUT_MEASUREMENT /begin LOC_MEASUREMENT /end LOC_MEASUREMENT /begin SUB_FUNCTION /end SUB_FUNCTION /end FUNCTION
/begin FUNCTION DAKLE "" /begin DEF_CHARACTERISTIC AKLEFA CWPSAKLE /end DEF_CHARACTERISTIC /begin REF_CHARACTERISTIC /end REF_CHARACTERISTIC /begin IN_MEASUREMENT B_uusys nmot /end IN_MEASUREMENT /begin OUT_MEASUREMENT B_eakle /end OUT_MEASUREMENT /begin LOC_MEASUREMENT /end LOC_MEASUREMENT /begin SUB_FUNCTION /end SUB_FUNCTION /end FUNCTION
/begin FUNCTION DASC "Diagnose ASC-Signale" /begin DEF_CHARACTERISTIC CWDASC MIMSRMXN TASCNP TASCNP2 /end DEF_CHARACTERISTIC /begin REF_CHARACTERISTIC BZ_MSR_M /end REF_CHARACTERISTIC
 /begin IN_MEASUREMENT asc_alive B_asrext B_msrext B_nomsr_um miasrl miasrs mimsr nmot_w /end IN_MEASUREMENT
 /begin OUT_MEASUREMENT B_ascdme B_ascsipl mimsr_w /end OUT_MEASUREMENT
 /begin LOC_MEASUREMENT /end LOC_MEASUREMENT
 /begin SUB_FUNCTION /end SUB_FUNCTION
/end FUNCTION
/begin FUNCTION DCABS "" /begin DEF_CHARACTERISTIC TDCABS TDHCABS /end DEF_CHARACTERISTIC /begin REF_CHARACTERISTIC UBDCAN /end REF_CHARACTERISTIC /begin IN_MEASUREMENT B_abs B_abs1new B_abs2new B_nmot ub /end IN_MEASUREMENT /begin OUT_MEASUREMENT /end OUT_MEASUREMENT /begin LOC_MEASUREMENT /end LOC_MEASUREMENT /begin SUB_FUNCTION /end SUB_FUNCTION /end FUNCTION
/begin FUNCTION DCANA "Diagnose CAN A (Fahrzeug-CAN)" /begin DEF_CHARACTERISTIC TDCANA1 TDCANA3 TDCANAH /end DEF_CHARACTERISTIC /begin REF_CHARACTERISTIC /end REF_CHARACTERISTIC /begin IN_MEASUREMENT B_fgdcan /end IN_MEASUREMENT /begin OUT_MEASUREMENT B_edprcana canastat canastati /end OUT_MEASUREMENT /begin LOC_MEASUREMENT /end LOC_MEASUREMENT /begin SUB_FUNCTION /end SUB_FUNCTION /end FUNCTION
/begin FUNCTION DCAS "Diagnose; CAN-Timeout ASC-Schnittstelle" /begin DEF_CHARACTERISTIC TDCAS /end DEF_CHARACTERISTIC /begin REF_CHARACTERISTIC UBDCAN /end REF_CHARACTERISTIC /begin IN_MEASUREMENT B_asc1new B_ascpkw B_nmot ub /end IN_MEASUREMENT /begin OUT_MEASUREMENT tdcas_ctr1 tdcas_ctr2 /end OUT_MEASUREMENT /begin LOC_MEASUREMENT /end LOC_MEASUREMENT /begin SUB_FUNCTION /end SUB_FUNCTION /end FUNCTION
/begin FUNCTION DCDACC "Diagnose; Zugriff auf Testerdaten" /begin DEF_CHARACTERISTIC /end DEF_CHARACTERISTIC /begin REF_CHARACTERISTIC /end REF_CHARACTERISTIC /begin IN_MEASUREMENT /end IN_MEASUREMENT /begin OUT_MEASUREMENT /end OUT_MEASUREMENT /begin LOC_MEASUREMENT /end LOC_MEASUREMENT /begin SUB_FUNCTION /end SUB_FUNCTION /end FUNCTION
/begin FUNCTION DCJ945 "" /begin DEF_CHARACTERISTIC CWTCJ945 /end DEF_CHARACTERISTIC /begin REF_CHARACTERISTIC /end REF_CHARACTERISTIC /begin IN_MEASUREMENT /end IN_MEASUREMENT /begin OUT_MEASUREMENT B_ecj945 B_ecj945_mux B_ecj945_temp /end OUT_MEASUREMENT /begin LOC_MEASUREMENT /end LOC_MEASUREMENT /begin SUB_FUNCTION /end SUB_FUNCTION /end FUNCTION
/begin FUNCTION DCKOMBI "" /begin DEF_CHARACTERISTIC TDCKOMBI TDHCKOMBI /end DEF_CHARACTERISTIC /begin REF_CHARACTERISTIC UBDCAN /end REF_CHARACTERISTIC /begin IN_MEASUREMENT B_kombi1new B_nmot ub /end IN_MEASUREMENT /begin OUT_MEASUREMENT /end OUT_MEASUREMENT /begin LOC_MEASUREMENT /end LOC_MEASUREMENT /begin SUB_FUNCTION /end SUB_FUNCTION /end FUNCTION
/begin FUNCTION DCLA "OBDII; Klassentabelle"
 /begin DEF_CHARACTERISTIC CL30LINE CL31LINE CL32LINE CL33LINE CL34LINE CL35LINE CL36LINE CL37LINE CL38LINE CL39LINE /end DEF_CHARACTERISTIC
 /begin REF_CHARACTERISTIC /end REF_CHARACTERISTIC
 /begin IN_MEASUREMENT /end IN_MEASUREMENT
 /begin OUT_MEASUREMENT /end OUT_MEASUREMENT
 /begin LOC_MEASUREMENT /end LOC_MEASUREMENT
 /begin SUB_FUNCTION /end SUB_FUNCTION
/end FUNCTION
/begin FUNCTION DCY315 "" /begin DEF_CHARACTERISTIC CWTCY315 CWU5VG /end DEF_CHARACTERISTIC /begin REF_CHARACTERISTIC /end REF_CHARACTERISTIC /begin IN_MEASUREMENT /end IN_MEASUREMENT
 /begin OUT_MEASUREMENT B_ecy315 B_ecy315_main_relay B_ecy315_supply_1 B_ecy315_supply_2 B_ecy315_supply_3 B_ecy315_temp /end OUT_MEASUREMENT
 /begin LOC_MEASUREMENT /end LOC_MEASUREMENT
 /begin SUB_FUNCTION /end SUB_FUNCTION
/end FUNCTION
/begin FUNCTION DCZFE "" /begin DEF_CHARACTERISTIC TDCZFE TDHCZFE /end DEF_CHARACTERISTIC /begin REF_CHARACTERISTIC UBDCAN /end REF_CHARACTERISTIC /begin IN_MEASUREMENT B_abs B_abs2new B_nmot B_zfe1new B_zfe2new ub /end IN_MEASUREMENT /begin OUT_MEASUREMENT /end OUT_MEASUREMENT /begin LOC_MEASUREMENT /end LOC_MEASUREMENT /begin SUB_FUNCTION /end SUB_FUNCTION /end FUNCTION
/begin FUNCTION DDCY "OBDII; Erf¸llung Bedingung 'driving cycle'" /begin DEF_CHARACTERISTIC TWBDCY /end DEF_CHARACTERISTIC /begin REF_CHARACTERISTIC /end REF_CHARACTERISTIC /begin IN_MEASUREMENT B_pwf B_stend /end IN_MEASUREMENT /begin OUT_MEASUREMENT bbdcy B_dcy dcycnt /end OUT_MEASUREMENT /begin LOC_MEASUREMENT /end LOC_MEASUREMENT /begin SUB_FUNCTION /end SUB_FUNCTION /end FUNCTION
/begin FUNCTION DDG "Diagnose Drehzahlgeber"
 /begin DEF_CHARACTERISTIC DTNWFL FSKRIT FSUKRIT LBMHYS LBMINIT LBMMX NKWKRIT PGFLWA TRUECKDREH UBDDG /end DEF_CHARACTERISTIC
 /begin REF_CHARACTERISTIC /end REF_CHARACTERISTIC
 /begin IN_MEASUREMENT A_anlasser B_nmin B_nmot B_rueckdre E_starte Kwerror Kwkriterr nmot Nwe1_irq ub /end IN_MEASUREMENT
 /begin OUT_MEASUREMENT B_nldg B_rsg_edge /end OUT_MEASUREMENT
 /begin LOC_MEASUREMENT B_kwcheck dtnwfl_ct2 Fszbm /end LOC_MEASUREMENT
 /begin SUB_FUNCTION /end SUB_FUNCTION
/end FUNCTION
/begin FUNCTION DEGFE "Diagnose der Eingangsgrˆﬂen F¸llungserfassung" /begin DEF_CHARACTERISTIC CWDEGFE TDEGFEMN TDEGFEMX TDEGFENO TDEGFEST /end DEF_CHARACTERISTIC /begin REF_CHARACTERISTIC /end REF_CHARACTERISTIC /begin IN_MEASUREMENT B_fkmsmn B_fkmsmx B_fkpvmn B_fkpvmx B_stend /end IN_MEASUREMENT /begin OUT_MEASUREMENT /end OUT_MEASUREMENT /begin LOC_MEASUREMENT /end LOC_MEASUREMENT /begin SUB_FUNCTION /end SUB_FUNCTION /end FUNCTION
/begin FUNCTION DEKPE "Diagnose; Elektrokraftstoffpumpe Endstufe" /begin DEF_CHARACTERISTIC CWPSEKPE EKPEFA /end DEF_CHARACTERISTIC /begin REF_CHARACTERISTIC /end REF_CHARACTERISTIC /begin IN_MEASUREMENT B_uuekp /end IN_MEASUREMENT /begin OUT_MEASUREMENT B_eekpe /end OUT_MEASUREMENT /begin LOC_MEASUREMENT /end LOC_MEASUREMENT /begin SUB_FUNCTION /end SUB_FUNCTION /end FUNCTION
/begin FUNCTION DEPCL "Diagnose; Elektronik Powertrain Control Lampe" /begin DEF_CHARACTERISTIC TEPCL TEPCLI /end DEF_CHARACTERISTIC /begin REF_CHARACTERISTIC /end REF_CHARACTERISTIC /begin IN_MEASUREMENT B_bt B_bteepcl B_btepcl B_nmot dfpmEpclState /end IN_MEASUREMENT /begin OUT_MEASUREMENT B_epcl /end OUT_MEASUREMENT /begin LOC_MEASUREMENT B_epclloc /end LOC_MEASUREMENT /begin SUB_FUNCTION /end SUB_FUNCTION /end FUNCTION
/begin FUNCTION DEVE "Diagnose; Einspritzventil - Endstufe" /begin DEF_CHARACTERISTIC CWPSEVE EVEFA /end DEF_CHARACTERISTIC /begin REF_CHARACTERISTIC /end REF_CHARACTERISTIC /begin IN_MEASUREMENT B_kl15 B_uuzdg E_kill E_kl15 nmot /end IN_MEASUREMENT /begin OUT_MEASUREMENT B_eeve /end OUT_MEASUREMENT /begin LOC_MEASUREMENT /end LOC_MEASUREMENT /begin SUB_FUNCTION /end SUB_FUNCTION /end FUNCTION
/begin FUNCTION DEWS "" /begin DEF_CHARACTERISTIC CW_DEWS EWS_FSW_IN EWS_FSW_OUT /end DEF_CHARACTERISTIC /begin REF_CHARACTERISTIC /end REF_CHARACTERISTIC /begin IN_MEASUREMENT /end IN_MEASUREMENT /begin OUT_MEASUREMENT /end OUT_MEASUREMENT /begin LOC_MEASUREMENT /end LOC_MEASUREMENT /begin SUB_FUNCTION /end SUB_FUNCTION /end FUNCTION
/begin FUNCTION DEWSE "" /begin DEF_CHARACTERISTIC CWPSEWSE EWSEFA /end DEF_CHARACTERISTIC /begin REF_CHARACTERISTIC /end REF_CHARACTERISTIC /begin IN_MEASUREMENT B_uusys B_uuzdg /end IN_MEASUREMENT /begin OUT_MEASUREMENT B_eewse /end OUT_MEASUREMENT /begin LOC_MEASUREMENT /end LOC_MEASUREMENT /begin SUB_FUNCTION /end SUB_FUNCTION /end FUNCTION
/begin FUNCTION DFFT "Diagnose; Freeze Frame Auswahltabelle" /begin DEF_CHARACTERISTIC /end DEF_CHARACTERISTIC /begin REF_CHARACTERISTIC /end REF_CHARACTERISTIC
 /begin IN_MEASUREMENT B_prell_a flglrs flglrs2 fr2_u fra2_u fra_u frps_fu frps_measu fr_u gangi mizuvfil ml nmot pu rinv2_u rinv_u rl rml rstpfad st_curp1_u st_curp2_u st_curs1_u st_curs2_u st_ref_a tabgm tabgm2 tabgmls tabgmls2 tans te_u tkatm tkatm2 tmew tmot tmotlin tmotzyl_u tmot_u tmrw tnst_u tpsvkmf2_u tpsvkmf_u ub udkp1_u udkpa_u ugetrg usvk usvk2 utzyl1 utzyl2 uuekp uusys uuzdg vfzggang_u vfzg_u wdkba wdks wped wtans wub zwout_u /end IN_MEASUREMENT
 /begin OUT_MEASUREMENT /end OUT_MEASUREMENT
 /begin LOC_MEASUREMENT /end LOC_MEASUREMENT
 /begin SUB_FUNCTION /end SUB_FUNCTION
/end FUNCTION
/begin FUNCTION DFFTCNV "Diagnose; Freeze Frame Tabelle, Konvertierung zu Bytes" /begin DEF_CHARACTERISTIC /end DEF_CHARACTERISTIC /begin REF_CHARACTERISTIC NMAX /end REF_CHARACTERISTIC
 /begin IN_MEASUREMENT fr2_w fra2_w frau2_w frau_w fra_w frhol_w frm2_w frm_w frps_filt frps_meas fr_w igod_w igokr_w lamsons2_w lamsons_w nmot_w rinv2_w rinv_w rkrn_w rlugd_w rl_w st_cur_pos st_cur_spd tabst_w te_w tmotlin tmotzyl_w tnse_w tnst_w tpsvkmf2_w tpsvkmf_w udkp1_w udsu_w uulsuv2_w uulsuv_w uusvk2_w uusvk_w vfzg vfzggang_w wtans wtmot zwout /end IN_MEASUREMENT
 /begin OUT_MEASUREMENT addsu_u adta_u adtm_u fr2_u fra2_u frau2_u frau_u fra_u frhol_u frm2_u frm_u frps_fu frps_measu fr_u igod_u igokr_u lamsons2_u lamsons_u rinv2_u rinv_u rkrn_u rl_u st_curp1_u st_curp2_u st_curs1_u st_curs2_u tabst_u te_u tmotzyl_u tmot_u tnse_u tnst_u tpsvkmf2_u tpsvkmf_u udkp1_u udkpa_u uulsuv2_u uulsuv_u uusvk2_u uusvk_u vfzggang_u vfzg_u zwout_u /end OUT_MEASUREMENT
 /begin LOC_MEASUREMENT /end LOC_MEASUREMENT
 /begin SUB_FUNCTION /end SUB_FUNCTION
/end FUNCTION
/begin FUNCTION DFFTK "Diagnose; Kundenspezifische Auswahlliste f¸r Freeze Frame-Werte" /begin DEF_CHARACTERISTIC /end DEF_CHARACTERISTIC /begin REF_CHARACTERISTIC /end REF_CHARACTERISTIC
 /begin IN_MEASUREMENT addsu_u adta_u adtm_u ahkat ahkat2 frau2_u frau_u frhol_u frm2_u frm_u igod_u igokr_u ikrma ikrmet lamsons2_u lamsons_u msabg msabg2 nmot rkrn_u tabst_u taml tmst tnse_u uulsuv2_u uulsuv_u uusvk2_u uusvk_u /end IN_MEASUREMENT
 /begin OUT_MEASUREMENT /end OUT_MEASUREMENT
 /begin LOC_MEASUREMENT /end LOC_MEASUREMENT
 /begin SUB_FUNCTION /end SUB_FUNCTION
/end FUNCTION
/begin FUNCTION DFPM "OBDII; Fehlerpfadmanager" /begin DEF_CHARACTERISTIC /end DEF_CHARACTERISTIC /begin REF_CHARACTERISTIC /end REF_CHARACTERISTIC /begin IN_MEASUREMENT B_pwf /end IN_MEASUREMENT
 /begin OUT_MEASUREMENT bbno bbsp3 bbtim B_no B_sp3 B_tim dfcmFcm dfcmNo dfcmSfp dfpmEpclState dfpmMilState dfp_ap fcmcla_0_A fcmdfp_0_A fcmdlc_0_A fcmEnd fcmfes_0_A fcmflc_0_A fcmfps_0_A fcmfrz0_0_A fcmfrz1_0_A fcmfrz10_0_A fcmfrz2_0_A fcmfrz3_0_A fcmfrz4_0_A fcmfrz5_0_A fcmfrz6_0_A fcmfrz7_0_A fcmfrz8_0_A fcmfrz9_0_A fcmhlc_0_A fcmhz_0_A FCMTab fcmtsf_0_A fcmtyp_0_A /end OUT_MEASUREMENT
 /begin LOC_MEASUREMENT /end LOC_MEASUREMENT
 /begin SUB_FUNCTION /end SUB_FUNCTION
/end FUNCTION
/begin FUNCTION DFPMHIS "Diagnose Fehlerpfadmanagement; History-Speicher" /begin DEF_CHARACTERISTIC /end DEF_CHARACTERISTIC /begin REF_CHARACTERISTIC /end REF_CHARACTERISTIC /begin IN_MEASUREMENT B_pwf fcmEnd FCMTab /end IN_MEASUREMENT /begin OUT_MEASUREMENT fcmHis /end OUT_MEASUREMENT /begin LOC_MEASUREMENT /end LOC_MEASUREMENT /begin SUB_FUNCTION /end SUB_FUNCTION /end FUNCTION
/begin FUNCTION DFPMOVF "Diagnose Fehlerpfadmanagement, Memory Overflow" /begin DEF_CHARACTERISTIC /end DEF_CHARACTERISTIC /begin REF_CHARACTERISTIC /end REF_CHARACTERISTIC /begin IN_MEASUREMENT fcmEnd /end IN_MEASUREMENT /begin OUT_MEASUREMENT /end OUT_MEASUREMENT /begin LOC_MEASUREMENT /end LOC_MEASUREMENT /begin SUB_FUNCTION /end SUB_FUNCTION /end FUNCTION
/begin FUNCTION DFPM_DAKLE "" /begin DEF_CHARACTERISTIC CDCAKLE CDKAKLE CDTAKLE CLAAKLE FFTAKLE TSFAKLE /end DEF_CHARACTERISTIC /begin REF_CHARACTERISTIC /end REF_CHARACTERISTIC /begin IN_MEASUREMENT /end IN_MEASUREMENT
 /begin OUT_MEASUREMENT B_beakle B_bkakle B_clakle B_ftakle B_mnakle B_mxakle B_npakle B_siakle E_akle sfpakle TYP_akle Z_akle /end OUT_MEASUREMENT
 /begin LOC_MEASUREMENT /end LOC_MEASUREMENT
 /begin SUB_FUNCTION /end SUB_FUNCTION
/end FUNCTION
/begin FUNCTION DFPM_DASC "" /begin DEF_CHARACTERISTIC CDCAS CDKAS CDTAS CLAAS FFTAS TSFAS /end DEF_CHARACTERISTIC /begin REF_CHARACTERISTIC /end REF_CHARACTERISTIC /begin IN_MEASUREMENT /end IN_MEASUREMENT
 /begin OUT_MEASUREMENT B_beas B_bkas B_clas B_ftas B_mnas B_mxas B_npas B_sias E_as sfpas TYP_as Z_as /end OUT_MEASUREMENT
 /begin LOC_MEASUREMENT /end LOC_MEASUREMENT
 /begin SUB_FUNCTION /end SUB_FUNCTION
/end FUNCTION
/begin FUNCTION DFPM_DCABS "" /begin DEF_CHARACTERISTIC CDCCABS CDKCABS CDTCABS CLACABS FFTCABS TSFCABS /end DEF_CHARACTERISTIC /begin REF_CHARACTERISTIC /end REF_CHARACTERISTIC /begin IN_MEASUREMENT /end IN_MEASUREMENT
 /begin OUT_MEASUREMENT B_becabs B_bkcabs B_clcabs B_ftcabs B_mncabs B_mxcabs B_npcabs B_sicabs E_CABS sfpcabs TYP_cabs Z_CABS /end OUT_MEASUREMENT
 /begin LOC_MEASUREMENT /end LOC_MEASUREMENT
 /begin SUB_FUNCTION /end SUB_FUNCTION
/end FUNCTION
/begin FUNCTION DFPM_DCANA "" /begin DEF_CHARACTERISTIC CDCCANA CDKCANA CDTCANA CLACANA FFTCANA TSFCANA /end DEF_CHARACTERISTIC /begin REF_CHARACTERISTIC /end REF_CHARACTERISTIC /begin IN_MEASUREMENT /end IN_MEASUREMENT
 /begin OUT_MEASUREMENT B_becana B_bkcana B_clcana B_ftcana B_mncana B_mxcana B_npcana B_sicana E_cana sfpcana TYP_cana Z_cana /end OUT_MEASUREMENT
 /begin LOC_MEASUREMENT /end LOC_MEASUREMENT
 /begin SUB_FUNCTION /end SUB_FUNCTION
/end FUNCTION
/begin FUNCTION DFPM_DCAS "" /begin DEF_CHARACTERISTIC CDCCAS CDKCAS CDTCAS CLACAS FFTCAS TSFCAS /end DEF_CHARACTERISTIC /begin REF_CHARACTERISTIC /end REF_CHARACTERISTIC /begin IN_MEASUREMENT /end IN_MEASUREMENT
 /begin OUT_MEASUREMENT B_becas B_bkcas B_clcas B_ftcas B_mncas B_mxcas B_npcas B_sicas E_CAS sfpcas TYP_cas Z_CAS /end OUT_MEASUREMENT
 /begin LOC_MEASUREMENT /end LOC_MEASUREMENT
 /begin SUB_FUNCTION /end SUB_FUNCTION
/end FUNCTION
/begin FUNCTION DFPM_DCKOM ""
 /begin DEF_CHARACTERISTIC CDCCKOMBI CDKCKOMBI CDTCKOMBI CLACKOMBI FFTCKOMBI TSFCKOMBI /end DEF_CHARACTERISTIC
 /begin REF_CHARACTERISTIC /end REF_CHARACTERISTIC
 /begin IN_MEASUREMENT /end IN_MEASUREMENT
 /begin OUT_MEASUREMENT B_beckombi B_bkckombi B_clckombi B_ftckombi B_mnckombi B_mxckombi B_npckombi B_sickombi E_CKOMBI sfpckombi TYP_ckombi Z_CKOMBI /end OUT_MEASUREMENT
 /begin LOC_MEASUREMENT /end LOC_MEASUREMENT
 /begin SUB_FUNCTION /end SUB_FUNCTION
/end FUNCTION
/begin FUNCTION DFPM_DCZFE "" /begin DEF_CHARACTERISTIC CDCCZFE CDKCZFE CDTCZFE CLACZFE FFTCZFE TSFCZFE /end DEF_CHARACTERISTIC /begin REF_CHARACTERISTIC /end REF_CHARACTERISTIC /begin IN_MEASUREMENT /end IN_MEASUREMENT
 /begin OUT_MEASUREMENT B_beczfe B_bkczfe B_clczfe B_ftczfe B_mnczfe B_mxczfe B_npczfe B_siczfe E_CZFE sfpczfe TYP_czfe Z_CZFE /end OUT_MEASUREMENT
 /begin LOC_MEASUREMENT /end LOC_MEASUREMENT
 /begin SUB_FUNCTION /end SUB_FUNCTION
/end FUNCTION
/begin FUNCTION DFPM_DDG ""
 /begin DEF_CHARACTERISTIC CDCBM CDCN CDKBM CDKN CDTBM CDTN CLABM CLAN FFTBM FFTN TSFBM TSFN /end DEF_CHARACTERISTIC
 /begin REF_CHARACTERISTIC /end REF_CHARACTERISTIC
 /begin IN_MEASUREMENT /end IN_MEASUREMENT
 /begin OUT_MEASUREMENT B_bebm B_ben B_bkbm B_bkn B_clbm B_cln B_ftbm B_ftn B_mnbm B_mnn B_mxbm B_mxn B_npbm B_npn B_sibm B_sin E_bm E_n sfpbm sfpn TYP_bm TYP_n Z_bm Z_n /end OUT_MEASUREMENT
 /begin LOC_MEASUREMENT /end LOC_MEASUREMENT
 /begin SUB_FUNCTION /end SUB_FUNCTION
/end FUNCTION
/begin FUNCTION DFPM_DDKP "" /begin DEF_CHARACTERISTIC CDCDKP CDKDKP CDTDKP CLADKP FFTDKP TSFDKP /end DEF_CHARACTERISTIC /begin REF_CHARACTERISTIC /end REF_CHARACTERISTIC /begin IN_MEASUREMENT /end IN_MEASUREMENT
 /begin OUT_MEASUREMENT B_bedkp B_bkdkp B_cldkp B_ftdkp B_mndkp B_mxdkp B_npdkp B_sidkp E_dkp sfpdkp TYP_dkp Z_dkp /end OUT_MEASUREMENT
 /begin LOC_MEASUREMENT /end LOC_MEASUREMENT
 /begin SUB_FUNCTION /end SUB_FUNCTION
/end FUNCTION
/begin FUNCTION DFPM_DDKPA "" /begin DEF_CHARACTERISTIC CDCDKPA CDKDKPA CDTDKPA CLADKPA FFTDKPA TSFDKPA /end DEF_CHARACTERISTIC /begin REF_CHARACTERISTIC /end REF_CHARACTERISTIC /begin IN_MEASUREMENT /end IN_MEASUREMENT
 /begin OUT_MEASUREMENT B_bedkpa B_bkdkpa B_cldkpa B_ftdkpa B_mndkpa B_mxdkpa B_npdkpa B_sidkpa E_dkpa sfpdkpa TYP_dkpa Z_dkpa /end OUT_MEASUREMENT
 /begin LOC_MEASUREMENT /end LOC_MEASUREMENT
 /begin SUB_FUNCTION /end SUB_FUNCTION
/end FUNCTION
/begin FUNCTION DFPM_DEKPE "" /begin DEF_CHARACTERISTIC CDCEKPE CDKEKPE CDTEKPE CLAEKPE FFTEKPE TSFEKPE /end DEF_CHARACTERISTIC /begin REF_CHARACTERISTIC /end REF_CHARACTERISTIC /begin IN_MEASUREMENT /end IN_MEASUREMENT
 /begin OUT_MEASUREMENT B_beekpe B_bkekpe B_clekpe B_ftekpe B_mnekpe B_mxekpe B_npekpe B_siekpe E_ekpe sfpekpe TYP_ekpe Z_ekpe /end OUT_MEASUREMENT
 /begin LOC_MEASUREMENT /end LOC_MEASUREMENT
 /begin SUB_FUNCTION /end SUB_FUNCTION
/end FUNCTION
/begin FUNCTION DFPM_DEVE ""
 /begin DEF_CHARACTERISTIC CDCEV1E CDCEV2E CDCEV3E CDCEV4E CDKEV1E CDKEV2E CDKEV3E CDKEV4E CDTEV1E CDTEV2E CDTEV3E CDTEV4E CLAEV1E CLAEV2E CLAEV3E CLAEV4E FFTEV1E FFTEV2E FFTEV3E FFTEV4E TSFEV1E TSFEV2E TSFEV3E TSFEV4E /end DEF_CHARACTERISTIC
 /begin REF_CHARACTERISTIC /end REF_CHARACTERISTIC
 /begin IN_MEASUREMENT /end IN_MEASUREMENT
 /begin OUT_MEASUREMENT B_beev1e B_beev2e B_beev3e B_beev4e B_bkev1e B_bkev2e B_bkev3e B_bkev4e B_clev1e B_clev2e B_clev3e B_clev4e B_ftev1e B_ftev2e B_ftev3e B_ftev4e B_mnev1e B_mnev2e B_mnev3e B_mnev4e B_mxev1e B_mxev2e B_mxev3e B_mxev4e B_npev1e B_npev2e B_npev3e B_npev4e B_siev1e B_siev2e B_siev3e B_siev4e E_ev1e E_ev2e E_ev3e E_ev4e sfpev1e sfpev2e sfpev3e sfpev4e TYP_ev1e TYP_ev2e TYP_ev3e TYP_ev4e Z_ev1e Z_ev2e Z_ev3e Z_ev4e /end OUT_MEASUREMENT
 /begin LOC_MEASUREMENT /end LOC_MEASUREMENT
 /begin SUB_FUNCTION /end SUB_FUNCTION
/end FUNCTION
/begin FUNCTION DFPM_DEWS "" /begin DEF_CHARACTERISTIC CDCEWS CDKEWS CDTEWS CLAEWS FFTEWS TSFEWS /end DEF_CHARACTERISTIC /begin REF_CHARACTERISTIC /end REF_CHARACTERISTIC /begin IN_MEASUREMENT /end IN_MEASUREMENT
 /begin OUT_MEASUREMENT B_beews B_bkews B_clews B_ftews B_mnews B_mxews B_npews B_siews E_ews sfpews TYP_ews Z_ews /end OUT_MEASUREMENT
 /begin LOC_MEASUREMENT /end LOC_MEASUREMENT
 /begin SUB_FUNCTION /end SUB_FUNCTION
/end FUNCTION
/begin FUNCTION DFPM_DEWSE "" /begin DEF_CHARACTERISTIC CDCEWSE CDKEWSE CDTEWSE CLAEWSE FFTEWSE TSFEWSE /end DEF_CHARACTERISTIC /begin REF_CHARACTERISTIC /end REF_CHARACTERISTIC /begin IN_MEASUREMENT /end IN_MEASUREMENT
 /begin OUT_MEASUREMENT B_beewse B_bkewse B_clewse B_ftewse B_mnewse B_mxewse B_npewse B_siewse E_ewse sfpewse TYP_ewse Z_ewse /end OUT_MEASUREMENT
 /begin LOC_MEASUREMENT /end LOC_MEASUREMENT
 /begin SUB_FUNCTION /end SUB_FUNCTION
/end FUNCTION
/begin FUNCTION DFPM_DFPM ""
 /begin DEF_CHARACTERISTIC CDCAAA CDCZZZ CDKAAA CDKZZZ CDTAAA CDTZZZ CLAAAA CLAZZZ FFTAAA FFTZZZ TSFAAA TSFZZZ /end DEF_CHARACTERISTIC
 /begin REF_CHARACTERISTIC /end REF_CHARACTERISTIC
 /begin IN_MEASUREMENT /end IN_MEASUREMENT
 /begin OUT_MEASUREMENT sfpaaa sfpzzz /end OUT_MEASUREMENT
 /begin LOC_MEASUREMENT /end LOC_MEASUREMENT
 /begin SUB_FUNCTION /end SUB_FUNCTION
/end FUNCTION
/begin FUNCTION DFPM_DKAT "" /begin DEF_CHARACTERISTIC CDCKAT CDKKAT CDTKAT CLAKAT FFTKAT TSFKAT /end DEF_CHARACTERISTIC /begin REF_CHARACTERISTIC /end REF_CHARACTERISTIC /begin IN_MEASUREMENT /end IN_MEASUREMENT
 /begin OUT_MEASUREMENT B_bekat B_bkkat B_clkat B_ftkat B_mnkat B_mxkat B_npkat B_sikat E_kat sfpkat TYP_kat Z_kat /end OUT_MEASUREMENT
 /begin LOC_MEASUREMENT /end LOC_MEASUREMENT
 /begin SUB_FUNCTION /end SUB_FUNCTION
/end FUNCTION
/begin FUNCTION DFPM_DKILL "" /begin DEF_CHARACTERISTIC CDCKILL CDKKILL CDTKILL CLAKILL FFTKILL TSFKILL /end DEF_CHARACTERISTIC /begin REF_CHARACTERISTIC /end REF_CHARACTERISTIC /begin IN_MEASUREMENT /end IN_MEASUREMENT
 /begin OUT_MEASUREMENT B_bekill B_bkkill B_clkill B_ftkill B_mnkill B_mxkill B_npkill B_sikill E_kill sfpkill TYP_kill Z_kill /end OUT_MEASUREMENT
 /begin LOC_MEASUREMENT /end LOC_MEASUREMENT
 /begin SUB_FUNCTION /end SUB_FUNCTION
/end FUNCTION
/begin FUNCTION DFPM_DKL15 "" /begin DEF_CHARACTERISTIC CDCKL15 CDKKL15 CDTKL15 CLAKL15 FFTKL15 TSFKL15 /end DEF_CHARACTERISTIC /begin REF_CHARACTERISTIC /end REF_CHARACTERISTIC /begin IN_MEASUREMENT /end IN_MEASUREMENT
 /begin OUT_MEASUREMENT B_bekl15 B_bkkl15 B_clkl15 B_ftkl15 B_mnkl15 B_mxkl15 B_npkl15 B_sikl15 E_kl15 sfpkl15 TYP_kl15 Z_kl15 /end OUT_MEASUREMENT
 /begin LOC_MEASUREMENT /end LOC_MEASUREMENT
 /begin SUB_FUNCTION /end SUB_FUNCTION
/end FUNCTION
/begin FUNCTION DFPM_DKRNT ""
 /begin DEF_CHARACTERISTIC CDCKRNT CDCKROF CDKKRNT CDKKROF CDTKRNT CDTKROF CLAKRNT CLAKROF FFTKRNT FFTKROF TSFKRNT TSFKROF /end DEF_CHARACTERISTIC
 /begin REF_CHARACTERISTIC /end REF_CHARACTERISTIC
 /begin IN_MEASUREMENT /end IN_MEASUREMENT
 /begin OUT_MEASUREMENT B_bekrnt B_bekrof B_bkkrnt B_bkkrof B_clkrnt B_clkrof B_ftkrnt B_ftkrof B_mnkrnt B_mnkrof B_mxkrnt B_mxkrof B_npkrnt B_npkrof B_sikrnt B_sikrof E_krnt E_krof sfpkrnt sfpkrof TYP_krnt TYP_krof Z_krnt Z_krof /end OUT_MEASUREMENT
 /begin LOC_MEASUREMENT /end LOC_MEASUREMENT
 /begin SUB_FUNCTION /end SUB_FUNCTION
/end FUNCTION
/begin FUNCTION DFPM_DKRS ""
 /begin DEF_CHARACTERISTIC CDCKS CDCKS1 CDCKS2 CDKKS CDKKS1 CDKKS2 CDTKS CDTKS1 CDTKS2 CLAKS CLAKS1 CLAKS2 FFTKS FFTKS1 FFTKS2 TSFKS TSFKS1 TSFKS2 /end DEF_CHARACTERISTIC
 /begin REF_CHARACTERISTIC /end REF_CHARACTERISTIC
 /begin IN_MEASUREMENT /end IN_MEASUREMENT
 /begin OUT_MEASUREMENT B_beks B_beks1 B_beks2 B_bkks B_bkks1 B_bkks2 B_clks B_clks1 B_clks2 B_ftks B_ftks1 B_ftks2 B_mnks B_mnks1 B_mnks2 B_mxks B_mxks1 B_mxks2 B_npks B_npks1 B_npks2 B_siks B_siks1 B_siks2 E_ks E_ks1 E_ks2 sfpks sfpks1 sfpks2 TYP_ks TYP_ks1 TYP_ks2 Z_ks Z_ks1 Z_ks2 /end OUT_MEASUREMENT
 /begin LOC_MEASUREMENT /end LOC_MEASUREMENT
 /begin SUB_FUNCTION /end SUB_FUNCTION
/end FUNCTION
/begin FUNCTION DFPM_DKRTP "" /begin DEF_CHARACTERISTIC CDCKRTP CDKKRTP CDTKRTP CLAKRTP FFTKRTP TSFKRTP /end DEF_CHARACTERISTIC /begin REF_CHARACTERISTIC /end REF_CHARACTERISTIC /begin IN_MEASUREMENT /end IN_MEASUREMENT
 /begin OUT_MEASUREMENT B_bekrtp B_bkkrtp B_clkrtp B_ftkrtp B_mnkrtp B_mxkrtp B_npkrtp B_sikrtp E_krtp sfpkrtp TYP_krtp Z_krtp /end OUT_MEASUREMENT
 /begin LOC_MEASUREMENT /end LOC_MEASUREMENT
 /begin SUB_FUNCTION /end SUB_FUNCTION
/end FUNCTION
/begin COMPU_METHOD acc_ub_b55p55 "" RAT_FUNC "%6.3" "m/(s^2)" COEFFS 0 1 0 0 0 0.217 /end COMPU_METHOD
/begin COMPU_METHOD B_TRUE "" TAB_VERB "%6.3" "" COMPU_TAB_REF B_TRUE /end COMPU_METHOD
/begin COMPU_VTAB B_TRUE "" TAB_VERB 2 0 "false" 1 "TRUE" /end COMPU_VTAB
/begin COMPU_METHOD cw_aku "" TAB_VERB "%6.3" "" COMPU_TAB_REF cw_aku /end COMPU_METHOD
/begin COMPU_VTAB cw_aku "" TAB_VERB 3 0 "Gang > 1" 1 "ECE" 2 "JAPAN" /end COMPU_VTAB
/begin COMPU_METHOD cw_vmx "" TAB_VERB "%6.3" "" COMPU_TAB_REF cw_vmx /end COMPU_METHOD
/begin COMPU_VTAB cw_vmx "" TAB_VERB 4 0 "keine VMX ¸ber NMX" 1 "NMX bei E_STP2" 2 "NMX bei V>KW_VX_THR_NX" 3 "NMX bei E_STP2 oder V>KW_VX_THR_NX" /end COMPU_VTAB
/begin COMPU_METHOD DEZ "" RAT_FUNC "%6.2" "" COEFFS 0 1 0 0 0 1 /end COMPU_METHOD
/begin COMPU_METHOD dez "" RAT_FUNC "%6.2" "" COEFFS 0 1 0 0 0 1 /end COMPU_METHOD
/begin COMPU_METHOD dichte_ub_b2 "" RAT_FUNC "%6.4" "kg/m^3" COEFFS 0 256 0 0 0 2 /end COMPU_METHOD
/begin COMPU_METHOD fak_4 "" RAT_FUNC "%6.2" "-" COEFFS 0 1 0 0 0 4 /end COMPU_METHOD
/begin COMPU_METHOD fak_q0p1 "" RAT_FUNC "%6.3" "-" COEFFS 0 1 0 0 0 0.1 /end COMPU_METHOD
/begin COMPU_METHOD fak_ub_b16 "" RAT_FUNC "%6.4" "-" COEFFS 0 256 0 0 0 16 /end COMPU_METHOD
/begin COMPU_METHOD fak_ub_b2 "" RAT_FUNC "%6.4" "-" COEFFS 0 256 0 0 0 2 /end COMPU_METHOD
/begin COMPU_METHOD fak_ub_b4 "" RAT_FUNC "%6.4" "-" COEFFS 0 256 0 0 0 4 /end COMPU_METHOD
/begin COMPU_METHOD fak_uw_b1 "" RAT_FUNC "%7.6" "-" COEFFS 0 65536 0 0 0 1 /end COMPU_METHOD
/begin COMPU_METHOD fak_uw_b16 "" RAT_FUNC "%6.5" "-" COEFFS 0 65536 0 0 0 16 /end COMPU_METHOD
/begin COMPU_METHOD fak_uw_b2 "" RAT_FUNC "%7.6" "-" COEFFS 0 65536 0 0 0 2 /end COMPU_METHOD
/begin COMPU_METHOD fak_uw_b32 "" RAT_FUNC "%6.5" "-" COEFFS 0 65536 0 0 0 32 /end COMPU_METHOD
/begin COMPU_METHOD fak_uw_b4 "" RAT_FUNC "%7.6" "-" COEFFS 0 65536 0 0 0 4 /end COMPU_METHOD
/begin COMPU_METHOD fak_uw_b8 "" RAT_FUNC "%6.5" "-" COEFFS 0 65536 0 0 0 8 /end COMPU_METHOD
/begin COMPU_METHOD fak_uw_q0p001 "" RAT_FUNC "%6.5" "-" COEFFS 0 65536 0 0 0 65.536 /end COMPU_METHOD
/begin COMPU_METHOD freq2000_ub "" RAT_FUNC "%5.2" "1/s" COEFFS 0 256 0 0 0 200 /end COMPU_METHOD
/begin COMPU_METHOD km_ul_q1 "" RAT_FUNC "%6.2" "km" COEFFS 0 1 0 0 0 1 /end COMPU_METHOD
/begin COMPU_METHOD kw_q1_o128 "" RAT_FUNC "%6.4" "Grad KW" COEFFS 0 1 128 0 0 1 /end COMPU_METHOD
/begin COMPU_METHOD md_ub_q16 "" RAT_FUNC "%6.1" "Nm" COEFFS 0 1 0 0 0 16 /end COMPU_METHOD
/begin COMPU_METHOD m_ub_b1020 "" RAT_FUNC "%6.2" "kg/h" COEFFS 0 1 0 0 0 4 /end COMPU_METHOD
/begin COMPU_METHOD m_ub_b23p3 "" RAT_FUNC "%6.3" "kg" COEFFS 0 2812.5 0 0 0 256 /end COMPU_METHOD
/begin COMPU_METHOD m_ub_b25p6 "" RAT_FUNC "%6.3" "kg/h" COEFFS 0 256 0 0 0 25.6 /end COMPU_METHOD
/begin COMPU_METHOD m_uw_b25p6 "" RAT_FUNC "%6.5" "kg/h" COEFFS 0 65536 0 0 0 25.6 /end COMPU_METHOD
/begin COMPU_METHOD m_uw_b6553p5 "" RAT_FUNC "%6.3" "kg/h" COEFFS 0 1 0 0 0 0.1 /end COMPU_METHOD
/begin COMPU_METHOD nmot_ub_q10 "" RAT_FUNC "%6.1" "1/min" COEFFS 0 1 0 0 0 10 /end COMPU_METHOD
/begin COMPU_METHOD nmot_ub_q40 "" RAT_FUNC "%6.1" "1/min" COEFFS 0 1 0 0 0 40 /end COMPU_METHOD
/begin COMPU_METHOD nmot_uw_q0p25 "" RAT_FUNC "%6.3" "1/min" COEFFS 0 1 0 0 0 0.25 /end COMPU_METHOD
/begin COMPU_METHOD p_q0p039s32768 "" RAT_FUNC "%7.1" "hPa" COEFFS 0 256 327680 0 0 10 /end COMPU_METHOD
/begin COMPU_METHOD p_sw_q0p039 "" RAT_FUNC "%6.4" "hPa" COEFFS 0 256 0 0 0 10 /end COMPU_METHOD
/begin COMPU_METHOD p_ub_q51p2 "" RAT_FUNC "%6.1" "hPa" COEFFS 0 5 0 0 0 256 /end COMPU_METHOD
/begin COMPU_METHOD p_uw_b32 "" RAT_FUNC "%6.5" "hPa/%" COEFFS 0 65536 0 0 0 32 /end COMPU_METHOD
/begin COMPU_METHOD p_uw_q0p039 "" RAT_FUNC "%6.4" "hPa" COEFFS 0 256 0 0 0 10 /end COMPU_METHOD
/begin COMPU_METHOD relDK_ub_b100 "" RAT_FUNC "%6.3" "%DK" COEFFS 0 255 0 0 0 100 /end COMPU_METHOD
/begin COMPU_METHOD relNWU_q0p0234 "" RAT_FUNC "%6.4" "%/NWU" COEFFS 0 32 0 0 0 0.75 /end COMPU_METHOD
/begin COMPU_METHOD rel_q0p392 "" RAT_FUNC "%6.3" "%" COEFFS 0 255 0 0 0 100 /end COMPU_METHOD
/begin COMPU_METHOD rel_sw_b100 "" RAT_FUNC "%6.4" "%" COEFFS 0 32768 0 0 0 100 /end COMPU_METHOD
/begin COMPU_METHOD rel_sw_b1536 "" RAT_FUNC "%6.4" "%" COEFFS 0 65536 0 0 0 3072 /end COMPU_METHOD
/begin COMPU_METHOD rel_sw_q0p0234 "" RAT_FUNC "%6.4" "%/seg" COEFFS 0 32 0 0 0 0.75 /end COMPU_METHOD
/begin COMPU_METHOD rel_ub_b100 "" RAT_FUNC "%6.3" "%" COEFFS 0 255 0 0 0 100 /end COMPU_METHOD
/begin COMPU_METHOD rel_ub_b24p9 "" RAT_FUNC "%6.3" "%" COEFFS 0 255 0 0 0 24.9 /end COMPU_METHOD
/begin COMPU_METHOD rel_ub_b99p6 "" RAT_FUNC "%6.3" "%" COEFFS 0 256 0 0 0 100 /end COMPU_METHOD
/begin COMPU_METHOD rel_ub_q0p1875 "" RAT_FUNC "%6.3" "KW/ms" COEFFS 0 256 0 0 0 48 /end COMPU_METHOD
/begin COMPU_METHOD rel_ub_q0p75 "" RAT_FUNC "%6.3" "%" COEFFS 0 1 0 0 0 0.75 /end COMPU_METHOD
/begin COMPU_METHOD rel_uw_b0p3 "" RAT_FUNC "%8.7" "%/hPa" COEFFS 0 65536 0 0 0 0.3 /end COMPU_METHOD
/begin COMPU_METHOD rel_uw_b100 "" RAT_FUNC "%6.4" "%" COEFFS 0 65536 0 0 0 100 /end COMPU_METHOD
/begin COMPU_METHOD rel_uw_q0p001 "" RAT_FUNC "%6.5" "%" COEFFS 0 1000 0 0 0 1 /end COMPU_METHOD
/begin COMPU_METHOD rel_uw_q0p0234 "" RAT_FUNC "%6.4" "%" COEFFS 0 32 0 0 0 0.75 /end COMPU_METHOD
/begin COMPU_METHOD r_ub_q64 "" RAT_FUNC "%6.1" "Ohm" COEFFS 0 1 0 0 0 64 /end COMPU_METHOD
/begin COMPU_METHOD SFP_TYP "" TAB_VERB "%6.3" "" COMPU_TAB_REF SFP_TYP /end COMPU_METHOD
/begin COMPU_VTAB SFP_TYP "" TAB_VERB 5 0 "clear" 1 "MAX" 2 "MIN" 4 "SIG" 8 "NPL" /end COMPU_VTAB
/begin COMPU_METHOD spgg_sb_b3052 "" RAT_FUNC "%6.1" "V/s" COEFFS 0 1 0 0 0 23.8438 /end COMPU_METHOD
/begin COMPU_METHOD spg_q0p625 "" RAT_FUNC "%6.3" "V" COEFFS 0 8 0 0 0 5 /end COMPU_METHOD
/begin COMPU_METHOD spg_ubatt "" RAT_FUNC "%6.3" "V" COEFFS 0 1 0 0 0 0.0942 /end COMPU_METHOD
/begin COMPU_METHOD spg_ub_b5 "" RAT_FUNC "%6.4" "V" COEFFS 0 256 0 0 0 5 /end COMPU_METHOD
/begin COMPU_METHOD sprzi_q0p1 "" RAT_FUNC "%3.2" "Grad KW" COEFFS 0 10 0 0 0 1 /end COMPU_METHOD
/begin COMPU_METHOD t100msxs_ub_b25p5 "" RAT_FUNC "%6.3" "s" COEFFS 0 1 0 0 0 0.1 /end COMPU_METHOD
/begin COMPU_METHOD t100msxs_uw_b6553p5 "" RAT_FUNC "%6.3" "s" COEFFS 0 1 0 0 0 0.1 /end COMPU_METHOD
/begin COMPU_METHOD t10msxs_ub_b10p2 "" RAT_FUNC "%6.4" "s" COEFFS 0 1 0 0 0 0.04 /end COMPU_METHOD
/begin COMPU_METHOD t10msxs_ub_b2p55 "" RAT_FUNC "%6.4" "s" COEFFS 0 1 0 0 0 0.01 /end COMPU_METHOD
/begin COMPU_METHOD t10msxs_uw_b655p35 "" RAT_FUNC "%6.4" "s" COEFFS 0 1 0 0 0 0.01 /end COMPU_METHOD
/begin COMPU_METHOD t128ms_uw "" RAT_FUNC "%5.4" "s" COEFFS 0 512 0 0 0 1 /end COMPU_METHOD
/begin COMPU_METHOD t1msxms_q1 "" RAT_FUNC "%6.2" "ms" COEFFS 0 1 0 0 0 1 /end COMPU_METHOD
/begin COMPU_METHOD t1sxs_ub_b255 "" RAT_FUNC "%6.2" "s" COEFFS 0 1 0 0 0 1 /end COMPU_METHOD
/begin COMPU_METHOD t1sxs_ul_q1 "" RAT_FUNC "%6.2" "s" COEFFS 0 1 0 0 0 1 /end COMPU_METHOD
/begin COMPU_METHOD t1sxs_uw_b65535 "" RAT_FUNC "%6.2" "s" COEFFS 0 1 0 0 0 1 /end COMPU_METHOD
/begin COMPU_METHOD t1sxs_uw_q1 "" RAT_FUNC "%6.2" "s" COEFFS 0 1 0 0 0 1 /end COMPU_METHOD
/begin COMPU_METHOD t200msxs_ub_b51 "" RAT_FUNC "%6.3" "s" COEFFS 0 1 0 0 0 0.2 /end COMPU_METHOD
/begin COMPU_METHOD t200msxs_uw_q0p2 "" RAT_FUNC "%6.3" "s" COEFFS 0 1 0 0 0 0.2 /end COMPU_METHOD
/begin COMPU_METHOD t25p6sxs_ub_b6528 "" RAT_FUNC "%6.1" "s" COEFFS 0 1 0 0 0 25.6 /end COMPU_METHOD
/begin COMPU_METHOD t3p2usxms_uw_b209p7 "" RAT_FUNC "%6.4" "ms" COEFFS 0 65536 0 0 0 209.751 /end COMPU_METHOD
/begin COMPU_METHOD t640msxs_ub_b163p2 "" RAT_FUNC "%6.3" "s" COEFFS 0 1 0 0 0 0.64 /end COMPU_METHOD
/begin COMPU_METHOD t64p0usxms_ub "" RAT_FUNC "%6.4" "ms" COEFFS 0 1000 0 0 0 64 /end COMPU_METHOD
/begin COMPU_METHOD temp_sb_q0p75 "" RAT_FUNC "%6.3" "Grad C" COEFFS 0 1 0 0 0 0.75 /end COMPU_METHOD
/begin COMPU_METHOD temp_sw_q0p75 "" RAT_FUNC "%6.3" "Grad C" COEFFS 0 4 0 0 0 3 /end COMPU_METHOD
/begin COMPU_METHOD temp_ub_q0p75_o48 "" RAT_FUNC "%6.2" "Grad C" COEFFS 0 1 48 0 0 0.75 /end COMPU_METHOD
/begin COMPU_METHOD temp_ub_q1_o40 "" RAT_FUNC "%6.2" "Grad C" COEFFS 0 1 40 0 0 1 /end COMPU_METHOD
/begin COMPU_METHOD t_q0p1 "" RAT_FUNC "%6.3" "s" COEFFS 0 10 0 0 0 1 /end COMPU_METHOD
/begin COMPU_METHOD t_q16us "" RAT_FUNC "%6.1" "us" COEFFS 0 1 0 0 0 16 /end COMPU_METHOD
/begin COMPU_METHOD t_q256 "" RAT_FUNC "%6.0" "s" COEFFS 0 1 0 0 0 256 /end COMPU_METHOD
/begin COMPU_METHOD vfzg_q1p0 "" RAT_FUNC "%6.2" "km/h" COEFFS 0 1 0 0 0 1 /end COMPU_METHOD
/begin COMPU_METHOD vfzg_ub_q1p25 "" RAT_FUNC "%6.2" "km/h" COEFFS 0 1 0 0 0 1.25 /end COMPU_METHOD
/begin COMPU_METHOD vfzg_uw_b512 "" RAT_FUNC "%6.4" "km/h" COEFFS 0 65536 0 0 0 512 /end COMPU_METHOD
/begin COMPU_METHOD vfzg_uw_q0p0625 "" RAT_FUNC "%6.4" "km/h" COEFFS 0 1 0 0 0 0.0625 /end COMPU_METHOD
/begin COMPU_METHOD vs_uw_b25p6 "" RAT_FUNC "%6.5" "m^3/h" COEFFS 0 65536 0 0 0 25.6 /end COMPU_METHOD
/begin COMPU_METHOD zk100msxs_ub_b25p5 "" RAT_FUNC "%6.3" "s" COEFFS 0 0 256 0 10 0 /end COMPU_METHOD
/begin COMPU_METHOD zk100msxs_uw_b6553 "" RAT_FUNC "%10.3" "s" COEFFS 0 0 65536 0 10 0 /end COMPU_METHOD
/begin COMPU_METHOD zk10msxs_uw_b655 "" RAT_FUNC "%10.4" "s" COEFFS 0 0 65536 0 100 0 /end COMPU_METHOD
/begin COMPU_METHOD zk20msxs_ub_b5p1 "" RAT_FUNC "%6.4" "s" COEFFS 0 0 5.1 0 1 0 /end COMPU_METHOD
/begin COMPU_METHOD zw_sb_q0p75 "" RAT_FUNC "%6.3" "Grad KW" COEFFS 0 255 0 0 0 191.25 /end COMPU_METHOD
/begin COMPU_METHOD zw_ub_q6 "" RAT_FUNC "%6.2" "Grad KW" COEFFS 0 255 0 0 0 1530 /end COMPU_METHOD
/begin COMPU_METHOD default "" RAT_FUNC "%6.2" "" COEFFS 0 1 0 0 0 1 /end COMPU_METHOD
/begin RECORD_LAYOUT KfAxUbAyUbSstxUbSstyUbWUb NO_AXIS_PTS_X 1 UBYTE NO_AXIS_PTS_Y 2 UBYTE AXIS_PTS_X 3 UBYTE INDEX_INCR DIRECT AXIS_PTS_Y 4 UBYTE INDEX_INCR DIRECT FNC_VALUES 5 UBYTE COLUMN_DIR DIRECT /end RECORD_LAYOUT
/begin RECORD_LAYOUT KfAxUwAyUwSstxUwSstyUwWUw NO_AXIS_PTS_X 1 UWORD NO_AXIS_PTS_Y 2 UWORD AXIS_PTS_X 3 UWORD INDEX_INCR DIRECT AXIS_PTS_Y 4 UWORD INDEX_INCR DIRECT FNC_VALUES 5 UWORD COLUMN_DIR DIRECT /end RECORD_LAYOUT
/begin RECORD_LAYOUT KlASwSstSwWSw NO_AXIS_PTS_X 1 SWORD AXIS_PTS_X 2 SWORD INDEX_INCR DIRECT FNC_VALUES 3 SWORD COLUMN_DIR DIRECT /end RECORD_LAYOUT
/begin RECORD_LAYOUT KlAUbSstUbWUb NO_AXIS_PTS_X 1 UBYTE AXIS_PTS_X 2 UBYTE INDEX_INCR DIRECT FNC_VALUES 3 UBYTE COLUMN_DIR DIRECT /end RECORD_LAYOUT
/begin RECORD_LAYOUT KlAUbSstUbWUw NO_AXIS_PTS_X 1 UBYTE AXIS_PTS_X 2 UBYTE INDEX_INCR DIRECT FNC_VALUES 3 UWORD COLUMN_DIR DIRECT /end RECORD_LAYOUT
/begin RECORD_LAYOUT KlAUbSstUwWUw NO_AXIS_PTS_X 1 UWORD AXIS_PTS_X 2 UWORD INDEX_INCR DIRECT FNC_VALUES 3 UWORD COLUMN_DIR DIRECT /end RECORD_LAYOUT
/begin RECORD_LAYOUT KlAUwSstUwWUw NO_AXIS_PTS_X 1 UWORD AXIS_PTS_X 2 UWORD INDEX_INCR DIRECT FNC_VALUES 3 UWORD COLUMN_DIR DIRECT /end RECORD_LAYOUT
/begin RECORD_LAYOUT KwbSw FNC_VALUES 1 SWORD COLUMN_DIR DIRECT /end RECORD_LAYOUT
/begin RECORD_LAYOUT KwbUb FNC_VALUES 1 UBYTE COLUMN_DIR DIRECT /end RECORD_LAYOUT
/begin RECORD_LAYOUT KwbUw FNC_VALUES 1 UWORD COLUMN_DIR DIRECT /end RECORD_LAYOUT
/begin RECORD_LAYOUT KwbWU16 FNC_VALUES 1 UWORD COLUMN_DIR DIRECT /end RECORD_LAYOUT
/begin RECORD_LAYOUT KwbWU8 FNC_VALUES 1 UBYTE COLUMN_DIR DIRECT /end RECORD_LAYOUT
/begin RECORD_LAYOUT KwSb FNC_VALUES 1 SBYTE COLUMN_DIR DIRECT /end RECORD_LAYOUT
/begin RECORD_LAYOUT KwSw FNC_VALUES 1 SWORD COLUMN_DIR DIRECT /end RECORD_LAYOUT
/begin RECORD_LAYOUT KwUb FNC_VALUES 1 UBYTE COLUMN_DIR DIRECT /end RECORD_LAYOUT
/begin RECORD_LAYOUT KwUw FNC_VALUES 1 UWORD COLUMN_DIR DIRECT /end RECORD_LAYOUT
/begin RECORD_LAYOUT KwWU16 FNC_VALUES 1 UWORD COLUMN_DIR DIRECT /end RECORD_LAYOUT
/begin RECORD_LAYOUT KwWU8 FNC_VALUES 1 UBYTE COLUMN_DIR DIRECT /end RECORD_LAYOUT
/end MODULE
/end PROJECT
